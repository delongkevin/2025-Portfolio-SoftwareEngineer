/* !Encoding: 65001  */
includes
{
  #include "__VariablesLib.cin"
  #include "__CaplGeneratorLib.cin"
  #include "__CANoeReportFuntionsLib.cin"
}

variables
{
  // Global variables defined within this CAPL file
}

testcase Ttm494djn_ImageCaptureCompare()
{
  stack long __tableHandle;
  SetBreakOnFail(0);

  TestCommandBegin(__eCAPLInline, __cCAPLInline, "Start Image Capture Compare Script", "0");
  {
    __cim494djnCaplInline0();
  }
  TestCommandEnd();

}

void __cim494djnCaplInline0()
{
  stack long __tableHandle;
  {
    testWaitForSyscall("python cli_camera_tester.pyw",0,5000);
testStepPass();

  }
}

void Ttm494djn_Tet_TtInit()
{
  stack long __tableHandle;
}

void Ttm494djn_Tet_CaplTcCall0()
{
  stack long __tableHandle;
  CreateCaplIFFunction("Sleep_Wakeup_New", __eTcDef);
  AddIFParameterTestCaseAttribute("TC_ID", "");
  AddIFParameterTestCaseAttribute("Test Case ID", "");
  CallInterfaceFunction(__cEmpty , "", __cEmpty );
}

void Ttm494djn_Tet_CaplTcCall1()
{
  stack long __tableHandle;
  CreateCaplIFFunction("Hard_Reset_Test", __eTcDef);
  AddIFParameterTestCaseAttribute("TC_ID", "");
  AddIFParameterTestCaseAttribute("Test Case ID", "");
  AddIFParameterLong(1);
  CallInterfaceFunction(__cEmpty , "", __cEmpty );
}

void Ttm494djn_Tet_Tc0()
{
  CreateTTEIFFunction("Ttm494djn_Tc0", __eTcDef, __eLocal);  
  AddIFParameterTestCaseAttribute("TC_ID", "");
  AddIFParameterTestCaseAttribute("Test Case ID", "");
  CallInterfaceFunction("HMI View switching", __cEmpty , __cEmpty );
}
testcase Ttm494djn_Tc0()
{
  stack long __tableHandle;
int64 __tt1LoopVar0;

  SetBreakOnFail(0);

  {
    __type_of(1) __tcLocVar0;
    __type_of(15) __tcLocVar1;
    __type_of(1) __tcLocVar2;
  
    __tcLocVar0 = 1;
    __tcLocVar1 = 15;
    __tcLocVar2 = 1;
  
    snprintf(__cArray, 8192, "%s", "1");
    snprintf(__cArray2, 8192, "%s", "15");
    snprintf(__cArray3, 8192, "%s", "1");
  
    snprintf(__cArray4, 8192, "For (For i=%s..%s, increment=%s)", __cArray, __cArray2, __cArray3);
    TestControlStructBegin(__cFor, __cArray4, "0");  
    for(__tt1LoopVar0 = __tcLocVar0; (__tcLocVar2 < 0) ? (CheckSignalMatch(__tt1LoopVar0, __tcLocVar1, ">=" ) == 1) : (CheckSignalMatch(__tt1LoopVar0, __tcLocVar1, "<=") == 1); __tt1LoopVar0 += __tcLocVar2)
    {
      if(__LoopIsBlocking())  
        break;
  
      snprintf(__cArray, 8192, "%s", "1");
      snprintf(__cArray2, 8192, "%s", "15");
      snprintf(__cArray3, 8192, "%s", "1");
      snprintf(__cArray4, 8192, "For (For i=%s..%s, increment=%s; current i = %lld)", __cArray, __cArray2, __cArray3, __tt1LoopVar0);
      TestControlStructBegin(__cForIteration, __cArray4, "0");
      TestCommandBegin(__eSet, __cSet, "", "1");
      {
        __tableHandle = ReportTableHead3Columns(__cSetCaption , __cTSym, __cTOp, __cAssigned); 
        {
          $`FDCAN2::dbNode::`SGW::`TELEMATIC_FD_14::`TGW_CAMERA_DISP_STAT.phys = 4;
          snprintf(__cArray, 8192, "%s", "TGW_CAMERA_DISP_STAT");
          snprintf(__cArray2, 8192, "%s '%s'", __cCANSignal, __cArray);
          snprintf(__cArray3, 8192, "%s", "");
          
          ReportSetLValueOrSignalNotOnline(getSignalTime(`FDCAN2::dbNode::`SGW::`TELEMATIC_FD_14::`TGW_CAMERA_DISP_STAT), __cArray2, __cArray4, 8192);
          ReportTableRow(__tableHandle, 0, __cArray4, __cAOp, 4, __cArray3, __oneOfFlag, __bSetInCheckAlignment);
          
      
        }
        ReportTableEndTestStep(__tableHandle, "1");
      }
      TestCommandEnd();


      TestCommandBegin(__eSet, __cSet, "", "2");
      {
        __tableHandle = ReportTableHead3Columns(__cSetCaption , __cTSym, __cTOp, __cAssigned); 
        {
          $`FDCAN2::dbNode::`SGW::`TELEMATIC_FD_5::`CameraDisplaySts2.phys = __tt1LoopVar0;
          snprintf(__cArray, 8192, "%s", "CameraDisplaySts2");
          snprintf(__cArray2, 8192, "%s '%s'", __cCANSignal, __cArray);
          snprintf(__cArray3, 8192, "%s", "i");
          
          ReportSetLValueOrSignalNotOnline(getSignalTime(`FDCAN2::dbNode::`SGW::`TELEMATIC_FD_5::`CameraDisplaySts2), __cArray2, __cArray4, 8192);
          ReportTableRow(__tableHandle, 0, __cArray4, __cAOp, __tt1LoopVar0, __cArray3, __oneOfFlag, __bSetInCheckAlignment);
          
      
        }
        ReportTableEndTestStep(__tableHandle, "1");
      }
      TestCommandEnd();


      TestCommandBegin(__eWait, __cWait, "", "3");
      {
        Wait("1", (700 * 1000000LL), 1000000, "");
      }
      TestCommandEnd();

      {
        CreateCaplIFFunction("Capture_Image", __eFct);
        AddIFParameterChar("HMI_View_Switching");
        AddIFParameterChar("1200x900");
        CallInterfaceFunction(__cEmpty, __cEmpty, "4");
      }


      TestCommandBegin(__eCheck, __cCheck, "", "5");
      {
        __bVerdict = __eVerdictPass;
        __tableHandle = ReportTableHead5Columns(__cCheckCaption, __cTSym, __cTOp, __cRefVal, __cActual, __cRes);
        {
          __csr = CheckSignalMatch(`FDCAN2::dbNode::`CVADAS::`CVPAM_FD_Info::`DisplayView2, 0, "!=") == 1;
          snprintf(__cArray, 8192, "%s", "DisplayView2");
          snprintf(__cArray2, 8192, "%s '%s'", __cCANSignal, __cArray);
          snprintf(__cArray3, 8192, "%s", "");
          ReportTableRow(__tableHandle, 0, __cArray2, "!=", 0, __cArray3, __oneOfFlag, __bSetInCheckAlignment);
          ReportLValueOrSignalNotOnline(`FDCAN2::dbNode::`CVADAS::`CVPAM_FD_Info::`DisplayView2, __cArray5, 8192);
          ReportCell(__tableHandle, __cArray5);
          ReportCellResult(__tableHandle, __csr, __ePassFail);
      
          __bVerdict = __bVerdict && __csr;
        }
        ReportTableEndVerdict(__tableHandle, "1", __bVerdict);
      }
      TestCommandEnd();


      TestControlStructEnd(__eUndefined);
    }
    TestControlStructEnd(__eUndefined);
  }

}

void Ttm494djn_Tet_CaplTcCall2()
{
  stack long __tableHandle;
  CreateCaplIFFunction("Power_Cycle_CAN", __eTcDef);
  AddIFParameterTestCaseAttribute("TC_ID", "");
  AddIFParameterTestCaseAttribute("Test Case ID", "");
  AddIFParameterLong(1);
  CallInterfaceFunction(__cEmpty , "", __cEmpty );
}

