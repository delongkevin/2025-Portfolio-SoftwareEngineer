/*@!Encoding:1252*/
includes
{

}

variables
{
int checkId,i;
}

export RX_Messages_Cycletimecheck()
{
  Cycletimecheck_ADAS_FD_LANES_1_FDCAN2();
  Cycletimecheck_ADAS_FD_LANES_2_FDCAN2();
  
  //Cycletimecheck_CFG_DATA_CODE_RSP_PAM();
 // Cycletimecheck_CVPAM_FD_Control_CAN2();
  Cycletimecheck_CVPAM_FD_Info_CAN2();
 // Cycletimecheck_DIAGNOSTIC_RESPONSE_FD_PAM();
  //Cycletimecheck_DIAGNOSTIC_RESPONSE_PAM();
 // Cycletimecheck_DIAGNOSTIC_ROE_FD_PAM();
 // Cycletimecheck_DIAGNOSTIC_ROE_PAM();
 // Cycletimecheck_NM_PAM();
  Cycletimecheck_PDC_INFO_FD_PAM();
  Cycletimecheck_TRSCM_FD_1_CAN2();
  Cycletimecheck_ADAS_FD_LANES_1_CAN14();
  Cycletimecheck_ADAS_FD_LANES_2_CAN14();
  Cycletimecheck_CVPAM_FD_Control_CAN14();
  Cycletimecheck_CVPAM_FD_Info_CAN14();
  Cycletimecheck_TRSCM_FD_1_CAN14();
}

void Cycletimecheck_ADAS_FD_LANES_1_FDCAN2()
{
    checkId = ChkStart_MsgAbsCycleTimeViolation(FDCAN2::ADAS_FD_LANES_1,35,45);
    TestAddCondition(checkId);
    TestWaitForTimeout(1000);
    TestRemoveCondition(checkId); 
}

void Cycletimecheck_ADAS_FD_LANES_2_FDCAN2()
{
    checkId = ChkStart_MsgAbsCycleTimeViolation (FDCAN2::ADAS_FD_LANES_2,35,45);
    TestAddCondition(checkId);
    TestWaitForTimeout(1000);
    TestRemoveCondition(checkId); 
}

void Cycletimecheck_CVPAM_FD_Control_CAN2()
{
    checkId = ChkStart_MsgAbsCycleTimeViolation (FDCAN2::CVPAM_FD_Control,5,15);
    TestAddCondition(checkId);
    TestWaitForTimeout(1000);
    TestRemoveCondition(checkId); 
}

void Cycletimecheck_CVPAM_FD_Info_CAN2()
{
    checkId = ChkStart_MsgAbsCycleTimeViolation (FDCAN2::CVPAM_FD_Info,245,255);
    TestAddCondition(checkId);
    TestWaitForTimeout(1000);
    TestRemoveCondition(checkId); 
}

void Cycletimecheck_PDC_INFO_FD_PAM()
{
    checkId = ChkStart_MsgAbsCycleTimeViolation (PDC_INFO_FD_PAM,995,1005);
    TestAddCondition(checkId);
    TestWaitForTimeout(2000);
    TestRemoveCondition(checkId); 
}

void Cycletimecheck_TRSCM_FD_1_CAN2()
{
    checkId = ChkStart_MsgAbsCycleTimeViolation (FDCAN2::TRSCM_FD_1,995,1005);
    TestAddCondition(checkId);
    TestWaitForTimeout(2000);
    TestRemoveCondition(checkId); 
}

//////////////////////////////////////////////////////////////////////////////////////////////////////////////////
void Cycletimecheck_ADAS_FD_LANES_1_CAN14()
{
    checkId = ChkStart_MsgAbsCycleTimeViolation (FDCAN14::ADAS_FD_LANES_1,35,45);
    TestAddCondition(checkId);
    TestWaitForTimeout(1000);
    TestRemoveCondition(checkId); 
}

void Cycletimecheck_ADAS_FD_LANES_2_CAN14()
{
    checkId = ChkStart_MsgAbsCycleTimeViolation (FDCAN14::ADAS_FD_LANES_2,35,45);
    TestAddCondition(checkId);
    TestWaitForTimeout(1000);
    TestRemoveCondition(checkId); 
}

void Cycletimecheck_CVPAM_FD_Control_CAN14()
{
    checkId = ChkStart_MsgAbsCycleTimeViolation (FDCAN14::CVPAM_FD_Control,5,15);
    TestAddCondition(checkId);
    TestWaitForTimeout(1000);
    TestRemoveCondition(checkId); 
}

void Cycletimecheck_CVPAM_FD_Info_CAN14()
{
    checkId = ChkStart_MsgAbsCycleTimeViolation (FDCAN14::CVPAM_FD_Info,245,255);
    TestAddCondition(checkId);
    TestWaitForTimeout(1000);
    TestRemoveCondition(checkId); 
}

void Cycletimecheck_TRSCM_FD_1_CAN14()
{
    checkId = ChkStart_MsgAbsCycleTimeViolation (FDCAN14::TRSCM_FD_1,995,1005);
    TestAddCondition(checkId);
    TestWaitForTimeout(2000);
    TestRemoveCondition(checkId); 
}
