/*@!Encoding:1252*/
includes
{

}

variables
{
char pythonFolder[500] = "C:\\JS\\CT_Server_Standard_files_Continous_Testing\\HMI_Python";
    //"C:\\Users\\Tester\\Documents\\Azhar\\DT\\HMI_Python";
  char viewName[16][30] = {"Default", "FVTV_RVTV", "BackupRearView", "FFCV", "Idle", "TRG", "TrailerLeftTowView", "TrailerRightTowView", "BlindSpotLeftView", "BlindSpotRightView", "Idle", "FVTV", "RVTV", "FrontCrossPathView", "RearCrossPathView", "Idle"};
  char ecuName[100] = "CVADAS_0001_00000000_000";
  char gearName[6][2] = {"", "P", "R", "N", "D", "L"};
  mstimer t;
  long timeOut = 1;
  long canChannel = 0;
  float timeStart;
  float spentTime;
  float TTFFDCAN2 = 0;
  float TTFFDCAN14 = 0;
  float timeSinceLastFDCAN2;
  float timeSinceLastFDCAN14;
  float lastCANSleep;
  float timeForFDCAN2Wake = 1;
  float timeForFDCAN14Wake = 1;
  long reverseOnWake = 0;
}

on message Can1.* 
{
  if(this.dir == rx)
  {
    timeSinceLastFDCAN2 = timeNowFloat() / 100;
    if(timeForFDCAN2Wake == 0)timeForFDCAN2Wake = (timeNowFloat() / 100 - lastCANSleep) / 1000.0;
  }
}

on message Can2.* 
{
  if(this.dir == rx)
  {
    timeSinceLastFDCAN14 = timeNowFloat() / 100;
    if(timeForFDCAN14Wake == 0) timeForFDCAN14Wake = (timeNowFloat() / 100 - lastCANSleep) / 1000.0;
    if(reverseOnWake == 1 && timeForFDCAN2Wake != 0)
    {
      Switch_Gear_With_String("R");
      reverseOnWake = 0;
    }
  }
}

on timer t
{
  testStep("", " $FDCAN2::CVADAS::CVPAM_FD_Info::DisplayView2 = %d",  $FDCAN2::CVADAS::CVPAM_FD_Info::DisplayView2);
}

export void General_Precondition()
{
  char batchFileName [100] = "Other_Scripts\\Teraterm\\Start_All.bat";
  long response;
  
  //Run_Init_Port();
  
  //Power_Supply_On();
  
  testStep("", "Wait for 7000 ms");
  testWaitForTimeout(7000);
  
//  testStep("", "Set view to default");
//  $CameraDisplaySts2 = 0;
//  
//  testStep("", "Start UART logging");
//  response = testWaitForSyscall(pythonFolder, batchFileName, 0, 60000);
//  
//  if(response != 1) testStepFail("", "Failed to start UART logging, error code: %d", response);
}

export void General_Postcondition()
{
  char batchFileName [100] = "Other_Scripts\\Teraterm\\Kill_All.bat";
  long response;
  
  testStep("", "Stop UART logging");
  response = testWaitForSyscall(pythonFolder, batchFileName, 0, 60000);
  
  testStep("", "Set view to default");
  $CameraDisplaySts2 = 0;
  
  if(response != 1) testStepFail("", "Failed to stop UART logging, error code: %d", response);
}

export Power_Supply_SET(double volt)
{
  char voltInString[3] = "";
  char fullMessage[10] = "";
  int voltInInt;
  int temp;
  int i = 0;

  volt *= 10;
  voltInInt = volt;
  
  for(i = 2; i >= 0; i--)
  {
    temp = voltInInt % 10;
    voltInString[i] = temp + '0';
    voltInInt /= 10;
  
  }
  
  strncpy(fullMessage, "VOLT", 5);
  strncat(fullMessage, voltInString, 8);
  strncat(fullMessage, "\r", 10);
  //PowerSupply_Control(fullMessage);
}

export void Power_Cycle(long waitTime)
{
  Power_Supply_OFF();
  
  testStep("","Wait for %dms", waitTime);
  testWaitForTimeout(waitTime);
  
  Power_Supply_ON();
  
  testStep("","Wait for %dms", waitTime);
  testWaitForTimeout(waitTime);
  
}

export void Power_Cycle_Immediate_Return(long waitTime)
{
  Power_Supply_OFF();
  testStep("","Wait for %dms", waitTime);
  testWaitForTimeout(waitTime);
  Power_Supply_ON();
  
}

double Get_Comparison_Score(char image1[], char image2[], char resolution[])
{
  long response;
  char batchFileNameWithASpace [50] = "Image_Comparison.bat ";
  char fullCommand [256] = "";
  
  strncpy(fullCommand, batchFileNameWithASpace, 256);
  strncat(fullCommand, resolution, 256); 
  strncat(fullCommand, " compareTwoImages ", 256); 
  strncat(fullCommand, image1, 256);
  strncat(fullCommand, " ", 256);
  strncat(fullCommand, image2, 256);
  
  write("start comparing %s and %s", image1, image2);
  testStep("", "start comparing %s and %s", image1, image2);
  response = testWaitForSyscall(pythonFolder, fullCommand, 0, 60000);
  
  if(response == 1)
  {
    char buffer[64];
    double score = 0;
    dword glbHandle = 0;
    
    setFilePath (pythonFolder, 0);
    glbHandle = OpenFileRead ("score.txt", 0);

    if ( glbHandle!=0 )
    {
      fileGetStringSZ(buffer,elcount(buffer),glbHandle);
      score = atodbl (buffer);
      fileClose (glbHandle);
      write ("score: %f", score);
      testStep("", "score: %f", score);
      return score;
    }
    else
    {
      write ("File 'score.txt' was not opened for read access.");
      testStepFail("File 'score.txt' was not opened for read access.");
    }
  }
  else
  {
    write ("failed to finish image comparison, exit code: %d", response);
    testStepFail(" ", "failed to finish image comparison, exit code: %d", response);
  }
  return -1;
}

long View_Name_To_Number(char viewName[])
{
  if(strncmp(viewName, "Default", strlen("Default")) == 0) return 0;
  else if(strncmp(viewName, "FVTV_RVTV", strlen("FVTV_RVTV")) == 0) return 1;
  else if(strncmp(viewName, "BackupRearView", strlen("BackupRearView")) == 0) return 2;
  else if(strncmp(viewName, "FFCV", strlen("FFCV")) == 0) return 3;
  else if(strncmp(viewName, "TRG", strlen("TRG")) == 0) return 5;
  else if(strncmp(viewName, "TrailerLeftTowView", strlen("TrailerLeftTowView")) == 0) return 6;
  else if(strncmp(viewName, "TrailerRightTowView", strlen("TrailerRightTowView")) == 0) return 7;
  else if(strncmp(viewName, "BlindSpotLeftView", strlen("BlindSpotLeftView")) == 0) return 8;
  else if(strncmp(viewName, "BlindSpotRightView", strlen("BlindSpotRightView")) == 0) return 9;
  else if(strncmp(viewName, "FVTV", strlen("FVTV")) == 0) return 11;
  else if(strncmp(viewName, "RVTV", strlen("RVTV")) == 0) return 12;
  else if(strncmp(viewName, "FrontCrossPathView", strlen("FrontCrossPathView")) == 0) return 13;
  else if(strncmp(viewName, "RearCrossPathView", strlen("RearCrossPathView")) == 0) return 14;
  testStepFail("", "wrong view name");
  return -1;
}

export void HMI_test(char gear[], long masterViewNumber, char resolution[])
{
  char masterViewNumberInString [5];
  char masterImageName [30];
  
  ltoa(masterViewNumber, masterViewNumberInString, 10);
  strncpy(masterImageName, resolution, 10);
  strncat(masterImageName, "_", 15);
  strncat(masterImageName, gear, 20);
  strncat(masterImageName, masterViewNumberInString, 30);
  
  Capture_And_Compare(masterImageName, masterViewNumberInString, resolution);
  
}

export void Capture_And_Compare(char masterImageName[], char viewNumber[], char resolution[])
{
  long response, retries;
  char batchFileNameWithASpace [50] = "Image_Comparison.bat ";
  char fullCommand [256] = "";
  
  retries = 0;
  
  strncpy(fullCommand, batchFileNameWithASpace, 256);
  strncat(fullCommand, resolution, 256); 
  strncat(fullCommand, " captureAndCompare ", 256); 
  strncat(fullCommand, masterImageName, 256);
  strncat(fullCommand, " ", 256);
  strncat(fullCommand, viewNumber, 256);
  
  do
  {
    testStep("", "start running image comparison with %s, retries: %d", masterImageName, retries);
    response = testWaitForSyscall(pythonFolder, fullCommand, 0, 60000);
    retries ++;
  }while(response != 1 && retries < 3);
  
  if(response == 1)
  {
    char buffer[64];
    char takenImagePath[500];
    char masterImagePath[500];
    double score = 0;
    dword glbHandle = 0;
    dword glbHandle2 = 0;
    
    setFilePath (pythonFolder, 0);
    glbHandle = OpenFileRead ("score.txt", 0);

    if ( glbHandle!=0 )
    {
      fileGetStringSZ(buffer,elcount(buffer),glbHandle);
      score = atodbl (buffer);
      
      write ("score: %f", score);
      if (score >= 0.8 )  { testStepPass(" ", "Passed image comparison with %s, score: %f", masterImageName, score); } 
      else { testStepFail(" ", "Failed image comparison with %s, score: %f", masterImageName, score); }
      
      glbHandle2 = OpenFileRead ("takenImageName.txt", 0);
      
      if ( glbHandle2!=0 )
      {
        fileGetStringSZ(buffer,elcount(buffer),glbHandle2);
        strncpy(takenImagePath, pythonFolder, 500);
        strncat(takenImagePath, buffer, 500);
        strncpy(masterImagePath, pythonFolder, 500); 
        strncat(masterImagePath, "images/", 500);
        strncat(masterImagePath, masterImageName, 500);
        strncat(masterImagePath, ".png", 500);
        testReportAddImage("image taken", takenImagePath);
        testReportAddImage("master image", masterImagePath);
        
      }
      else
      {
        write ("File 'takenImageName.txt' was not opened for read access.");
        testStepFail("File 'takenImageName.txt' was not opened for read access.");
      }
      
    }
    else
    {
      write ("File 'score.txt' was not opened for read access.");
      testStepFail("File 'score.txt' was not opened for read access.");
    }
    
    fileClose (glbHandle);
    fileClose (glbHandle2);
  }
  else
  {
    write ("failed to finish image comparison, exit code: %d", response);
    testStepFail(" ", "failed to finish image comparison, exit code: %d", response);
  }
  
}

export void Capture_And_Compare_With_RGB(char masterImageName[], char resolution[])
{
  long response, retries;
  char batchFileNameWithASpace [50] = "Image_Comparison.bat ";
  char fullCommand [256] = "";
  
  retries = 0;
  
  strncpy(fullCommand, batchFileNameWithASpace, 256);
  strncat(fullCommand, resolution, 256);
  strncat(fullCommand, " captureAndCompareWithRGB ", 256); 
  strncat(fullCommand, masterImageName, 256);
  
  do
  {
    testStep("", "start running RGB image comparison with %s, retries: %d", masterImageName, retries);
    response = testWaitForSyscall(pythonFolder, fullCommand, 0, 60000);
    retries ++;
  }while(response != 1 && retries < 3);
  
  if(response == 1)
  {
    char buffer[64];
    char takenImagePath[500];
    char masterImagePath[500];
    char diffImagePath[500];
    double RGBDifference = 0;
    dword glbHandle = 0;
    dword glbHandle2 = 0;
    dword glbHandle3 = 0;
    
    setFilePath (pythonFolder, 0);
    glbHandle = OpenFileRead ("RGBDifference.txt", 0);

    if ( glbHandle!=0 )
    {
      fileGetStringSZ(buffer,elcount(buffer),glbHandle);
      RGBDifference = atodbl (buffer);
      
      write ("RGBDifference: %f", RGBDifference);
      if (RGBDifference <= 200 )  { testStepPass(" ", "Passed image comparison with %s, max RGB Difference: %.2f", masterImageName, RGBDifference); } 
      else { testStepFail(" ", "Failed image comparison with %s, max RGB Difference: %.2f", masterImageName, RGBDifference); }
      
      glbHandle2 = OpenFileRead ("takenImageName.txt", 0);
      
      if ( glbHandle2!=0 )
      {
        fileGetStringSZ(buffer,elcount(buffer),glbHandle2);
        strncpy(takenImagePath, pythonFolder, 500);
        strncat(takenImagePath, buffer, 500);
        strncpy(masterImagePath, pythonFolder, 500); 
        strncat(masterImagePath, "images/", 500);
        strncat(masterImagePath, masterImageName, 500);
        strncat(masterImagePath, ".png", 500);
        testReportAddImage("image taken", takenImagePath);
        testReportAddImage("master image", masterImagePath);
        
        glbHandle3 = OpenFileRead ("RGBDiffImageName.txt", 0);
        
        if ( glbHandle3!=0 )
        {
          fileGetStringSZ(buffer,elcount(buffer),glbHandle3);
          strncpy(diffImagePath, pythonFolder, 500);
          strncat(diffImagePath, buffer, 500);
          testReportAddImage("Image difference", diffImagePath);
        }
        else
        {
          write ("File 'RGBDiffImageName.txt' was not opened for read access.");
          testStepFail("File 'RGBDiffImageName.txt' was not opened for read access.");
        }
      }
      else
      {
        write ("File 'takenImageName.txt' was not opened for read access.");
        testStepFail("File 'takenImageName.txt' was not opened for read access.");
      }
      
    }
    else
    {
      write ("File 'RGBDifference.txt' was not opened for read access.");
      testStepFail("File 'RGBDifference.txt' was not opened for read access.");
    }
    
    fileClose (glbHandle);
    fileClose (glbHandle2);
    fileClose (glbHandle3);
  }
  else
  {
    write ("failed to finish RGB image comparison, exit code: %d", response);
    testStepFail(" ", "failed to finish RGB image comparison, exit code: %d", response);
  }
  
}

export void Capture_Image(char imageName[], char resolution[])
{
  long response, retries;
  char batchFileNameWithASpace[50] = "Image_Comparison.bat ";
  char fullCommand[256];
  
  response = 0;
  retries = 0;
  
  strncpy(fullCommand, batchFileNameWithASpace, 256); 
  strncat(fullCommand, resolution, 256);
  strncat(fullCommand, " captureOnly ", 256);
  strncat(fullCommand, imageName, 256);
  
  while(response != 1 && retries < 3)
  {
    testStep("", "start running image capture, retries: %d", retries);
    response = testWaitForSyscall(pythonFolder, fullCommand, 0, 60000);
    retries ++;
  }
  
  if(response == 1)
  {
    char takenImagePath[500];
    strncpy(takenImagePath, pythonFolder, 500);
    strncat(takenImagePath, "images/", 500);
    strncat(takenImagePath, imageName, 500);
    strncat(takenImagePath, ".png", 500);
    
    testStep("", "image name: %s", imageName);
    testReportAddImage("image taken", takenImagePath);
  }
  else
  {
    write ("failed to finish image capture, exit code: %d", response);
    testStepFail(" ", "failed to finish image capture, exit code: %d", response);
  }
}

export void Display_Switch_Test(char fromGear[], char toGear[], long fromView, long toView, char resolution[])
{
  long response;
  char batchFileNameWithASpace [50] = "Image_Comparison.bat ";
  char fullCommand [256] = "";
  char viewInString [10] = "";
  
  ltoa(toView, viewInString, 10);
  strncpy(fullCommand, batchFileNameWithASpace, 256); 
  strncat(fullCommand, resolution, 256);
  strncat(fullCommand, " checkWhenSwitch ", 256); 
  strncat(fullCommand, toGear, 256);
  strncat(fullCommand, viewInString, 256);
  strncat(fullCommand, " ", 256);
  strncat(fullCommand, viewInString, 256);
  
  testStep("", "start display switch check");
  
  response = testWaitForSyscall(pythonFolder, fullCommand, 0, 300000);
    
  if(response == 1)
  {
    char buffer[64];
    char bufferA[64];
    char bufferB[64];
    char beforeImagePath[500];
    char afterImagePath[500];
    double switchTime = 0;
    dword glbHandle = 0;
    dword glbHandleA = 0;
    dword glbHandleB = 0;
    
    setFilePath (pythonFolder, 0);
    glbHandle = OpenFileRead ("switchTime.txt", 0);

    if ( glbHandle!=0 )
    {
      fileGetStringSZ(buffer,elcount(buffer),glbHandle);
      switchTime = atodbl (buffer);
      fileClose (glbHandle);
      write ("switch time: %f", switchTime);
      if (switchTime < 0) 
      {
        switchTime *= -1;
        testStepFail(" ", "Failed to maintain correct display after switched with gear from %s to %s, view from %s to %s. Time spent: %f", fromGear, toGear, viewName[fromView], viewName[toView], switchTime);
      }
      else if (switchTime <= 2.0 )  { testStepPass(" ", "Passed display switch test with gear from %s to %s, view from %s to %s. Time spent: %f", fromGear, toGear, viewName[fromView], viewName[toView], switchTime); } 
      else { testStepFail(" ", "Failed display switch test time requirement with gear from %s to %s, view from %s to %s. Time spent: %f", fromGear, toGear, viewName[fromView], viewName[toView], switchTime); }
      
      glbHandleB = OpenFileRead ("beforeSwitch.txt", 0);
      glbHandleA = OpenFileRead ("afterSwitch.txt", 0);
      
      if ( glbHandleA != 0 && glbHandleB != 0)
      {
        fileGetStringSZ(bufferB,elcount(buffer),glbHandleB);
        fileGetStringSZ(bufferA,elcount(buffer),glbHandleA);
        fileClose(glbHandleA);
        fileClose(glbHandleB);
        strncpy(beforeImagePath, pythonFolder, 500);
        strncat(beforeImagePath, bufferB, 500);
        strncpy(afterImagePath, pythonFolder, 500);
        strncat(afterImagePath, bufferA, 500);
       
        
        testReportAddImage("before", beforeImagePath);
        testReportAddImage("after", afterImagePath);
        
      }
      else
      {
        write ("File 'beforeSwitch.txt' or 'afterSwitch.txt' was not opened for read access.");
        testStepFail("File 'beforeSwitch.txt' or 'afterSwitch.txt' was not opened for read access.");
      }
      
    }
    else
    {
      write ("File 'switchTime.txt' was not opened for read access.");
      testStepFail("File 'switchTime.txt' was not opened for read access.");
    }
  }
  else
  {
    write ("failed to finish view switch test, exit code: %d", response);
    testStepFail(" ", "failed to finish view switch test, exit code: %d", response);
  }
}

export void Switch_Gear_With_String(char gear[])
{
  long testPass;
  
  testPass = 0;
  if(strncmp(gear, "P", 10) == 0)
  {
    $ShiftLeverPosition = 1;
    if($ShiftLeverPosition == 1) testPass = 1;
  }
  else if(strncmp(gear, "R", 10) == 0)
  {
    $ShiftLeverPosition = 2;
    if($ShiftLeverPosition == 2) testPass = 1;
  }
  else if(strncmp(gear, "N", 10) == 0)
  {
    $ShiftLeverPosition = 3;
    if($ShiftLeverPosition == 3) testPass = 1;
  }
  else if(strncmp(gear, "D", 10) == 0)
  {
    $ShiftLeverPosition = 4;
    if($ShiftLeverPosition == 4) testPass = 1;
  }
  else if(strncmp(gear, "L", 10) == 0)
  {
    $ShiftLeverPosition = 5;
    if($ShiftLeverPosition == 5) testPass = 1;
  }
  testStepPass("","Set $ShiftLeverPosition = %s", gear);
  //if(testPass == 1) testStepPass("","Set $ShiftLeverPosition = %s", gear);
  //else testStepFail("", "Fail to set $ShiftLeverPosition to %s, current gear: %d", gear, $ShiftLeverPosition);
}

export void View_Switch(char gear[], long from, long to)
{
  Switch_Gear_With_String(gear);
  
  testStep("","Wait for 2000ms");
  testWaitForTimeout(2000);
  
  testStep("","Set $CameraDisplaySts2 = %d", from);
  $CameraDisplaySts2 = from;
  
  testStep("","Wait for 2000ms");
  testWaitForTimeout(2000);
  
  testStep("","Set $CameraDisplaySts2 = %d", to);
  $CameraDisplaySts2 = to;
  
  testStep("","Wait for 2000ms");
  testWaitForTimeout(2000);
  
  testStep("", "DisplayView2 = %f", getSignal(DisplayView2));
  
}

export testcase View_Switch_HMI_Test(char gear[], char view[], char resolution[])
{
  long i = 0;
  long viewNumber;
  
  General_Precondition();
  
  testStep("","Set $CameraDisplaySts2 = 2");
  $CameraDisplaySts2 = 2;
  viewNumber = View_Name_To_Number(view);
  for (i = 1; i <= 14; i++)
  {
    if(i == 4 || i == 10 || i == viewNumber || (viewNumber >= 11 && i == 1))
    {
      continue;
    }
    View_Switch(gear, viewNumber, i);
    HMI_test(gear, i, resolution);
  }
  
  General_Postcondition();
}

export testcase Gear_Switch_Test()
{
  char timeStampInString[10];
  General_Precondition();
  
  testStep("", "Set view to default");
  $CameraDisplaySts2 = 0;
  
  Switch_Gear_With_String("P");
  
  testStep("", "Wait 2 seconds");
  testWaitForTimeout(2000);
  
  Switch_Gear_With_String("R");
  
  testStep("", "Wait 2 seconds");
  testWaitForTimeout(2000);
  
  ltoa((long)(timeNowFloat()/100000.0), timeStampInString, 10);
  Capture_Image(timeStampInString, "1200x900");
  
  testStep("", "Set view to default");
  $CameraDisplaySts2 = 0;
  
  Switch_Gear_With_String("D");
  
  testStep("", "Wait 2 seconds");
  testWaitForTimeout(2000);
  
  ltoa((long)(timeNowFloat()/100000.0), timeStampInString, 10);
  Capture_Image(timeStampInString, "1200x900");

  General_Postcondition();
}

export testcase CmdIgnSts_HMI_Test()
{
  long response;
  char imageName [50];
  
  General_Precondition();
  
  testStep("", "Set CmdIgnSts to lock");
  $CmdIgnSts = 0;
  
  testStep("","Wait for 2000ms");
  testWaitForTimeout(2000);
  
  strncpy(imageName, "CmdIgnSts_Lock", 50);
  Capture_Image(imageName, "1200x900");
  
  response = Check_If_Black_Screen(imageName, "1200x900");
  
  if(response == 1) testStepPass("");
  
  General_Postcondition();
}

export int Check_If_Black_Screen(char imageName[], char resolution[])
{
  
  long response;
  char batchFileNameWithASpace [50] = "Image_Comparison.bat ";
  char fullCommand [256] = "";
 
  
  strncpy(fullCommand, batchFileNameWithASpace, 256); 
  strncat(fullCommand, resolution, 256); 
  strncat(fullCommand, " compareTwoImages ", 256);
  strncat(fullCommand, resolution, 256);
  strncat(fullCommand, "_BlackScreen_A", 256);
  strncat(fullCommand, " ", 256); 
  strncat(fullCommand, imageName, 256); 

  testStep("", "start running image comparison with Black Screen A");
  response = testWaitForSyscall(pythonFolder, fullCommand, 0, 60000);
  
  if(response == 1)
  {
    char buffer[64];
    double score = 0;
    dword glbHandle = 0;

    setFilePath (pythonFolder, 0);
    glbHandle = OpenFileRead ("score.txt", 0);

    if ( glbHandle!=0 )
    {
      fileGetStringSZ(buffer,elcount(buffer),glbHandle);
      score = atodbl (buffer);
      fileClose (glbHandle);
      write ("score: %f", score);
      if (score >= 0.8 )  
      { 
        testStep(" ", "Detect black screen A, score: %f", score);
        return 1;
      } 
      else 
      {
        strncpy(fullCommand, batchFileNameWithASpace, 256); 
        strncat(fullCommand, resolution, 256); 
        strncat(fullCommand, " compareTwoImages ", 256);
        strncat(fullCommand, resolution, 256);
        strncat(fullCommand, "_BlackScreen_B", 256);
        strncat(fullCommand, " ", 256); 
        strncat(fullCommand, imageName, 256); 

        testStep("", "start running image comparison with Black Screen B");
        response = testWaitForSyscall(pythonFolder, fullCommand, 0, 60000);
        
        if(response == 1)
        {
          char bufferB[64];
          double scoreB = 0;
          dword glbHandleB = 0;
          
          setFilePath (pythonFolder, 0);
          glbHandleB = OpenFileRead ("score.txt", 0);

          if ( glbHandleB!=0 )
          {
            fileGetStringSZ(bufferB,elcount(bufferB),glbHandleB);
            scoreB = atodbl (bufferB);
            fileClose (glbHandleB);
            write ("score: %f", scoreB);
            if (scoreB >= 0.8 )  
            { 
              testStep(" ", "Detect black screen B, score: %f", scoreB); 
              return 1;
            } 
            else 
            {
              testStep(" ", "Camera view is working, scores: %f, %f", score, scoreB);
              return 0;
            }
          }
          else
          {
            write ("File 'score.txt' was not opened for read access.");
            testStepFail("File 'score.txt' was not opened for read access.");
          }
        }
        else
        {
          write ("failed to finish image comparison, exit code: %d", response);
          testStepFail(" ", "failed to finish image comparison, exit code: %d", response);
        }
      }
    }
    else
    {
      write ("File 'score.txt' was not opened for read access.");
      testStepFail("File 'score.txt' was not opened for read access.");
    }
  }
  else
  {
    write ("failed to finish image comparison, exit code: %d", response);
    testStepFail(" ", "failed to finish image comparison, exit code: %d", response);
  }
  return -1;
}

export testcase Power_Cycle_CAN(long iterations)
{
  long i;
  General_Precondition();
  
  for(i = 0; i < iterations; i++)
  {
    testStep("", "Iteration %d", i);
    Power_Cycle(10000);
  
    if(Check_Both_Can_Messages() == 1)
    {
      testStepPass("", "Got CAN messages from both channels");
    }
  }
  
  General_Postcondition();
}

export testcase Power_Cycle_Test(long iterations)
{
  char imageName[80];
  char defaultImageName[80];
  char timeStampInString[10];
  long i;
  long response;
  
  General_Precondition();
  
  Power_Supply_ON();
  testStep("", "Wait for 7000ms");
  testWaitForTimeout(7000);
  
  Check_Both_Can_Messages();
  
  ltoa((long)(timeNowFloat()/100000.0), timeStampInString, 10);
  strncpy(defaultImageName, "Default_", 80);
  strncat(defaultImageName, timeStampInString, 80);
  
  Capture_Image(defaultImageName, "1200x900");
  
  response = Check_If_Black_Screen(defaultImageName, "1200x900");
  
  if(response == 1) testStepFail("", "Unexpected blackscreen detected!");
  
  for(i = 0; i < iterations; i++)
  {
    testStep("", "Iteration %d", i);
    
    Power_Cycle(10000);
  
    if(Check_Both_Can_Messages() == 1)
    {
       Capture_And_Compare(defaultImageName, "12", "1200x900");
    }
  }
  
  General_Postcondition();
}

export testcase Hard_Reset_CAN(long iterations)
{
  long i;
  General_Precondition();
  
  Power_Supply_ON();
  testStep("", "Wait for 7000ms");
  testWaitForTimeout(7000);
  
  for(i = 0; i < iterations; i++)
  {
    testStep("", "Iteration %d", i);
    
    Hard_Reset();
    
    testStep("", "Wait 11 seconds");
    testWaitForTimeout(11000);
    
  
    if(Check_Both_Can_Messages() == 1)
    {
      testStepPass("", "Got CAN messages from both channels");
    }
  }
  
  General_Postcondition();
}

export testcase Hard_Reset_Test(long iterations)
{
  char imageName[80];
  char defaultImageName[80];
  char timeStampInString[10];
  long i;
  long response;
  
  General_Precondition();
  
  Power_Supply_ON();
  testStep("", "Wait for 7000ms");
  testWaitForTimeout(7000);
  
  Check_Both_Can_Messages();
  
  ltoa((long)(timeNowFloat()/100000.0), timeStampInString, 10);
  strncpy(defaultImageName, "Default_", 80);
  strncat(defaultImageName, timeStampInString, 80);
  
  Capture_Image(defaultImageName, "1200x900");
  
  response = Check_If_Black_Screen(defaultImageName, "1200x900");
  
  if(response == 1) testStepFail("", "Unexpected blackscreen detected!");
  
  for(i = 0; i < iterations; i++)
  {
    testStep("", "Iteration %d", i);
    
    Hard_Reset();
    
    testStep("", "Wait 11 seconds");
    testWaitForTimeout(11000);
  
    if(Check_Both_Can_Messages() == 1)
    {
       Capture_And_Compare(defaultImageName, "12", "1200x900");
    }
  }
  
  General_Postcondition();
}

//On 3-14-2024 test fail was changed to test warning due to voltage testing 
export Check_DTC()
{
  BYTE primitiveRaw[200];
  long retries, response, size, dataStart, i;
  diagRequest CVADAS_0001_00000000_000.FaultMemory_Report_First_Confirmed_DTC reqFirst;
  diagResponse CVADAS_0001_00000000_000.FaultMemory_Report_First_Confirmed_DTC respFirst;
  diagRequest CVADAS_0001_00000000_000.FaultMemory_Report_Most_Recent_Confirmed_DTC reqRecent;
  diagResponse CVADAS_0001_00000000_000.FaultMemory_Report_Most_Recent_Confirmed_DTC respRecent;
    
  char errorMessage[50];
  char errorCode[10];
  char buffer[3];
  char hexString[500];
  
  retries = 0;
  
  while(retries <= 5)
  {
    retries ++;
    response = 0;
    
    reqFirst.SendRequest();
    response = TestWaitForDiagRequestSent(reqFirst, 2000);
    if(response != 1)
    {
      strncpy(errorMessage, "Failed to send diagnostic request, error code: ", 100);
      ltoa(response, errorCode, 10);
      strncat(errorMessage, errorCode, 100);
      write("%s", errorMessage);
      continue;
    }
    
    response = TestWaitForDiagResponse(reqFirst, 2000);
    if(response != 1)
    {
      strncpy(errorMessage, "Failed to receive diagnostic response, error code:  ", 100);
      ltoa(response, errorCode, 10);
      strncat(errorMessage, errorCode, 100);
      write("%s", errorMessage);
      continue;
    }
    
    diagGetLastResponse(respFirst);
    response = diagGetResponseCode(respFirst);
    if(response != -1)
    {
      strncpy(errorMessage, "Diagnostic response error, error code: ", 100);
      ltoa(response, errorCode, 10);
      strncat(errorMessage, errorCode, 100);
      write("%s", errorMessage);
      continue;
    }
    size = 0;
    size = DiagGetPrimitiveData(respFirst, primitiveRaw, elCount(primitiveRaw));
    if(size == 0)
    {
      strncpy(errorMessage, "Cannot read primitive data from diagnostic request", 100);
      write("%s", errorMessage);
      continue;
    }
    else if(size == 3)
     {
       testStepPass("", "No DTC");
       break;
     }
    
    dataStart = 3;
      
    strncpy(hexString, "", 500);
    for(i = dataStart; i < size; i++)
    {
      snprintf(buffer, 3, "%02x", primitiveRaw[i]);
      strncat(hexString, buffer, 500);
      if(i < size-1)
        strncat(hexString, " ", 500);
    }
  
    testStepFail("", "Received DTC response:\n%s", hexString);
    write("", "Hex string: %s", hexString);
    break;
  }
  
  if(retries == 6) testStepFail("", "%s", errorMessage);
  
  retries = 0;
  
  while(retries <= 5)
  {
    retries ++;
    response = 0;
    
    reqRecent.SendRequest();
    response = TestWaitForDiagRequestSent(reqRecent, 2000);
    if(response != 1)
    {
      strncpy(errorMessage, "Failed to send diagnostic request, error code: ", 100);
      ltoa(response, errorCode, 10);
      strncat(errorMessage, errorCode, 100);
      write("%s", errorMessage);
      continue;
    }
    
    response = TestWaitForDiagResponse(reqRecent, 2000);
    if(response != 1)
    {
      strncpy(errorMessage, "Failed to receive diagnostic response, error code:  ", 100);
      ltoa(response, errorCode, 10);
      strncat(errorMessage, errorCode, 100);
      write("%s", errorMessage);
      continue;
    }
    
    diagGetLastResponse(respRecent);
    response = diagGetResponseCode(respRecent);
    if(response != -1)
    {
      strncpy(errorMessage, "Diagnostic response error, error code: ", 100);
      ltoa(response, errorCode, 10);
      strncat(errorMessage, errorCode, 100);
      write("%s", errorMessage);
      continue;
    }
    size = 0;
    size = DiagGetPrimitiveData(respRecent, primitiveRaw, elCount(primitiveRaw));
    if(size == 0)
    {
      strncpy(errorMessage, "Cannot read primitive data from diagnostic request", 100);
      write("%s", errorMessage);
      continue;
    }
    else if(size == 3)
     {
       testStepPass("", "No DTC");
       break;
     }
    
    dataStart = 3;
      
    strncpy(hexString, "", 500);
    for(i = dataStart; i < size; i++)
    {
      snprintf(buffer, 3, "%02x", primitiveRaw[i]);
      strncat(hexString, buffer, 500);
      if(i < size-1)
        strncat(hexString, " ", 500);
    }
  
    testStepFail("", "Received DTC response:\n%s", hexString);
    write("", "Hex string: %s", hexString);
    break;
  }
  
  if(retries == 6) testStepFail("", "%s", errorMessage);
}

export void Clear_DTC()
{
  long response;
  diagRequest CVADAS_0001_00000000_000.FaultMemory_Clear req14;
  diagResponse CVADAS_0001_00000000_000.FaultMemory_Clear resp14;
  
  req14.SetParameter("GroupofDtc", "All groups  -  0xFF 0xFF 0xFF");
  testStep("", "Send request to clear DTC");
  req14.SendRequest();
  response = TestWaitForDiagRequestSent(req14, 2000);
  if(response != 1)
  {
    testStepFail("", "DTC clear request error, error code: %d", response);
    return;
  }
  
  response = TestWaitForDiagResponse(req14, 5000);
  if(response != 1)
  {
    testStepFail("", "DTC clear response not recieved, error code: %d", response);
    return;
  }
  
  diagGetLastResponse(resp14);
  response = diagGetResponseCode(resp14);
  if(response != -1)
  {
    testStepFail("", "DTC clear negative response, error code: %d", response);
    return;
  }
  testStepPass("","DTC cleared");
}

export testcase Sleep_Wakeup(long iterations, char gear[], long speed, long view)
{
  long i, j;
  char batchFileNameWithASpace [50] = "Image_Comparison.bat ";
  char fullCommand [256] = "";
  char timeStampInString [10];
  char masterImageName [30];
  char viewInString [5];
  char speedInString [5];
  long response;
  float switchTime;
  float totalTTFFDCAN2, totalTTFFDCAN14, totalTTFI;
  
  totalTTFFDCAN2 = 0;
  totalTTFFDCAN14 = 0;
  totalTTFI = 0;
  General_Precondition();
 
  for(i = 0; i < iterations; i++)
  {
    char takenImageName[16];
    testStep("", "Iteration %d", i);
    Clear_DTC();
    
    Disable_CAN_Communication();
  
    Enable_CAN_Communication(gear);
    
  //  testStep("", "Wait until CAN wakeup");
    
   // while(reverseOnWake != 0)
   // {
   //   TestWaitForTimeout(1);
  //  }
    
  //  testStep("", "CAN wakeup");
    
    //testStep("", "Wait 5 seconds");
    //testWaitForTimeout(5000);
    
    $CameraDisplaySts2 = view;
    testStep("","View is set to View %d", view);
//    $FDCAN14::BSM::BRAKE_FD_2::VehicleSpeedVSOSig = speed;
//    testStepPass("", "$FDCAN14::BSM::BRAKE_FD_2::VehicleSpeedVSOSig = %d", speed);
//    // else testStepFail("", "$FDCAN14::BSM::BRAKE_FD_2::VehicleSpeedVSOSig failed to set to %d, current value: %d", speed, $FDCAN14::BSM::BRAKE_FD_2::VehicleSpeedVSOSig);
//    testWaitForTimeout(10000);
//    testStep(""," wait for 10sec");
    
    // If you enable line 1261 you need to capture a master image
    
    strncpy(masterImageName, "1200x900_", 30);
    strncat(masterImageName, gear, 30);
    strncat(masterImageName, "_V", 30);
    ltoa(view, viewInString, 10);
    strncat(masterImageName, viewInString, 30);
    strncat(masterImageName, "_S", 30);
    ltoa(speed, speedInString, 10);
    strncat(masterImageName, speedInString, 30);
    
    if(view == 0) Capture_And_Compare(masterImageName, "1", "1200x900");
    else Capture_And_Compare(masterImageName, viewInString, "1200x900");
    ltoa((long)(timeNowFloat()/100000.0), timeStampInString, 10);
    //Capture_Image(timeStampInString, "1200x900");
    
    Check_DTC();
  }
  
  General_Postcondition();
}

export testcase TTFI(long iterations)
{
  long i, j;
  char batchFileNameWithASpace [50] = "Image_Comparison.bat ";
  char fullCommand [256] = "";
  long response;
  float switchTime;
  long validIterations;
  float totalTTFFDCAN2, totalTTFFDCAN14, totalTTFI;
  
  totalTTFFDCAN2 = 0;
  totalTTFFDCAN14 = 0;
  totalTTFI = 0;
  validIterations = iterations;
  
  General_Precondition();
  
  for(i = 0; i < iterations; i++)
  {
    char takenImageName[16];
    testStep("", "Iteration %d", i);
    Clear_DTC();
    
    testStep("", "Open driver door");
    $DriverDoorSts = 1;
    
    Disable_CAN_Communication();
  
    Enable_CAN_Communication("R");
    
    testStep("", "Wait until CAN wakeup");
    
    while(reverseOnWake != 0)
    {
      TestWaitForTimeout(1);
    }
    
    testStep("", "CAN wakeup");
    
    strncpy(fullCommand, batchFileNameWithASpace, 256);
    strncat(fullCommand, "1200x900 checkWhenSwitchAway 1200x900", 256); 
    strncat(fullCommand, "_BlackScreen", 256);
    
    testStep("", "start looking for the first valid image");
    response = testWaitForSyscall(pythonFolder, fullCommand, 0, 300000);
    
    if(response == 1)
    {
      char buffer[64];
      char bufferA[64];
      char bufferB[64];
      char beforeImagePath[500];
      char afterImagePath[500];
      dword glbHandle = 0;
      dword glbHandleA = 0;
      dword glbHandleB = 0;
      
      setFilePath (pythonFolder, 0);
      glbHandle = OpenFileRead ("switchTime.txt", 0);

      if ( glbHandle!=0 )
      {
        fileGetStringSZ(buffer,elcount(buffer),glbHandle);
        switchTime = atodbl (buffer);
        fileClose (glbHandle);
        if (switchTime < 0) 
        {
          switchTime *= -1;
          testStepFail(" ", "Failed to maintain correct display after received first image");
        }
        else if(switchTime == 10)
        {
          validIterations --;
          testStepFail("", "Failed to get any valid image in 10 seconds");
        }
        else
        {
          totalTTFI += switchTime;
          if(switchTime <= 2) testStepPass("", "TTFI = %f seconds", switchTime);
          else testStepFail("", "TTFI = %f seconds", switchTime);
        }
        
        glbHandleB = OpenFileRead ("beforeSwitch.txt", 0);
        glbHandleA = OpenFileRead ("afterSwitch.txt", 0);
        
        if ( glbHandleA != 0 && glbHandleB != 0)
        {
          long k;
          fileGetStringSZ(bufferB,elcount(buffer),glbHandleB);
          fileGetStringSZ(bufferA,elcount(buffer),glbHandleA);
          
          fileClose(glbHandleA);
          fileClose(glbHandleB);
          
          strncpy(beforeImagePath, pythonFolder, 500);
          strncat(beforeImagePath, bufferB, 500);
          strncpy(afterImagePath, pythonFolder, 500);
          strncat(afterImagePath, bufferA, 500);
         
          
          testReportAddImage("before", beforeImagePath);
          testReportAddImage("after", afterImagePath);
          
          for(k = 0; k < 15; k++)
          {
            takenImageName[k] = bufferA[k+7];
          }
          response = Check_If_Black_Screen(takenImageName, "1200x900");
          if(response == 1) testStepFail("", "Unexpected blackscreen detected!");
          
        }
        else
        {
          write ("File 'beforeSwitch.txt' or 'afterSwitch.txt' was not opened for read access.");
          testStepFail("File 'beforeSwitch.txt' or 'afterSwitch.txt' was not opened for read access.");
        }
        
      }
      else
      {
        write ("File 'switchTime.txt' was not opened for read access.");
        testStepFail("File 'switchTime.txt' was not opened for read access.");
      }
    }
    else
    {
      write ("failed to finish TTFI test, exit code: %d", response);
      testStepFail(" ", "failed to finish TTFI test, exit code: %d", response);
    }
    
    j = 0;
    while(j < 5)
    {
      testStep("", "Wait for 5 seconds");
      testWaitForTimeout(5000);
      if(timeForFDCAN2Wake != 0 && timeForFDCAN14Wake != 0)
      {
        testStepPass("", "FD-CAN2 = %f seconds, FD-CAN14 = %f seconds, TTFI = %f seconds", timeForFDCAN2Wake, timeForFDCAN14Wake, switchTime);
        totalTTFFDCAN2 += timeForFDCAN2Wake;
        totalTTFFDCAN14 += timeForFDCAN14Wake;
        if(timeForFDCAN2Wake > 0.5) testStepFail("", "timeForFDCAN2Wake > 0.5 seconds");
        if(timeForFDCAN14Wake > 0.9) testStepFail("", "timeForFDCAN14Wake > 0.9 seconds");
        break;
      }
      j++;
    }
    if(j >= 5) testStepFail("", "ECU failed to wake up");
  
    Check_DTC();
  }
  
  
  testStep("", "average FD-CAN2 = %f seconds, average FD-CAN14 = %f seconds, average TTFI = %f seconds", totalTTFFDCAN2 / iterations, totalTTFFDCAN14 / iterations, totalTTFI / validIterations);
  General_Postcondition();

}

export testcase Voltage_Drop(double minVoltage, long cycles, char resolution[])
{
  double maxVoltage = 12.0;
  long iter;
  double waitTime = 0;
  char minVoltageInString [10];
  
  Power_Supply_ON();
  
  _gcvt(minVoltage, 10, minVoltageInString);
  waitTime = 120000 / (maxVoltage - minVoltage) / 10;
  for(iter = 1; iter <= cycles; iter++)
  {
    char imageName[50];
    char iterInString[10];
    double j;
    
    for(j = maxVoltage; j >= minVoltage; j -= 0.1)
    {
      testStep("","Set power supply to %fV", j);
      Power_Supply_SET(j);
      testStep("","Wait for %fms", waitTime);
      testWaitForTimeout(waitTime);
    }
    
    testStep("","Set power supply to 12V", 12);
      Power_Supply_SET(12);
    
    testStep("","Wait for 10000ms");
    testWaitForTimeout(10000);
    
    ltoa(iter, iterInString, 10);
    strncpy(imageName, "Voltage_Drop/", 50);
    strncat(imageName, minVoltageInString, 50);
    strncat(imageName, "V/", 50);
    strncat(imageName, resolution, 50);
    strncat(imageName, "_", 50);
    strncat(imageName, iterInString, 50);
    Capture_Image(imageName, resolution);
  }
}

export testcase Take_Master_Images(char gear[], char resolution[])
{
  long iter;
  long lastView;
  char imageName[20];
  char lastImageName[20];
  char iterInString[5];
  
  iter = 0;
  lastView = 2;
  
  General_Precondition();
  
  strncpy(lastImageName, resolution, 20);
  strncat(lastImageName, "_old", 20);
  strncat(lastImageName, gear, 20);
  ltoa(lastView, iterInString, 20);
  write(iterInString);
  strncat(lastImageName, iterInString, 20);
  
  View_Switch(gear, lastView, lastView);
  Capture_Image(lastImageName, resolution);
  
  for (iter = 14; iter >= 1; iter--)
  {
    if(iter == 4 || iter == 10)
    {
      continue;
    }
    strncpy(imageName, resolution, 20);
    strncat(imageName, "_", 20);
    strncat(imageName, gear, 20);
    ltoa(iter, iterInString, 10);
    strncat(imageName, iterInString, 20);
    
    View_Switch(gear, lastView, iter);

    Capture_Image(imageName, resolution);
    
    if(Get_Comparison_Score(lastImageName, imageName, resolution) > 0.95)
    {
      testStepFail("", "failed to view swtich from %s to %s", viewName[lastView], viewName[iter]);
    }
    else
    {
      testStepPass("", "Captured %s", imageName);
    }
    strncpy(lastImageName, imageName, 20);
    lastView = iter;
  }
  write("Done capturing master images for gear %s, please double check the results", gear);
  testStepPass("", "Done capturing master images for gear %s, please double check the results", gear);
  
  General_Postcondition();
}

export testcase Send_Proxi(char proxi[])
{
  char arguments[1][500];
  strncpy(arguments[0], proxi, 500);
  
  Power_Supply_ON();
  
  testStep("", "Wait for 10 seconds");
  testWaitForTimeout(10000);
  
  Retry("Set_Default_Session");
  
  testStep("", "Wait for 10 seconds");
  testWaitForTimeout(10000);
  
  Retry("Set_Extended_Session");
  
  testStep("", "Wait for 10 seconds");
  testWaitForTimeout(10000);
  
  Retry_With_Arguments("Write_Proxi", arguments);
  
  testStep("", "Wait for 10 seconds");
  testWaitForTimeout(10000);
  
  Retry("Hard_Reset");
  
  testStep("", "Wait for 10 seconds");
  testWaitForTimeout(10000);
}

void Test_Pattern_Capture_And_Compare(char camera[], char resolution[])
{
  long response;
  
  Retry("Set_Extended_Session");
  response = Test_Pattern_Start(camera);
  
  testStep("", "Wait for 5 seconds");
  testWaitForTimeout(5000);
  
  if(response == 1)
  {
    testStepPass("","Test_Pattern_Start succeeded");
    
    if(camera[0] == 'F')
      Capture_And_Compare_With_RGB("FTP100", resolution);
    else if(camera[0] == 'L')
      Capture_And_Compare_With_RGB("LTP100", resolution);
    else if(camera[1] == 'e')
      Capture_And_Compare_With_RGB("ReTP100", resolution);
    else if(camera[1] == 'i')
      Capture_And_Compare_With_RGB("RiTP100", resolution);
    
    response = Test_Pattern_Stop();
    
    if(response == 1)
    {
      testStepPass("","Test_Pattern_Stop succeeded");
    }
    else
    {
      testStepFail("","Test_Pattern_Stop failed, response: %d", response);
    }
  }
  else
  {
    testStepFail("","Test_Pattern_Start failed, response: %d", response);
  }
}

void Test_Pattern_Capture_With_Power_Cycle(char camera[], char resolution[])
{
  long response;
  char timeStampInString[10];
    
  testStep("", "$CmdIgnsts = 'on'");
  $CmdIgnSts = 4;
  
  Retry("Set_Extended_Session");
  response = Test_Pattern_Start(camera);
  
  testStep("", "Wait for 5 seconds");
  testWaitForTimeout(5000);
  
  if(response == 1)
  {
    testStepPass("","Test_Pattern_Start succeeded");
    
    ltoa((long)(timeNowFloat()/100000.0), timeStampInString, 10);
    Capture_Image(timeStampInString, resolution);
    
    response = Test_Pattern_Stop();
    
    if(response == 1)
    {
      testStepPass("","Test_Pattern_Stop succeeded");
    }
    else
    {
      testStepFail("","Test_Pattern_Stop failed, response: %d", response);
    }
  }
  else
  {
    testStepFail("","Test_Pattern_Start failed, response: %d", response);
  }
  
  testStep("", "Wait for 5 seconds");
  testWaitForTimeout(5000);
  
  testStep("", "$CmdIgnsts = 'lock'");
  $CmdIgnSts = 0;
  
  Power_Cycle(5000);
}

void Test_Pattern_Capture_With_Hard_Reset(char camera[], char resolution[])
{
  long response;
  char timeStampInString[10];
  
  Retry("Set_Extended_Session");
  response = Test_Pattern_Start(camera);
  
  testStep("", "Wait for 5 seconds");
  testWaitForTimeout(5000);
  
  if(response == 1)
  {
    testStepPass("","Test_Pattern_Start succeeded");
    
    ltoa((long)(timeNowFloat()/100000.0), timeStampInString, 10);
    Capture_Image(timeStampInString, resolution);
    
    /*response = Test_Pattern_Stop();
    
    if(response == 1)
    {
      testStepPass("","Test_Pattern_Stop succeeded");
    }
    else
    {
      testStepFail("","Test_Pattern_Stop failed, response: %d", response);
    }*/
  }
  else
  {
    testStepFail("","Test_Pattern_Start failed, response: %d", response);
  }
  
  Retry("Hard_Reset");
  
  testStep("", "Wait for 10 seconds");
  testWaitForTimeout(10000);
  
  ltoa((long)(timeNowFloat()/100000.0), timeStampInString, 10);
  Capture_Image(timeStampInString, resolution);
}

export testcase Test_Pattern_Test(long set, char resolution[])
{
  long j;
  
  General_Precondition();
  
  for(j = 0; j < 25; j++)
  {
    testStep("", "Set %d, Iteration %d", set, j);
    
    Test_Pattern_Capture_And_Compare("Front Camera", resolution);
    Test_Pattern_Capture_And_Compare("Left Camera", resolution);
    Test_Pattern_Capture_And_Compare("Rear Camera", resolution);
    Test_Pattern_Capture_And_Compare("Right  Camera", resolution);
  }
  
  General_Postcondition();
}

export testcase Test_Pattern_Test_With_Power_Cycle(long set, char resolution[])
{
  long j;
  
  General_Precondition();
  
  for(j = 0; j < 25; j++)
  {
    testStep("", "Set %d, Iteration %d", set, j);
    Test_Pattern_Capture_With_Power_Cycle("Front Camera", resolution);
    Test_Pattern_Capture_With_Power_Cycle("Left Camera", resolution);
    Test_Pattern_Capture_With_Power_Cycle("Rear Camera", resolution);
    Test_Pattern_Capture_With_Power_Cycle("Right  Camera", resolution);
  }
  
  General_Postcondition();
}

export testcase Test_Pattern_Test_With_Hard_Reset(long set, char resolution[])
{
  long j;
  
  General_Precondition();
  
  for(j = 0; j < 25; j++)
  {
    testStep("", "Set %d, Iteration %d", set, j);
    Test_Pattern_Capture_With_Hard_Reset("Front Camera", resolution);
    Test_Pattern_Capture_With_Hard_Reset("Left Camera", resolution);
    Test_Pattern_Capture_With_Hard_Reset("Rear Camera", resolution);
    Test_Pattern_Capture_With_Hard_Reset("Right  Camera", resolution);
  }
  
  General_Postcondition();
}

export testcase HMI_Frame_Rate_Test(char resolution[])
{
  long iter;
  long lastView;
  char imageName[20];
  char lastImageName[20];
  char iterInString[5];
  
  iter = 0;
  lastView = 2;
  
  General_Precondition();
  
  Switch_Gear_With_String("P");
  
  strncpy(lastImageName, resolution, 20);
  strncat(lastImageName, "_old", 20);;
  ltoa(lastView, iterInString, 20);
  write(iterInString);
  strncat(lastImageName, iterInString, 20);
  
  Capture_Image(lastImageName, resolution);
  
  for (iter = 14; iter >= 1; iter--)
  {
    if(iter == 4 || iter == 10)
    {
      continue;
    }
    testStep("", "Start frame rate testing for %s", viewName[iter]);
    
    testStep("", "Switch view to %s", viewName[iter]);
    $CameraDisplaySts2 = iter;
    
    strncpy(imageName, resolution, 20);
    strncat(imageName, "_", 20);
    ltoa(iter, iterInString, 10);
    strncat(imageName, iterInString, 20);
    
    Capture_Image(imageName, resolution);
    
    if(Get_Comparison_Score(lastImageName, imageName, resolution) > 0.95)
    {
      testStepFail("", "failed to view swtich from %s to %s", viewName[lastView], viewName[iter]);
    }
    else
    {
      testStepPass("", "View switched");
    }
    
    testStep("", "Wait for 20 minutes");
    testWaitForTimeout(1200000);
    
    strncpy(lastImageName, imageName, 20);
    lastView = iter;
  }
  
  General_Postcondition();
}

void Retry(char functionName[])
{
  int retries;
  long response;
  
  retries = 0;
  do
  {
    if(retries == 0)
    {
      testStep("", "Try %s", functionName);
    }
    else
    {
      testStep("", "Retry %s, error code %d", functionName, response);
    }
    if(strncmp(functionName, "Set_Default_Session", 19) == 0)
    {
      response = Set_Default_Session();
    }
    else if(strncmp(functionName, "Set_Extended_Session", 20) == 0)
    {
      response = Set_Extended_Session();
    }
    else if(strncmp(functionName, "Hard_Reset", 10) == 0)
    {
      response = Hard_Reset();
    }
    else
    {
      testStepFail("", "Function not found to retry");
      return;
    }
    
    testStep("", "Wait for 250 ms");
    testWaitForTimeout(250);
    
    if(response == 1){
      testStepPass("","%s succeeded", functionName);
      return;
    }
    
    retries += 1;
  }
  while(retries < 3);
  testStepFail("","%s failed, error code: %d", functionName, response);
}

void Retry_With_Arguments(char functionName[], char arguments[][])
{
  int retries;
  long response;
  
  retries = 0;
  do
  {
    if(retries == 0)
    {
      testStep("", "Try %s", functionName);
    }
    else
    {
      testStep("", "Retry %s, error code %d", functionName, response);
    }
    if(strncmp(functionName, "Write_Proxi", 11) == 0)
    {
      response = Write_Proxi(arguments[0]);
    }
    else
    {
      testStepFail("", "Function not found to retry");
      return;
    }
    
    testStep("", "Wait for 250 ms");
    testWaitForTimeout(250);
    
    if(response == 1){
      testStepPass("","%s succeeded", functionName);
      return;
    }
    
    retries += 1;
  }
  while(retries < 3);
  testStepFail("","%s failed, error code: %d", functionName, response);
}

long Set_Default_Session()
{
  long response;
  diagRequest CVADAS_0001_00000000_000.Default_Session_Start defaultSessionStart;
  diagResponse CVADAS_0001_00000000_000.Default_Session_Start defaultSessionStartResp;
  
  testStep("","Set Default Session");
  defaultSessionStart.SendRequest();
  TestWaitForDiagRequestSent(defaultSessionStart, 1000);
  response = TestWaitForDiagResponse(defaultSessionStart, 1000);
  
  return response;
  
}

long Set_Extended_Session()
{
  long response;
  diagRequest CVADAS_0001_00000000_000.Extended_Diagnostic_Session_Start extendedSessionStart;
  
  testStep("","Set Extended Session");
  extendedSessionStart.SendRequest();
  TestWaitForDiagRequestSent(extendedSessionStart, 1000);
  response = TestWaitForDiagResponse(extendedSessionStart, 1000);
  return response;
  
}

long Hard_Reset()
{
  long response;
  diagRequest CVADAS_0001_00000000_000.HardReset_Reset hardReset;
  
  testStep("","ECU hard reset");
  hardReset.SendRequest();
  TestWaitForDiagRequestSent(hardReset, 1000);
  response = TestWaitForDiagResponse(hardReset, 1000);

  return response;
}

long Write_Proxi(char proxi[])
{
  long response;
  diagRequest CVADAS_0001_00000000_000._2E2023_PROXI_Data proxiData;
  
  testStep("", "Write proxi data");
  proxiData.SetParameter("_Data_24", proxi);
  proxiData.SendRequest();
  response = TestWaitForDiagResponse(proxiData, 1000);
  if(response == 1)
  {
    response = diagGetLastResponseCode(proxiData);
    if(response == -1)
    {
      return 1;
    }
    if(response == 1){
      return -1;
    }
  }
  return response;
}

long Test_Pattern_Start(char cameraIdentifier[])
{
  long response;
  diagRequest CVADAS_0001_00000000_000._3101FE0E_Test_Pattern_Control_Start req;
  diagResponse CVADAS_0001_00000000_000._3101FE0E_Test_Pattern_Control_Start resp;
    
  testStep("", "Test pattern start with %s", cameraIdentifier);
  req.SetParameter("Camera_Identifier", cameraIdentifier);
  req.SetParameter("Test_Pattern", "100% Vertical Color Bars Test Pattern");
  req.SendRequest();
  response = TestWaitForDiagRequestSent(req, 2000);
  if(response != 1) return response;
  response = TestWaitForDiagResponse(req, 2000);
  if(response != 1) return response;
  
  diagGetLastResponse(resp);
  response = diagGetResponseCode(resp);
  if(response != -1) return response;
  return 1;
}

long Test_Pattern_Stop()
{
  long response;
  diagRequest CVADAS_0001_00000000_000._3102FE0E_Test_Pattern_Control_Stop req;
  diagResponse CVADAS_0001_00000000_000._3102FE0E_Test_Pattern_Control_Stop resp;
  
  testStep("", "Test pattern stop");
  req.SendRequest();
  response = TestWaitForDiagRequestSent(req, 2000);
  if(response != 1) return response;
  response = TestWaitForDiagResponse(req, 2000);
  if(response != 1) return response;
  
  diagGetLastResponse(resp);
  response = diagGetResponseCode(resp);
  if(response != -1) return response;
  return 1;
  
}

long Check_FD_CAN_2_trace()
{
   if(((timeNowFloat() / 100) - timeSinceLastFDCAN2) <= 200) return 1;
   else return 0;
}

export void Disable_CAN_Communication()
{
  long response, j;
  dword context;
  
  testStep("", "Set view to default");
  $CameraDisplaySts2 = 0;
  if($CameraDisplaySts2 == 0) testStepPass("", "Set view to default");
  else testStepFail("", "Failed to set view to default, current view = %s", viewName[(int)$CameraDisplaySts2]);
  
  Switch_Gear_With_String("P");
  
  $CmdIgnSts = 0;
  
  testStep("", "Wait for 250ms");
  testWaitForTimeout(250);
  
  testStepPass("", "$CmdIgnSts set to 'lock'");
  //if($CmdIgnSts == 0) testStepPass("", "$CmdIgnSts set to 'lock'");
  //else testStepFail("", "$CmdIgnSts failed to set to 'lock', current $CmdIgnSts = %d", $CmdIgnSts);
  
  @sysvar::IL::Klemme15=0;
  @sysvar::IL::Klemme30=0;
  if(@sysvar::IL::Klemme15==0) testStepPass("", "Ignition turned off");
  else testStepFail("", "Ignition failed to turn off");
  if(@sysvar::IL::Klemme30==0) testStepPass("", "Can bus power turned off");
  else testStepFail("", "Can bus power failed to turn off");
  
  response = diagStopTesterPresent(ecuName);
  if(response != 0) testStepFail("", "Failed to stop Tester Present, error: %d", response);
  else testStep("", "Stopped Tester Present");
  
  j = 0;
  while(j < 6)
  {
    testStep("", "Wait for 2 seconds");
    testWaitForTimeout(2000);
    
    j++;
    
    if(((timeNowFloat() / 100) - timeSinceLastFDCAN2) >= 3000 && ((timeNowFloat() / 100) - timeSinceLastFDCAN14) >= 3000)
    {
      testStepPass("", "ECU went to sleep");
      break;
    }
  }
  
  if(j >= 6) testStepWarning("", "ECU failed to sleep in 12 seconds");
  while(j < 6)
  {
    testStep("", "Wait for 2 seconds");
    testWaitForTimeout(2000);
    j++;
  }
}

export void Enable_CAN_Communication(char gear[])
{
  long response;
  dword context;
  
  @sysvar::IL::Klemme15=1;
  @sysvar::IL::Klemme30=1;
  if(@sysvar::IL::Klemme15==1) testStepPass("", "Ignition turned on");
  else testStepFail("", "Ignition failed to turn on");
  if(@sysvar::IL::Klemme30==1) testStepPass("", "Can bus power turned on");
  else testStepFail("", "Can bus power failed to turn on");
  //change to 250ms 8-23-23
  testWaitForTimeout(350);
  testStep("","Wait for 350ms");
  
  $CmdIgnSts = 4;
  testStepPass("", "$CmdIgnSts set to 'run'");
  //if($CmdIgnSts == 4) testStepPass("", "$CmdIgnSts set to 'run'");
  // else testStepFail("", "$CmdIgnSts failed to set to 'run', current $CmdIgnSts = %d", $CmdIgnSts);
  //change to 2000ms
  teststep("","wait for 2750ms");
  testWaitForTimeout(2750);
  
  
  
  testStep("", "Set view to default");
  $CameraDisplaySts2 = 0;
  if($CameraDisplaySts2 == 0) testStepPass("", "Set view to default");
  else testStepFail("", "Failed to set view to default, current view = %s", viewName[(int)$CameraDisplaySts2]);
  teststep("","wait for 1000ms");
  testWaitForTimeout(1000);
 
  Switch_Gear_With_String("P");
  
  teststep("","wait for 650ms");
  testWaitForTimeout(650);
  testStep("", " $FDCAN2::CVADAS::CVPAM_FD_Info::DisplayView2 = %d",  $FDCAN2::CVADAS::CVPAM_FD_Info::DisplayView2);
  
  Switch_Gear_With_String(gear);
  setTimer(t, 800);
  
  //If needed comment-in for TTFI
  
//  testStep("", "Reset timer for TTFI and can wake up");
//  lastCANSleep = timeNowFloat() / 100.0;
//  timeForFDCAN2Wake = 0;
//  timeForFDCAN14Wake = 0;

  response = diagStartTesterPresent(ecuName);
  
  if(response != 0) testStepFail("", "Failed to start Tester Present, error: %d", response);
  else testStep("", "Started Tester Present");
  
}

export void Time_To_View_Switch_From_Reverse(char prevImageName[])
{
  long i, j;
  char batchFileNameWithASpace [50] = "Image_Comparison.bat ";
  char fullCommand [256] = "";
  long response;
  float switchTime;
  char takenImageName[16];
  
  Switch_Gear_With_String("R");
  
  strncpy(fullCommand, batchFileNameWithASpace, 256);
  strncat(fullCommand, "1200x900 checkWhenSwitchAway ", 256); 
  strncat(fullCommand, "prevImageName", 256);
  
  testStep("", "start looking for the first valid image");
  response = testWaitForSyscall(pythonFolder, fullCommand, 0, 300000);
  
  if(response == 1)
  {
    char buffer[64];
    char bufferA[64];
    char bufferB[64];
    char beforeImagePath[500];
    char afterImagePath[500];
    dword glbHandle = 0;
    dword glbHandleA = 0;
    dword glbHandleB = 0;
    
    setFilePath (pythonFolder, 0);
    glbHandle = OpenFileRead ("switchTime.txt", 0);

    if ( glbHandle!=0 )
    {
      fileGetStringSZ(buffer,elcount(buffer),glbHandle);
      switchTime = atodbl (buffer);
      fileClose (glbHandle);
      if (switchTime < 0) 
      {
        switchTime *= -1;
        testStepFail(" ", "Failed to maintain correct display after received first image");
      }
      else
      {
        testStepPass("", "spent %f seconds to receive first valid image", switchTime);
      }
      
      glbHandleB = OpenFileRead ("beforeSwitch.txt", 0);
      glbHandleA = OpenFileRead ("afterSwitch.txt", 0);
      
      if ( glbHandleA != 0 && glbHandleB != 0)
      {
        long k;
        fileGetStringSZ(bufferB,elcount(buffer),glbHandleB);
        fileGetStringSZ(bufferA,elcount(buffer),glbHandleA);
        
        fileClose(glbHandleA);
        fileClose(glbHandleB);
        
        strncpy(beforeImagePath, pythonFolder, 500);
        strncat(beforeImagePath, bufferB, 500);
        strncpy(afterImagePath, pythonFolder, 500);
        strncat(afterImagePath, bufferA, 500);
       
        
        testReportAddImage("before", beforeImagePath);
        testReportAddImage("after", afterImagePath);
        
        for(k = 0; k < 15; k++)
        {
          takenImageName[k] = bufferA[k+7];
        }
        response = Check_If_Black_Screen(takenImageName, "1200x900");
        if(response == 1) testStepFail("", "Unexpected blackscreen detected!");
        
      }
      else
      {
        write ("File 'beforeSwitch.txt' or 'afterSwitch.txt' was not opened for read access.");
        testStepFail("File 'beforeSwitch.txt' or 'afterSwitch.txt' was not opened for read access.");
      }
      
    }
    else
    {
      write ("File 'switchTime.txt' was not opened for read access.");
      testStepFail("File 'switchTime.txt' was not opened for read access.");
    }
  }
  else
  {
    write ("failed to finish TTFI test, exit code: %d", response);
    testStepFail(" ", "failed to finish TTFI test, exit code: %d", response);
  }
}

long Check_FD_CAN_14_trace()
{
   if(((timeNowFloat() / 100) - timeSinceLastFDCAN14) <= 200) return 1;
   else return 0;
}

long Check_Both_Can_Messages()
{
  long gotBothMessages;
  
  gotBothMessages = 1;
  if(Check_FD_CAN_2_trace() != 1)
  {
    testStepFail("", "No FDCAN2 message!");
    gotBothMessages = 0;
  }
  if(Check_FD_CAN_14_trace() != 1)
  {
    testStepFail("", "No FDCAN14 message!");
    gotBothMessages = 0;
  }
  return gotBothMessages;
}

export testcase DTC_Test()
{
  long i;
  for(i = 0; i < 10; i++)
  {
    Clear_DTC();
    Check_DTC();
  }
}

export testfunction Capture_And_Compare_G_V_S(int gear, int view, int speed)
{
  char masterImageName[50];
  char viewInString[5];
  char speedInString[5];
  
  strncpy(masterImageName, "1200x900_", 30);
  strncat(masterImageName, gearName[gear], 30);
  strncat(masterImageName, "_V", 30);
  ltoa(view, viewInString, 10);
  strncat(masterImageName, viewInString, 30);
  strncat(masterImageName, "_S", 30);
  ltoa(speed, speedInString, 10);
  strncat(masterImageName, speedInString, 30);
  
  if(view == 0) Capture_And_Compare(masterImageName, "1", "1200x900");
  else Capture_And_Compare(masterImageName, viewInString, "1200x900");
}
