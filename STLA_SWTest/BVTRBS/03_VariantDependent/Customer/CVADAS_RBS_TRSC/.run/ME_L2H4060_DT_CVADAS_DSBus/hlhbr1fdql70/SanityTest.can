/*@!Encoding:1252*/
includes
{

}

variables
{
int Rx_msg_CAN_1=0, Rx_msg_CAN_2=0, NM_msg_received=0;
  int FDCAN_2_Bus_Load, FDCAN_14_Bus_Load;
  message BCM_FD_2 msg;
  int NM_PAM_Status_1=0, NM_PAM_Status_2=0,PDC_INFO_FD_PAM_Status=0;
  long result;
  int results=0;
}

// CAN NM 
on message CAN1.*
{
   if(this.dir == rx)
   {
      // Checking the status of FDCAN_2 Communication
      Rx_msg_CAN_1 = 1;
      
      // Checking the status of PDC_INFO_FD_PAM msessage
      if(this.id == 0x1E360018)
      {
        PDC_INFO_FD_PAM_Status = 1;
      }
      else
      {
        PDC_INFO_FD_PAM_Status = 0;
      }
      
      // Checking the status of NM_PAM msessage
      if(this.id == 0x1E384018)
      {
        NM_PAM_Status_1 = 1;
      }
      else
      {
        NM_PAM_Status_1 = 0;
      }
	 }
   else
	 {
      Rx_msg_CAN_1 = 0;
	 }
}

on message CAN2.*
{
   if(this.dir == rx)
   {
      // Checking the status of FDCAN_14 Communication
      Rx_msg_CAN_2 = 1;
    
      // Checking the status of NM_PAM msessage
      if(this.id == 0x1E384018)
      {
        NM_PAM_Status_2 = 0;
      }
      else
      {
        NM_PAM_Status_2 = 1;
      }
   }
   else
	 {
      Rx_msg_CAN_2 = 0;
	 }
}

export testfunction startTesterPresent()
{
  diagStartTesterPresent();
  
}

export testfunction stopTesterPresent()
{
  diagStopTesterPresent();
  
}

export Check_Busload()
{
  write ("CAN1 busload = %d", CAN1.BusLoad);
  write ("CAN2 busload = %d", CAN2.BusLoad);
}

export Check_FD_CAN_2_trace()
{
   if(testWaitForMessage(CVADAS::CVPAM_FD_Info,255) && testWaitForMessage(ADAS_FD_LANES_1,45))
   {
        Rx_msg_CAN_1 = 1;
   }
   else
   {
        Rx_msg_CAN_1 = 0;
   }
}

export Check_FD_CAN_14_trace()
{
   if(testWaitForMessage(ADAS_FD_LANES_2,45) && testWaitForMessage(CVPAM_FD_Control,15))
   {
        Rx_msg_CAN_2 = 1;
   }
   else
   {
        Rx_msg_CAN_2 = 0;
   }
}

export After_sending_NM_Message()
{
   if(testWaitForMessage(CVPAM_FD_Info,250) && testWaitForMessage(CVPAM_FD_Control,250))
   {
       Rx_msg_CAN_2 = 1;
   }
   else
   {
        Rx_msg_CAN_2 = 0;
   }
}

export CAN_1_Comm_Rx_Dis()
{
    if(Rx_msg_CAN_1 == 0)
    {
      testStepPass(" ","ECU not Transmitted CAN messages");
    }
    else
    {
      testStepFail(" ","ECU Transmitted CAN messages");
    }
}

export CAN_1_Comm_Rx_En()
{
  Check_FD_CAN_2_trace();
  
  if(Rx_msg_CAN_1 == 1)
  {
    testStepPass(" ","ECU Transmitted CAN messages");
  }
  else
  {
    testStepFail(" ","ECU not Transmitted CAN messages");
  }
}

export Check_CAN_Communication_After_Power_ON()
{  
  if(Rx_msg_CAN_1 == 1)
  {
      testStepPass(" ","ECU Transmitted CAN messages");
  }
  else
  {
      testStepFail(" ","ECU not Transmitted CAN messages");
  }
}

export CAN_2_Comm_Rx_Dis()
{
    if(Rx_msg_CAN_2 == 0)
    {
      testStepPass(" ","ECU not Transmitted CAN messages");
    }
    else
    {
      testStepFail(" ","ECU Transmitted CAN messages");
    }
}

export CAN_2_Comm_Rx_En()
{
  if(Rx_msg_CAN_2 == 1)
  {
    testStepPass(" ","ECU Transmitted CAN messages");
  }
  else
  {
    testStepFail(" ","ECU not Transmitted CAN messages");
  }
}

export Check_PDC_Info_FD_PAM_msg()
{
  if(PDC_INFO_FD_PAM_Status == 1)
  {
    testStepPass(" ","Observed PDC_IFO_FD_PAM mesage in CAN communication");
  }
  else
  {
    testStepFail(" ","Not observed PDC_IFO_FD_PAM mesage in CAN communication");
  }
}

export Check_NM_PAM_msg()
{
  if(NM_PAM_Status_1 == 1)
  {
    testStepPass(" ","Observed NM_PAM mesage in CAN communication");
  }
  else
  {
    testStepFail(" ","Not observed NM_PAM mesage in CAN communication");
  }
}

export Cycle_Time_Difference_NM_PAM()
{
  result = ChkStart_MsgRelCycleTimeViolation(NM_PAM, 0.9, 1.1);
  if(result > 0)
  {
    testStepPass(" ","Observed time difference of 1000ms between two NM_PAM messages");
  }
  else
  {
    testStepFail(" ","Not observed time difference of 1000ms between two NM_PAM messages");
  }    
}

export CAN_communication_Stop()
{
  canSetChannelOutput(1,0);
  canSetChannelOutput(2,0);
}

export CAN_communication_Start()
{ 
  canSetChannelOutput(1,1);
  canSetChannelOutput(2,1);
}

export Communincation_Restart()
{  
  Check_FD_CAN_2_trace();
  testwaitfortimeout(500);
  if(Rx_msg_CAN_1 == 0)
  {
      do
      {
          Check_FD_CAN_2_trace();
          testwaitfortimeout(1000);
          CAN_communication_Stop();
          testwaitfortimeout(2000);
          Power_Supply_OFF();
          testwaitfortimeout(2000);
          Set_voltage(syspar::Power_Control::RS_232_Port_Number,syspar::Power_Control::Normal_Voltage);
          testwaitfortimeout(2000);
          Power_Supply_ON();
          testwaitfortimeout(500);
          CAN_communication_Start();
          testwaitfortimeout(500);
          setSignal(CmdIgnSts,0x4);
          testwaitfortimeout(2000);
          if(testWaitForMessage(CVADAS::CVPAM_FD_Info,15) && testWaitForMessage(PDC_INFO_FD_PAM,1100))
          {
              //
          }
          else
          {
              testwaitfortimeout(2000);
              if(testWaitForMessage(CVADAS::CVPAM_FD_Info,15) && testWaitForMessage(PDC_INFO_FD_PAM,1100))
              {
                  testwaitfortimeout(2500);
              }
              else
              {
                //
              }
          }
          
      }while(Rx_msg_CAN_1 == 0);
  }
  else
  {
    //
  }
  
  @MEnv_Default_SET_BOL_1 = 0;
  testwaitfortimeout(100);
  @MEnv_Default_SET_BOL_1 = 1;
  testwaitfortimeout(4000);
  
}

export Hard_Reset_Function()
{  
  Check_FD_CAN_2_trace();
  testwaitfortimeout(1000);
  if(Rx_msg_CAN_1 == 0)
  {
      do
      {
          Check_FD_CAN_2_trace();
          testwaitfortimeout(1000);
          Power_Supply_OFF();
          testwaitfortimeout(2000);
          Set_voltage(syspar::Power_Control::RS_232_Port_Number,syspar::Power_Control::Normal_Voltage);
          testwaitfortimeout(2000);
          Power_Supply_ON();
          testwaitfortimeout(2000);
      }while(Rx_msg_CAN_1 == 0);
  }
  else
  {
    //
  }
}

export Reset_CAN()
{
  resetCanEx(1);
  testwaitfortimeout(2000);
  resetCanEx(1);
  testwaitfortimeout(2000);
}
