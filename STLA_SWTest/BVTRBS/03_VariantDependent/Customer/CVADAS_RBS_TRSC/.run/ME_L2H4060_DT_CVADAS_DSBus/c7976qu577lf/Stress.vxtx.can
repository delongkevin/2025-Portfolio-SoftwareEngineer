/* !Encoding: 65001  */
includes
{
  #include "__DiagLibrary.cin"
  #include "__VariablesLib.cin"
  #include "__CaplGeneratorLib.cin"
  #include "__CANoeReportFuntionsLib.cin"
}

variables
{
  // Global variables defined within this CAPL file
  int64 __tt8cnt_1;
  int64 __tt8cnt_3;
  int64 __tt8cnt_5;
  int64 __tt8cnt_7;
  int64 __tt8cnt_9;
  int64 __tt8cnt_11;
  int64 __tt8cnt_13;
  int64 __tt8cnt_15;
  int64 __tt8cnt_17;
  int64 __tt8cnt_19;
  int64 __tt8cnt_21;
  int64 __tt8cnt_23;
  int64 __tt8cnt_25;
  int64 __tt8cnt_27;
  int64 __tt8cnt_29;
  int64 __tt8cnt_31;
  int64 __tt8cnt_33;
  int64 __tt8cnt_35;
  int64 __tt8cnt_37;
  int64 __tt8cnt_39;
  int64 __tt8cnt_41;
  int64 __tt8cnt_43;
  int64 __tt8cnt_45;
  int64 __tt8cnt_47;
  int64 __tt8cnt_49;
  int64 __tt8cnt_51;
  int64 __tt8LoopVar1;
  double __tt8LoopVar2;
}

void Tto7tsimc_General_Postconditions()
{
  stack long __tableHandle;
  TestCommandBegin(__eWait, __cWait, "", "0");
  {
    Wait("1", (200 * 1000000LL), 1000000, "");
  }
  TestCommandEnd();

  {
    CreateCaplIFFunction("Enable_CAN_Communication", __eFct);
    CallInterfaceFunction(__cEmpty, __cEmpty, "1");
  }


  TestCommandBegin(__eDiagService, __cDiagService, "", "2");
  {
    if (DiagIsFunctionalGroup("CVADAS_0001_00000000_000"))
    {
      DiagResponse * __resp;
      DiagRequest CVADAS_0001_00000000_000._22FDF2_Reset_Reason_Read __req;
      __diagServiceo7tsimc_0(__req, __resp);
    }
    else
    {
      DiagResponse CVADAS_0001_00000000_000.* __resp;
      DiagRequest CVADAS_0001_00000000_000._22FDF2_Reset_Reason_Read __req;
      __diagServiceo7tsimc_0(__req, __resp);
    }
  }
  TestCommandEnd();


}

  
void __diagServiceo7tsimc_0(DiagRequest * __req, DiagResponse * __resp )
{
  stack long __tableHandle;
  long __res, __paramLen, __bytePos;

   __bVerdict = __eVerdictPass;

  do {
    TestReportResetDiagObjectList();
    DiagSetReportDetailLevel("CVADAS_0001_00000000_000", EnumServiceDetails_onfail);
    // Request aspect
    {

      if (0 >= DiagSendReqAndWaitForResp("CVADAS_0001_00000000_000", __req, __resp, __res, -1, -1, -1, -1, -1, EnumResult_pos, EnumServiceDetails_onfail, EnumSendingMode_physical, EnumSuppressPosResBit_asconfigured, EnumVerdictOnInvalidValues_fail))
        break;
    }

    __res = DiagErrCodeTestStep(__res, "Can't retrieve last response for request! No check possible.") < 0;
    if(__res)
    {
	  __bVerdict = __eVerdictFail;
      break;
    }
    {
      __res = DiagInterpretAs(__resp, "RDBI_PR");
      if(__res != 0)
      {
        __bVerdict = __eVerdictFail;
        DiagErrCodeTestStep(__res, "Can't interpret response as diagnostic primitive 'RDBI_PR'.");
        break;
      }
      else
      {
        TestStepPass( "Received primitive can be interpreted as diagnostic primitive 'RDBI_PR'.");
      }
    }
  }
  while(0);


  // Response, check & read aspect
  {
    __res = 1;
    __tableHandle = ReportTableHead5Columns(__cCheckCaption, __cTSym, __cTOp, __cRefVal, __cActual, __cRes);
    {
      __bDiagValueArrayCtr = DiagGetParameterErrorHandled(__resp, "SOCResetRegister_Reset_Reason", __bDiagValueArray, elcount(__bDiagValueArray), __cDiagValueArray, elcount(__cDiagValueArray));
      {
        __bSetInCheckAlignment = 1;	
        {
          __bArrayCtr = __CopyBytes(__bDiagValueArray, __bDiagValueArrayCtr, __bArray);
          {
            sysvar * __systemVariable;
            __systemVariable = sysvarData::`Reset_Reason::`Reset;
            CheckSysVarSetBufferConsistency(sysSetVariableData(sysvarData::`Reset_Reason::`Reset, __bArray, __bArrayCtr), __systemVariable.name);
          }
          snprintf(__cArray, 8192, "%s", "Reset");
          snprintf(__cArray2, 8192, "%s '%s'", __cSysVar, __cArray);
          snprintf(__cArray3, 8192, "%s", "SOCResetRegister_Reset_Reason");
          
          ReportTableRow(__tableHandle, 0, __cArray2, __cAOp, __bArray, __bArrayCtr, __cArray3, __oneOfFlag, __bSetInCheckAlignment);
        
        }
    
        __bSetInCheckAlignment = 0;
      }
    }
    {
      DiagGetParameterErrorHandled(__resp, "PMIC_SafeState2_Reset_Reason", __bDiagValueArray, elcount(__bDiagValueArray), __cDiagValueArray, elcount(__cDiagValueArray));
      {
        __bSetInCheckAlignment = 1;	
        CheckCaplGenVarStringBufferConsistency(__cDiagValueArray, 8192);
        snprintf(__cArray, 8192, "%s", __cDiagValueArray);
        {
          sysvar * __systemVariable;
          __systemVariable = sysvarString::`Reset_Reason::`Reset_Reason_string;
          CheckSysVarSetBufferConsistency(sysSetVariableString(sysvarString::`Reset_Reason::`Reset_Reason_string, __cArray), __systemVariable.name);
        }
        snprintf(__cArray2, 8192, "%s", "Reset_Reason_string");
        snprintf(__cArray3, 8192, "%s '%s'", __cSysVar, __cArray2);
        snprintf(__cArray4, 8192, "%s", "PMIC_SafeState2_Reset_Reason");
        
        ReportTableRow(__tableHandle, 0, __cArray3, __cAOp, __cArray, __cArray4, __oneOfFlag, __bSetInCheckAlignment);
        
    
        __bSetInCheckAlignment = 0;
      }
    }
    ReportTableEndVerdict(__tableHandle, __cEvaluateResponse, __res);
	__bVerdict = __bVerdict && __res;
  }
  if (__bVerdict == __eVerdictFail)
    TestReportWriteDiagObjectList();
}

void Tto7tsimc_Default_Session_Standard_Physical_Address()
{
  stack long __tableHandle;
  TestCommandBegin(__eRequestResponse, __cRequestResponse, "", "0");
  {
    message `FDCAN2::`DIAGNOSTIC_RESPONSE_PAM __tt8msg_0;
  
    long __res;
    int64 __timeout;
    __res = 0;
    __nInt64 = 1;
    __timeout = syspar::`P2_Server * 1000000LL;
    {
    
      long __testStepInitOk;
      message `FDCAN2::`DIAGNOSTIC_REQUEST_PAM __output;
      message `FDCAN2::`DIAGNOSTIC_REQUEST_PAM __msgOrig;
      __output = __msgOrig;
      __testStepInitOk = 1;
      {
        int64 __dlc;
        __dlc = 3;
        if (__dlc >= 0 && __dlc <= (__output.EDL ? 15 : 8))
          __output.DLC = __dlc;
        else
        {
          testStepErrorInTestSystem(0, __cEmpty, "Unable to set DLC=%lld in message. Please check input parameter.", __dlc);
          __testStepInitOk = 0;
        }
      }
      if (__testStepInitOk)
      {
        snprintf(__cArray, elCount(__cArray), "CAN message '%s' ID = 416981233x (0x18DAA0F1x) on bus FDCAN2", "DIAGNOSTIC_REQUEST_PAM");
        snprintf(__cArray2, elCount(__cArray2), "Send %s", __cArray);
        __tableHandle = ReportTableHead3Columns(__cArray2, "Byte", __cTOp, __cAssigned);
        ReportByteIndex("", 0, __cArray, elCount(__cArray));
        snprintf(__cArray2, 8192, "%s", __cArray);
        snprintf(__cArray3, 8192, "%s", "");
        
        ReportTableRow(__tableHandle, 0, __cArray2, __cAOp, 0x2, __cArray3, __oneOfFlag, __bSetInCheckAlignment);
        
        if (0 >= 0 && 0 < 64)
        {
          __output.byte((word)0) = 0x2;
        }
        else
        {
          testStepErrorInTestSystem(0, __cEmpty, "Index out of range. Unable to set byte %lld in message. Please check input parameter.", (int64)0);
          __testStepInitOk = 0;
        }
        ReportByteIndex("", 1, __cArray, elCount(__cArray));
        snprintf(__cArray2, 8192, "%s", __cArray);
        snprintf(__cArray3, 8192, "%s", "");
        
        ReportTableRow(__tableHandle, 0, __cArray2, __cAOp, 0x10, __cArray3, __oneOfFlag, __bSetInCheckAlignment);
        
        if (1 >= 0 && 1 < 64)
        {
          __output.byte((word)1) = 0x10;
        }
        else
        {
          testStepErrorInTestSystem(0, __cEmpty, "Index out of range. Unable to set byte %lld in message. Please check input parameter.", (int64)1);
          __testStepInitOk = 0;
        }
        ReportByteIndex("", 2, __cArray, elCount(__cArray));
        snprintf(__cArray2, 8192, "%s", __cArray);
        snprintf(__cArray3, 8192, "%s", "");
        
        ReportTableRow(__tableHandle, 0, __cArray2, __cAOp, 0x1, __cArray3, __oneOfFlag, __bSetInCheckAlignment);
        
        if (2 >= 0 && 2 < 64)
        {
          __output.byte((word)2) = 0x1;
        }
        else
        {
          testStepErrorInTestSystem(0, __cEmpty, "Index out of range. Unable to set byte %lld in message. Please check input parameter.", (int64)2);
          __testStepInitOk = 0;
        }
      
        ReportTableEndTestStep(__tableHandle, "Req1");
      }
      if (__testStepInitOk)
      {
        output(__output);
      }
    }
    if (__timeout <= 0)
    {
      testStepErrorInTestSystem(0, "1", "Unable to wait for %.3f %s. Please check input parameter.", __timeout / ((float)1000000), "ms");
    }
    else
    {
      if (0 < 0 || 64 <= 0)
      {
        testStepErrorInTestSystem(0, __cEmpty, "Index out of range. Unable to get byte %lld in message.", (int64) 0);
        __nInt64 = 0;
      }
      if (1 < 0 || 64 <= 1)
      {
        testStepErrorInTestSystem(0, __cEmpty, "Index out of range. Unable to get byte %lld in message.", (int64) 1);
        __nInt64 = 0;
      }
      if (2 < 0 || 64 <= 2)
      {
        testStepErrorInTestSystem(0, __cEmpty, "Index out of range. Unable to get byte %lld in message.", (int64) 2);
        __nInt64 = 0;
      }
      if (3 < 0 || 64 <= 3)
      {
        testStepErrorInTestSystem(0, __cEmpty, "Index out of range. Unable to get byte %lld in message.", (int64) 3);
        __nInt64 = 0;
      }
      if (4 < 0 || 64 <= 4)
      {
        testStepErrorInTestSystem(0, __cEmpty, "Index out of range. Unable to get byte %lld in message.", (int64) 4);
        __nInt64 = 0;
      }
      if (5 < 0 || 64 <= 5)
      {
        testStepErrorInTestSystem(0, __cEmpty, "Index out of range. Unable to get byte %lld in message.", (int64) 5);
        __nInt64 = 0;
      }
      if (6 < 0 || 64 <= 6)
      {
        testStepErrorInTestSystem(0, __cEmpty, "Index out of range. Unable to get byte %lld in message.", (int64) 6);
        __nInt64 = 0;
      }
      __tt8cnt_1 = 0;
      snprintf(__cArray, elCount(__cArray), "CAN message '%s' ID = 417001888x (0x18DAF1A0x) on bus FDCAN2", "DIAGNOSTIC_RESPONSE_PAM");
      if(SetBusContextByName("FDCAN2", __eSaveCurrent, __nBusContextNew, __nBusContextOld))
        testJoinMessageEvent(`FDCAN2::`DIAGNOSTIC_RESPONSE_PAM,  __cArray,
             delegate dword(message * __m)
             {
               dword __msg_callback_ret;
               byte __b0;
               byte __b1;
               byte __b2;
               byte __b3;
               byte __b4;
               byte __b5;
               byte __b6;
               if (__tt8cnt_1 == -1)
               {
                 return 1;
               }
               __tt8msg_0 = __m;
               __msg_callback_ret = 1;
               __tt8cnt_1++;
               if (0 < 0 || 64 <= 0) return 0;
               __csr = CheckSignalMatch(__tt8msg_0.byte((word)0), 0x6, "==") == 1;
               __msg_callback_ret &= __csr;
               if (1 < 0 || 64 <= 1) return 0;
               __csr = CheckSignalMatch(__tt8msg_0.byte((word)1), 0x50, "==") == 1;
               __msg_callback_ret &= __csr;
               if (2 < 0 || 64 <= 2) return 0;
               __csr = CheckSignalMatch(__tt8msg_0.byte((word)2), 0x1, "==") == 1;
               __msg_callback_ret &= __csr;
               if (3 < 0 || 64 <= 3) return 0;
               __csr = CheckSignalMatch(__tt8msg_0.byte((word)3), 0x0, "==") == 1;
               __msg_callback_ret &= __csr;
               if (4 < 0 || 64 <= 4) return 0;
               __csr = CheckSignalMatch(__tt8msg_0.byte((word)4), 0x32, "==") == 1;
               __msg_callback_ret &= __csr;
               if (5 < 0 || 64 <= 5) return 0;
               __csr = CheckSignalMatch(__tt8msg_0.byte((word)5), 0x1, "==") == 1;
               __msg_callback_ret &= __csr;
               if (6 < 0 || 64 <= 6) return 0;
               __csr = CheckSignalMatch(__tt8msg_0.byte((word)6), 0xF4, "==") == 1;
               __msg_callback_ret &= __csr;
               if (__msg_callback_ret)
               {
                 __tt8cnt_1 = -1;
                 return 1;
               }
               return 0;
             });
      __res = testWaitForAllJoinedEventsNS(__timeout);
      if (__nInt64 != 0)
      {
        snprintf(__cArray, elCount(__cArray), "CAN message '%s' ID = 417001888x (0x18DAF1A0x) on bus FDCAN2", "DIAGNOSTIC_RESPONSE_PAM");
        if(__tt8cnt_1 == -1)
        {
          snprintf(__cArray2, 8192, "Response of %s", __cArray);
        snprintf(__cArray, 8192, "%s", __cActual);
        }
        else
        {
          snprintf(__cArray2, 8192, "Response of %s (received %d times)", __cArray, __tt8cnt_1);
          snprintf(__cArray, 8192, "Last Received");
        }
        if (__tt8cnt_1 == 0)
        {
          testStepFail(0, "Resp1", __cArray2);
        }
        else
        {
          byte __b0;
          byte __b1;
          byte __b2;
          byte __b3;
          byte __b4;
          byte __b5;
          byte __b6;
          __bVerdict = __eVerdictPass;
          __tableHandle = ReportTableHead5Columns(__cArray2, "Signal/Byte", __cTOp, __cRefVal, __cArray, __cRes);
        __csr = CheckSignalMatch(__tt8msg_0.byte((word)0), 0x6, "==") == 1;
        ReportByteIndex("", 0, __cArray, elCount(__cArray));
        snprintf(__cArray2, 8192, "%s", __cArray);
        snprintf(__cArray3, 8192, "%s", "");
        ReportTableRow(__tableHandle, 0, __cArray2, "==", 0x6, __cArray3, __oneOfFlag, __bSetInCheckAlignment);
        ReportCell(__tableHandle, __tt8msg_0.byte((word)0));
        ReportCellResult(__tableHandle, __csr, __ePassFail);
          __bVerdict &= __csr;
        __csr = CheckSignalMatch(__tt8msg_0.byte((word)1), 0x50, "==") == 1;
        ReportByteIndex("", 1, __cArray, elCount(__cArray));
        snprintf(__cArray2, 8192, "%s", __cArray);
        snprintf(__cArray3, 8192, "%s", "");
        ReportTableRow(__tableHandle, 0, __cArray2, "==", 0x50, __cArray3, __oneOfFlag, __bSetInCheckAlignment);
        ReportCell(__tableHandle, __tt8msg_0.byte((word)1));
        ReportCellResult(__tableHandle, __csr, __ePassFail);
          __bVerdict &= __csr;
        __csr = CheckSignalMatch(__tt8msg_0.byte((word)2), 0x1, "==") == 1;
        ReportByteIndex("", 2, __cArray, elCount(__cArray));
        snprintf(__cArray2, 8192, "%s", __cArray);
        snprintf(__cArray3, 8192, "%s", "");
        ReportTableRow(__tableHandle, 0, __cArray2, "==", 0x1, __cArray3, __oneOfFlag, __bSetInCheckAlignment);
        ReportCell(__tableHandle, __tt8msg_0.byte((word)2));
        ReportCellResult(__tableHandle, __csr, __ePassFail);
          __bVerdict &= __csr;
        __csr = CheckSignalMatch(__tt8msg_0.byte((word)3), 0x0, "==") == 1;
        ReportByteIndex("", 3, __cArray, elCount(__cArray));
        snprintf(__cArray2, 8192, "%s", __cArray);
        snprintf(__cArray3, 8192, "%s", "");
        ReportTableRow(__tableHandle, 0, __cArray2, "==", 0x0, __cArray3, __oneOfFlag, __bSetInCheckAlignment);
        ReportCell(__tableHandle, __tt8msg_0.byte((word)3));
        ReportCellResult(__tableHandle, __csr, __ePassFail);
          __bVerdict &= __csr;
        __csr = CheckSignalMatch(__tt8msg_0.byte((word)4), 0x32, "==") == 1;
        ReportByteIndex("", 4, __cArray, elCount(__cArray));
        snprintf(__cArray2, 8192, "%s", __cArray);
        snprintf(__cArray3, 8192, "%s", "");
        ReportTableRow(__tableHandle, 0, __cArray2, "==", 0x32, __cArray3, __oneOfFlag, __bSetInCheckAlignment);
        ReportCell(__tableHandle, __tt8msg_0.byte((word)4));
        ReportCellResult(__tableHandle, __csr, __ePassFail);
          __bVerdict &= __csr;
        __csr = CheckSignalMatch(__tt8msg_0.byte((word)5), 0x1, "==") == 1;
        ReportByteIndex("", 5, __cArray, elCount(__cArray));
        snprintf(__cArray2, 8192, "%s", __cArray);
        snprintf(__cArray3, 8192, "%s", "");
        ReportTableRow(__tableHandle, 0, __cArray2, "==", 0x1, __cArray3, __oneOfFlag, __bSetInCheckAlignment);
        ReportCell(__tableHandle, __tt8msg_0.byte((word)5));
        ReportCellResult(__tableHandle, __csr, __ePassFail);
          __bVerdict &= __csr;
        __csr = CheckSignalMatch(__tt8msg_0.byte((word)6), 0xF4, "==") == 1;
        ReportByteIndex("", 6, __cArray, elCount(__cArray));
        snprintf(__cArray2, 8192, "%s", __cArray);
        snprintf(__cArray3, 8192, "%s", "");
        ReportTableRow(__tableHandle, 0, __cArray2, "==", 0xF4, __cArray3, __oneOfFlag, __bSetInCheckAlignment);
        ReportCell(__tableHandle, __tt8msg_0.byte((word)6));
        ReportCellResult(__tableHandle, __csr, __ePassFail);
          __bVerdict &= __csr;
          ReportTableEndVerdict(__tableHandle, "Resp1", __bVerdict);
        }
        __ReportRequestResponseResult(__res, 0);
      }
      ResetBusContext(__nBusContextNew, __nBusContextOld);
    }
  }
  TestCommandEnd();

}

void Tto7tsimc_Extended_Session_Standard_Physical_Address()
{
  stack long __tableHandle;
  TestCommandBegin(__eRequestResponse, __cRequestResponse, "", "0");
  {
    message `FDCAN2::`DIAGNOSTIC_RESPONSE_PAM __tt8msg_2;
  
    long __res;
    int64 __timeout;
    __res = 0;
    __nInt64 = 1;
    __timeout = syspar::`P2_Server * 1000000LL;
    {
    
      long __testStepInitOk;
      message `FDCAN2::`DIAGNOSTIC_REQUEST_PAM __output;
      message `FDCAN2::`DIAGNOSTIC_REQUEST_PAM __msgOrig;
      __output = __msgOrig;
      __testStepInitOk = 1;
      {
        int64 __dlc;
        __dlc = 3;
        if (__dlc >= 0 && __dlc <= (__output.EDL ? 15 : 8))
          __output.DLC = __dlc;
        else
        {
          testStepErrorInTestSystem(0, __cEmpty, "Unable to set DLC=%lld in message. Please check input parameter.", __dlc);
          __testStepInitOk = 0;
        }
      }
      if (__testStepInitOk)
      {
        snprintf(__cArray, elCount(__cArray), "CAN message '%s' ID = 416981233x (0x18DAA0F1x) on bus FDCAN2", "DIAGNOSTIC_REQUEST_PAM");
        snprintf(__cArray2, elCount(__cArray2), "Send %s", __cArray);
        __tableHandle = ReportTableHead3Columns(__cArray2, "Byte", __cTOp, __cAssigned);
        ReportByteIndex("", 0, __cArray, elCount(__cArray));
        snprintf(__cArray2, 8192, "%s", __cArray);
        snprintf(__cArray3, 8192, "%s", "");
        
        ReportTableRow(__tableHandle, 0, __cArray2, __cAOp, 0x2, __cArray3, __oneOfFlag, __bSetInCheckAlignment);
        
        if (0 >= 0 && 0 < 64)
        {
          __output.byte((word)0) = 0x2;
        }
        else
        {
          testStepErrorInTestSystem(0, __cEmpty, "Index out of range. Unable to set byte %lld in message. Please check input parameter.", (int64)0);
          __testStepInitOk = 0;
        }
        ReportByteIndex("", 1, __cArray, elCount(__cArray));
        snprintf(__cArray2, 8192, "%s", __cArray);
        snprintf(__cArray3, 8192, "%s", "");
        
        ReportTableRow(__tableHandle, 0, __cArray2, __cAOp, 0x10, __cArray3, __oneOfFlag, __bSetInCheckAlignment);
        
        if (1 >= 0 && 1 < 64)
        {
          __output.byte((word)1) = 0x10;
        }
        else
        {
          testStepErrorInTestSystem(0, __cEmpty, "Index out of range. Unable to set byte %lld in message. Please check input parameter.", (int64)1);
          __testStepInitOk = 0;
        }
        ReportByteIndex("", 2, __cArray, elCount(__cArray));
        snprintf(__cArray2, 8192, "%s", __cArray);
        snprintf(__cArray3, 8192, "%s", "");
        
        ReportTableRow(__tableHandle, 0, __cArray2, __cAOp, 0x3, __cArray3, __oneOfFlag, __bSetInCheckAlignment);
        
        if (2 >= 0 && 2 < 64)
        {
          __output.byte((word)2) = 0x3;
        }
        else
        {
          testStepErrorInTestSystem(0, __cEmpty, "Index out of range. Unable to set byte %lld in message. Please check input parameter.", (int64)2);
          __testStepInitOk = 0;
        }
      
        ReportTableEndTestStep(__tableHandle, "Req1");
      }
      if (__testStepInitOk)
      {
        output(__output);
      }
    }
    if (__timeout <= 0)
    {
      testStepErrorInTestSystem(0, "1", "Unable to wait for %.3f %s. Please check input parameter.", __timeout / ((float)1000000), "ms");
    }
    else
    {
      if (0 < 0 || 64 <= 0)
      {
        testStepErrorInTestSystem(0, __cEmpty, "Index out of range. Unable to get byte %lld in message.", (int64) 0);
        __nInt64 = 0;
      }
      if (1 < 0 || 64 <= 1)
      {
        testStepErrorInTestSystem(0, __cEmpty, "Index out of range. Unable to get byte %lld in message.", (int64) 1);
        __nInt64 = 0;
      }
      if (2 < 0 || 64 <= 2)
      {
        testStepErrorInTestSystem(0, __cEmpty, "Index out of range. Unable to get byte %lld in message.", (int64) 2);
        __nInt64 = 0;
      }
      if (3 < 0 || 64 <= 3)
      {
        testStepErrorInTestSystem(0, __cEmpty, "Index out of range. Unable to get byte %lld in message.", (int64) 3);
        __nInt64 = 0;
      }
      if (4 < 0 || 64 <= 4)
      {
        testStepErrorInTestSystem(0, __cEmpty, "Index out of range. Unable to get byte %lld in message.", (int64) 4);
        __nInt64 = 0;
      }
      if (5 < 0 || 64 <= 5)
      {
        testStepErrorInTestSystem(0, __cEmpty, "Index out of range. Unable to get byte %lld in message.", (int64) 5);
        __nInt64 = 0;
      }
      if (6 < 0 || 64 <= 6)
      {
        testStepErrorInTestSystem(0, __cEmpty, "Index out of range. Unable to get byte %lld in message.", (int64) 6);
        __nInt64 = 0;
      }
      __tt8cnt_3 = 0;
      snprintf(__cArray, elCount(__cArray), "CAN message '%s' ID = 417001888x (0x18DAF1A0x) on bus FDCAN2", "DIAGNOSTIC_RESPONSE_PAM");
      if(SetBusContextByName("FDCAN2", __eSaveCurrent, __nBusContextNew, __nBusContextOld))
        testJoinMessageEvent(`FDCAN2::`DIAGNOSTIC_RESPONSE_PAM,  __cArray,
             delegate dword(message * __m)
             {
               dword __msg_callback_ret;
               byte __b0;
               byte __b1;
               byte __b2;
               byte __b3;
               byte __b4;
               byte __b5;
               byte __b6;
               if (__tt8cnt_3 == -1)
               {
                 return 1;
               }
               __tt8msg_2 = __m;
               __msg_callback_ret = 1;
               __tt8cnt_3++;
               if (0 < 0 || 64 <= 0) return 0;
               __csr = CheckSignalMatch(__tt8msg_2.byte((word)0), 0x6, "==") == 1;
               __msg_callback_ret &= __csr;
               if (1 < 0 || 64 <= 1) return 0;
               __csr = CheckSignalMatch(__tt8msg_2.byte((word)1), 0x50, "==") == 1;
               __msg_callback_ret &= __csr;
               if (2 < 0 || 64 <= 2) return 0;
               __csr = CheckSignalMatch(__tt8msg_2.byte((word)2), 0x3, "==") == 1;
               __msg_callback_ret &= __csr;
               if (3 < 0 || 64 <= 3) return 0;
               __csr = CheckSignalMatch(__tt8msg_2.byte((word)3), 0x0, "==") == 1;
               __msg_callback_ret &= __csr;
               if (4 < 0 || 64 <= 4) return 0;
               __csr = CheckSignalMatch(__tt8msg_2.byte((word)4), 0x32, "==") == 1;
               __msg_callback_ret &= __csr;
               if (5 < 0 || 64 <= 5) return 0;
               __csr = CheckSignalMatch(__tt8msg_2.byte((word)5), 0x1, "==") == 1;
               __msg_callback_ret &= __csr;
               if (6 < 0 || 64 <= 6) return 0;
               __csr = CheckSignalMatch(__tt8msg_2.byte((word)6), 0xF4, "==") == 1;
               __msg_callback_ret &= __csr;
               if (__msg_callback_ret)
               {
                 __tt8cnt_3 = -1;
                 return 1;
               }
               return 0;
             });
      __res = testWaitForAllJoinedEventsNS(__timeout);
      if (__nInt64 != 0)
      {
        snprintf(__cArray, elCount(__cArray), "CAN message '%s' ID = 417001888x (0x18DAF1A0x) on bus FDCAN2", "DIAGNOSTIC_RESPONSE_PAM");
        if(__tt8cnt_3 == -1)
        {
          snprintf(__cArray2, 8192, "Response of %s", __cArray);
        snprintf(__cArray, 8192, "%s", __cActual);
        }
        else
        {
          snprintf(__cArray2, 8192, "Response of %s (received %d times)", __cArray, __tt8cnt_3);
          snprintf(__cArray, 8192, "Last Received");
        }
        if (__tt8cnt_3 == 0)
        {
          testStepFail(0, "Resp1", __cArray2);
        }
        else
        {
          byte __b0;
          byte __b1;
          byte __b2;
          byte __b3;
          byte __b4;
          byte __b5;
          byte __b6;
          __bVerdict = __eVerdictPass;
          __tableHandle = ReportTableHead5Columns(__cArray2, "Signal/Byte", __cTOp, __cRefVal, __cArray, __cRes);
        __csr = CheckSignalMatch(__tt8msg_2.byte((word)0), 0x6, "==") == 1;
        ReportByteIndex("", 0, __cArray, elCount(__cArray));
        snprintf(__cArray2, 8192, "%s", __cArray);
        snprintf(__cArray3, 8192, "%s", "");
        ReportTableRow(__tableHandle, 0, __cArray2, "==", 0x6, __cArray3, __oneOfFlag, __bSetInCheckAlignment);
        ReportCell(__tableHandle, __tt8msg_2.byte((word)0));
        ReportCellResult(__tableHandle, __csr, __ePassFail);
          __bVerdict &= __csr;
        __csr = CheckSignalMatch(__tt8msg_2.byte((word)1), 0x50, "==") == 1;
        ReportByteIndex("", 1, __cArray, elCount(__cArray));
        snprintf(__cArray2, 8192, "%s", __cArray);
        snprintf(__cArray3, 8192, "%s", "");
        ReportTableRow(__tableHandle, 0, __cArray2, "==", 0x50, __cArray3, __oneOfFlag, __bSetInCheckAlignment);
        ReportCell(__tableHandle, __tt8msg_2.byte((word)1));
        ReportCellResult(__tableHandle, __csr, __ePassFail);
          __bVerdict &= __csr;
        __csr = CheckSignalMatch(__tt8msg_2.byte((word)2), 0x3, "==") == 1;
        ReportByteIndex("", 2, __cArray, elCount(__cArray));
        snprintf(__cArray2, 8192, "%s", __cArray);
        snprintf(__cArray3, 8192, "%s", "");
        ReportTableRow(__tableHandle, 0, __cArray2, "==", 0x3, __cArray3, __oneOfFlag, __bSetInCheckAlignment);
        ReportCell(__tableHandle, __tt8msg_2.byte((word)2));
        ReportCellResult(__tableHandle, __csr, __ePassFail);
          __bVerdict &= __csr;
        __csr = CheckSignalMatch(__tt8msg_2.byte((word)3), 0x0, "==") == 1;
        ReportByteIndex("", 3, __cArray, elCount(__cArray));
        snprintf(__cArray2, 8192, "%s", __cArray);
        snprintf(__cArray3, 8192, "%s", "");
        ReportTableRow(__tableHandle, 0, __cArray2, "==", 0x0, __cArray3, __oneOfFlag, __bSetInCheckAlignment);
        ReportCell(__tableHandle, __tt8msg_2.byte((word)3));
        ReportCellResult(__tableHandle, __csr, __ePassFail);
          __bVerdict &= __csr;
        __csr = CheckSignalMatch(__tt8msg_2.byte((word)4), 0x32, "==") == 1;
        ReportByteIndex("", 4, __cArray, elCount(__cArray));
        snprintf(__cArray2, 8192, "%s", __cArray);
        snprintf(__cArray3, 8192, "%s", "");
        ReportTableRow(__tableHandle, 0, __cArray2, "==", 0x32, __cArray3, __oneOfFlag, __bSetInCheckAlignment);
        ReportCell(__tableHandle, __tt8msg_2.byte((word)4));
        ReportCellResult(__tableHandle, __csr, __ePassFail);
          __bVerdict &= __csr;
        __csr = CheckSignalMatch(__tt8msg_2.byte((word)5), 0x1, "==") == 1;
        ReportByteIndex("", 5, __cArray, elCount(__cArray));
        snprintf(__cArray2, 8192, "%s", __cArray);
        snprintf(__cArray3, 8192, "%s", "");
        ReportTableRow(__tableHandle, 0, __cArray2, "==", 0x1, __cArray3, __oneOfFlag, __bSetInCheckAlignment);
        ReportCell(__tableHandle, __tt8msg_2.byte((word)5));
        ReportCellResult(__tableHandle, __csr, __ePassFail);
          __bVerdict &= __csr;
        __csr = CheckSignalMatch(__tt8msg_2.byte((word)6), 0xF4, "==") == 1;
        ReportByteIndex("", 6, __cArray, elCount(__cArray));
        snprintf(__cArray2, 8192, "%s", __cArray);
        snprintf(__cArray3, 8192, "%s", "");
        ReportTableRow(__tableHandle, 0, __cArray2, "==", 0xF4, __cArray3, __oneOfFlag, __bSetInCheckAlignment);
        ReportCell(__tableHandle, __tt8msg_2.byte((word)6));
        ReportCellResult(__tableHandle, __csr, __ePassFail);
          __bVerdict &= __csr;
          ReportTableEndVerdict(__tableHandle, "Resp1", __bVerdict);
        }
        __ReportRequestResponseResult(__res, 0);
      }
      ResetBusContext(__nBusContextNew, __nBusContextOld);
    }
  }
  TestCommandEnd();

}

void Tto7tsimc_Programming_Session_Standard_Physical_Address()
{
  stack long __tableHandle;
  TestCommandBegin(__eRequestResponse, __cRequestResponse, "", "0");
  {
  
    long __res;
    int64 __timeout;
    __res = 0;
    __nInt64 = 1;
    __timeout = syspar::`P2_Server * 1000000LL;
    {
    
      long __testStepInitOk;
      message `FDCAN2::`DIAGNOSTIC_REQUEST_PAM __output;
      message `FDCAN2::`DIAGNOSTIC_REQUEST_PAM __msgOrig;
      __output = __msgOrig;
      __testStepInitOk = 1;
      {
        int64 __dlc;
        __dlc = 3;
        if (__dlc >= 0 && __dlc <= (__output.EDL ? 15 : 8))
          __output.DLC = __dlc;
        else
        {
          testStepErrorInTestSystem(0, __cEmpty, "Unable to set DLC=%lld in message. Please check input parameter.", __dlc);
          __testStepInitOk = 0;
        }
      }
      if (__testStepInitOk)
      {
        snprintf(__cArray, elCount(__cArray), "CAN message '%s' ID = 416981233x (0x18DAA0F1x) on bus FDCAN2", "DIAGNOSTIC_REQUEST_PAM");
        snprintf(__cArray2, elCount(__cArray2), "Send %s", __cArray);
        __tableHandle = ReportTableHead3Columns(__cArray2, "Byte", __cTOp, __cAssigned);
        ReportByteIndex("", 0, __cArray, elCount(__cArray));
        snprintf(__cArray2, 8192, "%s", __cArray);
        snprintf(__cArray3, 8192, "%s", "");
        
        ReportTableRow(__tableHandle, 0, __cArray2, __cAOp, 0x2, __cArray3, __oneOfFlag, __bSetInCheckAlignment);
        
        if (0 >= 0 && 0 < 64)
        {
          __output.byte((word)0) = 0x2;
        }
        else
        {
          testStepErrorInTestSystem(0, __cEmpty, "Index out of range. Unable to set byte %lld in message. Please check input parameter.", (int64)0);
          __testStepInitOk = 0;
        }
        ReportByteIndex("", 1, __cArray, elCount(__cArray));
        snprintf(__cArray2, 8192, "%s", __cArray);
        snprintf(__cArray3, 8192, "%s", "");
        
        ReportTableRow(__tableHandle, 0, __cArray2, __cAOp, 0x10, __cArray3, __oneOfFlag, __bSetInCheckAlignment);
        
        if (1 >= 0 && 1 < 64)
        {
          __output.byte((word)1) = 0x10;
        }
        else
        {
          testStepErrorInTestSystem(0, __cEmpty, "Index out of range. Unable to set byte %lld in message. Please check input parameter.", (int64)1);
          __testStepInitOk = 0;
        }
        ReportByteIndex("", 2, __cArray, elCount(__cArray));
        snprintf(__cArray2, 8192, "%s", __cArray);
        snprintf(__cArray3, 8192, "%s", "");
        
        ReportTableRow(__tableHandle, 0, __cArray2, __cAOp, 0x2, __cArray3, __oneOfFlag, __bSetInCheckAlignment);
        
        if (2 >= 0 && 2 < 64)
        {
          __output.byte((word)2) = 0x2;
        }
        else
        {
          testStepErrorInTestSystem(0, __cEmpty, "Index out of range. Unable to set byte %lld in message. Please check input parameter.", (int64)2);
          __testStepInitOk = 0;
        }
      
        ReportTableEndTestStep(__tableHandle, "Req1");
      }
      if (__testStepInitOk)
      {
        output(__output);
      }
    }
    if (__timeout <= 0)
    {
      testStepErrorInTestSystem(0, "1", "Unable to wait for %.3f %s. Please check input parameter.", __timeout / ((float)1000000), "ms");
    }
    else
    {
      __tt8cnt_5 = 0;
      snprintf(__cArray, elCount(__cArray), "CAN message '%s' ID = 417001888x (0x18DAF1A0x) on bus FDCAN2", "DIAGNOSTIC_RESPONSE_PAM");
      if(SetBusContextByName("FDCAN2", __eSaveCurrent, __nBusContextNew, __nBusContextOld))
        testJoinMessageEvent(`FDCAN2::`DIAGNOSTIC_RESPONSE_PAM,  __cArray,
             delegate dword(message * __m)
             {
               dword __msg_callback_ret;
               if (__tt8cnt_5 == -1)
               {
                 return 1;
               }
               __msg_callback_ret = 1;
               __tt8cnt_5++;
               if (__msg_callback_ret)
               {
                 __tt8cnt_5 = -1;
                 return 1;
               }
               return 0;
             });
      __res = testWaitForAllJoinedEventsNS(__timeout);
      if (__nInt64 != 0)
      {
        snprintf(__cArray, elCount(__cArray), "CAN message '%s' ID = 417001888x (0x18DAF1A0x) on bus FDCAN2", "DIAGNOSTIC_RESPONSE_PAM");
        if(__tt8cnt_5 == -1)
        {
          snprintf(__cArray2, 8192, "Response of %s", __cArray);
        }
        else
        {
          snprintf(__cArray2, 8192, "Response of %s (received %d times)", __cArray, __tt8cnt_5);
        }
        if (__tt8cnt_5 == 0)
        {
          testStepFail(0, "Resp1", __cArray2);
        }
        else
        {
          testStepPass(2, "Resp1", __cArray2);
        }
        __ReportRequestResponseResult(__res, 0);
      }
      ResetBusContext(__nBusContextNew, __nBusContextOld);
    }
  }
  TestCommandEnd();

}

void Tto7tsimc_F181_DID_with_Physical_Address()
{
  stack long __tableHandle;
  TestCommandBegin(__eDiagService, __cDiagService, "", "0");
  {
    if (DiagIsFunctionalGroup("CVADAS_0001_00000000_000"))
    {
      DiagResponse * __resp;
      DiagRequest CVADAS_0001_00000000_000._22F181_Application_Software_Identification __req;
      __diagServiceo7tsimc_1(__req, __resp);
    }
    else
    {
      DiagResponse CVADAS_0001_00000000_000.* __resp;
      DiagRequest CVADAS_0001_00000000_000._22F181_Application_Software_Identification __req;
      __diagServiceo7tsimc_1(__req, __resp);
    }
  }
  TestCommandEnd();


}

  
void __diagServiceo7tsimc_1(DiagRequest * __req, DiagResponse * __resp )
{
  stack long __tableHandle;
  long __res, __paramLen, __bytePos;

   __bVerdict = __eVerdictPass;

  do {
    TestReportResetDiagObjectList();
    DiagSetReportDetailLevel("CVADAS_0001_00000000_000", EnumServiceDetails_onfail);
    // Request aspect
    {

      if (0 >= DiagSendReqAndWaitForResp("CVADAS_0001_00000000_000", __req, __resp, __res, -1, -1, -1, -1, -1, EnumResult_pos, EnumServiceDetails_onfail, EnumSendingMode_physical, EnumSuppressPosResBit_asconfigured, EnumVerdictOnInvalidValues_fail))
        break;
    }

    __res = DiagErrCodeTestStep(__res, "Can't retrieve last response for request! No check possible.") < 0;
    if(__res)
    {
	  __bVerdict = __eVerdictFail;
      break;
    }
    {
      __res = DiagInterpretAs(__resp, "RDBI_PR");
      if(__res != 0)
      {
        __bVerdict = __eVerdictFail;
        DiagErrCodeTestStep(__res, "Can't interpret response as diagnostic primitive 'RDBI_PR'.");
        break;
      }
      else
      {
        TestStepPass( "Received primitive can be interpreted as diagnostic primitive 'RDBI_PR'.");
      }
    }
  }
  while(0);


  // Response, check & read aspect
  {
    __res = 1;
    __tableHandle = ReportTableHead5Columns(__cCheckCaption, __cTSym, __cTOp, __cRefVal, __cActual, __cRes);
    {
      __bDiagValueArrayCtr = DiagGetParameterErrorHandled(__resp, "Application_Software_Logical_Block_0_Version_Information_Ident_1", __bDiagValueArray, elcount(__bDiagValueArray), __cDiagValueArray, elcount(__cDiagValueArray));
      {
        __bSetInCheckAlignment = 1;	
        {
          __bArrayCtr = __CopyBytes(__bDiagValueArray, __bDiagValueArrayCtr, __bArray);
          {
            sysvar * __systemVariable;
            __systemVariable = sysvarData::`PartNumber::`Part_Number;
            CheckSysVarSetBufferConsistency(sysSetVariableData(sysvarData::`PartNumber::`Part_Number, __bArray, __bArrayCtr), __systemVariable.name);
          }
          snprintf(__cArray, 8192, "%s", "Part_Number");
          snprintf(__cArray2, 8192, "%s '%s'", __cSysVar, __cArray);
          snprintf(__cArray3, 8192, "%s", "Application_Software_Logical_Block_0_Version_Information_Ident_1");
          
          ReportTableRow(__tableHandle, 0, __cArray2, __cAOp, __bArray, __bArrayCtr, __cArray3, __oneOfFlag, __bSetInCheckAlignment);
        
        }
    
        __bSetInCheckAlignment = 0;
      }
    }
    {
      __bDiagValueArrayCtr = DiagGetParameterErrorHandled(__resp, "Application_Software_Logical_Block_0_Version_Information_Ident_2", __bDiagValueArray, elcount(__bDiagValueArray), __cDiagValueArray, elcount(__cDiagValueArray));
      {
        __bSetInCheckAlignment = 1;	
        {
          __bArrayCtr = __CopyBytes(__bDiagValueArray, __bDiagValueArrayCtr, __bArray);
          {
            sysvar * __systemVariable;
            __systemVariable = sysvarData::`PartNumber::`Part_Number;
            CheckSysVarSetBufferConsistency(sysSetVariableData(sysvarData::`PartNumber::`Part_Number, __bArray, __bArrayCtr), __systemVariable.name);
          }
          snprintf(__cArray, 8192, "%s", "Part_Number");
          snprintf(__cArray2, 8192, "%s '%s'", __cSysVar, __cArray);
          snprintf(__cArray3, 8192, "%s", "Application_Software_Logical_Block_0_Version_Information_Ident_2");
          
          ReportTableRow(__tableHandle, 0, __cArray2, __cAOp, __bArray, __bArrayCtr, __cArray3, __oneOfFlag, __bSetInCheckAlignment);
        
        }
    
        __bSetInCheckAlignment = 0;
      }
    }
    {
      __bDiagValueArrayCtr = DiagGetParameterErrorHandled(__resp, "Application_Software_Logical_Block_0_Version_Information_Patch_1", __bDiagValueArray, elcount(__bDiagValueArray), __cDiagValueArray, elcount(__cDiagValueArray));
      {
        __bSetInCheckAlignment = 1;	
        {
          __bArrayCtr = __CopyBytes(__bDiagValueArray, __bDiagValueArrayCtr, __bArray);
          {
            sysvar * __systemVariable;
            __systemVariable = sysvarData::`PartNumber::`Part_Number;
            CheckSysVarSetBufferConsistency(sysSetVariableData(sysvarData::`PartNumber::`Part_Number, __bArray, __bArrayCtr), __systemVariable.name);
          }
          snprintf(__cArray, 8192, "%s", "Part_Number");
          snprintf(__cArray2, 8192, "%s '%s'", __cSysVar, __cArray);
          snprintf(__cArray3, 8192, "%s", "Application_Software_Logical_Block_0_Version_Information_Patch_1");
          
          ReportTableRow(__tableHandle, 0, __cArray2, __cAOp, __bArray, __bArrayCtr, __cArray3, __oneOfFlag, __bSetInCheckAlignment);
        
        }
    
        __bSetInCheckAlignment = 0;
      }
    }
    {
      __bDiagValueArrayCtr = DiagGetParameterErrorHandled(__resp, "Application_Software_Logical_Block_0_Version_Information_Patch_2", __bDiagValueArray, elcount(__bDiagValueArray), __cDiagValueArray, elcount(__cDiagValueArray));
      {
        __bSetInCheckAlignment = 1;	
        {
          __bArrayCtr = __CopyBytes(__bDiagValueArray, __bDiagValueArrayCtr, __bArray);
          {
            sysvar * __systemVariable;
            __systemVariable = sysvarData::`PartNumber::`Part_Number;
            CheckSysVarSetBufferConsistency(sysSetVariableData(sysvarData::`PartNumber::`Part_Number, __bArray, __bArrayCtr), __systemVariable.name);
          }
          snprintf(__cArray, 8192, "%s", "Part_Number");
          snprintf(__cArray2, 8192, "%s '%s'", __cSysVar, __cArray);
          snprintf(__cArray3, 8192, "%s", "Application_Software_Logical_Block_0_Version_Information_Patch_2");
          
          ReportTableRow(__tableHandle, 0, __cArray2, __cAOp, __bArray, __bArrayCtr, __cArray3, __oneOfFlag, __bSetInCheckAlignment);
        
        }
    
        __bSetInCheckAlignment = 0;
      }
    }
    {
      __bDiagValueArrayCtr = DiagGetParameterErrorHandled(__resp, "Application_Software_Logical_Block_2_Week", __bDiagValueArray, elcount(__bDiagValueArray), __cDiagValueArray, elcount(__cDiagValueArray));
      {
        __bSetInCheckAlignment = 1;	
        {
          __bArrayCtr = __CopyBytes(__bDiagValueArray, __bDiagValueArrayCtr, __bArray);
          {
            sysvar * __systemVariable;
            __systemVariable = sysvarData::`PartNumber::`Part_Number;
            CheckSysVarSetBufferConsistency(sysSetVariableData(sysvarData::`PartNumber::`Part_Number, __bArray, __bArrayCtr), __systemVariable.name);
          }
          snprintf(__cArray, 8192, "%s", "Part_Number");
          snprintf(__cArray2, 8192, "%s '%s'", __cSysVar, __cArray);
          snprintf(__cArray3, 8192, "%s", "Application_Software_Logical_Block_2_Week");
          
          ReportTableRow(__tableHandle, 0, __cArray2, __cAOp, __bArray, __bArrayCtr, __cArray3, __oneOfFlag, __bSetInCheckAlignment);
        
        }
    
        __bSetInCheckAlignment = 0;
      }
    }
    {
      __bDiagValueArrayCtr = DiagGetParameterErrorHandled(__resp, "Application_Software_Logical_Block_2_Year", __bDiagValueArray, elcount(__bDiagValueArray), __cDiagValueArray, elcount(__cDiagValueArray));
      {
        __bSetInCheckAlignment = 1;	
        {
          __bArrayCtr = __CopyBytes(__bDiagValueArray, __bDiagValueArrayCtr, __bArray);
          {
            sysvar * __systemVariable;
            __systemVariable = sysvarData::`PartNumber::`Part_Number;
            CheckSysVarSetBufferConsistency(sysSetVariableData(sysvarData::`PartNumber::`Part_Number, __bArray, __bArrayCtr), __systemVariable.name);
          }
          snprintf(__cArray, 8192, "%s", "Part_Number");
          snprintf(__cArray2, 8192, "%s '%s'", __cSysVar, __cArray);
          snprintf(__cArray3, 8192, "%s", "Application_Software_Logical_Block_2_Year");
          
          ReportTableRow(__tableHandle, 0, __cArray2, __cAOp, __bArray, __bArrayCtr, __cArray3, __oneOfFlag, __bSetInCheckAlignment);
        
        }
    
        __bSetInCheckAlignment = 0;
      }
    }
    {
      __bDiagValueArrayCtr = DiagGetParameterErrorHandled(__resp, "Application_Software_Logical_Block_3_Week", __bDiagValueArray, elcount(__bDiagValueArray), __cDiagValueArray, elcount(__cDiagValueArray));
      {
        __bSetInCheckAlignment = 1;	
        {
          __bArrayCtr = __CopyBytes(__bDiagValueArray, __bDiagValueArrayCtr, __bArray);
          {
            sysvar * __systemVariable;
            __systemVariable = sysvarData::`PartNumber::`Part_Number;
            CheckSysVarSetBufferConsistency(sysSetVariableData(sysvarData::`PartNumber::`Part_Number, __bArray, __bArrayCtr), __systemVariable.name);
          }
          snprintf(__cArray, 8192, "%s", "Part_Number");
          snprintf(__cArray2, 8192, "%s '%s'", __cSysVar, __cArray);
          snprintf(__cArray3, 8192, "%s", "Application_Software_Logical_Block_3_Week");
          
          ReportTableRow(__tableHandle, 0, __cArray2, __cAOp, __bArray, __bArrayCtr, __cArray3, __oneOfFlag, __bSetInCheckAlignment);
        
        }
    
        __bSetInCheckAlignment = 0;
      }
    }
    {
      __bDiagValueArrayCtr = DiagGetParameterErrorHandled(__resp, "Application_Software_Logical_Block_3_Year", __bDiagValueArray, elcount(__bDiagValueArray), __cDiagValueArray, elcount(__cDiagValueArray));
      {
        __bSetInCheckAlignment = 1;	
        {
          __bArrayCtr = __CopyBytes(__bDiagValueArray, __bDiagValueArrayCtr, __bArray);
          {
            sysvar * __systemVariable;
            __systemVariable = sysvarData::`PartNumber::`Part_Number;
            CheckSysVarSetBufferConsistency(sysSetVariableData(sysvarData::`PartNumber::`Part_Number, __bArray, __bArrayCtr), __systemVariable.name);
          }
          snprintf(__cArray, 8192, "%s", "Part_Number");
          snprintf(__cArray2, 8192, "%s '%s'", __cSysVar, __cArray);
          snprintf(__cArray3, 8192, "%s", "Application_Software_Logical_Block_3_Year");
          
          ReportTableRow(__tableHandle, 0, __cArray2, __cAOp, __bArray, __bArrayCtr, __cArray3, __oneOfFlag, __bSetInCheckAlignment);
        
        }
    
        __bSetInCheckAlignment = 0;
      }
    }
    {
      __bDiagValueArrayCtr = DiagGetParameterErrorHandled(__resp, "Application_Software_Logical_Block_4_Identification", __bDiagValueArray, elcount(__bDiagValueArray), __cDiagValueArray, elcount(__cDiagValueArray));
      {
        __bSetInCheckAlignment = 1;	
        {
          __bArrayCtr = __CopyBytes(__bDiagValueArray, __bDiagValueArrayCtr, __bArray);
          {
            sysvar * __systemVariable;
            __systemVariable = sysvarData::`PartNumber::`Part_Number;
            CheckSysVarSetBufferConsistency(sysSetVariableData(sysvarData::`PartNumber::`Part_Number, __bArray, __bArrayCtr), __systemVariable.name);
          }
          snprintf(__cArray, 8192, "%s", "Part_Number");
          snprintf(__cArray2, 8192, "%s '%s'", __cSysVar, __cArray);
          snprintf(__cArray3, 8192, "%s", "Application_Software_Logical_Block_4_Identification");
          
          ReportTableRow(__tableHandle, 0, __cArray2, __cAOp, __bArray, __bArrayCtr, __cArray3, __oneOfFlag, __bSetInCheckAlignment);
        
        }
    
        __bSetInCheckAlignment = 0;
      }
    }
    {
      __bDiagValueArrayCtr = DiagGetParameterErrorHandled(__resp, "Application_Software_Logical_Block_4_Patch_Level", __bDiagValueArray, elcount(__bDiagValueArray), __cDiagValueArray, elcount(__cDiagValueArray));
      {
        __bSetInCheckAlignment = 1;	
        {
          __bArrayCtr = __CopyBytes(__bDiagValueArray, __bDiagValueArrayCtr, __bArray);
          {
            sysvar * __systemVariable;
            __systemVariable = sysvarData::`PartNumber::`Part_Number;
            CheckSysVarSetBufferConsistency(sysSetVariableData(sysvarData::`PartNumber::`Part_Number, __bArray, __bArrayCtr), __systemVariable.name);
          }
          snprintf(__cArray, 8192, "%s", "Part_Number");
          snprintf(__cArray2, 8192, "%s '%s'", __cSysVar, __cArray);
          snprintf(__cArray3, 8192, "%s", "Application_Software_Logical_Block_4_Patch_Level");
          
          ReportTableRow(__tableHandle, 0, __cArray2, __cAOp, __bArray, __bArrayCtr, __cArray3, __oneOfFlag, __bSetInCheckAlignment);
        
        }
    
        __bSetInCheckAlignment = 0;
      }
    }
    {
      __bDiagValueArrayCtr = DiagGetParameterErrorHandled(__resp, "Application_Software_Logical_Block_4_Week", __bDiagValueArray, elcount(__bDiagValueArray), __cDiagValueArray, elcount(__cDiagValueArray));
      {
        __bSetInCheckAlignment = 1;	
        {
          __bArrayCtr = __CopyBytes(__bDiagValueArray, __bDiagValueArrayCtr, __bArray);
          {
            sysvar * __systemVariable;
            __systemVariable = sysvarData::`PartNumber::`Part_Number;
            CheckSysVarSetBufferConsistency(sysSetVariableData(sysvarData::`PartNumber::`Part_Number, __bArray, __bArrayCtr), __systemVariable.name);
          }
          snprintf(__cArray, 8192, "%s", "Part_Number");
          snprintf(__cArray2, 8192, "%s '%s'", __cSysVar, __cArray);
          snprintf(__cArray3, 8192, "%s", "Application_Software_Logical_Block_4_Week");
          
          ReportTableRow(__tableHandle, 0, __cArray2, __cAOp, __bArray, __bArrayCtr, __cArray3, __oneOfFlag, __bSetInCheckAlignment);
        
        }
    
        __bSetInCheckAlignment = 0;
      }
    }
    {
      __bDiagValueArrayCtr = DiagGetParameterErrorHandled(__resp, "Application_Software_Logical_Block_4_Year", __bDiagValueArray, elcount(__bDiagValueArray), __cDiagValueArray, elcount(__cDiagValueArray));
      {
        __bSetInCheckAlignment = 1;	
        {
          __bArrayCtr = __CopyBytes(__bDiagValueArray, __bDiagValueArrayCtr, __bArray);
          {
            sysvar * __systemVariable;
            __systemVariable = sysvarData::`PartNumber::`Part_Number;
            CheckSysVarSetBufferConsistency(sysSetVariableData(sysvarData::`PartNumber::`Part_Number, __bArray, __bArrayCtr), __systemVariable.name);
          }
          snprintf(__cArray, 8192, "%s", "Part_Number");
          snprintf(__cArray2, 8192, "%s '%s'", __cSysVar, __cArray);
          snprintf(__cArray3, 8192, "%s", "Application_Software_Logical_Block_4_Year");
          
          ReportTableRow(__tableHandle, 0, __cArray2, __cAOp, __bArray, __bArrayCtr, __cArray3, __oneOfFlag, __bSetInCheckAlignment);
        
        }
    
        __bSetInCheckAlignment = 0;
      }
    }
    {
      __bDiagValueArrayCtr = DiagGetParameterErrorHandled(__resp, "Application_Software_Logical_Block_5_Identification", __bDiagValueArray, elcount(__bDiagValueArray), __cDiagValueArray, elcount(__cDiagValueArray));
      {
        __bSetInCheckAlignment = 1;	
        {
          __bArrayCtr = __CopyBytes(__bDiagValueArray, __bDiagValueArrayCtr, __bArray);
          {
            sysvar * __systemVariable;
            __systemVariable = sysvarData::`PartNumber::`Part_Number;
            CheckSysVarSetBufferConsistency(sysSetVariableData(sysvarData::`PartNumber::`Part_Number, __bArray, __bArrayCtr), __systemVariable.name);
          }
          snprintf(__cArray, 8192, "%s", "Part_Number");
          snprintf(__cArray2, 8192, "%s '%s'", __cSysVar, __cArray);
          snprintf(__cArray3, 8192, "%s", "Application_Software_Logical_Block_5_Identification");
          
          ReportTableRow(__tableHandle, 0, __cArray2, __cAOp, __bArray, __bArrayCtr, __cArray3, __oneOfFlag, __bSetInCheckAlignment);
        
        }
    
        __bSetInCheckAlignment = 0;
      }
    }
    {
      __bDiagValueArrayCtr = DiagGetParameterErrorHandled(__resp, "Application_Software_Logical_Block_5_Patch_Level", __bDiagValueArray, elcount(__bDiagValueArray), __cDiagValueArray, elcount(__cDiagValueArray));
      {
        __bSetInCheckAlignment = 1;	
        {
          __bArrayCtr = __CopyBytes(__bDiagValueArray, __bDiagValueArrayCtr, __bArray);
          {
            sysvar * __systemVariable;
            __systemVariable = sysvarData::`PartNumber::`Part_Number;
            CheckSysVarSetBufferConsistency(sysSetVariableData(sysvarData::`PartNumber::`Part_Number, __bArray, __bArrayCtr), __systemVariable.name);
          }
          snprintf(__cArray, 8192, "%s", "Part_Number");
          snprintf(__cArray2, 8192, "%s '%s'", __cSysVar, __cArray);
          snprintf(__cArray3, 8192, "%s", "Application_Software_Logical_Block_5_Patch_Level");
          
          ReportTableRow(__tableHandle, 0, __cArray2, __cAOp, __bArray, __bArrayCtr, __cArray3, __oneOfFlag, __bSetInCheckAlignment);
        
        }
    
        __bSetInCheckAlignment = 0;
      }
    }
    {
      __bDiagValueArrayCtr = DiagGetParameterErrorHandled(__resp, "Application_Software_Logical_Block_5_Week", __bDiagValueArray, elcount(__bDiagValueArray), __cDiagValueArray, elcount(__cDiagValueArray));
      {
        __bSetInCheckAlignment = 1;	
        {
          __bArrayCtr = __CopyBytes(__bDiagValueArray, __bDiagValueArrayCtr, __bArray);
          {
            sysvar * __systemVariable;
            __systemVariable = sysvarData::`PartNumber::`Part_Number;
            CheckSysVarSetBufferConsistency(sysSetVariableData(sysvarData::`PartNumber::`Part_Number, __bArray, __bArrayCtr), __systemVariable.name);
          }
          snprintf(__cArray, 8192, "%s", "Part_Number");
          snprintf(__cArray2, 8192, "%s '%s'", __cSysVar, __cArray);
          snprintf(__cArray3, 8192, "%s", "Application_Software_Logical_Block_5_Week");
          
          ReportTableRow(__tableHandle, 0, __cArray2, __cAOp, __bArray, __bArrayCtr, __cArray3, __oneOfFlag, __bSetInCheckAlignment);
        
        }
    
        __bSetInCheckAlignment = 0;
      }
    }
    {
      __bDiagValueArrayCtr = DiagGetParameterErrorHandled(__resp, "Application_Software_Logical_Block_5_Year", __bDiagValueArray, elcount(__bDiagValueArray), __cDiagValueArray, elcount(__cDiagValueArray));
      {
        __bSetInCheckAlignment = 1;	
        {
          __bArrayCtr = __CopyBytes(__bDiagValueArray, __bDiagValueArrayCtr, __bArray);
          {
            sysvar * __systemVariable;
            __systemVariable = sysvarData::`PartNumber::`Part_Number;
            CheckSysVarSetBufferConsistency(sysSetVariableData(sysvarData::`PartNumber::`Part_Number, __bArray, __bArrayCtr), __systemVariable.name);
          }
          snprintf(__cArray, 8192, "%s", "Part_Number");
          snprintf(__cArray2, 8192, "%s '%s'", __cSysVar, __cArray);
          snprintf(__cArray3, 8192, "%s", "Application_Software_Logical_Block_5_Year");
          
          ReportTableRow(__tableHandle, 0, __cArray2, __cAOp, __bArray, __bArrayCtr, __cArray3, __oneOfFlag, __bSetInCheckAlignment);
        
        }
    
        __bSetInCheckAlignment = 0;
      }
    }
    {
      __bDiagValueArrayCtr = DiagGetParameterErrorHandled(__resp, "_Application_Software_Logical_Block_1_Version_Information__Iden", __bDiagValueArray, elcount(__bDiagValueArray), __cDiagValueArray, elcount(__cDiagValueArray));
      {
        __bSetInCheckAlignment = 1;	
        {
          __bArrayCtr = __CopyBytes(__bDiagValueArray, __bDiagValueArrayCtr, __bArray);
          {
            sysvar * __systemVariable;
            __systemVariable = sysvarData::`PartNumber::`Part_Number;
            CheckSysVarSetBufferConsistency(sysSetVariableData(sysvarData::`PartNumber::`Part_Number, __bArray, __bArrayCtr), __systemVariable.name);
          }
          snprintf(__cArray, 8192, "%s", "Part_Number");
          snprintf(__cArray2, 8192, "%s '%s'", __cSysVar, __cArray);
          snprintf(__cArray3, 8192, "%s", "_Application_Software_Logical_Block_1_Version_Information__Iden");
          
          ReportTableRow(__tableHandle, 0, __cArray2, __cAOp, __bArray, __bArrayCtr, __cArray3, __oneOfFlag, __bSetInCheckAlignment);
        
        }
    
        __bSetInCheckAlignment = 0;
      }
    }
    {
      __bDiagValueArrayCtr = DiagGetParameterErrorHandled(__resp, "_Application_Software_Logical_Block_1_Version_Information__Patc", __bDiagValueArray, elcount(__bDiagValueArray), __cDiagValueArray, elcount(__cDiagValueArray));
      {
        __bSetInCheckAlignment = 1;	
        {
          __bArrayCtr = __CopyBytes(__bDiagValueArray, __bDiagValueArrayCtr, __bArray);
          {
            sysvar * __systemVariable;
            __systemVariable = sysvarData::`PartNumber::`Part_Number;
            CheckSysVarSetBufferConsistency(sysSetVariableData(sysvarData::`PartNumber::`Part_Number, __bArray, __bArrayCtr), __systemVariable.name);
          }
          snprintf(__cArray, 8192, "%s", "Part_Number");
          snprintf(__cArray2, 8192, "%s '%s'", __cSysVar, __cArray);
          snprintf(__cArray3, 8192, "%s", "_Application_Software_Logical_Block_1_Version_Information__Patc");
          
          ReportTableRow(__tableHandle, 0, __cArray2, __cAOp, __bArray, __bArrayCtr, __cArray3, __oneOfFlag, __bSetInCheckAlignment);
        
        }
    
        __bSetInCheckAlignment = 0;
      }
    }
    {
      __bDiagValueArrayCtr = DiagGetParameterErrorHandled(__resp, "_Application_Software_Logical_Block_1_Version_Information__Week", __bDiagValueArray, elcount(__bDiagValueArray), __cDiagValueArray, elcount(__cDiagValueArray));
      {
        __bSetInCheckAlignment = 1;	
        {
          __bArrayCtr = __CopyBytes(__bDiagValueArray, __bDiagValueArrayCtr, __bArray);
          {
            sysvar * __systemVariable;
            __systemVariable = sysvarData::`PartNumber::`Part_Number;
            CheckSysVarSetBufferConsistency(sysSetVariableData(sysvarData::`PartNumber::`Part_Number, __bArray, __bArrayCtr), __systemVariable.name);
          }
          snprintf(__cArray, 8192, "%s", "Part_Number");
          snprintf(__cArray2, 8192, "%s '%s'", __cSysVar, __cArray);
          snprintf(__cArray3, 8192, "%s", "_Application_Software_Logical_Block_1_Version_Information__Week");
          
          ReportTableRow(__tableHandle, 0, __cArray2, __cAOp, __bArray, __bArrayCtr, __cArray3, __oneOfFlag, __bSetInCheckAlignment);
        
        }
    
        __bSetInCheckAlignment = 0;
      }
    }
    {
      __bDiagValueArrayCtr = DiagGetParameterErrorHandled(__resp, "_Application_Software_Logical_Block_1_Version_Information__Year", __bDiagValueArray, elcount(__bDiagValueArray), __cDiagValueArray, elcount(__cDiagValueArray));
      {
        __bSetInCheckAlignment = 1;	
        {
          __bArrayCtr = __CopyBytes(__bDiagValueArray, __bDiagValueArrayCtr, __bArray);
          {
            sysvar * __systemVariable;
            __systemVariable = sysvarData::`PartNumber::`Part_Number;
            CheckSysVarSetBufferConsistency(sysSetVariableData(sysvarData::`PartNumber::`Part_Number, __bArray, __bArrayCtr), __systemVariable.name);
          }
          snprintf(__cArray, 8192, "%s", "Part_Number");
          snprintf(__cArray2, 8192, "%s '%s'", __cSysVar, __cArray);
          snprintf(__cArray3, 8192, "%s", "_Application_Software_Logical_Block_1_Version_Information__Year");
          
          ReportTableRow(__tableHandle, 0, __cArray2, __cAOp, __bArray, __bArrayCtr, __cArray3, __oneOfFlag, __bSetInCheckAlignment);
        
        }
    
        __bSetInCheckAlignment = 0;
      }
    }
    ReportTableEndVerdict(__tableHandle, __cEvaluateResponse, __res);
	__bVerdict = __bVerdict && __res;
  }
  if (__bVerdict == __eVerdictFail)
    TestReportWriteDiagObjectList();
}

void Tto7tsimc_F181_DID_with_Standard_Physical_Address()
{
  stack long __tableHandle;
  TestCommandBegin(__eRequestResponse, __cRequestResponse, "", "0");
  {
  
    long __res;
    int64 __timeout;
    __res = 0;
    __nInt64 = 1;
    __timeout = syspar::`P2_Server * 1000000LL;
    {
    
      long __testStepInitOk;
      message `FDCAN2::`DIAGNOSTIC_REQUEST_PAM __output;
      message `FDCAN2::`DIAGNOSTIC_REQUEST_PAM __msgOrig;
      __output = __msgOrig;
      __testStepInitOk = 1;
      {
        int64 __dlc;
        __dlc = 4;
        if (__dlc >= 0 && __dlc <= (__output.EDL ? 15 : 8))
          __output.DLC = __dlc;
        else
        {
          testStepErrorInTestSystem(0, __cEmpty, "Unable to set DLC=%lld in message. Please check input parameter.", __dlc);
          __testStepInitOk = 0;
        }
      }
      if (__testStepInitOk)
      {
        snprintf(__cArray, elCount(__cArray), "CAN message '%s' ID = 416981233x (0x18DAA0F1x) on bus FDCAN2", "DIAGNOSTIC_REQUEST_PAM");
        snprintf(__cArray2, elCount(__cArray2), "Send %s", __cArray);
        __tableHandle = ReportTableHead3Columns(__cArray2, "Byte", __cTOp, __cAssigned);
        ReportByteIndex("", 0, __cArray, elCount(__cArray));
        snprintf(__cArray2, 8192, "%s", __cArray);
        snprintf(__cArray3, 8192, "%s", "");
        
        ReportTableRow(__tableHandle, 0, __cArray2, __cAOp, 0x3, __cArray3, __oneOfFlag, __bSetInCheckAlignment);
        
        if (0 >= 0 && 0 < 64)
        {
          __output.byte((word)0) = 0x3;
        }
        else
        {
          testStepErrorInTestSystem(0, __cEmpty, "Index out of range. Unable to set byte %lld in message. Please check input parameter.", (int64)0);
          __testStepInitOk = 0;
        }
        ReportByteIndex("", 1, __cArray, elCount(__cArray));
        snprintf(__cArray2, 8192, "%s", __cArray);
        snprintf(__cArray3, 8192, "%s", "");
        
        ReportTableRow(__tableHandle, 0, __cArray2, __cAOp, 0x22, __cArray3, __oneOfFlag, __bSetInCheckAlignment);
        
        if (1 >= 0 && 1 < 64)
        {
          __output.byte((word)1) = 0x22;
        }
        else
        {
          testStepErrorInTestSystem(0, __cEmpty, "Index out of range. Unable to set byte %lld in message. Please check input parameter.", (int64)1);
          __testStepInitOk = 0;
        }
        ReportByteIndex("", 2, __cArray, elCount(__cArray));
        snprintf(__cArray2, 8192, "%s", __cArray);
        snprintf(__cArray3, 8192, "%s", "");
        
        ReportTableRow(__tableHandle, 0, __cArray2, __cAOp, 0xF1, __cArray3, __oneOfFlag, __bSetInCheckAlignment);
        
        if (2 >= 0 && 2 < 64)
        {
          __output.byte((word)2) = 0xF1;
        }
        else
        {
          testStepErrorInTestSystem(0, __cEmpty, "Index out of range. Unable to set byte %lld in message. Please check input parameter.", (int64)2);
          __testStepInitOk = 0;
        }
        ReportByteIndex("", 3, __cArray, elCount(__cArray));
        snprintf(__cArray2, 8192, "%s", __cArray);
        snprintf(__cArray3, 8192, "%s", "");
        
        ReportTableRow(__tableHandle, 0, __cArray2, __cAOp, 0x81, __cArray3, __oneOfFlag, __bSetInCheckAlignment);
        
        if (3 >= 0 && 3 < 64)
        {
          __output.byte((word)3) = 0x81;
        }
        else
        {
          testStepErrorInTestSystem(0, __cEmpty, "Index out of range. Unable to set byte %lld in message. Please check input parameter.", (int64)3);
          __testStepInitOk = 0;
        }
      
        ReportTableEndTestStep(__tableHandle, "Req1");
      }
      if (__testStepInitOk)
      {
        output(__output);
      }
    }
    if (__timeout <= 0)
    {
      testStepErrorInTestSystem(0, "1", "Unable to wait for %.3f %s. Please check input parameter.", __timeout / ((float)1000000), "ms");
    }
    else
    {
      __tt8cnt_7 = 0;
      snprintf(__cArray, elCount(__cArray), "CAN message '%s' ID = 417001888x (0x18DAF1A0x) on bus FDCAN2", "DIAGNOSTIC_RESPONSE_PAM");
      if(SetBusContextByName("FDCAN2", __eSaveCurrent, __nBusContextNew, __nBusContextOld))
        testJoinMessageEvent(`FDCAN2::`DIAGNOSTIC_RESPONSE_PAM,  __cArray,
             delegate dword(message * __m)
             {
               dword __msg_callback_ret;
               if (__tt8cnt_7 == -1)
               {
                 return 1;
               }
               __msg_callback_ret = 1;
               __tt8cnt_7++;
               if (__msg_callback_ret)
               {
                 __tt8cnt_7 = -1;
                 return 1;
               }
               return 0;
             });
      __res = testWaitForAllJoinedEventsNS(__timeout);
      if (__nInt64 != 0)
      {
        snprintf(__cArray, elCount(__cArray), "CAN message '%s' ID = 417001888x (0x18DAF1A0x) on bus FDCAN2", "DIAGNOSTIC_RESPONSE_PAM");
        if(__tt8cnt_7 == -1)
        {
          snprintf(__cArray2, 8192, "Response of %s", __cArray);
        }
        else
        {
          snprintf(__cArray2, 8192, "Response of %s (received %d times)", __cArray, __tt8cnt_7);
        }
        if (__tt8cnt_7 == 0)
        {
          testStepFail(0, "Resp1", __cArray2);
        }
        else
        {
          testStepPass(2, "Resp1", __cArray2);
        }
        __ReportRequestResponseResult(__res, 0);
      }
      ResetBusContext(__nBusContextNew, __nBusContextOld);
    }
  }
  TestCommandEnd();

}

void Tto7tsimc_F181_DID_with_Functional_Address()
{
  stack long __tableHandle;
  TestCommandBegin(__eDiagService, __cDiagService, "", "0");
  {
    if (DiagIsFunctionalGroup("CVADAS_0001_00000000_000"))
    {
      DiagResponse * __resp;
      DiagRequest CVADAS_0001_00000000_000._22F181_Application_Software_Identification __req;
      __diagServiceo7tsimc_2(__req, __resp);
    }
    else
    {
      DiagResponse CVADAS_0001_00000000_000.* __resp;
      DiagRequest CVADAS_0001_00000000_000._22F181_Application_Software_Identification __req;
      __diagServiceo7tsimc_2(__req, __resp);
    }
  }
  TestCommandEnd();


}

  
void __diagServiceo7tsimc_2(DiagRequest * __req, DiagResponse * __resp )
{
  stack long __tableHandle;
  long __res, __paramLen, __bytePos;

   __bVerdict = __eVerdictPass;

  do {
    TestReportResetDiagObjectList();
    DiagSetReportDetailLevel("CVADAS_0001_00000000_000", EnumServiceDetails_onfail);
    // Request aspect
    {

      if (0 >= DiagSendReqAndWaitForResp("CVADAS_0001_00000000_000", __req, __resp, __res, -1, -1, -1, -1, -1, EnumResult_pos, EnumServiceDetails_onfail, EnumSendingMode_physical, EnumSuppressPosResBit_asconfigured, EnumVerdictOnInvalidValues_fail))
        break;
    }

    __res = DiagErrCodeTestStep(__res, "Can't retrieve last response for request! No check possible.") < 0;
    if(__res)
    {
	  __bVerdict = __eVerdictFail;
      break;
    }
    {
      __res = DiagInterpretAs(__resp, "RDBI_PR");
      if(__res != 0)
      {
        __bVerdict = __eVerdictFail;
        DiagErrCodeTestStep(__res, "Can't interpret response as diagnostic primitive 'RDBI_PR'.");
        break;
      }
      else
      {
        TestStepPass( "Received primitive can be interpreted as diagnostic primitive 'RDBI_PR'.");
      }
    }
  }
  while(0);


  // Response, check & read aspect
  {
    __res = 1;
    __tableHandle = ReportTableHead5Columns(__cCheckCaption, __cTSym, __cTOp, __cRefVal, __cActual, __cRes);
    {
      __bDiagValueArrayCtr = DiagGetParameterErrorHandled(__resp, "Application_Software_Logical_Block_0_Version_Information_Ident_1", __bDiagValueArray, elcount(__bDiagValueArray), __cDiagValueArray, elcount(__cDiagValueArray));
      {
        __bSetInCheckAlignment = 1;	
        {
          __bArrayCtr = __CopyBytes(__bDiagValueArray, __bDiagValueArrayCtr, __bArray);
          {
            sysvar * __systemVariable;
            __systemVariable = sysvarData::`PartNumber::`Part_Number;
            CheckSysVarSetBufferConsistency(sysSetVariableData(sysvarData::`PartNumber::`Part_Number, __bArray, __bArrayCtr), __systemVariable.name);
          }
          snprintf(__cArray, 8192, "%s", "Part_Number");
          snprintf(__cArray2, 8192, "%s '%s'", __cSysVar, __cArray);
          snprintf(__cArray3, 8192, "%s", "Application_Software_Logical_Block_0_Version_Information_Ident_1");
          
          ReportTableRow(__tableHandle, 0, __cArray2, __cAOp, __bArray, __bArrayCtr, __cArray3, __oneOfFlag, __bSetInCheckAlignment);
        
        }
    
        __bSetInCheckAlignment = 0;
      }
    }
    {
      __bDiagValueArrayCtr = DiagGetParameterErrorHandled(__resp, "Application_Software_Logical_Block_0_Version_Information_Ident_2", __bDiagValueArray, elcount(__bDiagValueArray), __cDiagValueArray, elcount(__cDiagValueArray));
      {
        __bSetInCheckAlignment = 1;	
        {
          __bArrayCtr = __CopyBytes(__bDiagValueArray, __bDiagValueArrayCtr, __bArray);
          {
            sysvar * __systemVariable;
            __systemVariable = sysvarData::`PartNumber::`Part_Number;
            CheckSysVarSetBufferConsistency(sysSetVariableData(sysvarData::`PartNumber::`Part_Number, __bArray, __bArrayCtr), __systemVariable.name);
          }
          snprintf(__cArray, 8192, "%s", "Part_Number");
          snprintf(__cArray2, 8192, "%s '%s'", __cSysVar, __cArray);
          snprintf(__cArray3, 8192, "%s", "Application_Software_Logical_Block_0_Version_Information_Ident_2");
          
          ReportTableRow(__tableHandle, 0, __cArray2, __cAOp, __bArray, __bArrayCtr, __cArray3, __oneOfFlag, __bSetInCheckAlignment);
        
        }
    
        __bSetInCheckAlignment = 0;
      }
    }
    {
      __bDiagValueArrayCtr = DiagGetParameterErrorHandled(__resp, "Application_Software_Logical_Block_0_Version_Information_Patch_1", __bDiagValueArray, elcount(__bDiagValueArray), __cDiagValueArray, elcount(__cDiagValueArray));
      {
        __bSetInCheckAlignment = 1;	
        {
          __bArrayCtr = __CopyBytes(__bDiagValueArray, __bDiagValueArrayCtr, __bArray);
          {
            sysvar * __systemVariable;
            __systemVariable = sysvarData::`PartNumber::`Part_Number;
            CheckSysVarSetBufferConsistency(sysSetVariableData(sysvarData::`PartNumber::`Part_Number, __bArray, __bArrayCtr), __systemVariable.name);
          }
          snprintf(__cArray, 8192, "%s", "Part_Number");
          snprintf(__cArray2, 8192, "%s '%s'", __cSysVar, __cArray);
          snprintf(__cArray3, 8192, "%s", "Application_Software_Logical_Block_0_Version_Information_Patch_1");
          
          ReportTableRow(__tableHandle, 0, __cArray2, __cAOp, __bArray, __bArrayCtr, __cArray3, __oneOfFlag, __bSetInCheckAlignment);
        
        }
    
        __bSetInCheckAlignment = 0;
      }
    }
    {
      __bDiagValueArrayCtr = DiagGetParameterErrorHandled(__resp, "Application_Software_Logical_Block_0_Version_Information_Patch_2", __bDiagValueArray, elcount(__bDiagValueArray), __cDiagValueArray, elcount(__cDiagValueArray));
      {
        __bSetInCheckAlignment = 1;	
        {
          __bArrayCtr = __CopyBytes(__bDiagValueArray, __bDiagValueArrayCtr, __bArray);
          {
            sysvar * __systemVariable;
            __systemVariable = sysvarData::`PartNumber::`Part_Number;
            CheckSysVarSetBufferConsistency(sysSetVariableData(sysvarData::`PartNumber::`Part_Number, __bArray, __bArrayCtr), __systemVariable.name);
          }
          snprintf(__cArray, 8192, "%s", "Part_Number");
          snprintf(__cArray2, 8192, "%s '%s'", __cSysVar, __cArray);
          snprintf(__cArray3, 8192, "%s", "Application_Software_Logical_Block_0_Version_Information_Patch_2");
          
          ReportTableRow(__tableHandle, 0, __cArray2, __cAOp, __bArray, __bArrayCtr, __cArray3, __oneOfFlag, __bSetInCheckAlignment);
        
        }
    
        __bSetInCheckAlignment = 0;
      }
    }
    {
      __bDiagValueArrayCtr = DiagGetParameterErrorHandled(__resp, "Application_Software_Logical_Block_2_Week", __bDiagValueArray, elcount(__bDiagValueArray), __cDiagValueArray, elcount(__cDiagValueArray));
      {
        __bSetInCheckAlignment = 1;	
        {
          __bArrayCtr = __CopyBytes(__bDiagValueArray, __bDiagValueArrayCtr, __bArray);
          {
            sysvar * __systemVariable;
            __systemVariable = sysvarData::`PartNumber::`Part_Number;
            CheckSysVarSetBufferConsistency(sysSetVariableData(sysvarData::`PartNumber::`Part_Number, __bArray, __bArrayCtr), __systemVariable.name);
          }
          snprintf(__cArray, 8192, "%s", "Part_Number");
          snprintf(__cArray2, 8192, "%s '%s'", __cSysVar, __cArray);
          snprintf(__cArray3, 8192, "%s", "Application_Software_Logical_Block_2_Week");
          
          ReportTableRow(__tableHandle, 0, __cArray2, __cAOp, __bArray, __bArrayCtr, __cArray3, __oneOfFlag, __bSetInCheckAlignment);
        
        }
    
        __bSetInCheckAlignment = 0;
      }
    }
    {
      __bDiagValueArrayCtr = DiagGetParameterErrorHandled(__resp, "Application_Software_Logical_Block_2_Year", __bDiagValueArray, elcount(__bDiagValueArray), __cDiagValueArray, elcount(__cDiagValueArray));
      {
        __bSetInCheckAlignment = 1;	
        {
          __bArrayCtr = __CopyBytes(__bDiagValueArray, __bDiagValueArrayCtr, __bArray);
          {
            sysvar * __systemVariable;
            __systemVariable = sysvarData::`PartNumber::`Part_Number;
            CheckSysVarSetBufferConsistency(sysSetVariableData(sysvarData::`PartNumber::`Part_Number, __bArray, __bArrayCtr), __systemVariable.name);
          }
          snprintf(__cArray, 8192, "%s", "Part_Number");
          snprintf(__cArray2, 8192, "%s '%s'", __cSysVar, __cArray);
          snprintf(__cArray3, 8192, "%s", "Application_Software_Logical_Block_2_Year");
          
          ReportTableRow(__tableHandle, 0, __cArray2, __cAOp, __bArray, __bArrayCtr, __cArray3, __oneOfFlag, __bSetInCheckAlignment);
        
        }
    
        __bSetInCheckAlignment = 0;
      }
    }
    {
      __bDiagValueArrayCtr = DiagGetParameterErrorHandled(__resp, "Application_Software_Logical_Block_3_Week", __bDiagValueArray, elcount(__bDiagValueArray), __cDiagValueArray, elcount(__cDiagValueArray));
      {
        __bSetInCheckAlignment = 1;	
        {
          __bArrayCtr = __CopyBytes(__bDiagValueArray, __bDiagValueArrayCtr, __bArray);
          {
            sysvar * __systemVariable;
            __systemVariable = sysvarData::`PartNumber::`Part_Number;
            CheckSysVarSetBufferConsistency(sysSetVariableData(sysvarData::`PartNumber::`Part_Number, __bArray, __bArrayCtr), __systemVariable.name);
          }
          snprintf(__cArray, 8192, "%s", "Part_Number");
          snprintf(__cArray2, 8192, "%s '%s'", __cSysVar, __cArray);
          snprintf(__cArray3, 8192, "%s", "Application_Software_Logical_Block_3_Week");
          
          ReportTableRow(__tableHandle, 0, __cArray2, __cAOp, __bArray, __bArrayCtr, __cArray3, __oneOfFlag, __bSetInCheckAlignment);
        
        }
    
        __bSetInCheckAlignment = 0;
      }
    }
    {
      __bDiagValueArrayCtr = DiagGetParameterErrorHandled(__resp, "Application_Software_Logical_Block_3_Year", __bDiagValueArray, elcount(__bDiagValueArray), __cDiagValueArray, elcount(__cDiagValueArray));
      {
        __bSetInCheckAlignment = 1;	
        {
          __bArrayCtr = __CopyBytes(__bDiagValueArray, __bDiagValueArrayCtr, __bArray);
          {
            sysvar * __systemVariable;
            __systemVariable = sysvarData::`PartNumber::`Part_Number;
            CheckSysVarSetBufferConsistency(sysSetVariableData(sysvarData::`PartNumber::`Part_Number, __bArray, __bArrayCtr), __systemVariable.name);
          }
          snprintf(__cArray, 8192, "%s", "Part_Number");
          snprintf(__cArray2, 8192, "%s '%s'", __cSysVar, __cArray);
          snprintf(__cArray3, 8192, "%s", "Application_Software_Logical_Block_3_Year");
          
          ReportTableRow(__tableHandle, 0, __cArray2, __cAOp, __bArray, __bArrayCtr, __cArray3, __oneOfFlag, __bSetInCheckAlignment);
        
        }
    
        __bSetInCheckAlignment = 0;
      }
    }
    {
      __bDiagValueArrayCtr = DiagGetParameterErrorHandled(__resp, "Application_Software_Logical_Block_4_Identification", __bDiagValueArray, elcount(__bDiagValueArray), __cDiagValueArray, elcount(__cDiagValueArray));
      {
        __bSetInCheckAlignment = 1;	
        {
          __bArrayCtr = __CopyBytes(__bDiagValueArray, __bDiagValueArrayCtr, __bArray);
          {
            sysvar * __systemVariable;
            __systemVariable = sysvarData::`PartNumber::`Part_Number;
            CheckSysVarSetBufferConsistency(sysSetVariableData(sysvarData::`PartNumber::`Part_Number, __bArray, __bArrayCtr), __systemVariable.name);
          }
          snprintf(__cArray, 8192, "%s", "Part_Number");
          snprintf(__cArray2, 8192, "%s '%s'", __cSysVar, __cArray);
          snprintf(__cArray3, 8192, "%s", "Application_Software_Logical_Block_4_Identification");
          
          ReportTableRow(__tableHandle, 0, __cArray2, __cAOp, __bArray, __bArrayCtr, __cArray3, __oneOfFlag, __bSetInCheckAlignment);
        
        }
    
        __bSetInCheckAlignment = 0;
      }
    }
    {
      __bDiagValueArrayCtr = DiagGetParameterErrorHandled(__resp, "Application_Software_Logical_Block_4_Patch_Level", __bDiagValueArray, elcount(__bDiagValueArray), __cDiagValueArray, elcount(__cDiagValueArray));
      {
        __bSetInCheckAlignment = 1;	
        {
          __bArrayCtr = __CopyBytes(__bDiagValueArray, __bDiagValueArrayCtr, __bArray);
          {
            sysvar * __systemVariable;
            __systemVariable = sysvarData::`PartNumber::`Part_Number;
            CheckSysVarSetBufferConsistency(sysSetVariableData(sysvarData::`PartNumber::`Part_Number, __bArray, __bArrayCtr), __systemVariable.name);
          }
          snprintf(__cArray, 8192, "%s", "Part_Number");
          snprintf(__cArray2, 8192, "%s '%s'", __cSysVar, __cArray);
          snprintf(__cArray3, 8192, "%s", "Application_Software_Logical_Block_4_Patch_Level");
          
          ReportTableRow(__tableHandle, 0, __cArray2, __cAOp, __bArray, __bArrayCtr, __cArray3, __oneOfFlag, __bSetInCheckAlignment);
        
        }
    
        __bSetInCheckAlignment = 0;
      }
    }
    {
      __bDiagValueArrayCtr = DiagGetParameterErrorHandled(__resp, "Application_Software_Logical_Block_4_Week", __bDiagValueArray, elcount(__bDiagValueArray), __cDiagValueArray, elcount(__cDiagValueArray));
      {
        __bSetInCheckAlignment = 1;	
        {
          __bArrayCtr = __CopyBytes(__bDiagValueArray, __bDiagValueArrayCtr, __bArray);
          {
            sysvar * __systemVariable;
            __systemVariable = sysvarData::`PartNumber::`Part_Number;
            CheckSysVarSetBufferConsistency(sysSetVariableData(sysvarData::`PartNumber::`Part_Number, __bArray, __bArrayCtr), __systemVariable.name);
          }
          snprintf(__cArray, 8192, "%s", "Part_Number");
          snprintf(__cArray2, 8192, "%s '%s'", __cSysVar, __cArray);
          snprintf(__cArray3, 8192, "%s", "Application_Software_Logical_Block_4_Week");
          
          ReportTableRow(__tableHandle, 0, __cArray2, __cAOp, __bArray, __bArrayCtr, __cArray3, __oneOfFlag, __bSetInCheckAlignment);
        
        }
    
        __bSetInCheckAlignment = 0;
      }
    }
    {
      __bDiagValueArrayCtr = DiagGetParameterErrorHandled(__resp, "Application_Software_Logical_Block_4_Year", __bDiagValueArray, elcount(__bDiagValueArray), __cDiagValueArray, elcount(__cDiagValueArray));
      {
        __bSetInCheckAlignment = 1;	
        {
          __bArrayCtr = __CopyBytes(__bDiagValueArray, __bDiagValueArrayCtr, __bArray);
          {
            sysvar * __systemVariable;
            __systemVariable = sysvarData::`PartNumber::`Part_Number;
            CheckSysVarSetBufferConsistency(sysSetVariableData(sysvarData::`PartNumber::`Part_Number, __bArray, __bArrayCtr), __systemVariable.name);
          }
          snprintf(__cArray, 8192, "%s", "Part_Number");
          snprintf(__cArray2, 8192, "%s '%s'", __cSysVar, __cArray);
          snprintf(__cArray3, 8192, "%s", "Application_Software_Logical_Block_4_Year");
          
          ReportTableRow(__tableHandle, 0, __cArray2, __cAOp, __bArray, __bArrayCtr, __cArray3, __oneOfFlag, __bSetInCheckAlignment);
        
        }
    
        __bSetInCheckAlignment = 0;
      }
    }
    {
      __bDiagValueArrayCtr = DiagGetParameterErrorHandled(__resp, "Application_Software_Logical_Block_5_Identification", __bDiagValueArray, elcount(__bDiagValueArray), __cDiagValueArray, elcount(__cDiagValueArray));
      {
        __bSetInCheckAlignment = 1;	
        {
          __bArrayCtr = __CopyBytes(__bDiagValueArray, __bDiagValueArrayCtr, __bArray);
          {
            sysvar * __systemVariable;
            __systemVariable = sysvarData::`PartNumber::`Part_Number;
            CheckSysVarSetBufferConsistency(sysSetVariableData(sysvarData::`PartNumber::`Part_Number, __bArray, __bArrayCtr), __systemVariable.name);
          }
          snprintf(__cArray, 8192, "%s", "Part_Number");
          snprintf(__cArray2, 8192, "%s '%s'", __cSysVar, __cArray);
          snprintf(__cArray3, 8192, "%s", "Application_Software_Logical_Block_5_Identification");
          
          ReportTableRow(__tableHandle, 0, __cArray2, __cAOp, __bArray, __bArrayCtr, __cArray3, __oneOfFlag, __bSetInCheckAlignment);
        
        }
    
        __bSetInCheckAlignment = 0;
      }
    }
    {
      __bDiagValueArrayCtr = DiagGetParameterErrorHandled(__resp, "Application_Software_Logical_Block_5_Patch_Level", __bDiagValueArray, elcount(__bDiagValueArray), __cDiagValueArray, elcount(__cDiagValueArray));
      {
        __bSetInCheckAlignment = 1;	
        {
          __bArrayCtr = __CopyBytes(__bDiagValueArray, __bDiagValueArrayCtr, __bArray);
          {
            sysvar * __systemVariable;
            __systemVariable = sysvarData::`PartNumber::`Part_Number;
            CheckSysVarSetBufferConsistency(sysSetVariableData(sysvarData::`PartNumber::`Part_Number, __bArray, __bArrayCtr), __systemVariable.name);
          }
          snprintf(__cArray, 8192, "%s", "Part_Number");
          snprintf(__cArray2, 8192, "%s '%s'", __cSysVar, __cArray);
          snprintf(__cArray3, 8192, "%s", "Application_Software_Logical_Block_5_Patch_Level");
          
          ReportTableRow(__tableHandle, 0, __cArray2, __cAOp, __bArray, __bArrayCtr, __cArray3, __oneOfFlag, __bSetInCheckAlignment);
        
        }
    
        __bSetInCheckAlignment = 0;
      }
    }
    {
      __bDiagValueArrayCtr = DiagGetParameterErrorHandled(__resp, "Application_Software_Logical_Block_5_Week", __bDiagValueArray, elcount(__bDiagValueArray), __cDiagValueArray, elcount(__cDiagValueArray));
      {
        __bSetInCheckAlignment = 1;	
        {
          __bArrayCtr = __CopyBytes(__bDiagValueArray, __bDiagValueArrayCtr, __bArray);
          {
            sysvar * __systemVariable;
            __systemVariable = sysvarData::`PartNumber::`Part_Number;
            CheckSysVarSetBufferConsistency(sysSetVariableData(sysvarData::`PartNumber::`Part_Number, __bArray, __bArrayCtr), __systemVariable.name);
          }
          snprintf(__cArray, 8192, "%s", "Part_Number");
          snprintf(__cArray2, 8192, "%s '%s'", __cSysVar, __cArray);
          snprintf(__cArray3, 8192, "%s", "Application_Software_Logical_Block_5_Week");
          
          ReportTableRow(__tableHandle, 0, __cArray2, __cAOp, __bArray, __bArrayCtr, __cArray3, __oneOfFlag, __bSetInCheckAlignment);
        
        }
    
        __bSetInCheckAlignment = 0;
      }
    }
    {
      __bDiagValueArrayCtr = DiagGetParameterErrorHandled(__resp, "Application_Software_Logical_Block_5_Year", __bDiagValueArray, elcount(__bDiagValueArray), __cDiagValueArray, elcount(__cDiagValueArray));
      {
        __bSetInCheckAlignment = 1;	
        {
          __bArrayCtr = __CopyBytes(__bDiagValueArray, __bDiagValueArrayCtr, __bArray);
          {
            sysvar * __systemVariable;
            __systemVariable = sysvarData::`PartNumber::`Part_Number;
            CheckSysVarSetBufferConsistency(sysSetVariableData(sysvarData::`PartNumber::`Part_Number, __bArray, __bArrayCtr), __systemVariable.name);
          }
          snprintf(__cArray, 8192, "%s", "Part_Number");
          snprintf(__cArray2, 8192, "%s '%s'", __cSysVar, __cArray);
          snprintf(__cArray3, 8192, "%s", "Application_Software_Logical_Block_5_Year");
          
          ReportTableRow(__tableHandle, 0, __cArray2, __cAOp, __bArray, __bArrayCtr, __cArray3, __oneOfFlag, __bSetInCheckAlignment);
        
        }
    
        __bSetInCheckAlignment = 0;
      }
    }
    {
      __bDiagValueArrayCtr = DiagGetParameterErrorHandled(__resp, "_Application_Software_Logical_Block_1_Version_Information__Iden", __bDiagValueArray, elcount(__bDiagValueArray), __cDiagValueArray, elcount(__cDiagValueArray));
      {
        __bSetInCheckAlignment = 1;	
        {
          __bArrayCtr = __CopyBytes(__bDiagValueArray, __bDiagValueArrayCtr, __bArray);
          {
            sysvar * __systemVariable;
            __systemVariable = sysvarData::`PartNumber::`Part_Number;
            CheckSysVarSetBufferConsistency(sysSetVariableData(sysvarData::`PartNumber::`Part_Number, __bArray, __bArrayCtr), __systemVariable.name);
          }
          snprintf(__cArray, 8192, "%s", "Part_Number");
          snprintf(__cArray2, 8192, "%s '%s'", __cSysVar, __cArray);
          snprintf(__cArray3, 8192, "%s", "_Application_Software_Logical_Block_1_Version_Information__Iden");
          
          ReportTableRow(__tableHandle, 0, __cArray2, __cAOp, __bArray, __bArrayCtr, __cArray3, __oneOfFlag, __bSetInCheckAlignment);
        
        }
    
        __bSetInCheckAlignment = 0;
      }
    }
    {
      __bDiagValueArrayCtr = DiagGetParameterErrorHandled(__resp, "_Application_Software_Logical_Block_1_Version_Information__Patc", __bDiagValueArray, elcount(__bDiagValueArray), __cDiagValueArray, elcount(__cDiagValueArray));
      {
        __bSetInCheckAlignment = 1;	
        {
          __bArrayCtr = __CopyBytes(__bDiagValueArray, __bDiagValueArrayCtr, __bArray);
          {
            sysvar * __systemVariable;
            __systemVariable = sysvarData::`PartNumber::`Part_Number;
            CheckSysVarSetBufferConsistency(sysSetVariableData(sysvarData::`PartNumber::`Part_Number, __bArray, __bArrayCtr), __systemVariable.name);
          }
          snprintf(__cArray, 8192, "%s", "Part_Number");
          snprintf(__cArray2, 8192, "%s '%s'", __cSysVar, __cArray);
          snprintf(__cArray3, 8192, "%s", "_Application_Software_Logical_Block_1_Version_Information__Patc");
          
          ReportTableRow(__tableHandle, 0, __cArray2, __cAOp, __bArray, __bArrayCtr, __cArray3, __oneOfFlag, __bSetInCheckAlignment);
        
        }
    
        __bSetInCheckAlignment = 0;
      }
    }
    {
      __bDiagValueArrayCtr = DiagGetParameterErrorHandled(__resp, "_Application_Software_Logical_Block_1_Version_Information__Week", __bDiagValueArray, elcount(__bDiagValueArray), __cDiagValueArray, elcount(__cDiagValueArray));
      {
        __bSetInCheckAlignment = 1;	
        {
          __bArrayCtr = __CopyBytes(__bDiagValueArray, __bDiagValueArrayCtr, __bArray);
          {
            sysvar * __systemVariable;
            __systemVariable = sysvarData::`PartNumber::`Part_Number;
            CheckSysVarSetBufferConsistency(sysSetVariableData(sysvarData::`PartNumber::`Part_Number, __bArray, __bArrayCtr), __systemVariable.name);
          }
          snprintf(__cArray, 8192, "%s", "Part_Number");
          snprintf(__cArray2, 8192, "%s '%s'", __cSysVar, __cArray);
          snprintf(__cArray3, 8192, "%s", "_Application_Software_Logical_Block_1_Version_Information__Week");
          
          ReportTableRow(__tableHandle, 0, __cArray2, __cAOp, __bArray, __bArrayCtr, __cArray3, __oneOfFlag, __bSetInCheckAlignment);
        
        }
    
        __bSetInCheckAlignment = 0;
      }
    }
    {
      __bDiagValueArrayCtr = DiagGetParameterErrorHandled(__resp, "_Application_Software_Logical_Block_1_Version_Information__Year", __bDiagValueArray, elcount(__bDiagValueArray), __cDiagValueArray, elcount(__cDiagValueArray));
      {
        __bSetInCheckAlignment = 1;	
        {
          __bArrayCtr = __CopyBytes(__bDiagValueArray, __bDiagValueArrayCtr, __bArray);
          {
            sysvar * __systemVariable;
            __systemVariable = sysvarData::`PartNumber::`Part_Number;
            CheckSysVarSetBufferConsistency(sysSetVariableData(sysvarData::`PartNumber::`Part_Number, __bArray, __bArrayCtr), __systemVariable.name);
          }
          snprintf(__cArray, 8192, "%s", "Part_Number");
          snprintf(__cArray2, 8192, "%s '%s'", __cSysVar, __cArray);
          snprintf(__cArray3, 8192, "%s", "_Application_Software_Logical_Block_1_Version_Information__Year");
          
          ReportTableRow(__tableHandle, 0, __cArray2, __cAOp, __bArray, __bArrayCtr, __cArray3, __oneOfFlag, __bSetInCheckAlignment);
        
        }
    
        __bSetInCheckAlignment = 0;
      }
    }
    ReportTableEndVerdict(__tableHandle, __cEvaluateResponse, __res);
	__bVerdict = __bVerdict && __res;
  }
  if (__bVerdict == __eVerdictFail)
    TestReportWriteDiagObjectList();
}

void Tto7tsimc_F182_DID_with_Physical_Address()
{
  stack long __tableHandle;
  TestCommandBegin(__eDiagService, __cDiagService, "", "0");
  {
    if (DiagIsFunctionalGroup("CVADAS_0001_00000000_000"))
    {
      DiagResponse * __resp;
      DiagRequest CVADAS_0001_00000000_000._22F182_Application_Data_Identification __req;
      __diagServiceo7tsimc_3(__req, __resp);
    }
    else
    {
      DiagResponse CVADAS_0001_00000000_000.* __resp;
      DiagRequest CVADAS_0001_00000000_000._22F182_Application_Data_Identification __req;
      __diagServiceo7tsimc_3(__req, __resp);
    }
  }
  TestCommandEnd();


}

  
void __diagServiceo7tsimc_3(DiagRequest * __req, DiagResponse * __resp )
{
  stack long __tableHandle;
  long __res, __paramLen, __bytePos;

   __bVerdict = __eVerdictPass;

  do {
    TestReportResetDiagObjectList();
    DiagSetReportDetailLevel("CVADAS_0001_00000000_000", EnumServiceDetails_onfail);
    // Request aspect
    {

      if (0 >= DiagSendReqAndWaitForResp("CVADAS_0001_00000000_000", __req, __resp, __res, -1, -1, -1, -1, -1, EnumResult_pos, EnumServiceDetails_onfail, EnumSendingMode_physical, EnumSuppressPosResBit_asconfigured, EnumVerdictOnInvalidValues_fail))
        break;
    }

    __res = DiagErrCodeTestStep(__res, "Can't retrieve last response for request! No check possible.") < 0;
    if(__res)
    {
	  __bVerdict = __eVerdictFail;
      break;
    }
    {
      __res = DiagInterpretAs(__resp, "RDBI_PR");
      if(__res != 0)
      {
        __bVerdict = __eVerdictFail;
        DiagErrCodeTestStep(__res, "Can't interpret response as diagnostic primitive 'RDBI_PR'.");
        break;
      }
      else
      {
        TestStepPass( "Received primitive can be interpreted as diagnostic primitive 'RDBI_PR'.");
      }
    }
  }
  while(0);


  // Response, check & read aspect
  {
    __res = 1;
    __tableHandle = ReportTableHead5Columns(__cCheckCaption, __cTSym, __cTOp, __cRefVal, __cActual, __cRes);
    {
      __bDiagValueArrayCtr = DiagGetParameterErrorHandled(__resp, "Application_Data_Logical_Block_7_SwIdentification", __bDiagValueArray, elcount(__bDiagValueArray), __cDiagValueArray, elcount(__cDiagValueArray));
      {
        __bSetInCheckAlignment = 1;	
        {
          __bArrayCtr = __CopyBytes(__bDiagValueArray, __bDiagValueArrayCtr, __bArray);
          {
            sysvar * __systemVariable;
            __systemVariable = sysvarData::`PartNumber::`Part_Number;
            CheckSysVarSetBufferConsistency(sysSetVariableData(sysvarData::`PartNumber::`Part_Number, __bArray, __bArrayCtr), __systemVariable.name);
          }
          snprintf(__cArray, 8192, "%s", "Part_Number");
          snprintf(__cArray2, 8192, "%s '%s'", __cSysVar, __cArray);
          snprintf(__cArray3, 8192, "%s", "Application_Data_Logical_Block_7_SwIdentification");
          
          ReportTableRow(__tableHandle, 0, __cArray2, __cAOp, __bArray, __bArrayCtr, __cArray3, __oneOfFlag, __bSetInCheckAlignment);
        
        }
    
        __bSetInCheckAlignment = 0;
      }
    }
    {
      __bDiagValueArrayCtr = DiagGetParameterErrorHandled(__resp, "Application_Data_Logical_Block_7_SwPatch_Level", __bDiagValueArray, elcount(__bDiagValueArray), __cDiagValueArray, elcount(__cDiagValueArray));
      {
        __bSetInCheckAlignment = 1;	
        {
          __bArrayCtr = __CopyBytes(__bDiagValueArray, __bDiagValueArrayCtr, __bArray);
          {
            sysvar * __systemVariable;
            __systemVariable = sysvarData::`PartNumber::`Part_Number;
            CheckSysVarSetBufferConsistency(sysSetVariableData(sysvarData::`PartNumber::`Part_Number, __bArray, __bArrayCtr), __systemVariable.name);
          }
          snprintf(__cArray, 8192, "%s", "Part_Number");
          snprintf(__cArray2, 8192, "%s '%s'", __cSysVar, __cArray);
          snprintf(__cArray3, 8192, "%s", "Application_Data_Logical_Block_7_SwPatch_Level");
          
          ReportTableRow(__tableHandle, 0, __cArray2, __cAOp, __bArray, __bArrayCtr, __cArray3, __oneOfFlag, __bSetInCheckAlignment);
        
        }
    
        __bSetInCheckAlignment = 0;
      }
    }
    {
      __bDiagValueArrayCtr = DiagGetParameterErrorHandled(__resp, "Application_Data_Logical_Block_7_SwWeek", __bDiagValueArray, elcount(__bDiagValueArray), __cDiagValueArray, elcount(__cDiagValueArray));
      {
        __bSetInCheckAlignment = 1;	
        {
          __bArrayCtr = __CopyBytes(__bDiagValueArray, __bDiagValueArrayCtr, __bArray);
          {
            sysvar * __systemVariable;
            __systemVariable = sysvarData::`PartNumber::`Part_Number;
            CheckSysVarSetBufferConsistency(sysSetVariableData(sysvarData::`PartNumber::`Part_Number, __bArray, __bArrayCtr), __systemVariable.name);
          }
          snprintf(__cArray, 8192, "%s", "Part_Number");
          snprintf(__cArray2, 8192, "%s '%s'", __cSysVar, __cArray);
          snprintf(__cArray3, 8192, "%s", "Application_Data_Logical_Block_7_SwWeek");
          
          ReportTableRow(__tableHandle, 0, __cArray2, __cAOp, __bArray, __bArrayCtr, __cArray3, __oneOfFlag, __bSetInCheckAlignment);
        
        }
    
        __bSetInCheckAlignment = 0;
      }
    }
    {
      __bDiagValueArrayCtr = DiagGetParameterErrorHandled(__resp, "Application_Data_Logical_Block_7_SwYear", __bDiagValueArray, elcount(__bDiagValueArray), __cDiagValueArray, elcount(__cDiagValueArray));
      {
        __bSetInCheckAlignment = 1;	
        {
          __bArrayCtr = __CopyBytes(__bDiagValueArray, __bDiagValueArrayCtr, __bArray);
          {
            sysvar * __systemVariable;
            __systemVariable = sysvarData::`PartNumber::`Part_Number;
            CheckSysVarSetBufferConsistency(sysSetVariableData(sysvarData::`PartNumber::`Part_Number, __bArray, __bArrayCtr), __systemVariable.name);
          }
          snprintf(__cArray, 8192, "%s", "Part_Number");
          snprintf(__cArray2, 8192, "%s '%s'", __cSysVar, __cArray);
          snprintf(__cArray3, 8192, "%s", "Application_Data_Logical_Block_7_SwYear");
          
          ReportTableRow(__tableHandle, 0, __cArray2, __cAOp, __bArray, __bArrayCtr, __cArray3, __oneOfFlag, __bSetInCheckAlignment);
        
        }
    
        __bSetInCheckAlignment = 0;
      }
    }
    {
      __bDiagValueArrayCtr = DiagGetParameterErrorHandled(__resp, "Application_Data_Logical_Block_8_SwIdentification", __bDiagValueArray, elcount(__bDiagValueArray), __cDiagValueArray, elcount(__cDiagValueArray));
      {
        __bSetInCheckAlignment = 1;	
        {
          __bArrayCtr = __CopyBytes(__bDiagValueArray, __bDiagValueArrayCtr, __bArray);
          {
            sysvar * __systemVariable;
            __systemVariable = sysvarData::`PartNumber::`Part_Number;
            CheckSysVarSetBufferConsistency(sysSetVariableData(sysvarData::`PartNumber::`Part_Number, __bArray, __bArrayCtr), __systemVariable.name);
          }
          snprintf(__cArray, 8192, "%s", "Part_Number");
          snprintf(__cArray2, 8192, "%s '%s'", __cSysVar, __cArray);
          snprintf(__cArray3, 8192, "%s", "Application_Data_Logical_Block_8_SwIdentification");
          
          ReportTableRow(__tableHandle, 0, __cArray2, __cAOp, __bArray, __bArrayCtr, __cArray3, __oneOfFlag, __bSetInCheckAlignment);
        
        }
    
        __bSetInCheckAlignment = 0;
      }
    }
    {
      __bDiagValueArrayCtr = DiagGetParameterErrorHandled(__resp, "Application_Data_Logical_Block_8_SwPatch_Level", __bDiagValueArray, elcount(__bDiagValueArray), __cDiagValueArray, elcount(__cDiagValueArray));
      {
        __bSetInCheckAlignment = 1;	
        {
          __bArrayCtr = __CopyBytes(__bDiagValueArray, __bDiagValueArrayCtr, __bArray);
          {
            sysvar * __systemVariable;
            __systemVariable = sysvarData::`PartNumber::`Part_Number;
            CheckSysVarSetBufferConsistency(sysSetVariableData(sysvarData::`PartNumber::`Part_Number, __bArray, __bArrayCtr), __systemVariable.name);
          }
          snprintf(__cArray, 8192, "%s", "Part_Number");
          snprintf(__cArray2, 8192, "%s '%s'", __cSysVar, __cArray);
          snprintf(__cArray3, 8192, "%s", "Application_Data_Logical_Block_8_SwPatch_Level");
          
          ReportTableRow(__tableHandle, 0, __cArray2, __cAOp, __bArray, __bArrayCtr, __cArray3, __oneOfFlag, __bSetInCheckAlignment);
        
        }
    
        __bSetInCheckAlignment = 0;
      }
    }
    {
      __bDiagValueArrayCtr = DiagGetParameterErrorHandled(__resp, "Application_Data_Logical_Block_8_SwWeek", __bDiagValueArray, elcount(__bDiagValueArray), __cDiagValueArray, elcount(__cDiagValueArray));
      {
        __bSetInCheckAlignment = 1;	
        {
          __bArrayCtr = __CopyBytes(__bDiagValueArray, __bDiagValueArrayCtr, __bArray);
          {
            sysvar * __systemVariable;
            __systemVariable = sysvarData::`PartNumber::`Part_Number;
            CheckSysVarSetBufferConsistency(sysSetVariableData(sysvarData::`PartNumber::`Part_Number, __bArray, __bArrayCtr), __systemVariable.name);
          }
          snprintf(__cArray, 8192, "%s", "Part_Number");
          snprintf(__cArray2, 8192, "%s '%s'", __cSysVar, __cArray);
          snprintf(__cArray3, 8192, "%s", "Application_Data_Logical_Block_8_SwWeek");
          
          ReportTableRow(__tableHandle, 0, __cArray2, __cAOp, __bArray, __bArrayCtr, __cArray3, __oneOfFlag, __bSetInCheckAlignment);
        
        }
    
        __bSetInCheckAlignment = 0;
      }
    }
    {
      __bDiagValueArrayCtr = DiagGetParameterErrorHandled(__resp, "Application_Data_Logical_Block_8_SwYear", __bDiagValueArray, elcount(__bDiagValueArray), __cDiagValueArray, elcount(__cDiagValueArray));
      {
        __bSetInCheckAlignment = 1;	
        {
          __bArrayCtr = __CopyBytes(__bDiagValueArray, __bDiagValueArrayCtr, __bArray);
          {
            sysvar * __systemVariable;
            __systemVariable = sysvarData::`PartNumber::`Part_Number;
            CheckSysVarSetBufferConsistency(sysSetVariableData(sysvarData::`PartNumber::`Part_Number, __bArray, __bArrayCtr), __systemVariable.name);
          }
          snprintf(__cArray, 8192, "%s", "Part_Number");
          snprintf(__cArray2, 8192, "%s '%s'", __cSysVar, __cArray);
          snprintf(__cArray3, 8192, "%s", "Application_Data_Logical_Block_8_SwYear");
          
          ReportTableRow(__tableHandle, 0, __cArray2, __cAOp, __bArray, __bArrayCtr, __cArray3, __oneOfFlag, __bSetInCheckAlignment);
        
        }
    
        __bSetInCheckAlignment = 0;
      }
    }
    {
      __bDiagValueArrayCtr = DiagGetParameterErrorHandled(__resp, "_Number_of_Application_Data_Logical_Blocks_24", __bDiagValueArray, elcount(__bDiagValueArray), __cDiagValueArray, elcount(__cDiagValueArray));
      {
        __bSetInCheckAlignment = 1;	
        {
          __bArrayCtr = __CopyBytes(__bDiagValueArray, __bDiagValueArrayCtr, __bArray);
          {
            sysvar * __systemVariable;
            __systemVariable = sysvarData::`PartNumber::`Part_Number;
            CheckSysVarSetBufferConsistency(sysSetVariableData(sysvarData::`PartNumber::`Part_Number, __bArray, __bArrayCtr), __systemVariable.name);
          }
          snprintf(__cArray, 8192, "%s", "Part_Number");
          snprintf(__cArray2, 8192, "%s '%s'", __cSysVar, __cArray);
          snprintf(__cArray3, 8192, "%s", "_Number_of_Application_Data_Logical_Blocks_24");
          
          ReportTableRow(__tableHandle, 0, __cArray2, __cAOp, __bArray, __bArrayCtr, __cArray3, __oneOfFlag, __bSetInCheckAlignment);
        
        }
    
        __bSetInCheckAlignment = 0;
      }
    }
    {
      __bDiagValueArrayCtr = DiagGetParameterErrorHandled(__resp, "_SW_Year_32", __bDiagValueArray, elcount(__bDiagValueArray), __cDiagValueArray, elcount(__cDiagValueArray));
      {
        __bSetInCheckAlignment = 1;	
        {
          __bArrayCtr = __CopyBytes(__bDiagValueArray, __bDiagValueArrayCtr, __bArray);
          {
            sysvar * __systemVariable;
            __systemVariable = sysvarData::`PartNumber::`Part_Number;
            CheckSysVarSetBufferConsistency(sysSetVariableData(sysvarData::`PartNumber::`Part_Number, __bArray, __bArrayCtr), __systemVariable.name);
          }
          snprintf(__cArray, 8192, "%s", "Part_Number");
          snprintf(__cArray2, 8192, "%s '%s'", __cSysVar, __cArray);
          snprintf(__cArray3, 8192, "%s", "_SW_Year_32");
          
          ReportTableRow(__tableHandle, 0, __cArray2, __cAOp, __bArray, __bArrayCtr, __cArray3, __oneOfFlag, __bSetInCheckAlignment);
        
        }
    
        __bSetInCheckAlignment = 0;
      }
    }
    {
      __bDiagValueArrayCtr = DiagGetParameterErrorHandled(__resp, "_SW__Identification_56", __bDiagValueArray, elcount(__bDiagValueArray), __cDiagValueArray, elcount(__cDiagValueArray));
      {
        __bSetInCheckAlignment = 1;	
        {
          __bArrayCtr = __CopyBytes(__bDiagValueArray, __bDiagValueArrayCtr, __bArray);
          {
            sysvar * __systemVariable;
            __systemVariable = sysvarData::`PartNumber::`Part_Number;
            CheckSysVarSetBufferConsistency(sysSetVariableData(sysvarData::`PartNumber::`Part_Number, __bArray, __bArrayCtr), __systemVariable.name);
          }
          snprintf(__cArray, 8192, "%s", "Part_Number");
          snprintf(__cArray2, 8192, "%s '%s'", __cSysVar, __cArray);
          snprintf(__cArray3, 8192, "%s", "_SW__Identification_56");
          
          ReportTableRow(__tableHandle, 0, __cArray2, __cAOp, __bArray, __bArrayCtr, __cArray3, __oneOfFlag, __bSetInCheckAlignment);
        
        }
    
        __bSetInCheckAlignment = 0;
      }
    }
    {
      __bDiagValueArrayCtr = DiagGetParameterErrorHandled(__resp, "_SW__Patch_Level_48", __bDiagValueArray, elcount(__bDiagValueArray), __cDiagValueArray, elcount(__cDiagValueArray));
      {
        __bSetInCheckAlignment = 1;	
        {
          __bArrayCtr = __CopyBytes(__bDiagValueArray, __bDiagValueArrayCtr, __bArray);
          {
            sysvar * __systemVariable;
            __systemVariable = sysvarData::`PartNumber::`Part_Number;
            CheckSysVarSetBufferConsistency(sysSetVariableData(sysvarData::`PartNumber::`Part_Number, __bArray, __bArrayCtr), __systemVariable.name);
          }
          snprintf(__cArray, 8192, "%s", "Part_Number");
          snprintf(__cArray2, 8192, "%s '%s'", __cSysVar, __cArray);
          snprintf(__cArray3, 8192, "%s", "_SW__Patch_Level_48");
          
          ReportTableRow(__tableHandle, 0, __cArray2, __cAOp, __bArray, __bArrayCtr, __cArray3, __oneOfFlag, __bSetInCheckAlignment);
        
        }
    
        __bSetInCheckAlignment = 0;
      }
    }
    {
      __bDiagValueArrayCtr = DiagGetParameterErrorHandled(__resp, "_SW__Week_40", __bDiagValueArray, elcount(__bDiagValueArray), __cDiagValueArray, elcount(__cDiagValueArray));
      {
        __bSetInCheckAlignment = 1;	
        {
          __bArrayCtr = __CopyBytes(__bDiagValueArray, __bDiagValueArrayCtr, __bArray);
          {
            sysvar * __systemVariable;
            __systemVariable = sysvarData::`PartNumber::`Part_Number;
            CheckSysVarSetBufferConsistency(sysSetVariableData(sysvarData::`PartNumber::`Part_Number, __bArray, __bArrayCtr), __systemVariable.name);
          }
          snprintf(__cArray, 8192, "%s", "Part_Number");
          snprintf(__cArray2, 8192, "%s '%s'", __cSysVar, __cArray);
          snprintf(__cArray3, 8192, "%s", "_SW__Week_40");
          
          ReportTableRow(__tableHandle, 0, __cArray2, __cAOp, __bArray, __bArrayCtr, __cArray3, __oneOfFlag, __bSetInCheckAlignment);
        
        }
    
        __bSetInCheckAlignment = 0;
      }
    }
    ReportTableEndVerdict(__tableHandle, __cEvaluateResponse, __res);
	__bVerdict = __bVerdict && __res;
  }
  if (__bVerdict == __eVerdictFail)
    TestReportWriteDiagObjectList();
}

void Tto7tsimc_F182_DID_with_Functional_Address()
{
  stack long __tableHandle;
  TestCommandBegin(__eDiagService, __cDiagService, "", "0");
  {
    if (DiagIsFunctionalGroup("CVADAS_0001_00000000_000"))
    {
      DiagResponse * __resp;
      DiagRequest CVADAS_0001_00000000_000._22F182_Application_Data_Identification __req;
      __diagServiceo7tsimc_4(__req, __resp);
    }
    else
    {
      DiagResponse CVADAS_0001_00000000_000.* __resp;
      DiagRequest CVADAS_0001_00000000_000._22F182_Application_Data_Identification __req;
      __diagServiceo7tsimc_4(__req, __resp);
    }
  }
  TestCommandEnd();


}

  
void __diagServiceo7tsimc_4(DiagRequest * __req, DiagResponse * __resp )
{
  stack long __tableHandle;
  long __res, __paramLen, __bytePos;

   __bVerdict = __eVerdictPass;

  do {
    TestReportResetDiagObjectList();
    DiagSetReportDetailLevel("CVADAS_0001_00000000_000", EnumServiceDetails_onfail);
    // Request aspect
    {

      if (0 >= DiagSendReqAndWaitForResp("CVADAS_0001_00000000_000", __req, __resp, __res, -1, -1, -1, -1, -1, EnumResult_pos, EnumServiceDetails_onfail, EnumSendingMode_physical, EnumSuppressPosResBit_asconfigured, EnumVerdictOnInvalidValues_fail))
        break;
    }

    __res = DiagErrCodeTestStep(__res, "Can't retrieve last response for request! No check possible.") < 0;
    if(__res)
    {
	  __bVerdict = __eVerdictFail;
      break;
    }
    {
      __res = DiagInterpretAs(__resp, "RDBI_PR");
      if(__res != 0)
      {
        __bVerdict = __eVerdictFail;
        DiagErrCodeTestStep(__res, "Can't interpret response as diagnostic primitive 'RDBI_PR'.");
        break;
      }
      else
      {
        TestStepPass( "Received primitive can be interpreted as diagnostic primitive 'RDBI_PR'.");
      }
    }
  }
  while(0);


  // Response, check & read aspect
  {
    __res = 1;
    __tableHandle = ReportTableHead5Columns(__cCheckCaption, __cTSym, __cTOp, __cRefVal, __cActual, __cRes);
    {
      __bDiagValueArrayCtr = DiagGetParameterErrorHandled(__resp, "Application_Data_Logical_Block_7_SwIdentification", __bDiagValueArray, elcount(__bDiagValueArray), __cDiagValueArray, elcount(__cDiagValueArray));
      {
        __bSetInCheckAlignment = 1;	
        {
          __bArrayCtr = __CopyBytes(__bDiagValueArray, __bDiagValueArrayCtr, __bArray);
          {
            sysvar * __systemVariable;
            __systemVariable = sysvarData::`PartNumber::`Part_Number;
            CheckSysVarSetBufferConsistency(sysSetVariableData(sysvarData::`PartNumber::`Part_Number, __bArray, __bArrayCtr), __systemVariable.name);
          }
          snprintf(__cArray, 8192, "%s", "Part_Number");
          snprintf(__cArray2, 8192, "%s '%s'", __cSysVar, __cArray);
          snprintf(__cArray3, 8192, "%s", "Application_Data_Logical_Block_7_SwIdentification");
          
          ReportTableRow(__tableHandle, 0, __cArray2, __cAOp, __bArray, __bArrayCtr, __cArray3, __oneOfFlag, __bSetInCheckAlignment);
        
        }
    
        __bSetInCheckAlignment = 0;
      }
    }
    {
      __bDiagValueArrayCtr = DiagGetParameterErrorHandled(__resp, "Application_Data_Logical_Block_7_SwPatch_Level", __bDiagValueArray, elcount(__bDiagValueArray), __cDiagValueArray, elcount(__cDiagValueArray));
      {
        __bSetInCheckAlignment = 1;	
        {
          __bArrayCtr = __CopyBytes(__bDiagValueArray, __bDiagValueArrayCtr, __bArray);
          {
            sysvar * __systemVariable;
            __systemVariable = sysvarData::`PartNumber::`Part_Number;
            CheckSysVarSetBufferConsistency(sysSetVariableData(sysvarData::`PartNumber::`Part_Number, __bArray, __bArrayCtr), __systemVariable.name);
          }
          snprintf(__cArray, 8192, "%s", "Part_Number");
          snprintf(__cArray2, 8192, "%s '%s'", __cSysVar, __cArray);
          snprintf(__cArray3, 8192, "%s", "Application_Data_Logical_Block_7_SwPatch_Level");
          
          ReportTableRow(__tableHandle, 0, __cArray2, __cAOp, __bArray, __bArrayCtr, __cArray3, __oneOfFlag, __bSetInCheckAlignment);
        
        }
    
        __bSetInCheckAlignment = 0;
      }
    }
    {
      __bDiagValueArrayCtr = DiagGetParameterErrorHandled(__resp, "Application_Data_Logical_Block_7_SwWeek", __bDiagValueArray, elcount(__bDiagValueArray), __cDiagValueArray, elcount(__cDiagValueArray));
      {
        __bSetInCheckAlignment = 1;	
        {
          __bArrayCtr = __CopyBytes(__bDiagValueArray, __bDiagValueArrayCtr, __bArray);
          {
            sysvar * __systemVariable;
            __systemVariable = sysvarData::`PartNumber::`Part_Number;
            CheckSysVarSetBufferConsistency(sysSetVariableData(sysvarData::`PartNumber::`Part_Number, __bArray, __bArrayCtr), __systemVariable.name);
          }
          snprintf(__cArray, 8192, "%s", "Part_Number");
          snprintf(__cArray2, 8192, "%s '%s'", __cSysVar, __cArray);
          snprintf(__cArray3, 8192, "%s", "Application_Data_Logical_Block_7_SwWeek");
          
          ReportTableRow(__tableHandle, 0, __cArray2, __cAOp, __bArray, __bArrayCtr, __cArray3, __oneOfFlag, __bSetInCheckAlignment);
        
        }
    
        __bSetInCheckAlignment = 0;
      }
    }
    {
      __bDiagValueArrayCtr = DiagGetParameterErrorHandled(__resp, "Application_Data_Logical_Block_7_SwYear", __bDiagValueArray, elcount(__bDiagValueArray), __cDiagValueArray, elcount(__cDiagValueArray));
      {
        __bSetInCheckAlignment = 1;	
        {
          __bArrayCtr = __CopyBytes(__bDiagValueArray, __bDiagValueArrayCtr, __bArray);
          {
            sysvar * __systemVariable;
            __systemVariable = sysvarData::`PartNumber::`Part_Number;
            CheckSysVarSetBufferConsistency(sysSetVariableData(sysvarData::`PartNumber::`Part_Number, __bArray, __bArrayCtr), __systemVariable.name);
          }
          snprintf(__cArray, 8192, "%s", "Part_Number");
          snprintf(__cArray2, 8192, "%s '%s'", __cSysVar, __cArray);
          snprintf(__cArray3, 8192, "%s", "Application_Data_Logical_Block_7_SwYear");
          
          ReportTableRow(__tableHandle, 0, __cArray2, __cAOp, __bArray, __bArrayCtr, __cArray3, __oneOfFlag, __bSetInCheckAlignment);
        
        }
    
        __bSetInCheckAlignment = 0;
      }
    }
    {
      __bDiagValueArrayCtr = DiagGetParameterErrorHandled(__resp, "Application_Data_Logical_Block_8_SwIdentification", __bDiagValueArray, elcount(__bDiagValueArray), __cDiagValueArray, elcount(__cDiagValueArray));
      {
        __bSetInCheckAlignment = 1;	
        {
          __bArrayCtr = __CopyBytes(__bDiagValueArray, __bDiagValueArrayCtr, __bArray);
          {
            sysvar * __systemVariable;
            __systemVariable = sysvarData::`PartNumber::`Part_Number;
            CheckSysVarSetBufferConsistency(sysSetVariableData(sysvarData::`PartNumber::`Part_Number, __bArray, __bArrayCtr), __systemVariable.name);
          }
          snprintf(__cArray, 8192, "%s", "Part_Number");
          snprintf(__cArray2, 8192, "%s '%s'", __cSysVar, __cArray);
          snprintf(__cArray3, 8192, "%s", "Application_Data_Logical_Block_8_SwIdentification");
          
          ReportTableRow(__tableHandle, 0, __cArray2, __cAOp, __bArray, __bArrayCtr, __cArray3, __oneOfFlag, __bSetInCheckAlignment);
        
        }
    
        __bSetInCheckAlignment = 0;
      }
    }
    {
      __bDiagValueArrayCtr = DiagGetParameterErrorHandled(__resp, "Application_Data_Logical_Block_8_SwPatch_Level", __bDiagValueArray, elcount(__bDiagValueArray), __cDiagValueArray, elcount(__cDiagValueArray));
      {
        __bSetInCheckAlignment = 1;	
        {
          __bArrayCtr = __CopyBytes(__bDiagValueArray, __bDiagValueArrayCtr, __bArray);
          {
            sysvar * __systemVariable;
            __systemVariable = sysvarData::`PartNumber::`Part_Number;
            CheckSysVarSetBufferConsistency(sysSetVariableData(sysvarData::`PartNumber::`Part_Number, __bArray, __bArrayCtr), __systemVariable.name);
          }
          snprintf(__cArray, 8192, "%s", "Part_Number");
          snprintf(__cArray2, 8192, "%s '%s'", __cSysVar, __cArray);
          snprintf(__cArray3, 8192, "%s", "Application_Data_Logical_Block_8_SwPatch_Level");
          
          ReportTableRow(__tableHandle, 0, __cArray2, __cAOp, __bArray, __bArrayCtr, __cArray3, __oneOfFlag, __bSetInCheckAlignment);
        
        }
    
        __bSetInCheckAlignment = 0;
      }
    }
    {
      __bDiagValueArrayCtr = DiagGetParameterErrorHandled(__resp, "Application_Data_Logical_Block_8_SwWeek", __bDiagValueArray, elcount(__bDiagValueArray), __cDiagValueArray, elcount(__cDiagValueArray));
      {
        __bSetInCheckAlignment = 1;	
        {
          __bArrayCtr = __CopyBytes(__bDiagValueArray, __bDiagValueArrayCtr, __bArray);
          {
            sysvar * __systemVariable;
            __systemVariable = sysvarData::`PartNumber::`Part_Number;
            CheckSysVarSetBufferConsistency(sysSetVariableData(sysvarData::`PartNumber::`Part_Number, __bArray, __bArrayCtr), __systemVariable.name);
          }
          snprintf(__cArray, 8192, "%s", "Part_Number");
          snprintf(__cArray2, 8192, "%s '%s'", __cSysVar, __cArray);
          snprintf(__cArray3, 8192, "%s", "Application_Data_Logical_Block_8_SwWeek");
          
          ReportTableRow(__tableHandle, 0, __cArray2, __cAOp, __bArray, __bArrayCtr, __cArray3, __oneOfFlag, __bSetInCheckAlignment);
        
        }
    
        __bSetInCheckAlignment = 0;
      }
    }
    {
      __bDiagValueArrayCtr = DiagGetParameterErrorHandled(__resp, "Application_Data_Logical_Block_8_SwYear", __bDiagValueArray, elcount(__bDiagValueArray), __cDiagValueArray, elcount(__cDiagValueArray));
      {
        __bSetInCheckAlignment = 1;	
        {
          __bArrayCtr = __CopyBytes(__bDiagValueArray, __bDiagValueArrayCtr, __bArray);
          {
            sysvar * __systemVariable;
            __systemVariable = sysvarData::`PartNumber::`Part_Number;
            CheckSysVarSetBufferConsistency(sysSetVariableData(sysvarData::`PartNumber::`Part_Number, __bArray, __bArrayCtr), __systemVariable.name);
          }
          snprintf(__cArray, 8192, "%s", "Part_Number");
          snprintf(__cArray2, 8192, "%s '%s'", __cSysVar, __cArray);
          snprintf(__cArray3, 8192, "%s", "Application_Data_Logical_Block_8_SwYear");
          
          ReportTableRow(__tableHandle, 0, __cArray2, __cAOp, __bArray, __bArrayCtr, __cArray3, __oneOfFlag, __bSetInCheckAlignment);
        
        }
    
        __bSetInCheckAlignment = 0;
      }
    }
    {
      __bDiagValueArrayCtr = DiagGetParameterErrorHandled(__resp, "_Number_of_Application_Data_Logical_Blocks_24", __bDiagValueArray, elcount(__bDiagValueArray), __cDiagValueArray, elcount(__cDiagValueArray));
      {
        __bSetInCheckAlignment = 1;	
        {
          __bArrayCtr = __CopyBytes(__bDiagValueArray, __bDiagValueArrayCtr, __bArray);
          {
            sysvar * __systemVariable;
            __systemVariable = sysvarData::`PartNumber::`Part_Number;
            CheckSysVarSetBufferConsistency(sysSetVariableData(sysvarData::`PartNumber::`Part_Number, __bArray, __bArrayCtr), __systemVariable.name);
          }
          snprintf(__cArray, 8192, "%s", "Part_Number");
          snprintf(__cArray2, 8192, "%s '%s'", __cSysVar, __cArray);
          snprintf(__cArray3, 8192, "%s", "_Number_of_Application_Data_Logical_Blocks_24");
          
          ReportTableRow(__tableHandle, 0, __cArray2, __cAOp, __bArray, __bArrayCtr, __cArray3, __oneOfFlag, __bSetInCheckAlignment);
        
        }
    
        __bSetInCheckAlignment = 0;
      }
    }
    {
      __bDiagValueArrayCtr = DiagGetParameterErrorHandled(__resp, "_SW_Year_32", __bDiagValueArray, elcount(__bDiagValueArray), __cDiagValueArray, elcount(__cDiagValueArray));
      {
        __bSetInCheckAlignment = 1;	
        {
          __bArrayCtr = __CopyBytes(__bDiagValueArray, __bDiagValueArrayCtr, __bArray);
          {
            sysvar * __systemVariable;
            __systemVariable = sysvarData::`PartNumber::`Part_Number;
            CheckSysVarSetBufferConsistency(sysSetVariableData(sysvarData::`PartNumber::`Part_Number, __bArray, __bArrayCtr), __systemVariable.name);
          }
          snprintf(__cArray, 8192, "%s", "Part_Number");
          snprintf(__cArray2, 8192, "%s '%s'", __cSysVar, __cArray);
          snprintf(__cArray3, 8192, "%s", "_SW_Year_32");
          
          ReportTableRow(__tableHandle, 0, __cArray2, __cAOp, __bArray, __bArrayCtr, __cArray3, __oneOfFlag, __bSetInCheckAlignment);
        
        }
    
        __bSetInCheckAlignment = 0;
      }
    }
    {
      __bDiagValueArrayCtr = DiagGetParameterErrorHandled(__resp, "_SW__Identification_56", __bDiagValueArray, elcount(__bDiagValueArray), __cDiagValueArray, elcount(__cDiagValueArray));
      {
        __bSetInCheckAlignment = 1;	
        {
          __bArrayCtr = __CopyBytes(__bDiagValueArray, __bDiagValueArrayCtr, __bArray);
          {
            sysvar * __systemVariable;
            __systemVariable = sysvarData::`PartNumber::`Part_Number;
            CheckSysVarSetBufferConsistency(sysSetVariableData(sysvarData::`PartNumber::`Part_Number, __bArray, __bArrayCtr), __systemVariable.name);
          }
          snprintf(__cArray, 8192, "%s", "Part_Number");
          snprintf(__cArray2, 8192, "%s '%s'", __cSysVar, __cArray);
          snprintf(__cArray3, 8192, "%s", "_SW__Identification_56");
          
          ReportTableRow(__tableHandle, 0, __cArray2, __cAOp, __bArray, __bArrayCtr, __cArray3, __oneOfFlag, __bSetInCheckAlignment);
        
        }
    
        __bSetInCheckAlignment = 0;
      }
    }
    {
      __bDiagValueArrayCtr = DiagGetParameterErrorHandled(__resp, "_SW__Patch_Level_48", __bDiagValueArray, elcount(__bDiagValueArray), __cDiagValueArray, elcount(__cDiagValueArray));
      {
        __bSetInCheckAlignment = 1;	
        {
          __bArrayCtr = __CopyBytes(__bDiagValueArray, __bDiagValueArrayCtr, __bArray);
          {
            sysvar * __systemVariable;
            __systemVariable = sysvarData::`PartNumber::`Part_Number;
            CheckSysVarSetBufferConsistency(sysSetVariableData(sysvarData::`PartNumber::`Part_Number, __bArray, __bArrayCtr), __systemVariable.name);
          }
          snprintf(__cArray, 8192, "%s", "Part_Number");
          snprintf(__cArray2, 8192, "%s '%s'", __cSysVar, __cArray);
          snprintf(__cArray3, 8192, "%s", "_SW__Patch_Level_48");
          
          ReportTableRow(__tableHandle, 0, __cArray2, __cAOp, __bArray, __bArrayCtr, __cArray3, __oneOfFlag, __bSetInCheckAlignment);
        
        }
    
        __bSetInCheckAlignment = 0;
      }
    }
    {
      __bDiagValueArrayCtr = DiagGetParameterErrorHandled(__resp, "_SW__Week_40", __bDiagValueArray, elcount(__bDiagValueArray), __cDiagValueArray, elcount(__cDiagValueArray));
      {
        __bSetInCheckAlignment = 1;	
        {
          __bArrayCtr = __CopyBytes(__bDiagValueArray, __bDiagValueArrayCtr, __bArray);
          {
            sysvar * __systemVariable;
            __systemVariable = sysvarData::`PartNumber::`Part_Number;
            CheckSysVarSetBufferConsistency(sysSetVariableData(sysvarData::`PartNumber::`Part_Number, __bArray, __bArrayCtr), __systemVariable.name);
          }
          snprintf(__cArray, 8192, "%s", "Part_Number");
          snprintf(__cArray2, 8192, "%s '%s'", __cSysVar, __cArray);
          snprintf(__cArray3, 8192, "%s", "_SW__Week_40");
          
          ReportTableRow(__tableHandle, 0, __cArray2, __cAOp, __bArray, __bArrayCtr, __cArray3, __oneOfFlag, __bSetInCheckAlignment);
        
        }
    
        __bSetInCheckAlignment = 0;
      }
    }
    ReportTableEndVerdict(__tableHandle, __cEvaluateResponse, __res);
	__bVerdict = __bVerdict && __res;
  }
  if (__bVerdict == __eVerdictFail)
    TestReportWriteDiagObjectList();
}

void Tto7tsimc_F182_DID_with_Standard_Physical_Address()
{
  stack long __tableHandle;
  TestCommandBegin(__eRequestResponse, __cRequestResponse, "", "0");
  {
  
    long __res;
    int64 __timeout;
    __res = 0;
    __nInt64 = 1;
    __timeout = syspar::`P2_Server * 1000000LL;
    {
    
      long __testStepInitOk;
      message `FDCAN2::`DIAGNOSTIC_REQUEST_PAM __output;
      message `FDCAN2::`DIAGNOSTIC_REQUEST_PAM __msgOrig;
      __output = __msgOrig;
      __testStepInitOk = 1;
      {
        int64 __dlc;
        __dlc = 4;
        if (__dlc >= 0 && __dlc <= (__output.EDL ? 15 : 8))
          __output.DLC = __dlc;
        else
        {
          testStepErrorInTestSystem(0, __cEmpty, "Unable to set DLC=%lld in message. Please check input parameter.", __dlc);
          __testStepInitOk = 0;
        }
      }
      if (__testStepInitOk)
      {
        snprintf(__cArray, elCount(__cArray), "CAN message '%s' ID = 416981233x (0x18DAA0F1x) on bus FDCAN2", "DIAGNOSTIC_REQUEST_PAM");
        snprintf(__cArray2, elCount(__cArray2), "Send %s", __cArray);
        __tableHandle = ReportTableHead3Columns(__cArray2, "Byte", __cTOp, __cAssigned);
        ReportByteIndex("", 0, __cArray, elCount(__cArray));
        snprintf(__cArray2, 8192, "%s", __cArray);
        snprintf(__cArray3, 8192, "%s", "");
        
        ReportTableRow(__tableHandle, 0, __cArray2, __cAOp, 0x3, __cArray3, __oneOfFlag, __bSetInCheckAlignment);
        
        if (0 >= 0 && 0 < 64)
        {
          __output.byte((word)0) = 0x3;
        }
        else
        {
          testStepErrorInTestSystem(0, __cEmpty, "Index out of range. Unable to set byte %lld in message. Please check input parameter.", (int64)0);
          __testStepInitOk = 0;
        }
        ReportByteIndex("", 1, __cArray, elCount(__cArray));
        snprintf(__cArray2, 8192, "%s", __cArray);
        snprintf(__cArray3, 8192, "%s", "");
        
        ReportTableRow(__tableHandle, 0, __cArray2, __cAOp, 0x22, __cArray3, __oneOfFlag, __bSetInCheckAlignment);
        
        if (1 >= 0 && 1 < 64)
        {
          __output.byte((word)1) = 0x22;
        }
        else
        {
          testStepErrorInTestSystem(0, __cEmpty, "Index out of range. Unable to set byte %lld in message. Please check input parameter.", (int64)1);
          __testStepInitOk = 0;
        }
        ReportByteIndex("", 2, __cArray, elCount(__cArray));
        snprintf(__cArray2, 8192, "%s", __cArray);
        snprintf(__cArray3, 8192, "%s", "");
        
        ReportTableRow(__tableHandle, 0, __cArray2, __cAOp, 0xF1, __cArray3, __oneOfFlag, __bSetInCheckAlignment);
        
        if (2 >= 0 && 2 < 64)
        {
          __output.byte((word)2) = 0xF1;
        }
        else
        {
          testStepErrorInTestSystem(0, __cEmpty, "Index out of range. Unable to set byte %lld in message. Please check input parameter.", (int64)2);
          __testStepInitOk = 0;
        }
        ReportByteIndex("", 3, __cArray, elCount(__cArray));
        snprintf(__cArray2, 8192, "%s", __cArray);
        snprintf(__cArray3, 8192, "%s", "");
        
        ReportTableRow(__tableHandle, 0, __cArray2, __cAOp, 0x82, __cArray3, __oneOfFlag, __bSetInCheckAlignment);
        
        if (3 >= 0 && 3 < 64)
        {
          __output.byte((word)3) = 0x82;
        }
        else
        {
          testStepErrorInTestSystem(0, __cEmpty, "Index out of range. Unable to set byte %lld in message. Please check input parameter.", (int64)3);
          __testStepInitOk = 0;
        }
      
        ReportTableEndTestStep(__tableHandle, "Req1");
      }
      if (__testStepInitOk)
      {
        output(__output);
      }
    }
    if (__timeout <= 0)
    {
      testStepErrorInTestSystem(0, "1", "Unable to wait for %.3f %s. Please check input parameter.", __timeout / ((float)1000000), "ms");
    }
    else
    {
      __tt8cnt_9 = 0;
      snprintf(__cArray, elCount(__cArray), "CAN message '%s' ID = 417001888x (0x18DAF1A0x) on bus FDCAN2", "DIAGNOSTIC_RESPONSE_PAM");
      if(SetBusContextByName("FDCAN2", __eSaveCurrent, __nBusContextNew, __nBusContextOld))
        testJoinMessageEvent(`FDCAN2::`DIAGNOSTIC_RESPONSE_PAM,  __cArray,
             delegate dword(message * __m)
             {
               dword __msg_callback_ret;
               if (__tt8cnt_9 == -1)
               {
                 return 1;
               }
               __msg_callback_ret = 1;
               __tt8cnt_9++;
               if (__msg_callback_ret)
               {
                 __tt8cnt_9 = -1;
                 return 1;
               }
               return 0;
             });
      __res = testWaitForAllJoinedEventsNS(__timeout);
      if (__nInt64 != 0)
      {
        snprintf(__cArray, elCount(__cArray), "CAN message '%s' ID = 417001888x (0x18DAF1A0x) on bus FDCAN2", "DIAGNOSTIC_RESPONSE_PAM");
        if(__tt8cnt_9 == -1)
        {
          snprintf(__cArray2, 8192, "Response of %s", __cArray);
        }
        else
        {
          snprintf(__cArray2, 8192, "Response of %s (received %d times)", __cArray, __tt8cnt_9);
        }
        if (__tt8cnt_9 == 0)
        {
          testStepFail(0, "Resp1", __cArray2);
        }
        else
        {
          testStepPass(2, "Resp1", __cArray2);
        }
        __ReportRequestResponseResult(__res, 0);
      }
      ResetBusContext(__nBusContextNew, __nBusContextOld);
    }
  }
  TestCommandEnd();

}

void Tto7tsimc_F122_DID_with_Physical_Address()
{
  stack long __tableHandle;
  TestCommandBegin(__eDiagService, __cDiagService, "", "0");
  {
    if (DiagIsFunctionalGroup("CVADAS_0001_00000000_000"))
    {
      DiagResponse * __resp;
      DiagRequest CVADAS_0001_00000000_000._22F122_Software_EBOM_Part_Number __req;
      __diagServiceo7tsimc_5(__req, __resp);
    }
    else
    {
      DiagResponse CVADAS_0001_00000000_000.* __resp;
      DiagRequest CVADAS_0001_00000000_000._22F122_Software_EBOM_Part_Number __req;
      __diagServiceo7tsimc_5(__req, __resp);
    }
  }
  TestCommandEnd();


}

  
void __diagServiceo7tsimc_5(DiagRequest * __req, DiagResponse * __resp )
{
  stack long __tableHandle;
  long __res, __paramLen, __bytePos;

   __bVerdict = __eVerdictPass;

  do {
    TestReportResetDiagObjectList();
    DiagSetReportDetailLevel("CVADAS_0001_00000000_000", EnumServiceDetails_onfail);
    // Request aspect
    {

      if (0 >= DiagSendReqAndWaitForResp("CVADAS_0001_00000000_000", __req, __resp, __res, -1, -1, -1, -1, -1, EnumResult_pos, EnumServiceDetails_onfail, EnumSendingMode_physical, EnumSuppressPosResBit_asconfigured, EnumVerdictOnInvalidValues_fail))
        break;
    }

    __res = DiagErrCodeTestStep(__res, "Can't retrieve last response for request! No check possible.") < 0;
    if(__res)
    {
	  __bVerdict = __eVerdictFail;
      break;
    }
    {
      __res = DiagInterpretAs(__resp, "RDBI_PR");
      if(__res != 0)
      {
        __bVerdict = __eVerdictFail;
        DiagErrCodeTestStep(__res, "Can't interpret response as diagnostic primitive 'RDBI_PR'.");
        break;
      }
      else
      {
        TestStepPass( "Received primitive can be interpreted as diagnostic primitive 'RDBI_PR'.");
      }
    }
  }
  while(0);


  // Response, check & read aspect
  {
    __res = 1;
    __tableHandle = ReportTableHead5Columns(__cCheckCaption, __cTSym, __cTOp, __cRefVal, __cActual, __cRes);
    {
      __bDiagValueArrayCtr = DiagGetParameterErrorHandled(__resp, "_Software_Logical_Block_1_Part_Number_24", __bDiagValueArray, elcount(__bDiagValueArray), __cDiagValueArray, elcount(__cDiagValueArray));
      {
        __bSetInCheckAlignment = 1;	
        {
          __bArrayCtr = __CopyBytes(__bDiagValueArray, __bDiagValueArrayCtr, __bArray);
          {
            sysvar * __systemVariable;
            __systemVariable = sysvarData::`PartNumber::`Part_Number;
            CheckSysVarSetBufferConsistency(sysSetVariableData(sysvarData::`PartNumber::`Part_Number, __bArray, __bArrayCtr), __systemVariable.name);
          }
          snprintf(__cArray, 8192, "%s", "Part_Number");
          snprintf(__cArray2, 8192, "%s '%s'", __cSysVar, __cArray);
          snprintf(__cArray3, 8192, "%s", "_Software_Logical_Block_1_Part_Number_24");
          
          ReportTableRow(__tableHandle, 0, __cArray2, __cAOp, __bArray, __bArrayCtr, __cArray3, __oneOfFlag, __bSetInCheckAlignment);
        
        }
    
        __bSetInCheckAlignment = 0;
      }
    }
    {
      __bDiagValueArrayCtr = DiagGetParameterErrorHandled(__resp, "Software_Logical_Block_2_Part_Number", __bDiagValueArray, elcount(__bDiagValueArray), __cDiagValueArray, elcount(__cDiagValueArray));
      {
        __bSetInCheckAlignment = 1;	
        {
          __bArrayCtr = __CopyBytes(__bDiagValueArray, __bDiagValueArrayCtr, __bArray);
          {
            sysvar * __systemVariable;
            __systemVariable = sysvarData::`PartNumber::`Part_Number;
            CheckSysVarSetBufferConsistency(sysSetVariableData(sysvarData::`PartNumber::`Part_Number, __bArray, __bArrayCtr), __systemVariable.name);
          }
          snprintf(__cArray, 8192, "%s", "Part_Number");
          snprintf(__cArray2, 8192, "%s '%s'", __cSysVar, __cArray);
          snprintf(__cArray3, 8192, "%s", "Software_Logical_Block_2_Part_Number");
          
          ReportTableRow(__tableHandle, 0, __cArray2, __cAOp, __bArray, __bArrayCtr, __cArray3, __oneOfFlag, __bSetInCheckAlignment);
        
        }
    
        __bSetInCheckAlignment = 0;
      }
    }
    {
      __bDiagValueArrayCtr = DiagGetParameterErrorHandled(__resp, "Software_Logical_Block_3_Part_Number", __bDiagValueArray, elcount(__bDiagValueArray), __cDiagValueArray, elcount(__cDiagValueArray));
      {
        __bSetInCheckAlignment = 1;	
        {
          __bArrayCtr = __CopyBytes(__bDiagValueArray, __bDiagValueArrayCtr, __bArray);
          {
            sysvar * __systemVariable;
            __systemVariable = sysvarData::`PartNumber::`Part_Number;
            CheckSysVarSetBufferConsistency(sysSetVariableData(sysvarData::`PartNumber::`Part_Number, __bArray, __bArrayCtr), __systemVariable.name);
          }
          snprintf(__cArray, 8192, "%s", "Part_Number");
          snprintf(__cArray2, 8192, "%s '%s'", __cSysVar, __cArray);
          snprintf(__cArray3, 8192, "%s", "Software_Logical_Block_3_Part_Number");
          
          ReportTableRow(__tableHandle, 0, __cArray2, __cAOp, __bArray, __bArrayCtr, __cArray3, __oneOfFlag, __bSetInCheckAlignment);
        
        }
    
        __bSetInCheckAlignment = 0;
      }
    }
    {
      __bDiagValueArrayCtr = DiagGetParameterErrorHandled(__resp, "Software_Logical_Block_4_Part_Number", __bDiagValueArray, elcount(__bDiagValueArray), __cDiagValueArray, elcount(__cDiagValueArray));
      {
        __bSetInCheckAlignment = 1;	
        {
          __bArrayCtr = __CopyBytes(__bDiagValueArray, __bDiagValueArrayCtr, __bArray);
          {
            sysvar * __systemVariable;
            __systemVariable = sysvarData::`PartNumber::`Part_Number;
            CheckSysVarSetBufferConsistency(sysSetVariableData(sysvarData::`PartNumber::`Part_Number, __bArray, __bArrayCtr), __systemVariable.name);
          }
          snprintf(__cArray, 8192, "%s", "Part_Number");
          snprintf(__cArray2, 8192, "%s '%s'", __cSysVar, __cArray);
          snprintf(__cArray3, 8192, "%s", "Software_Logical_Block_4_Part_Number");
          
          ReportTableRow(__tableHandle, 0, __cArray2, __cAOp, __bArray, __bArrayCtr, __cArray3, __oneOfFlag, __bSetInCheckAlignment);
        
        }
    
        __bSetInCheckAlignment = 0;
      }
    }
    {
      __bDiagValueArrayCtr = DiagGetParameterErrorHandled(__resp, "Software_Logical_Block_5_Part_Number", __bDiagValueArray, elcount(__bDiagValueArray), __cDiagValueArray, elcount(__cDiagValueArray));
      {
        __bSetInCheckAlignment = 1;	
        {
          __bArrayCtr = __CopyBytes(__bDiagValueArray, __bDiagValueArrayCtr, __bArray);
          {
            sysvar * __systemVariable;
            __systemVariable = sysvarData::`PartNumber::`Part_Number;
            CheckSysVarSetBufferConsistency(sysSetVariableData(sysvarData::`PartNumber::`Part_Number, __bArray, __bArrayCtr), __systemVariable.name);
          }
          snprintf(__cArray, 8192, "%s", "Part_Number");
          snprintf(__cArray2, 8192, "%s '%s'", __cSysVar, __cArray);
          snprintf(__cArray3, 8192, "%s", "Software_Logical_Block_5_Part_Number");
          
          ReportTableRow(__tableHandle, 0, __cArray2, __cAOp, __bArray, __bArrayCtr, __cArray3, __oneOfFlag, __bSetInCheckAlignment);
        
        }
    
        __bSetInCheckAlignment = 0;
      }
    }
    {
      __bDiagValueArrayCtr = DiagGetParameterErrorHandled(__resp, "Software_Logical_Block_7_Part_Number", __bDiagValueArray, elcount(__bDiagValueArray), __cDiagValueArray, elcount(__cDiagValueArray));
      {
        __bSetInCheckAlignment = 1;	
        {
          __bArrayCtr = __CopyBytes(__bDiagValueArray, __bDiagValueArrayCtr, __bArray);
          {
            sysvar * __systemVariable;
            __systemVariable = sysvarData::`PartNumber::`Part_Number;
            CheckSysVarSetBufferConsistency(sysSetVariableData(sysvarData::`PartNumber::`Part_Number, __bArray, __bArrayCtr), __systemVariable.name);
          }
          snprintf(__cArray, 8192, "%s", "Part_Number");
          snprintf(__cArray2, 8192, "%s '%s'", __cSysVar, __cArray);
          snprintf(__cArray3, 8192, "%s", "Software_Logical_Block_7_Part_Number");
          
          ReportTableRow(__tableHandle, 0, __cArray2, __cAOp, __bArray, __bArrayCtr, __cArray3, __oneOfFlag, __bSetInCheckAlignment);
        
        }
    
        __bSetInCheckAlignment = 0;
      }
    }
    {
      __bDiagValueArrayCtr = DiagGetParameterErrorHandled(__resp, "Software_Logical_Block_8_Part_Number", __bDiagValueArray, elcount(__bDiagValueArray), __cDiagValueArray, elcount(__cDiagValueArray));
      {
        __bSetInCheckAlignment = 1;	
        {
          __bArrayCtr = __CopyBytes(__bDiagValueArray, __bDiagValueArrayCtr, __bArray);
          {
            sysvar * __systemVariable;
            __systemVariable = sysvarData::`PartNumber::`Part_Number;
            CheckSysVarSetBufferConsistency(sysSetVariableData(sysvarData::`PartNumber::`Part_Number, __bArray, __bArrayCtr), __systemVariable.name);
          }
          snprintf(__cArray, 8192, "%s", "Part_Number");
          snprintf(__cArray2, 8192, "%s '%s'", __cSysVar, __cArray);
          snprintf(__cArray3, 8192, "%s", "Software_Logical_Block_8_Part_Number");
          
          ReportTableRow(__tableHandle, 0, __cArray2, __cAOp, __bArray, __bArrayCtr, __cArray3, __oneOfFlag, __bSetInCheckAlignment);
        
        }
    
        __bSetInCheckAlignment = 0;
      }
    }
    ReportTableEndVerdict(__tableHandle, __cEvaluateResponse, __res);
	__bVerdict = __bVerdict && __res;
  }
  if (__bVerdict == __eVerdictFail)
    TestReportWriteDiagObjectList();
}

void Tto7tsimc_F122_DID_with_Functional_Address()
{
  stack long __tableHandle;
  TestCommandBegin(__eDiagService, __cDiagService, "", "0");
  {
    if (DiagIsFunctionalGroup("CVADAS_0001_00000000_000"))
    {
      DiagResponse * __resp;
      DiagRequest CVADAS_0001_00000000_000._22F122_Software_EBOM_Part_Number __req;
      __diagServiceo7tsimc_6(__req, __resp);
    }
    else
    {
      DiagResponse CVADAS_0001_00000000_000.* __resp;
      DiagRequest CVADAS_0001_00000000_000._22F122_Software_EBOM_Part_Number __req;
      __diagServiceo7tsimc_6(__req, __resp);
    }
  }
  TestCommandEnd();


}

  
void __diagServiceo7tsimc_6(DiagRequest * __req, DiagResponse * __resp )
{
  stack long __tableHandle;
  long __res, __paramLen, __bytePos;

   __bVerdict = __eVerdictPass;

  do {
    TestReportResetDiagObjectList();
    DiagSetReportDetailLevel("CVADAS_0001_00000000_000", EnumServiceDetails_onfail);
    // Request aspect
    {

      if (0 >= DiagSendReqAndWaitForResp("CVADAS_0001_00000000_000", __req, __resp, __res, -1, -1, -1, -1, -1, EnumResult_pos, EnumServiceDetails_onfail, EnumSendingMode_physical, EnumSuppressPosResBit_asconfigured, EnumVerdictOnInvalidValues_fail))
        break;
    }

    __res = DiagErrCodeTestStep(__res, "Can't retrieve last response for request! No check possible.") < 0;
    if(__res)
    {
	  __bVerdict = __eVerdictFail;
      break;
    }
    {
      __res = DiagInterpretAs(__resp, "RDBI_PR");
      if(__res != 0)
      {
        __bVerdict = __eVerdictFail;
        DiagErrCodeTestStep(__res, "Can't interpret response as diagnostic primitive 'RDBI_PR'.");
        break;
      }
      else
      {
        TestStepPass( "Received primitive can be interpreted as diagnostic primitive 'RDBI_PR'.");
      }
    }
  }
  while(0);


  // Response, check & read aspect
  {
    __res = 1;
    __tableHandle = ReportTableHead5Columns(__cCheckCaption, __cTSym, __cTOp, __cRefVal, __cActual, __cRes);
    {
      __bDiagValueArrayCtr = DiagGetParameterErrorHandled(__resp, "_Software_Logical_Block_1_Part_Number_24", __bDiagValueArray, elcount(__bDiagValueArray), __cDiagValueArray, elcount(__cDiagValueArray));
      {
        __bSetInCheckAlignment = 1;	
        {
          __bArrayCtr = __CopyBytes(__bDiagValueArray, __bDiagValueArrayCtr, __bArray);
          {
            sysvar * __systemVariable;
            __systemVariable = sysvarData::`PartNumber::`Part_Number;
            CheckSysVarSetBufferConsistency(sysSetVariableData(sysvarData::`PartNumber::`Part_Number, __bArray, __bArrayCtr), __systemVariable.name);
          }
          snprintf(__cArray, 8192, "%s", "Part_Number");
          snprintf(__cArray2, 8192, "%s '%s'", __cSysVar, __cArray);
          snprintf(__cArray3, 8192, "%s", "_Software_Logical_Block_1_Part_Number_24");
          
          ReportTableRow(__tableHandle, 0, __cArray2, __cAOp, __bArray, __bArrayCtr, __cArray3, __oneOfFlag, __bSetInCheckAlignment);
        
        }
    
        __bSetInCheckAlignment = 0;
      }
    }
    {
      __bDiagValueArrayCtr = DiagGetParameterErrorHandled(__resp, "Software_Logical_Block_2_Part_Number", __bDiagValueArray, elcount(__bDiagValueArray), __cDiagValueArray, elcount(__cDiagValueArray));
      {
        __bSetInCheckAlignment = 1;	
        {
          __bArrayCtr = __CopyBytes(__bDiagValueArray, __bDiagValueArrayCtr, __bArray);
          {
            sysvar * __systemVariable;
            __systemVariable = sysvarData::`PartNumber::`Part_Number;
            CheckSysVarSetBufferConsistency(sysSetVariableData(sysvarData::`PartNumber::`Part_Number, __bArray, __bArrayCtr), __systemVariable.name);
          }
          snprintf(__cArray, 8192, "%s", "Part_Number");
          snprintf(__cArray2, 8192, "%s '%s'", __cSysVar, __cArray);
          snprintf(__cArray3, 8192, "%s", "Software_Logical_Block_2_Part_Number");
          
          ReportTableRow(__tableHandle, 0, __cArray2, __cAOp, __bArray, __bArrayCtr, __cArray3, __oneOfFlag, __bSetInCheckAlignment);
        
        }
    
        __bSetInCheckAlignment = 0;
      }
    }
    {
      __bDiagValueArrayCtr = DiagGetParameterErrorHandled(__resp, "Software_Logical_Block_3_Part_Number", __bDiagValueArray, elcount(__bDiagValueArray), __cDiagValueArray, elcount(__cDiagValueArray));
      {
        __bSetInCheckAlignment = 1;	
        {
          __bArrayCtr = __CopyBytes(__bDiagValueArray, __bDiagValueArrayCtr, __bArray);
          {
            sysvar * __systemVariable;
            __systemVariable = sysvarData::`PartNumber::`Part_Number;
            CheckSysVarSetBufferConsistency(sysSetVariableData(sysvarData::`PartNumber::`Part_Number, __bArray, __bArrayCtr), __systemVariable.name);
          }
          snprintf(__cArray, 8192, "%s", "Part_Number");
          snprintf(__cArray2, 8192, "%s '%s'", __cSysVar, __cArray);
          snprintf(__cArray3, 8192, "%s", "Software_Logical_Block_3_Part_Number");
          
          ReportTableRow(__tableHandle, 0, __cArray2, __cAOp, __bArray, __bArrayCtr, __cArray3, __oneOfFlag, __bSetInCheckAlignment);
        
        }
    
        __bSetInCheckAlignment = 0;
      }
    }
    {
      __bDiagValueArrayCtr = DiagGetParameterErrorHandled(__resp, "Software_Logical_Block_4_Part_Number", __bDiagValueArray, elcount(__bDiagValueArray), __cDiagValueArray, elcount(__cDiagValueArray));
      {
        __bSetInCheckAlignment = 1;	
        {
          __bArrayCtr = __CopyBytes(__bDiagValueArray, __bDiagValueArrayCtr, __bArray);
          {
            sysvar * __systemVariable;
            __systemVariable = sysvarData::`PartNumber::`Part_Number;
            CheckSysVarSetBufferConsistency(sysSetVariableData(sysvarData::`PartNumber::`Part_Number, __bArray, __bArrayCtr), __systemVariable.name);
          }
          snprintf(__cArray, 8192, "%s", "Part_Number");
          snprintf(__cArray2, 8192, "%s '%s'", __cSysVar, __cArray);
          snprintf(__cArray3, 8192, "%s", "Software_Logical_Block_4_Part_Number");
          
          ReportTableRow(__tableHandle, 0, __cArray2, __cAOp, __bArray, __bArrayCtr, __cArray3, __oneOfFlag, __bSetInCheckAlignment);
        
        }
    
        __bSetInCheckAlignment = 0;
      }
    }
    {
      __bDiagValueArrayCtr = DiagGetParameterErrorHandled(__resp, "Software_Logical_Block_5_Part_Number", __bDiagValueArray, elcount(__bDiagValueArray), __cDiagValueArray, elcount(__cDiagValueArray));
      {
        __bSetInCheckAlignment = 1;	
        {
          __bArrayCtr = __CopyBytes(__bDiagValueArray, __bDiagValueArrayCtr, __bArray);
          {
            sysvar * __systemVariable;
            __systemVariable = sysvarData::`PartNumber::`Part_Number;
            CheckSysVarSetBufferConsistency(sysSetVariableData(sysvarData::`PartNumber::`Part_Number, __bArray, __bArrayCtr), __systemVariable.name);
          }
          snprintf(__cArray, 8192, "%s", "Part_Number");
          snprintf(__cArray2, 8192, "%s '%s'", __cSysVar, __cArray);
          snprintf(__cArray3, 8192, "%s", "Software_Logical_Block_5_Part_Number");
          
          ReportTableRow(__tableHandle, 0, __cArray2, __cAOp, __bArray, __bArrayCtr, __cArray3, __oneOfFlag, __bSetInCheckAlignment);
        
        }
    
        __bSetInCheckAlignment = 0;
      }
    }
    {
      __bDiagValueArrayCtr = DiagGetParameterErrorHandled(__resp, "Software_Logical_Block_7_Part_Number", __bDiagValueArray, elcount(__bDiagValueArray), __cDiagValueArray, elcount(__cDiagValueArray));
      {
        __bSetInCheckAlignment = 1;	
        {
          __bArrayCtr = __CopyBytes(__bDiagValueArray, __bDiagValueArrayCtr, __bArray);
          {
            sysvar * __systemVariable;
            __systemVariable = sysvarData::`PartNumber::`Part_Number;
            CheckSysVarSetBufferConsistency(sysSetVariableData(sysvarData::`PartNumber::`Part_Number, __bArray, __bArrayCtr), __systemVariable.name);
          }
          snprintf(__cArray, 8192, "%s", "Part_Number");
          snprintf(__cArray2, 8192, "%s '%s'", __cSysVar, __cArray);
          snprintf(__cArray3, 8192, "%s", "Software_Logical_Block_7_Part_Number");
          
          ReportTableRow(__tableHandle, 0, __cArray2, __cAOp, __bArray, __bArrayCtr, __cArray3, __oneOfFlag, __bSetInCheckAlignment);
        
        }
    
        __bSetInCheckAlignment = 0;
      }
    }
    {
      __bDiagValueArrayCtr = DiagGetParameterErrorHandled(__resp, "Software_Logical_Block_8_Part_Number", __bDiagValueArray, elcount(__bDiagValueArray), __cDiagValueArray, elcount(__cDiagValueArray));
      {
        __bSetInCheckAlignment = 1;	
        {
          __bArrayCtr = __CopyBytes(__bDiagValueArray, __bDiagValueArrayCtr, __bArray);
          {
            sysvar * __systemVariable;
            __systemVariable = sysvarData::`PartNumber::`Part_Number;
            CheckSysVarSetBufferConsistency(sysSetVariableData(sysvarData::`PartNumber::`Part_Number, __bArray, __bArrayCtr), __systemVariable.name);
          }
          snprintf(__cArray, 8192, "%s", "Part_Number");
          snprintf(__cArray2, 8192, "%s '%s'", __cSysVar, __cArray);
          snprintf(__cArray3, 8192, "%s", "Software_Logical_Block_8_Part_Number");
          
          ReportTableRow(__tableHandle, 0, __cArray2, __cAOp, __bArray, __bArrayCtr, __cArray3, __oneOfFlag, __bSetInCheckAlignment);
        
        }
    
        __bSetInCheckAlignment = 0;
      }
    }
    ReportTableEndVerdict(__tableHandle, __cEvaluateResponse, __res);
	__bVerdict = __bVerdict && __res;
  }
  if (__bVerdict == __eVerdictFail)
    TestReportWriteDiagObjectList();
}

void Tto7tsimc_F122_DID_with_Standard_Physical_Address()
{
  stack long __tableHandle;
  TestCommandBegin(__eRequestResponse, __cRequestResponse, "", "0");
  {
  
    long __res;
    int64 __timeout;
    __res = 0;
    __nInt64 = 1;
    __timeout = syspar::`P2_Server * 1000000LL;
    {
    
      long __testStepInitOk;
      message `FDCAN2::`DIAGNOSTIC_REQUEST_PAM __output;
      message `FDCAN2::`DIAGNOSTIC_REQUEST_PAM __msgOrig;
      __output = __msgOrig;
      __testStepInitOk = 1;
      {
        int64 __dlc;
        __dlc = 4;
        if (__dlc >= 0 && __dlc <= (__output.EDL ? 15 : 8))
          __output.DLC = __dlc;
        else
        {
          testStepErrorInTestSystem(0, __cEmpty, "Unable to set DLC=%lld in message. Please check input parameter.", __dlc);
          __testStepInitOk = 0;
        }
      }
      if (__testStepInitOk)
      {
        snprintf(__cArray, elCount(__cArray), "CAN message '%s' ID = 416981233x (0x18DAA0F1x) on bus FDCAN2", "DIAGNOSTIC_REQUEST_PAM");
        snprintf(__cArray2, elCount(__cArray2), "Send %s", __cArray);
        __tableHandle = ReportTableHead3Columns(__cArray2, "Byte", __cTOp, __cAssigned);
        ReportByteIndex("", 0, __cArray, elCount(__cArray));
        snprintf(__cArray2, 8192, "%s", __cArray);
        snprintf(__cArray3, 8192, "%s", "");
        
        ReportTableRow(__tableHandle, 0, __cArray2, __cAOp, 0x3, __cArray3, __oneOfFlag, __bSetInCheckAlignment);
        
        if (0 >= 0 && 0 < 64)
        {
          __output.byte((word)0) = 0x3;
        }
        else
        {
          testStepErrorInTestSystem(0, __cEmpty, "Index out of range. Unable to set byte %lld in message. Please check input parameter.", (int64)0);
          __testStepInitOk = 0;
        }
        ReportByteIndex("", 1, __cArray, elCount(__cArray));
        snprintf(__cArray2, 8192, "%s", __cArray);
        snprintf(__cArray3, 8192, "%s", "");
        
        ReportTableRow(__tableHandle, 0, __cArray2, __cAOp, 0x22, __cArray3, __oneOfFlag, __bSetInCheckAlignment);
        
        if (1 >= 0 && 1 < 64)
        {
          __output.byte((word)1) = 0x22;
        }
        else
        {
          testStepErrorInTestSystem(0, __cEmpty, "Index out of range. Unable to set byte %lld in message. Please check input parameter.", (int64)1);
          __testStepInitOk = 0;
        }
        ReportByteIndex("", 2, __cArray, elCount(__cArray));
        snprintf(__cArray2, 8192, "%s", __cArray);
        snprintf(__cArray3, 8192, "%s", "");
        
        ReportTableRow(__tableHandle, 0, __cArray2, __cAOp, 0xF1, __cArray3, __oneOfFlag, __bSetInCheckAlignment);
        
        if (2 >= 0 && 2 < 64)
        {
          __output.byte((word)2) = 0xF1;
        }
        else
        {
          testStepErrorInTestSystem(0, __cEmpty, "Index out of range. Unable to set byte %lld in message. Please check input parameter.", (int64)2);
          __testStepInitOk = 0;
        }
        ReportByteIndex("", 3, __cArray, elCount(__cArray));
        snprintf(__cArray2, 8192, "%s", __cArray);
        snprintf(__cArray3, 8192, "%s", "");
        
        ReportTableRow(__tableHandle, 0, __cArray2, __cAOp, 0x22, __cArray3, __oneOfFlag, __bSetInCheckAlignment);
        
        if (3 >= 0 && 3 < 64)
        {
          __output.byte((word)3) = 0x22;
        }
        else
        {
          testStepErrorInTestSystem(0, __cEmpty, "Index out of range. Unable to set byte %lld in message. Please check input parameter.", (int64)3);
          __testStepInitOk = 0;
        }
      
        ReportTableEndTestStep(__tableHandle, "Req1");
      }
      if (__testStepInitOk)
      {
        output(__output);
      }
    }
    if (__timeout <= 0)
    {
      testStepErrorInTestSystem(0, "1", "Unable to wait for %.3f %s. Please check input parameter.", __timeout / ((float)1000000), "ms");
    }
    else
    {
      __tt8cnt_11 = 0;
      snprintf(__cArray, elCount(__cArray), "CAN message '%s' ID = 417001888x (0x18DAF1A0x) on bus FDCAN2", "DIAGNOSTIC_RESPONSE_PAM");
      if(SetBusContextByName("FDCAN2", __eSaveCurrent, __nBusContextNew, __nBusContextOld))
        testJoinMessageEvent(`FDCAN2::`DIAGNOSTIC_RESPONSE_PAM,  __cArray,
             delegate dword(message * __m)
             {
               dword __msg_callback_ret;
               if (__tt8cnt_11 == -1)
               {
                 return 1;
               }
               __msg_callback_ret = 1;
               __tt8cnt_11++;
               if (__msg_callback_ret)
               {
                 __tt8cnt_11 = -1;
                 return 1;
               }
               return 0;
             });
      __res = testWaitForAllJoinedEventsNS(__timeout);
      if (__nInt64 != 0)
      {
        snprintf(__cArray, elCount(__cArray), "CAN message '%s' ID = 417001888x (0x18DAF1A0x) on bus FDCAN2", "DIAGNOSTIC_RESPONSE_PAM");
        if(__tt8cnt_11 == -1)
        {
          snprintf(__cArray2, 8192, "Response of %s", __cArray);
        }
        else
        {
          snprintf(__cArray2, 8192, "Response of %s (received %d times)", __cArray, __tt8cnt_11);
        }
        if (__tt8cnt_11 == 0)
        {
          testStepFail(0, "Resp1", __cArray2);
        }
        else
        {
          testStepPass(2, "Resp1", __cArray2);
        }
        __ReportRequestResponseResult(__res, 0);
      }
      ResetBusContext(__nBusContextNew, __nBusContextOld);
    }
  }
  TestCommandEnd();

}

void Tto7tsimc_F180_DID_with_Physical_Address()
{
  stack long __tableHandle;
  TestCommandBegin(__eDiagService, __cDiagService, "", "0");
  {
    if (DiagIsFunctionalGroup("CVADAS_0001_00000000_000"))
    {
      DiagResponse * __resp;
      DiagRequest CVADAS_0001_00000000_000._22F180_Boot_Software_Version_Information __req;
      __diagServiceo7tsimc_7(__req, __resp);
    }
    else
    {
      DiagResponse CVADAS_0001_00000000_000.* __resp;
      DiagRequest CVADAS_0001_00000000_000._22F180_Boot_Software_Version_Information __req;
      __diagServiceo7tsimc_7(__req, __resp);
    }
  }
  TestCommandEnd();


}

  
void __diagServiceo7tsimc_7(DiagRequest * __req, DiagResponse * __resp )
{
  stack long __tableHandle;
  long __res, __paramLen, __bytePos;

   __bVerdict = __eVerdictPass;

  do {
    TestReportResetDiagObjectList();
    DiagSetReportDetailLevel("CVADAS_0001_00000000_000", EnumServiceDetails_onfail);
    // Request aspect
    {

      if (0 >= DiagSendReqAndWaitForResp("CVADAS_0001_00000000_000", __req, __resp, __res, -1, -1, -1, -1, -1, EnumResult_pos, EnumServiceDetails_onfail, EnumSendingMode_physical, EnumSuppressPosResBit_asconfigured, EnumVerdictOnInvalidValues_fail))
        break;
    }

    __res = DiagErrCodeTestStep(__res, "Can't retrieve last response for request! No check possible.") < 0;
    if(__res)
    {
	  __bVerdict = __eVerdictFail;
      break;
    }
    {
      __res = DiagInterpretAs(__resp, "RDBI_PR");
      if(__res != 0)
      {
        __bVerdict = __eVerdictFail;
        DiagErrCodeTestStep(__res, "Can't interpret response as diagnostic primitive 'RDBI_PR'.");
        break;
      }
      else
      {
        TestStepPass( "Received primitive can be interpreted as diagnostic primitive 'RDBI_PR'.");
      }
    }
  }
  while(0);


  // Response, check & read aspect
  {
    __res = 1;
    __tableHandle = ReportTableHead5Columns(__cCheckCaption, __cTSym, __cTOp, __cRefVal, __cActual, __cRes);
    {
      __bDiagValueArrayCtr = DiagGetParameterErrorHandled(__resp, "_SW_Year_32", __bDiagValueArray, elcount(__bDiagValueArray), __cDiagValueArray, elcount(__cDiagValueArray));
      {
        __bSetInCheckAlignment = 1;	
        {
          __bArrayCtr = __CopyBytes(__bDiagValueArray, __bDiagValueArrayCtr, __bArray);
          {
            sysvar * __systemVariable;
            __systemVariable = sysvarData::`PartNumber::`Part_Number;
            CheckSysVarSetBufferConsistency(sysSetVariableData(sysvarData::`PartNumber::`Part_Number, __bArray, __bArrayCtr), __systemVariable.name);
          }
          snprintf(__cArray, 8192, "%s", "Part_Number");
          snprintf(__cArray2, 8192, "%s '%s'", __cSysVar, __cArray);
          snprintf(__cArray3, 8192, "%s", "_SW_Year_32");
          
          ReportTableRow(__tableHandle, 0, __cArray2, __cAOp, __bArray, __bArrayCtr, __cArray3, __oneOfFlag, __bSetInCheckAlignment);
        
        }
    
        __bSetInCheckAlignment = 0;
      }
    }
    {
      __bDiagValueArrayCtr = DiagGetParameterErrorHandled(__resp, "_SW__Identification_56", __bDiagValueArray, elcount(__bDiagValueArray), __cDiagValueArray, elcount(__cDiagValueArray));
      {
        __bSetInCheckAlignment = 1;	
        {
          __bArrayCtr = __CopyBytes(__bDiagValueArray, __bDiagValueArrayCtr, __bArray);
          {
            sysvar * __systemVariable;
            __systemVariable = sysvarData::`PartNumber::`Part_Number;
            CheckSysVarSetBufferConsistency(sysSetVariableData(sysvarData::`PartNumber::`Part_Number, __bArray, __bArrayCtr), __systemVariable.name);
          }
          snprintf(__cArray, 8192, "%s", "Part_Number");
          snprintf(__cArray2, 8192, "%s '%s'", __cSysVar, __cArray);
          snprintf(__cArray3, 8192, "%s", "_SW__Identification_56");
          
          ReportTableRow(__tableHandle, 0, __cArray2, __cAOp, __bArray, __bArrayCtr, __cArray3, __oneOfFlag, __bSetInCheckAlignment);
        
        }
    
        __bSetInCheckAlignment = 0;
      }
    }
    {
      __bDiagValueArrayCtr = DiagGetParameterErrorHandled(__resp, "_SW__Patch_Level_48", __bDiagValueArray, elcount(__bDiagValueArray), __cDiagValueArray, elcount(__cDiagValueArray));
      {
        __bSetInCheckAlignment = 1;	
        {
          __bArrayCtr = __CopyBytes(__bDiagValueArray, __bDiagValueArrayCtr, __bArray);
          {
            sysvar * __systemVariable;
            __systemVariable = sysvarData::`PartNumber::`Part_Number;
            CheckSysVarSetBufferConsistency(sysSetVariableData(sysvarData::`PartNumber::`Part_Number, __bArray, __bArrayCtr), __systemVariable.name);
          }
          snprintf(__cArray, 8192, "%s", "Part_Number");
          snprintf(__cArray2, 8192, "%s '%s'", __cSysVar, __cArray);
          snprintf(__cArray3, 8192, "%s", "_SW__Patch_Level_48");
          
          ReportTableRow(__tableHandle, 0, __cArray2, __cAOp, __bArray, __bArrayCtr, __cArray3, __oneOfFlag, __bSetInCheckAlignment);
        
        }
    
        __bSetInCheckAlignment = 0;
      }
    }
    {
      __bDiagValueArrayCtr = DiagGetParameterErrorHandled(__resp, "_SW__Week_40", __bDiagValueArray, elcount(__bDiagValueArray), __cDiagValueArray, elcount(__cDiagValueArray));
      {
        __bSetInCheckAlignment = 1;	
        {
          __bArrayCtr = __CopyBytes(__bDiagValueArray, __bDiagValueArrayCtr, __bArray);
          {
            sysvar * __systemVariable;
            __systemVariable = sysvarData::`PartNumber::`Part_Number;
            CheckSysVarSetBufferConsistency(sysSetVariableData(sysvarData::`PartNumber::`Part_Number, __bArray, __bArrayCtr), __systemVariable.name);
          }
          snprintf(__cArray, 8192, "%s", "Part_Number");
          snprintf(__cArray2, 8192, "%s '%s'", __cSysVar, __cArray);
          snprintf(__cArray3, 8192, "%s", "_SW__Week_40");
          
          ReportTableRow(__tableHandle, 0, __cArray2, __cAOp, __bArray, __bArrayCtr, __cArray3, __oneOfFlag, __bSetInCheckAlignment);
        
        }
    
        __bSetInCheckAlignment = 0;
      }
    }
    {
      __bDiagValueArrayCtr = DiagGetParameterErrorHandled(__resp, "_Number_of_Boot_Software_Logical_Blocks_24", __bDiagValueArray, elcount(__bDiagValueArray), __cDiagValueArray, elcount(__cDiagValueArray));
      {
        __bSetInCheckAlignment = 1;	
        {
          __bArrayCtr = __CopyBytes(__bDiagValueArray, __bDiagValueArrayCtr, __bArray);
          {
            sysvar * __systemVariable;
            __systemVariable = sysvarData::`PartNumber::`Part_Number;
            CheckSysVarSetBufferConsistency(sysSetVariableData(sysvarData::`PartNumber::`Part_Number, __bArray, __bArrayCtr), __systemVariable.name);
          }
          snprintf(__cArray, 8192, "%s", "Part_Number");
          snprintf(__cArray2, 8192, "%s '%s'", __cSysVar, __cArray);
          snprintf(__cArray3, 8192, "%s", "_Number_of_Boot_Software_Logical_Blocks_24");
          
          ReportTableRow(__tableHandle, 0, __cArray2, __cAOp, __bArray, __bArrayCtr, __cArray3, __oneOfFlag, __bSetInCheckAlignment);
        
        }
    
        __bSetInCheckAlignment = 0;
      }
    }
    ReportTableEndVerdict(__tableHandle, __cEvaluateResponse, __res);
	__bVerdict = __bVerdict && __res;
  }
  if (__bVerdict == __eVerdictFail)
    TestReportWriteDiagObjectList();
}

void Tto7tsimc_F180_DID_with_Functional_Address()
{
  stack long __tableHandle;
  TestCommandBegin(__eDiagService, __cDiagService, "", "0");
  {
    if (DiagIsFunctionalGroup("CVADAS_0001_00000000_000"))
    {
      DiagResponse * __resp;
      DiagRequest CVADAS_0001_00000000_000._22F180_Boot_Software_Version_Information __req;
      __diagServiceo7tsimc_8(__req, __resp);
    }
    else
    {
      DiagResponse CVADAS_0001_00000000_000.* __resp;
      DiagRequest CVADAS_0001_00000000_000._22F180_Boot_Software_Version_Information __req;
      __diagServiceo7tsimc_8(__req, __resp);
    }
  }
  TestCommandEnd();


}

  
void __diagServiceo7tsimc_8(DiagRequest * __req, DiagResponse * __resp )
{
  stack long __tableHandle;
  long __res, __paramLen, __bytePos;

   __bVerdict = __eVerdictPass;

  do {
    TestReportResetDiagObjectList();
    DiagSetReportDetailLevel("CVADAS_0001_00000000_000", EnumServiceDetails_onfail);
    // Request aspect
    {

      if (0 >= DiagSendReqAndWaitForResp("CVADAS_0001_00000000_000", __req, __resp, __res, -1, -1, -1, -1, -1, EnumResult_pos, EnumServiceDetails_onfail, EnumSendingMode_physical, EnumSuppressPosResBit_asconfigured, EnumVerdictOnInvalidValues_fail))
        break;
    }

    __res = DiagErrCodeTestStep(__res, "Can't retrieve last response for request! No check possible.") < 0;
    if(__res)
    {
	  __bVerdict = __eVerdictFail;
      break;
    }
    {
      __res = DiagInterpretAs(__resp, "RDBI_PR");
      if(__res != 0)
      {
        __bVerdict = __eVerdictFail;
        DiagErrCodeTestStep(__res, "Can't interpret response as diagnostic primitive 'RDBI_PR'.");
        break;
      }
      else
      {
        TestStepPass( "Received primitive can be interpreted as diagnostic primitive 'RDBI_PR'.");
      }
    }
  }
  while(0);


  // Response, check & read aspect
  {
    __res = 1;
    __tableHandle = ReportTableHead5Columns(__cCheckCaption, __cTSym, __cTOp, __cRefVal, __cActual, __cRes);
    {
      __bDiagValueArrayCtr = DiagGetParameterErrorHandled(__resp, "_SW_Year_32", __bDiagValueArray, elcount(__bDiagValueArray), __cDiagValueArray, elcount(__cDiagValueArray));
      {
        __bSetInCheckAlignment = 1;	
        {
          __bArrayCtr = __CopyBytes(__bDiagValueArray, __bDiagValueArrayCtr, __bArray);
          {
            sysvar * __systemVariable;
            __systemVariable = sysvarData::`PartNumber::`Part_Number;
            CheckSysVarSetBufferConsistency(sysSetVariableData(sysvarData::`PartNumber::`Part_Number, __bArray, __bArrayCtr), __systemVariable.name);
          }
          snprintf(__cArray, 8192, "%s", "Part_Number");
          snprintf(__cArray2, 8192, "%s '%s'", __cSysVar, __cArray);
          snprintf(__cArray3, 8192, "%s", "_SW_Year_32");
          
          ReportTableRow(__tableHandle, 0, __cArray2, __cAOp, __bArray, __bArrayCtr, __cArray3, __oneOfFlag, __bSetInCheckAlignment);
        
        }
    
        __bSetInCheckAlignment = 0;
      }
    }
    {
      __bDiagValueArrayCtr = DiagGetParameterErrorHandled(__resp, "_SW__Identification_56", __bDiagValueArray, elcount(__bDiagValueArray), __cDiagValueArray, elcount(__cDiagValueArray));
      {
        __bSetInCheckAlignment = 1;	
        {
          __bArrayCtr = __CopyBytes(__bDiagValueArray, __bDiagValueArrayCtr, __bArray);
          {
            sysvar * __systemVariable;
            __systemVariable = sysvarData::`PartNumber::`Part_Number;
            CheckSysVarSetBufferConsistency(sysSetVariableData(sysvarData::`PartNumber::`Part_Number, __bArray, __bArrayCtr), __systemVariable.name);
          }
          snprintf(__cArray, 8192, "%s", "Part_Number");
          snprintf(__cArray2, 8192, "%s '%s'", __cSysVar, __cArray);
          snprintf(__cArray3, 8192, "%s", "_SW__Identification_56");
          
          ReportTableRow(__tableHandle, 0, __cArray2, __cAOp, __bArray, __bArrayCtr, __cArray3, __oneOfFlag, __bSetInCheckAlignment);
        
        }
    
        __bSetInCheckAlignment = 0;
      }
    }
    {
      __bDiagValueArrayCtr = DiagGetParameterErrorHandled(__resp, "_SW__Patch_Level_48", __bDiagValueArray, elcount(__bDiagValueArray), __cDiagValueArray, elcount(__cDiagValueArray));
      {
        __bSetInCheckAlignment = 1;	
        {
          __bArrayCtr = __CopyBytes(__bDiagValueArray, __bDiagValueArrayCtr, __bArray);
          {
            sysvar * __systemVariable;
            __systemVariable = sysvarData::`PartNumber::`Part_Number;
            CheckSysVarSetBufferConsistency(sysSetVariableData(sysvarData::`PartNumber::`Part_Number, __bArray, __bArrayCtr), __systemVariable.name);
          }
          snprintf(__cArray, 8192, "%s", "Part_Number");
          snprintf(__cArray2, 8192, "%s '%s'", __cSysVar, __cArray);
          snprintf(__cArray3, 8192, "%s", "_SW__Patch_Level_48");
          
          ReportTableRow(__tableHandle, 0, __cArray2, __cAOp, __bArray, __bArrayCtr, __cArray3, __oneOfFlag, __bSetInCheckAlignment);
        
        }
    
        __bSetInCheckAlignment = 0;
      }
    }
    {
      __bDiagValueArrayCtr = DiagGetParameterErrorHandled(__resp, "_SW__Week_40", __bDiagValueArray, elcount(__bDiagValueArray), __cDiagValueArray, elcount(__cDiagValueArray));
      {
        __bSetInCheckAlignment = 1;	
        {
          __bArrayCtr = __CopyBytes(__bDiagValueArray, __bDiagValueArrayCtr, __bArray);
          {
            sysvar * __systemVariable;
            __systemVariable = sysvarData::`PartNumber::`Part_Number;
            CheckSysVarSetBufferConsistency(sysSetVariableData(sysvarData::`PartNumber::`Part_Number, __bArray, __bArrayCtr), __systemVariable.name);
          }
          snprintf(__cArray, 8192, "%s", "Part_Number");
          snprintf(__cArray2, 8192, "%s '%s'", __cSysVar, __cArray);
          snprintf(__cArray3, 8192, "%s", "_SW__Week_40");
          
          ReportTableRow(__tableHandle, 0, __cArray2, __cAOp, __bArray, __bArrayCtr, __cArray3, __oneOfFlag, __bSetInCheckAlignment);
        
        }
    
        __bSetInCheckAlignment = 0;
      }
    }
    {
      __bDiagValueArrayCtr = DiagGetParameterErrorHandled(__resp, "_Number_of_Boot_Software_Logical_Blocks_24", __bDiagValueArray, elcount(__bDiagValueArray), __cDiagValueArray, elcount(__cDiagValueArray));
      {
        __bSetInCheckAlignment = 1;	
        {
          __bArrayCtr = __CopyBytes(__bDiagValueArray, __bDiagValueArrayCtr, __bArray);
          {
            sysvar * __systemVariable;
            __systemVariable = sysvarData::`PartNumber::`Part_Number;
            CheckSysVarSetBufferConsistency(sysSetVariableData(sysvarData::`PartNumber::`Part_Number, __bArray, __bArrayCtr), __systemVariable.name);
          }
          snprintf(__cArray, 8192, "%s", "Part_Number");
          snprintf(__cArray2, 8192, "%s '%s'", __cSysVar, __cArray);
          snprintf(__cArray3, 8192, "%s", "_Number_of_Boot_Software_Logical_Blocks_24");
          
          ReportTableRow(__tableHandle, 0, __cArray2, __cAOp, __bArray, __bArrayCtr, __cArray3, __oneOfFlag, __bSetInCheckAlignment);
        
        }
    
        __bSetInCheckAlignment = 0;
      }
    }
    ReportTableEndVerdict(__tableHandle, __cEvaluateResponse, __res);
	__bVerdict = __bVerdict && __res;
  }
  if (__bVerdict == __eVerdictFail)
    TestReportWriteDiagObjectList();
}

void Tto7tsimc_F180_DID_with_Standard_Physical_Address()
{
  stack long __tableHandle;
  TestCommandBegin(__eRequestResponse, __cRequestResponse, "", "0");
  {
  
    long __res;
    int64 __timeout;
    __res = 0;
    __nInt64 = 1;
    __timeout = syspar::`P2_Server * 1000000LL;
    {
    
      long __testStepInitOk;
      message `FDCAN2::`DIAGNOSTIC_REQUEST_PAM __output;
      message `FDCAN2::`DIAGNOSTIC_REQUEST_PAM __msgOrig;
      __output = __msgOrig;
      __testStepInitOk = 1;
      {
        int64 __dlc;
        __dlc = 4;
        if (__dlc >= 0 && __dlc <= (__output.EDL ? 15 : 8))
          __output.DLC = __dlc;
        else
        {
          testStepErrorInTestSystem(0, __cEmpty, "Unable to set DLC=%lld in message. Please check input parameter.", __dlc);
          __testStepInitOk = 0;
        }
      }
      if (__testStepInitOk)
      {
        snprintf(__cArray, elCount(__cArray), "CAN message '%s' ID = 416981233x (0x18DAA0F1x) on bus FDCAN2", "DIAGNOSTIC_REQUEST_PAM");
        snprintf(__cArray2, elCount(__cArray2), "Send %s", __cArray);
        __tableHandle = ReportTableHead3Columns(__cArray2, "Byte", __cTOp, __cAssigned);
        ReportByteIndex("", 0, __cArray, elCount(__cArray));
        snprintf(__cArray2, 8192, "%s", __cArray);
        snprintf(__cArray3, 8192, "%s", "");
        
        ReportTableRow(__tableHandle, 0, __cArray2, __cAOp, 0x3, __cArray3, __oneOfFlag, __bSetInCheckAlignment);
        
        if (0 >= 0 && 0 < 64)
        {
          __output.byte((word)0) = 0x3;
        }
        else
        {
          testStepErrorInTestSystem(0, __cEmpty, "Index out of range. Unable to set byte %lld in message. Please check input parameter.", (int64)0);
          __testStepInitOk = 0;
        }
        ReportByteIndex("", 1, __cArray, elCount(__cArray));
        snprintf(__cArray2, 8192, "%s", __cArray);
        snprintf(__cArray3, 8192, "%s", "");
        
        ReportTableRow(__tableHandle, 0, __cArray2, __cAOp, 0x22, __cArray3, __oneOfFlag, __bSetInCheckAlignment);
        
        if (1 >= 0 && 1 < 64)
        {
          __output.byte((word)1) = 0x22;
        }
        else
        {
          testStepErrorInTestSystem(0, __cEmpty, "Index out of range. Unable to set byte %lld in message. Please check input parameter.", (int64)1);
          __testStepInitOk = 0;
        }
        ReportByteIndex("", 2, __cArray, elCount(__cArray));
        snprintf(__cArray2, 8192, "%s", __cArray);
        snprintf(__cArray3, 8192, "%s", "");
        
        ReportTableRow(__tableHandle, 0, __cArray2, __cAOp, 0xF1, __cArray3, __oneOfFlag, __bSetInCheckAlignment);
        
        if (2 >= 0 && 2 < 64)
        {
          __output.byte((word)2) = 0xF1;
        }
        else
        {
          testStepErrorInTestSystem(0, __cEmpty, "Index out of range. Unable to set byte %lld in message. Please check input parameter.", (int64)2);
          __testStepInitOk = 0;
        }
        ReportByteIndex("", 3, __cArray, elCount(__cArray));
        snprintf(__cArray2, 8192, "%s", __cArray);
        snprintf(__cArray3, 8192, "%s", "");
        
        ReportTableRow(__tableHandle, 0, __cArray2, __cAOp, 0x80, __cArray3, __oneOfFlag, __bSetInCheckAlignment);
        
        if (3 >= 0 && 3 < 64)
        {
          __output.byte((word)3) = 0x80;
        }
        else
        {
          testStepErrorInTestSystem(0, __cEmpty, "Index out of range. Unable to set byte %lld in message. Please check input parameter.", (int64)3);
          __testStepInitOk = 0;
        }
      
        ReportTableEndTestStep(__tableHandle, "Req1");
      }
      if (__testStepInitOk)
      {
        output(__output);
      }
    }
    if (__timeout <= 0)
    {
      testStepErrorInTestSystem(0, "1", "Unable to wait for %.3f %s. Please check input parameter.", __timeout / ((float)1000000), "ms");
    }
    else
    {
      __tt8cnt_13 = 0;
      snprintf(__cArray, elCount(__cArray), "CAN message '%s' ID = 417001888x (0x18DAF1A0x) on bus FDCAN2", "DIAGNOSTIC_RESPONSE_PAM");
      if(SetBusContextByName("FDCAN2", __eSaveCurrent, __nBusContextNew, __nBusContextOld))
        testJoinMessageEvent(`FDCAN2::`DIAGNOSTIC_RESPONSE_PAM,  __cArray,
             delegate dword(message * __m)
             {
               dword __msg_callback_ret;
               if (__tt8cnt_13 == -1)
               {
                 return 1;
               }
               __msg_callback_ret = 1;
               __tt8cnt_13++;
               if (__msg_callback_ret)
               {
                 __tt8cnt_13 = -1;
                 return 1;
               }
               return 0;
             });
      __res = testWaitForAllJoinedEventsNS(__timeout);
      if (__nInt64 != 0)
      {
        snprintf(__cArray, elCount(__cArray), "CAN message '%s' ID = 417001888x (0x18DAF1A0x) on bus FDCAN2", "DIAGNOSTIC_RESPONSE_PAM");
        if(__tt8cnt_13 == -1)
        {
          snprintf(__cArray2, 8192, "Response of %s", __cArray);
        }
        else
        {
          snprintf(__cArray2, 8192, "Response of %s (received %d times)", __cArray, __tt8cnt_13);
        }
        if (__tt8cnt_13 == 0)
        {
          testStepFail(0, "Resp1", __cArray2);
        }
        else
        {
          testStepPass(2, "Resp1", __cArray2);
        }
        __ReportRequestResponseResult(__res, 0);
      }
      ResetBusContext(__nBusContextNew, __nBusContextOld);
    }
  }
  TestCommandEnd();

}

void Tto7tsimc_F132_DID_with_Physical_Address()
{
  stack long __tableHandle;
  TestCommandBegin(__eDiagService, __cDiagService, "", "0");
  {
    if (DiagIsFunctionalGroup("CVADAS_0001_00000000_000"))
    {
      DiagResponse * __resp;
      DiagRequest CVADAS_0001_00000000_000._22F132_EBOM_ECU_Part_Number __req;
      __diagServiceo7tsimc_9(__req, __resp);
    }
    else
    {
      DiagResponse CVADAS_0001_00000000_000.* __resp;
      DiagRequest CVADAS_0001_00000000_000._22F132_EBOM_ECU_Part_Number __req;
      __diagServiceo7tsimc_9(__req, __resp);
    }
  }
  TestCommandEnd();


}

  
void __diagServiceo7tsimc_9(DiagRequest * __req, DiagResponse * __resp )
{
  stack long __tableHandle;
  long __res, __paramLen, __bytePos;

   __bVerdict = __eVerdictPass;

  do {
    TestReportResetDiagObjectList();
    DiagSetReportDetailLevel("CVADAS_0001_00000000_000", EnumServiceDetails_onfail);
    // Request aspect
    {

      if (0 >= DiagSendReqAndWaitForResp("CVADAS_0001_00000000_000", __req, __resp, __res, -1, -1, -1, -1, -1, EnumResult_pos, EnumServiceDetails_onfail, EnumSendingMode_physical, EnumSuppressPosResBit_asconfigured, EnumVerdictOnInvalidValues_fail))
        break;
    }

    __res = DiagErrCodeTestStep(__res, "Can't retrieve last response for request! No check possible.") < 0;
    if(__res)
    {
	  __bVerdict = __eVerdictFail;
      break;
    }
    {
      __res = DiagInterpretAs(__resp, "RDBI_PR");
      if(__res != 0)
      {
        __bVerdict = __eVerdictFail;
        DiagErrCodeTestStep(__res, "Can't interpret response as diagnostic primitive 'RDBI_PR'.");
        break;
      }
      else
      {
        TestStepPass( "Received primitive can be interpreted as diagnostic primitive 'RDBI_PR'.");
      }
    }
  }
  while(0);


  // Response, check & read aspect
  {
    __res = 1;
    __tableHandle = ReportTableHead5Columns(__cCheckCaption, __cTSym, __cTOp, __cRefVal, __cActual, __cRes);
    {
      __bDiagValueArrayCtr = DiagGetParameterErrorHandled(__resp, "_EBOM_ECU_Part_Number_24", __bDiagValueArray, elcount(__bDiagValueArray), __cDiagValueArray, elcount(__cDiagValueArray));
      {
        __bSetInCheckAlignment = 1;	
        {
          __bArrayCtr = __CopyBytes(__bDiagValueArray, __bDiagValueArrayCtr, __bArray);
          {
            sysvar * __systemVariable;
            __systemVariable = sysvarData::`PartNumber::`Part_Number;
            CheckSysVarSetBufferConsistency(sysSetVariableData(sysvarData::`PartNumber::`Part_Number, __bArray, __bArrayCtr), __systemVariable.name);
          }
          snprintf(__cArray, 8192, "%s", "Part_Number");
          snprintf(__cArray2, 8192, "%s '%s'", __cSysVar, __cArray);
          snprintf(__cArray3, 8192, "%s", "_EBOM_ECU_Part_Number_24");
          
          ReportTableRow(__tableHandle, 0, __cArray2, __cAOp, __bArray, __bArrayCtr, __cArray3, __oneOfFlag, __bSetInCheckAlignment);
        
        }
    
        __bSetInCheckAlignment = 0;
      }
    }
    ReportTableEndVerdict(__tableHandle, __cEvaluateResponse, __res);
	__bVerdict = __bVerdict && __res;
  }
  if (__bVerdict == __eVerdictFail)
    TestReportWriteDiagObjectList();
}

void Tto7tsimc_F132_DID_with_Functional_Address()
{
  stack long __tableHandle;
  TestCommandBegin(__eDiagService, __cDiagService, "", "0");
  {
    if (DiagIsFunctionalGroup("CVADAS_0001_00000000_000"))
    {
      DiagResponse * __resp;
      DiagRequest CVADAS_0001_00000000_000._22F132_EBOM_ECU_Part_Number __req;
      __diagServiceo7tsimc_10(__req, __resp);
    }
    else
    {
      DiagResponse CVADAS_0001_00000000_000.* __resp;
      DiagRequest CVADAS_0001_00000000_000._22F132_EBOM_ECU_Part_Number __req;
      __diagServiceo7tsimc_10(__req, __resp);
    }
  }
  TestCommandEnd();


}

  
void __diagServiceo7tsimc_10(DiagRequest * __req, DiagResponse * __resp )
{
  stack long __tableHandle;
  long __res, __paramLen, __bytePos;

   __bVerdict = __eVerdictPass;

  do {
    TestReportResetDiagObjectList();
    DiagSetReportDetailLevel("CVADAS_0001_00000000_000", EnumServiceDetails_onfail);
    // Request aspect
    {

      if (0 >= DiagSendReqAndWaitForResp("CVADAS_0001_00000000_000", __req, __resp, __res, -1, -1, -1, -1, -1, EnumResult_pos, EnumServiceDetails_onfail, EnumSendingMode_functional, EnumSuppressPosResBit_asconfigured, EnumVerdictOnInvalidValues_fail))
        break;
    }

    __res = DiagErrCodeTestStep(__res, "Can't retrieve last response for request! No check possible.") < 0;
    if(__res)
    {
	  __bVerdict = __eVerdictFail;
      break;
    }
    {
      __res = DiagInterpretAs(__resp, "RDBI_PR");
      if(__res != 0)
      {
        __bVerdict = __eVerdictFail;
        DiagErrCodeTestStep(__res, "Can't interpret response as diagnostic primitive 'RDBI_PR'.");
        break;
      }
      else
      {
        TestStepPass( "Received primitive can be interpreted as diagnostic primitive 'RDBI_PR'.");
      }
    }
  }
  while(0);


  // Response, check & read aspect
  {
    __res = 1;
    __tableHandle = ReportTableHead5Columns(__cCheckCaption, __cTSym, __cTOp, __cRefVal, __cActual, __cRes);
    {
      __bDiagValueArrayCtr = DiagGetParameterErrorHandled(__resp, "_EBOM_ECU_Part_Number_24", __bDiagValueArray, elcount(__bDiagValueArray), __cDiagValueArray, elcount(__cDiagValueArray));
      {
        __bSetInCheckAlignment = 1;	
        {
          __bArrayCtr = __CopyBytes(__bDiagValueArray, __bDiagValueArrayCtr, __bArray);
          {
            sysvar * __systemVariable;
            __systemVariable = sysvarData::`PartNumber::`Part_Number;
            CheckSysVarSetBufferConsistency(sysSetVariableData(sysvarData::`PartNumber::`Part_Number, __bArray, __bArrayCtr), __systemVariable.name);
          }
          snprintf(__cArray, 8192, "%s", "Part_Number");
          snprintf(__cArray2, 8192, "%s '%s'", __cSysVar, __cArray);
          snprintf(__cArray3, 8192, "%s", "_EBOM_ECU_Part_Number_24");
          
          ReportTableRow(__tableHandle, 0, __cArray2, __cAOp, __bArray, __bArrayCtr, __cArray3, __oneOfFlag, __bSetInCheckAlignment);
        
        }
    
        __bSetInCheckAlignment = 0;
      }
    }
    ReportTableEndVerdict(__tableHandle, __cEvaluateResponse, __res);
	__bVerdict = __bVerdict && __res;
  }
  if (__bVerdict == __eVerdictFail)
    TestReportWriteDiagObjectList();
}

void Tto7tsimc_F132_DID_with_Standard_Physical_Address()
{
  stack long __tableHandle;
  TestCommandBegin(__eRequestResponse, __cRequestResponse, "", "0");
  {
  
    long __res;
    int64 __timeout;
    __res = 0;
    __nInt64 = 1;
    __timeout = syspar::`P2_Server * 1000000LL;
    {
    
      long __testStepInitOk;
      message `FDCAN2::`DIAGNOSTIC_REQUEST_PAM __output;
      message `FDCAN2::`DIAGNOSTIC_REQUEST_PAM __msgOrig;
      __output = __msgOrig;
      __testStepInitOk = 1;
      {
        int64 __dlc;
        __dlc = 4;
        if (__dlc >= 0 && __dlc <= (__output.EDL ? 15 : 8))
          __output.DLC = __dlc;
        else
        {
          testStepErrorInTestSystem(0, __cEmpty, "Unable to set DLC=%lld in message. Please check input parameter.", __dlc);
          __testStepInitOk = 0;
        }
      }
      if (__testStepInitOk)
      {
        snprintf(__cArray, elCount(__cArray), "CAN message '%s' ID = 416981233x (0x18DAA0F1x) on bus FDCAN2", "DIAGNOSTIC_REQUEST_PAM");
        snprintf(__cArray2, elCount(__cArray2), "Send %s", __cArray);
        __tableHandle = ReportTableHead3Columns(__cArray2, "Byte", __cTOp, __cAssigned);
        ReportByteIndex("", 0, __cArray, elCount(__cArray));
        snprintf(__cArray2, 8192, "%s", __cArray);
        snprintf(__cArray3, 8192, "%s", "");
        
        ReportTableRow(__tableHandle, 0, __cArray2, __cAOp, 0x3, __cArray3, __oneOfFlag, __bSetInCheckAlignment);
        
        if (0 >= 0 && 0 < 64)
        {
          __output.byte((word)0) = 0x3;
        }
        else
        {
          testStepErrorInTestSystem(0, __cEmpty, "Index out of range. Unable to set byte %lld in message. Please check input parameter.", (int64)0);
          __testStepInitOk = 0;
        }
        ReportByteIndex("", 1, __cArray, elCount(__cArray));
        snprintf(__cArray2, 8192, "%s", __cArray);
        snprintf(__cArray3, 8192, "%s", "");
        
        ReportTableRow(__tableHandle, 0, __cArray2, __cAOp, 0x22, __cArray3, __oneOfFlag, __bSetInCheckAlignment);
        
        if (1 >= 0 && 1 < 64)
        {
          __output.byte((word)1) = 0x22;
        }
        else
        {
          testStepErrorInTestSystem(0, __cEmpty, "Index out of range. Unable to set byte %lld in message. Please check input parameter.", (int64)1);
          __testStepInitOk = 0;
        }
        ReportByteIndex("", 2, __cArray, elCount(__cArray));
        snprintf(__cArray2, 8192, "%s", __cArray);
        snprintf(__cArray3, 8192, "%s", "");
        
        ReportTableRow(__tableHandle, 0, __cArray2, __cAOp, 0xF1, __cArray3, __oneOfFlag, __bSetInCheckAlignment);
        
        if (2 >= 0 && 2 < 64)
        {
          __output.byte((word)2) = 0xF1;
        }
        else
        {
          testStepErrorInTestSystem(0, __cEmpty, "Index out of range. Unable to set byte %lld in message. Please check input parameter.", (int64)2);
          __testStepInitOk = 0;
        }
        ReportByteIndex("", 3, __cArray, elCount(__cArray));
        snprintf(__cArray2, 8192, "%s", __cArray);
        snprintf(__cArray3, 8192, "%s", "");
        
        ReportTableRow(__tableHandle, 0, __cArray2, __cAOp, 0x32, __cArray3, __oneOfFlag, __bSetInCheckAlignment);
        
        if (3 >= 0 && 3 < 64)
        {
          __output.byte((word)3) = 0x32;
        }
        else
        {
          testStepErrorInTestSystem(0, __cEmpty, "Index out of range. Unable to set byte %lld in message. Please check input parameter.", (int64)3);
          __testStepInitOk = 0;
        }
      
        ReportTableEndTestStep(__tableHandle, "Req1");
      }
      if (__testStepInitOk)
      {
        output(__output);
      }
    }
    if (__timeout <= 0)
    {
      testStepErrorInTestSystem(0, "1", "Unable to wait for %.3f %s. Please check input parameter.", __timeout / ((float)1000000), "ms");
    }
    else
    {
      __tt8cnt_15 = 0;
      snprintf(__cArray, elCount(__cArray), "CAN message '%s' ID = 417001888x (0x18DAF1A0x) on bus FDCAN2", "DIAGNOSTIC_RESPONSE_PAM");
      if(SetBusContextByName("FDCAN2", __eSaveCurrent, __nBusContextNew, __nBusContextOld))
        testJoinMessageEvent(`FDCAN2::`DIAGNOSTIC_RESPONSE_PAM,  __cArray,
             delegate dword(message * __m)
             {
               dword __msg_callback_ret;
               if (__tt8cnt_15 == -1)
               {
                 return 1;
               }
               __msg_callback_ret = 1;
               __tt8cnt_15++;
               if (__msg_callback_ret)
               {
                 __tt8cnt_15 = -1;
                 return 1;
               }
               return 0;
             });
      __res = testWaitForAllJoinedEventsNS(__timeout);
      if (__nInt64 != 0)
      {
        snprintf(__cArray, elCount(__cArray), "CAN message '%s' ID = 417001888x (0x18DAF1A0x) on bus FDCAN2", "DIAGNOSTIC_RESPONSE_PAM");
        if(__tt8cnt_15 == -1)
        {
          snprintf(__cArray2, 8192, "Response of %s", __cArray);
        }
        else
        {
          snprintf(__cArray2, 8192, "Response of %s (received %d times)", __cArray, __tt8cnt_15);
        }
        if (__tt8cnt_15 == 0)
        {
          testStepFail(0, "Resp1", __cArray2);
        }
        else
        {
          testStepPass(2, "Resp1", __cArray2);
        }
        __ReportRequestResponseResult(__res, 0);
      }
      ResetBusContext(__nBusContextNew, __nBusContextOld);
    }
  }
  TestCommandEnd();

}

void Tto7tsimc_F1A2_DID_with_Physical_Address()
{
  stack long __tableHandle;
  TestCommandBegin(__eDiagService, __cDiagService, "", "0");
  {
    if (DiagIsFunctionalGroup("CVADAS_0001_00000000_000"))
    {
      DiagResponse * __resp;
      DiagRequest CVADAS_0001_00000000_000._22F1A2_Vector_Delivery_ID __req;
      __diagServiceo7tsimc_11(__req, __resp);
    }
    else
    {
      DiagResponse CVADAS_0001_00000000_000.* __resp;
      DiagRequest CVADAS_0001_00000000_000._22F1A2_Vector_Delivery_ID __req;
      __diagServiceo7tsimc_11(__req, __resp);
    }
  }
  TestCommandEnd();


}

  
void __diagServiceo7tsimc_11(DiagRequest * __req, DiagResponse * __resp )
{
  stack long __tableHandle;
  long __res, __paramLen, __bytePos;

   __bVerdict = __eVerdictPass;

  do {
    TestReportResetDiagObjectList();
    DiagSetReportDetailLevel("CVADAS_0001_00000000_000", EnumServiceDetails_onfail);
    // Request aspect
    {

      if (0 >= DiagSendReqAndWaitForResp("CVADAS_0001_00000000_000", __req, __resp, __res, -1, -1, -1, -1, -1, EnumResult_pos, EnumServiceDetails_onfail, EnumSendingMode_physical, EnumSuppressPosResBit_asconfigured, EnumVerdictOnInvalidValues_fail))
        break;
    }

    __res = DiagErrCodeTestStep(__res, "Can't retrieve last response for request! No check possible.") < 0;
    if(__res)
    {
	  __bVerdict = __eVerdictFail;
      break;
    }
    {
      __res = DiagInterpretAs(__resp, "RDBI_PR");
      if(__res != 0)
      {
        __bVerdict = __eVerdictFail;
        DiagErrCodeTestStep(__res, "Can't interpret response as diagnostic primitive 'RDBI_PR'.");
        break;
      }
      else
      {
        TestStepPass( "Received primitive can be interpreted as diagnostic primitive 'RDBI_PR'.");
      }
    }
  }
  while(0);


  // Response, check & read aspect
  {
    __res = 1;
    __tableHandle = ReportTableHead5Columns(__cCheckCaption, __cTSym, __cTOp, __cRefVal, __cActual, __cRes);
    {
      __bDiagValueArrayCtr = DiagGetParameterErrorHandled(__resp, "_Autosar_Revision_ASR_Major_Release_88", __bDiagValueArray, elcount(__bDiagValueArray), __cDiagValueArray, elcount(__cDiagValueArray));
      {
        __bSetInCheckAlignment = 1;	
        {
          __bArrayCtr = __CopyBytes(__bDiagValueArray, __bDiagValueArrayCtr, __bArray);
          {
            sysvar * __systemVariable;
            __systemVariable = sysvarData::`PartNumber::`Part_Number;
            CheckSysVarSetBufferConsistency(sysSetVariableData(sysvarData::`PartNumber::`Part_Number, __bArray, __bArrayCtr), __systemVariable.name);
          }
          snprintf(__cArray, 8192, "%s", "Part_Number");
          snprintf(__cArray2, 8192, "%s '%s'", __cSysVar, __cArray);
          snprintf(__cArray3, 8192, "%s", "_Autosar_Revision_ASR_Major_Release_88");
          
          ReportTableRow(__tableHandle, 0, __cArray2, __cAOp, __bArray, __bArrayCtr, __cArray3, __oneOfFlag, __bSetInCheckAlignment);
        
        }
    
        __bSetInCheckAlignment = 0;
      }
    }
    {
      __bDiagValueArrayCtr = DiagGetParameterErrorHandled(__resp, "_Software_License_Package_SLP_96", __bDiagValueArray, elcount(__bDiagValueArray), __cDiagValueArray, elcount(__cDiagValueArray));
      {
        __bSetInCheckAlignment = 1;	
        {
          __bArrayCtr = __CopyBytes(__bDiagValueArray, __bDiagValueArrayCtr, __bArray);
          {
            sysvar * __systemVariable;
            __systemVariable = sysvarData::`PartNumber::`Part_Number;
            CheckSysVarSetBufferConsistency(sysSetVariableData(sysvarData::`PartNumber::`Part_Number, __bArray, __bArrayCtr), __systemVariable.name);
          }
          snprintf(__cArray, 8192, "%s", "Part_Number");
          snprintf(__cArray2, 8192, "%s '%s'", __cSysVar, __cArray);
          snprintf(__cArray3, 8192, "%s", "_Software_License_Package_SLP_96");
          
          ReportTableRow(__tableHandle, 0, __cArray2, __cAOp, __bArray, __bArrayCtr, __cArray3, __oneOfFlag, __bSetInCheckAlignment);
        
        }
    
        __bSetInCheckAlignment = 0;
      }
    }
    {
      __bDiagValueArrayCtr = DiagGetParameterErrorHandled(__resp, "_Vector_Delivery_Number_80", __bDiagValueArray, elcount(__bDiagValueArray), __cDiagValueArray, elcount(__cDiagValueArray));
      {
        __bSetInCheckAlignment = 1;	
        {
          __bArrayCtr = __CopyBytes(__bDiagValueArray, __bDiagValueArrayCtr, __bArray);
          {
            sysvar * __systemVariable;
            __systemVariable = sysvarData::`PartNumber::`Part_Number;
            CheckSysVarSetBufferConsistency(sysSetVariableData(sysvarData::`PartNumber::`Part_Number, __bArray, __bArrayCtr), __systemVariable.name);
          }
          snprintf(__cArray, 8192, "%s", "Part_Number");
          snprintf(__cArray2, 8192, "%s '%s'", __cSysVar, __cArray);
          snprintf(__cArray3, 8192, "%s", "_Vector_Delivery_Number_80");
          
          ReportTableRow(__tableHandle, 0, __cArray2, __cAOp, __bArray, __bArrayCtr, __cArray3, __oneOfFlag, __bSetInCheckAlignment);
        
        }
    
        __bSetInCheckAlignment = 0;
      }
    }
    {
      __bDiagValueArrayCtr = DiagGetParameterErrorHandled(__resp, "_Vector_License_Number_CBD_Number_48", __bDiagValueArray, elcount(__bDiagValueArray), __cDiagValueArray, elcount(__cDiagValueArray));
      {
        __bSetInCheckAlignment = 1;	
        {
          __bArrayCtr = __CopyBytes(__bDiagValueArray, __bDiagValueArrayCtr, __bArray);
          {
            sysvar * __systemVariable;
            __systemVariable = sysvarData::`PartNumber::`Part_Number;
            CheckSysVarSetBufferConsistency(sysSetVariableData(sysvarData::`PartNumber::`Part_Number, __bArray, __bArrayCtr), __systemVariable.name);
          }
          snprintf(__cArray, 8192, "%s", "Part_Number");
          snprintf(__cArray2, 8192, "%s '%s'", __cSysVar, __cArray);
          snprintf(__cArray3, 8192, "%s", "_Vector_License_Number_CBD_Number_48");
          
          ReportTableRow(__tableHandle, 0, __cArray2, __cAOp, __bArray, __bArrayCtr, __cArray3, __oneOfFlag, __bSetInCheckAlignment);
        
        }
    
        __bSetInCheckAlignment = 0;
      }
    }
    {
      __bDiagValueArrayCtr = DiagGetParameterErrorHandled(__resp, "_Vector_Release_Version_Basic_Software_BSW_24", __bDiagValueArray, elcount(__bDiagValueArray), __cDiagValueArray, elcount(__cDiagValueArray));
      {
        __bSetInCheckAlignment = 1;	
        {
          __bArrayCtr = __CopyBytes(__bDiagValueArray, __bDiagValueArrayCtr, __bArray);
          {
            sysvar * __systemVariable;
            __systemVariable = sysvarData::`PartNumber::`Part_Number;
            CheckSysVarSetBufferConsistency(sysSetVariableData(sysvarData::`PartNumber::`Part_Number, __bArray, __bArrayCtr), __systemVariable.name);
          }
          snprintf(__cArray, 8192, "%s", "Part_Number");
          snprintf(__cArray2, 8192, "%s '%s'", __cSysVar, __cArray);
          snprintf(__cArray3, 8192, "%s", "_Vector_Release_Version_Basic_Software_BSW_24");
          
          ReportTableRow(__tableHandle, 0, __cArray2, __cAOp, __bArray, __bArrayCtr, __cArray3, __oneOfFlag, __bSetInCheckAlignment);
        
        }
    
        __bSetInCheckAlignment = 0;
      }
    }
    ReportTableEndVerdict(__tableHandle, __cEvaluateResponse, __res);
	__bVerdict = __bVerdict && __res;
  }
  if (__bVerdict == __eVerdictFail)
    TestReportWriteDiagObjectList();
}

void Tto7tsimc_F1A2_DID_with_Functional_Address()
{
  stack long __tableHandle;
  TestCommandBegin(__eDiagService, __cDiagService, "", "0");
  {
    if (DiagIsFunctionalGroup("CVADAS_0001_00000000_000"))
    {
      DiagResponse * __resp;
      DiagRequest CVADAS_0001_00000000_000._22F1A2_Vector_Delivery_ID __req;
      __diagServiceo7tsimc_12(__req, __resp);
    }
    else
    {
      DiagResponse CVADAS_0001_00000000_000.* __resp;
      DiagRequest CVADAS_0001_00000000_000._22F1A2_Vector_Delivery_ID __req;
      __diagServiceo7tsimc_12(__req, __resp);
    }
  }
  TestCommandEnd();


}

  
void __diagServiceo7tsimc_12(DiagRequest * __req, DiagResponse * __resp )
{
  stack long __tableHandle;
  long __res, __paramLen, __bytePos;

   __bVerdict = __eVerdictPass;

  do {
    TestReportResetDiagObjectList();
    DiagSetReportDetailLevel("CVADAS_0001_00000000_000", EnumServiceDetails_onfail);
    // Request aspect
    {

      if (0 >= DiagSendReqAndWaitForResp("CVADAS_0001_00000000_000", __req, __resp, __res, -1, -1, -1, -1, -1, EnumResult_pos, EnumServiceDetails_onfail, EnumSendingMode_physical, EnumSuppressPosResBit_asconfigured, EnumVerdictOnInvalidValues_fail))
        break;
    }

    __res = DiagErrCodeTestStep(__res, "Can't retrieve last response for request! No check possible.") < 0;
    if(__res)
    {
	  __bVerdict = __eVerdictFail;
      break;
    }
    {
      __res = DiagInterpretAs(__resp, "RDBI_PR");
      if(__res != 0)
      {
        __bVerdict = __eVerdictFail;
        DiagErrCodeTestStep(__res, "Can't interpret response as diagnostic primitive 'RDBI_PR'.");
        break;
      }
      else
      {
        TestStepPass( "Received primitive can be interpreted as diagnostic primitive 'RDBI_PR'.");
      }
    }
  }
  while(0);


  // Response, check & read aspect
  {
    __res = 1;
    __tableHandle = ReportTableHead5Columns(__cCheckCaption, __cTSym, __cTOp, __cRefVal, __cActual, __cRes);
    {
      __bDiagValueArrayCtr = DiagGetParameterErrorHandled(__resp, "_Autosar_Revision_ASR_Major_Release_88", __bDiagValueArray, elcount(__bDiagValueArray), __cDiagValueArray, elcount(__cDiagValueArray));
      {
        __bSetInCheckAlignment = 1;	
        {
          __bArrayCtr = __CopyBytes(__bDiagValueArray, __bDiagValueArrayCtr, __bArray);
          {
            sysvar * __systemVariable;
            __systemVariable = sysvarData::`PartNumber::`Part_Number;
            CheckSysVarSetBufferConsistency(sysSetVariableData(sysvarData::`PartNumber::`Part_Number, __bArray, __bArrayCtr), __systemVariable.name);
          }
          snprintf(__cArray, 8192, "%s", "Part_Number");
          snprintf(__cArray2, 8192, "%s '%s'", __cSysVar, __cArray);
          snprintf(__cArray3, 8192, "%s", "_Autosar_Revision_ASR_Major_Release_88");
          
          ReportTableRow(__tableHandle, 0, __cArray2, __cAOp, __bArray, __bArrayCtr, __cArray3, __oneOfFlag, __bSetInCheckAlignment);
        
        }
    
        __bSetInCheckAlignment = 0;
      }
    }
    {
      __bDiagValueArrayCtr = DiagGetParameterErrorHandled(__resp, "_Software_License_Package_SLP_96", __bDiagValueArray, elcount(__bDiagValueArray), __cDiagValueArray, elcount(__cDiagValueArray));
      {
        __bSetInCheckAlignment = 1;	
        {
          __bArrayCtr = __CopyBytes(__bDiagValueArray, __bDiagValueArrayCtr, __bArray);
          {
            sysvar * __systemVariable;
            __systemVariable = sysvarData::`PartNumber::`Part_Number;
            CheckSysVarSetBufferConsistency(sysSetVariableData(sysvarData::`PartNumber::`Part_Number, __bArray, __bArrayCtr), __systemVariable.name);
          }
          snprintf(__cArray, 8192, "%s", "Part_Number");
          snprintf(__cArray2, 8192, "%s '%s'", __cSysVar, __cArray);
          snprintf(__cArray3, 8192, "%s", "_Software_License_Package_SLP_96");
          
          ReportTableRow(__tableHandle, 0, __cArray2, __cAOp, __bArray, __bArrayCtr, __cArray3, __oneOfFlag, __bSetInCheckAlignment);
        
        }
    
        __bSetInCheckAlignment = 0;
      }
    }
    {
      __bDiagValueArrayCtr = DiagGetParameterErrorHandled(__resp, "_Vector_Delivery_Number_80", __bDiagValueArray, elcount(__bDiagValueArray), __cDiagValueArray, elcount(__cDiagValueArray));
      {
        __bSetInCheckAlignment = 1;	
        {
          __bArrayCtr = __CopyBytes(__bDiagValueArray, __bDiagValueArrayCtr, __bArray);
          {
            sysvar * __systemVariable;
            __systemVariable = sysvarData::`PartNumber::`Part_Number;
            CheckSysVarSetBufferConsistency(sysSetVariableData(sysvarData::`PartNumber::`Part_Number, __bArray, __bArrayCtr), __systemVariable.name);
          }
          snprintf(__cArray, 8192, "%s", "Part_Number");
          snprintf(__cArray2, 8192, "%s '%s'", __cSysVar, __cArray);
          snprintf(__cArray3, 8192, "%s", "_Vector_Delivery_Number_80");
          
          ReportTableRow(__tableHandle, 0, __cArray2, __cAOp, __bArray, __bArrayCtr, __cArray3, __oneOfFlag, __bSetInCheckAlignment);
        
        }
    
        __bSetInCheckAlignment = 0;
      }
    }
    {
      __bDiagValueArrayCtr = DiagGetParameterErrorHandled(__resp, "_Vector_License_Number_CBD_Number_48", __bDiagValueArray, elcount(__bDiagValueArray), __cDiagValueArray, elcount(__cDiagValueArray));
      {
        __bSetInCheckAlignment = 1;	
        {
          __bArrayCtr = __CopyBytes(__bDiagValueArray, __bDiagValueArrayCtr, __bArray);
          {
            sysvar * __systemVariable;
            __systemVariable = sysvarData::`PartNumber::`Part_Number;
            CheckSysVarSetBufferConsistency(sysSetVariableData(sysvarData::`PartNumber::`Part_Number, __bArray, __bArrayCtr), __systemVariable.name);
          }
          snprintf(__cArray, 8192, "%s", "Part_Number");
          snprintf(__cArray2, 8192, "%s '%s'", __cSysVar, __cArray);
          snprintf(__cArray3, 8192, "%s", "_Vector_License_Number_CBD_Number_48");
          
          ReportTableRow(__tableHandle, 0, __cArray2, __cAOp, __bArray, __bArrayCtr, __cArray3, __oneOfFlag, __bSetInCheckAlignment);
        
        }
    
        __bSetInCheckAlignment = 0;
      }
    }
    {
      __bDiagValueArrayCtr = DiagGetParameterErrorHandled(__resp, "_Vector_Release_Version_Basic_Software_BSW_24", __bDiagValueArray, elcount(__bDiagValueArray), __cDiagValueArray, elcount(__cDiagValueArray));
      {
        __bSetInCheckAlignment = 1;	
        {
          __bArrayCtr = __CopyBytes(__bDiagValueArray, __bDiagValueArrayCtr, __bArray);
          {
            sysvar * __systemVariable;
            __systemVariable = sysvarData::`PartNumber::`Part_Number;
            CheckSysVarSetBufferConsistency(sysSetVariableData(sysvarData::`PartNumber::`Part_Number, __bArray, __bArrayCtr), __systemVariable.name);
          }
          snprintf(__cArray, 8192, "%s", "Part_Number");
          snprintf(__cArray2, 8192, "%s '%s'", __cSysVar, __cArray);
          snprintf(__cArray3, 8192, "%s", "_Vector_Release_Version_Basic_Software_BSW_24");
          
          ReportTableRow(__tableHandle, 0, __cArray2, __cAOp, __bArray, __bArrayCtr, __cArray3, __oneOfFlag, __bSetInCheckAlignment);
        
        }
    
        __bSetInCheckAlignment = 0;
      }
    }
    ReportTableEndVerdict(__tableHandle, __cEvaluateResponse, __res);
	__bVerdict = __bVerdict && __res;
  }
  if (__bVerdict == __eVerdictFail)
    TestReportWriteDiagObjectList();
}

void Tto7tsimc_F1A2_DID_with_Standard_Physical_Address()
{
  stack long __tableHandle;
  TestCommandBegin(__eRequestResponse, __cRequestResponse, "", "0");
  {
  
    long __res;
    int64 __timeout;
    __res = 0;
    __nInt64 = 1;
    __timeout = syspar::`P2_Server * 1000000LL;
    {
    
      long __testStepInitOk;
      message `FDCAN2::`DIAGNOSTIC_REQUEST_PAM __output;
      message `FDCAN2::`DIAGNOSTIC_REQUEST_PAM __msgOrig;
      __output = __msgOrig;
      __testStepInitOk = 1;
      {
        int64 __dlc;
        __dlc = 4;
        if (__dlc >= 0 && __dlc <= (__output.EDL ? 15 : 8))
          __output.DLC = __dlc;
        else
        {
          testStepErrorInTestSystem(0, __cEmpty, "Unable to set DLC=%lld in message. Please check input parameter.", __dlc);
          __testStepInitOk = 0;
        }
      }
      if (__testStepInitOk)
      {
        snprintf(__cArray, elCount(__cArray), "CAN message '%s' ID = 416981233x (0x18DAA0F1x) on bus FDCAN2", "DIAGNOSTIC_REQUEST_PAM");
        snprintf(__cArray2, elCount(__cArray2), "Send %s", __cArray);
        __tableHandle = ReportTableHead3Columns(__cArray2, "Byte", __cTOp, __cAssigned);
        ReportByteIndex("", 0, __cArray, elCount(__cArray));
        snprintf(__cArray2, 8192, "%s", __cArray);
        snprintf(__cArray3, 8192, "%s", "");
        
        ReportTableRow(__tableHandle, 0, __cArray2, __cAOp, 0x3, __cArray3, __oneOfFlag, __bSetInCheckAlignment);
        
        if (0 >= 0 && 0 < 64)
        {
          __output.byte((word)0) = 0x3;
        }
        else
        {
          testStepErrorInTestSystem(0, __cEmpty, "Index out of range. Unable to set byte %lld in message. Please check input parameter.", (int64)0);
          __testStepInitOk = 0;
        }
        ReportByteIndex("", 1, __cArray, elCount(__cArray));
        snprintf(__cArray2, 8192, "%s", __cArray);
        snprintf(__cArray3, 8192, "%s", "");
        
        ReportTableRow(__tableHandle, 0, __cArray2, __cAOp, 0x22, __cArray3, __oneOfFlag, __bSetInCheckAlignment);
        
        if (1 >= 0 && 1 < 64)
        {
          __output.byte((word)1) = 0x22;
        }
        else
        {
          testStepErrorInTestSystem(0, __cEmpty, "Index out of range. Unable to set byte %lld in message. Please check input parameter.", (int64)1);
          __testStepInitOk = 0;
        }
        ReportByteIndex("", 2, __cArray, elCount(__cArray));
        snprintf(__cArray2, 8192, "%s", __cArray);
        snprintf(__cArray3, 8192, "%s", "");
        
        ReportTableRow(__tableHandle, 0, __cArray2, __cAOp, 0xF1, __cArray3, __oneOfFlag, __bSetInCheckAlignment);
        
        if (2 >= 0 && 2 < 64)
        {
          __output.byte((word)2) = 0xF1;
        }
        else
        {
          testStepErrorInTestSystem(0, __cEmpty, "Index out of range. Unable to set byte %lld in message. Please check input parameter.", (int64)2);
          __testStepInitOk = 0;
        }
        ReportByteIndex("", 3, __cArray, elCount(__cArray));
        snprintf(__cArray2, 8192, "%s", __cArray);
        snprintf(__cArray3, 8192, "%s", "");
        
        ReportTableRow(__tableHandle, 0, __cArray2, __cAOp, 0xA2, __cArray3, __oneOfFlag, __bSetInCheckAlignment);
        
        if (3 >= 0 && 3 < 64)
        {
          __output.byte((word)3) = 0xA2;
        }
        else
        {
          testStepErrorInTestSystem(0, __cEmpty, "Index out of range. Unable to set byte %lld in message. Please check input parameter.", (int64)3);
          __testStepInitOk = 0;
        }
      
        ReportTableEndTestStep(__tableHandle, "Req1");
      }
      if (__testStepInitOk)
      {
        output(__output);
      }
    }
    if (__timeout <= 0)
    {
      testStepErrorInTestSystem(0, "1", "Unable to wait for %.3f %s. Please check input parameter.", __timeout / ((float)1000000), "ms");
    }
    else
    {
      __tt8cnt_17 = 0;
      snprintf(__cArray, elCount(__cArray), "CAN message '%s' ID = 417001888x (0x18DAF1A0x) on bus FDCAN2", "DIAGNOSTIC_RESPONSE_PAM");
      if(SetBusContextByName("FDCAN2", __eSaveCurrent, __nBusContextNew, __nBusContextOld))
        testJoinMessageEvent(`FDCAN2::`DIAGNOSTIC_RESPONSE_PAM,  __cArray,
             delegate dword(message * __m)
             {
               dword __msg_callback_ret;
               if (__tt8cnt_17 == -1)
               {
                 return 1;
               }
               __msg_callback_ret = 1;
               __tt8cnt_17++;
               if (__msg_callback_ret)
               {
                 __tt8cnt_17 = -1;
                 return 1;
               }
               return 0;
             });
      __res = testWaitForAllJoinedEventsNS(__timeout);
      if (__nInt64 != 0)
      {
        snprintf(__cArray, elCount(__cArray), "CAN message '%s' ID = 417001888x (0x18DAF1A0x) on bus FDCAN2", "DIAGNOSTIC_RESPONSE_PAM");
        if(__tt8cnt_17 == -1)
        {
          snprintf(__cArray2, 8192, "Response of %s", __cArray);
        }
        else
        {
          snprintf(__cArray2, 8192, "Response of %s (received %d times)", __cArray, __tt8cnt_17);
        }
        if (__tt8cnt_17 == 0)
        {
          testStepFail(0, "Resp1", __cArray2);
        }
        else
        {
          testStepPass(2, "Resp1", __cArray2);
        }
        __ReportRequestResponseResult(__res, 0);
      }
      ResetBusContext(__nBusContextNew, __nBusContextOld);
    }
  }
  TestCommandEnd();

}

void Tto7tsimc_F154_DID_with_Physical_Address()
{
  stack long __tableHandle;
  TestCommandBegin(__eDiagService, __cDiagService, "", "0");
  {
    if (DiagIsFunctionalGroup("CVADAS_0001_00000000_000"))
    {
      DiagResponse * __resp;
      DiagRequest CVADAS_0001_00000000_000._22F154_Hardware_Supplier_Identification __req;
      __diagServiceo7tsimc_13(__req, __resp);
    }
    else
    {
      DiagResponse CVADAS_0001_00000000_000.* __resp;
      DiagRequest CVADAS_0001_00000000_000._22F154_Hardware_Supplier_Identification __req;
      __diagServiceo7tsimc_13(__req, __resp);
    }
  }
  TestCommandEnd();


}

  
void __diagServiceo7tsimc_13(DiagRequest * __req, DiagResponse * __resp )
{
  stack long __tableHandle;
  long __res, __paramLen, __bytePos;

   __bVerdict = __eVerdictPass;

  do {
    TestReportResetDiagObjectList();
    DiagSetReportDetailLevel("CVADAS_0001_00000000_000", EnumServiceDetails_onfail);
    // Request aspect
    {

      if (0 >= DiagSendReqAndWaitForResp("CVADAS_0001_00000000_000", __req, __resp, __res, -1, -1, -1, -1, -1, EnumResult_pos, EnumServiceDetails_onfail, EnumSendingMode_physical, EnumSuppressPosResBit_asconfigured, EnumVerdictOnInvalidValues_fail))
        break;
    }

    __res = DiagErrCodeTestStep(__res, "Can't retrieve last response for request! No check possible.") < 0;
    if(__res)
    {
	  __bVerdict = __eVerdictFail;
      break;
    }
    {
      __res = DiagInterpretAs(__resp, "RDBI_PR");
      if(__res != 0)
      {
        __bVerdict = __eVerdictFail;
        DiagErrCodeTestStep(__res, "Can't interpret response as diagnostic primitive 'RDBI_PR'.");
        break;
      }
      else
      {
        TestStepPass( "Received primitive can be interpreted as diagnostic primitive 'RDBI_PR'.");
      }
    }
  }
  while(0);


  // Response, check & read aspect
  {
    __res = 1;
    __tableHandle = ReportTableHead5Columns(__cCheckCaption, __cTSym, __cTOp, __cRefVal, __cActual, __cRes);
    {
      __bDiagValueArrayCtr = DiagGetParameterErrorHandled(__resp, "_Hardware_Supplier_Identification_24", __bDiagValueArray, elcount(__bDiagValueArray), __cDiagValueArray, elcount(__cDiagValueArray));
      {
        __bSetInCheckAlignment = 1;	
        {
          __bArrayCtr = __CopyBytes(__bDiagValueArray, __bDiagValueArrayCtr, __bArray);
          {
            sysvar * __systemVariable;
            __systemVariable = sysvarData::`PartNumber::`Part_Number;
            CheckSysVarSetBufferConsistency(sysSetVariableData(sysvarData::`PartNumber::`Part_Number, __bArray, __bArrayCtr), __systemVariable.name);
          }
          snprintf(__cArray, 8192, "%s", "Part_Number");
          snprintf(__cArray2, 8192, "%s '%s'", __cSysVar, __cArray);
          snprintf(__cArray3, 8192, "%s", "_Hardware_Supplier_Identification_24");
          
          ReportTableRow(__tableHandle, 0, __cArray2, __cAOp, __bArray, __bArrayCtr, __cArray3, __oneOfFlag, __bSetInCheckAlignment);
        
        }
    
        __bSetInCheckAlignment = 0;
      }
    }
    ReportTableEndVerdict(__tableHandle, __cEvaluateResponse, __res);
	__bVerdict = __bVerdict && __res;
  }
  if (__bVerdict == __eVerdictFail)
    TestReportWriteDiagObjectList();
}

void Tto7tsimc_F154_DID_with_Functional_Address()
{
  stack long __tableHandle;
  TestCommandBegin(__eDiagService, __cDiagService, "", "0");
  {
    if (DiagIsFunctionalGroup("CVADAS_0001_00000000_000"))
    {
      DiagResponse * __resp;
      DiagRequest CVADAS_0001_00000000_000._22F154_Hardware_Supplier_Identification __req;
      __diagServiceo7tsimc_14(__req, __resp);
    }
    else
    {
      DiagResponse CVADAS_0001_00000000_000.* __resp;
      DiagRequest CVADAS_0001_00000000_000._22F154_Hardware_Supplier_Identification __req;
      __diagServiceo7tsimc_14(__req, __resp);
    }
  }
  TestCommandEnd();


}

  
void __diagServiceo7tsimc_14(DiagRequest * __req, DiagResponse * __resp )
{
  stack long __tableHandle;
  long __res, __paramLen, __bytePos;

   __bVerdict = __eVerdictPass;

  do {
    TestReportResetDiagObjectList();
    DiagSetReportDetailLevel("CVADAS_0001_00000000_000", EnumServiceDetails_onfail);
    // Request aspect
    {

      if (0 >= DiagSendReqAndWaitForResp("CVADAS_0001_00000000_000", __req, __resp, __res, -1, -1, -1, -1, -1, EnumResult_pos, EnumServiceDetails_onfail, EnumSendingMode_physical, EnumSuppressPosResBit_asconfigured, EnumVerdictOnInvalidValues_fail))
        break;
    }

    __res = DiagErrCodeTestStep(__res, "Can't retrieve last response for request! No check possible.") < 0;
    if(__res)
    {
	  __bVerdict = __eVerdictFail;
      break;
    }
    {
      __res = DiagInterpretAs(__resp, "RDBI_PR");
      if(__res != 0)
      {
        __bVerdict = __eVerdictFail;
        DiagErrCodeTestStep(__res, "Can't interpret response as diagnostic primitive 'RDBI_PR'.");
        break;
      }
      else
      {
        TestStepPass( "Received primitive can be interpreted as diagnostic primitive 'RDBI_PR'.");
      }
    }
  }
  while(0);


  // Response, check & read aspect
  {
    __res = 1;
    __tableHandle = ReportTableHead5Columns(__cCheckCaption, __cTSym, __cTOp, __cRefVal, __cActual, __cRes);
    {
      __bDiagValueArrayCtr = DiagGetParameterErrorHandled(__resp, "_Hardware_Supplier_Identification_24", __bDiagValueArray, elcount(__bDiagValueArray), __cDiagValueArray, elcount(__cDiagValueArray));
      {
        __bSetInCheckAlignment = 1;	
        {
          __bArrayCtr = __CopyBytes(__bDiagValueArray, __bDiagValueArrayCtr, __bArray);
          {
            sysvar * __systemVariable;
            __systemVariable = sysvarData::`PartNumber::`Part_Number;
            CheckSysVarSetBufferConsistency(sysSetVariableData(sysvarData::`PartNumber::`Part_Number, __bArray, __bArrayCtr), __systemVariable.name);
          }
          snprintf(__cArray, 8192, "%s", "Part_Number");
          snprintf(__cArray2, 8192, "%s '%s'", __cSysVar, __cArray);
          snprintf(__cArray3, 8192, "%s", "_Hardware_Supplier_Identification_24");
          
          ReportTableRow(__tableHandle, 0, __cArray2, __cAOp, __bArray, __bArrayCtr, __cArray3, __oneOfFlag, __bSetInCheckAlignment);
        
        }
    
        __bSetInCheckAlignment = 0;
      }
    }
    ReportTableEndVerdict(__tableHandle, __cEvaluateResponse, __res);
	__bVerdict = __bVerdict && __res;
  }
  if (__bVerdict == __eVerdictFail)
    TestReportWriteDiagObjectList();
}

void Tto7tsimc_F154_DID_with_Standard_Physical_Address()
{
  stack long __tableHandle;
  TestCommandBegin(__eRequestResponse, __cRequestResponse, "", "0");
  {
  
    long __res;
    int64 __timeout;
    __res = 0;
    __nInt64 = 1;
    __timeout = syspar::`P2_Server * 1000000LL;
    {
    
      long __testStepInitOk;
      message `FDCAN2::`DIAGNOSTIC_REQUEST_PAM __output;
      message `FDCAN2::`DIAGNOSTIC_REQUEST_PAM __msgOrig;
      __output = __msgOrig;
      __testStepInitOk = 1;
      snprintf(__cArray, elCount(__cArray), "CAN message '%s' ID = 416981233x (0x18DAA0F1x) on bus FDCAN2", "DIAGNOSTIC_REQUEST_PAM");
      snprintf(__cArray2, elCount(__cArray2), "Send %s", __cArray);
      __tableHandle = ReportTableHead3Columns(__cArray2, "Byte", __cTOp, __cAssigned);
      ReportByteIndex("", 0, __cArray, elCount(__cArray));
      snprintf(__cArray2, 8192, "%s", __cArray);
      snprintf(__cArray3, 8192, "%s", "");
      
      ReportTableRow(__tableHandle, 0, __cArray2, __cAOp, 0x3, __cArray3, __oneOfFlag, __bSetInCheckAlignment);
      
      if (0 >= 0 && 0 < 64)
      {
        __output.byte((word)0) = 0x3;
      }
      else
      {
        testStepErrorInTestSystem(0, __cEmpty, "Index out of range. Unable to set byte %lld in message. Please check input parameter.", (int64)0);
        __testStepInitOk = 0;
      }
      ReportByteIndex("", 1, __cArray, elCount(__cArray));
      snprintf(__cArray2, 8192, "%s", __cArray);
      snprintf(__cArray3, 8192, "%s", "");
      
      ReportTableRow(__tableHandle, 0, __cArray2, __cAOp, 0x22, __cArray3, __oneOfFlag, __bSetInCheckAlignment);
      
      if (1 >= 0 && 1 < 64)
      {
        __output.byte((word)1) = 0x22;
      }
      else
      {
        testStepErrorInTestSystem(0, __cEmpty, "Index out of range. Unable to set byte %lld in message. Please check input parameter.", (int64)1);
        __testStepInitOk = 0;
      }
      ReportByteIndex("", 2, __cArray, elCount(__cArray));
      snprintf(__cArray2, 8192, "%s", __cArray);
      snprintf(__cArray3, 8192, "%s", "");
      
      ReportTableRow(__tableHandle, 0, __cArray2, __cAOp, 0xF1, __cArray3, __oneOfFlag, __bSetInCheckAlignment);
      
      if (2 >= 0 && 2 < 64)
      {
        __output.byte((word)2) = 0xF1;
      }
      else
      {
        testStepErrorInTestSystem(0, __cEmpty, "Index out of range. Unable to set byte %lld in message. Please check input parameter.", (int64)2);
        __testStepInitOk = 0;
      }
      ReportByteIndex("", 3, __cArray, elCount(__cArray));
      snprintf(__cArray2, 8192, "%s", __cArray);
      snprintf(__cArray3, 8192, "%s", "");
      
      ReportTableRow(__tableHandle, 0, __cArray2, __cAOp, 0x54, __cArray3, __oneOfFlag, __bSetInCheckAlignment);
      
      if (3 >= 0 && 3 < 64)
      {
        __output.byte((word)3) = 0x54;
      }
      else
      {
        testStepErrorInTestSystem(0, __cEmpty, "Index out of range. Unable to set byte %lld in message. Please check input parameter.", (int64)3);
        __testStepInitOk = 0;
      }
    
      ReportTableEndTestStep(__tableHandle, "Req1");
      if (__testStepInitOk)
      {
        output(__output);
      }
    }
    if (__timeout <= 0)
    {
      testStepErrorInTestSystem(0, "1", "Unable to wait for %.3f %s. Please check input parameter.", __timeout / ((float)1000000), "ms");
    }
    else
    {
      __tt8cnt_19 = 0;
      snprintf(__cArray, elCount(__cArray), "CAN message '%s' ID = 417001888x (0x18DAF1A0x) on bus FDCAN2", "DIAGNOSTIC_RESPONSE_PAM");
      if(SetBusContextByName("FDCAN2", __eSaveCurrent, __nBusContextNew, __nBusContextOld))
        testJoinMessageEvent(`FDCAN2::`DIAGNOSTIC_RESPONSE_PAM,  __cArray,
             delegate dword(message * __m)
             {
               dword __msg_callback_ret;
               if (__tt8cnt_19 == -1)
               {
                 return 1;
               }
               __msg_callback_ret = 1;
               __tt8cnt_19++;
               if (__msg_callback_ret)
               {
                 __tt8cnt_19 = -1;
                 return 1;
               }
               return 0;
             });
      __res = testWaitForAllJoinedEventsNS(__timeout);
      if (__nInt64 != 0)
      {
        snprintf(__cArray, elCount(__cArray), "CAN message '%s' ID = 417001888x (0x18DAF1A0x) on bus FDCAN2", "DIAGNOSTIC_RESPONSE_PAM");
        if(__tt8cnt_19 == -1)
        {
          snprintf(__cArray2, 8192, "Response of %s", __cArray);
        }
        else
        {
          snprintf(__cArray2, 8192, "Response of %s (received %d times)", __cArray, __tt8cnt_19);
        }
        if (__tt8cnt_19 == 0)
        {
          testStepFail(0, "Resp1", __cArray2);
        }
        else
        {
          testStepPass(2, "Resp1", __cArray2);
        }
        __ReportRequestResponseResult(__res, 0);
      }
      ResetBusContext(__nBusContextNew, __nBusContextOld);
    }
  }
  TestCommandEnd();

}

void Tto7tsimc_F155_DID_with_Physical_Address()
{
  stack long __tableHandle;
  TestCommandBegin(__eDiagService, __cDiagService, "", "0");
  {
    if (DiagIsFunctionalGroup("CVADAS_0001_00000000_000"))
    {
      DiagResponse * __resp;
      DiagRequest CVADAS_0001_00000000_000._22F155_Software_Supplier_Identification __req;
      __diagServiceo7tsimc_15(__req, __resp);
    }
    else
    {
      DiagResponse CVADAS_0001_00000000_000.* __resp;
      DiagRequest CVADAS_0001_00000000_000._22F155_Software_Supplier_Identification __req;
      __diagServiceo7tsimc_15(__req, __resp);
    }
  }
  TestCommandEnd();


}

  
void __diagServiceo7tsimc_15(DiagRequest * __req, DiagResponse * __resp )
{
  stack long __tableHandle;
  long __res, __paramLen, __bytePos;

   __bVerdict = __eVerdictPass;

  do {
    TestReportResetDiagObjectList();
    DiagSetReportDetailLevel("CVADAS_0001_00000000_000", EnumServiceDetails_onfail);
    // Request aspect
    {

      if (0 >= DiagSendReqAndWaitForResp("CVADAS_0001_00000000_000", __req, __resp, __res, -1, -1, -1, -1, -1, EnumResult_pos, EnumServiceDetails_onfail, EnumSendingMode_functional, EnumSuppressPosResBit_asconfigured, EnumVerdictOnInvalidValues_fail))
        break;
    }

    __res = DiagErrCodeTestStep(__res, "Can't retrieve last response for request! No check possible.") < 0;
    if(__res)
    {
	  __bVerdict = __eVerdictFail;
      break;
    }
    {
      __res = DiagInterpretAs(__resp, "RDBI_PR");
      if(__res != 0)
      {
        __bVerdict = __eVerdictFail;
        DiagErrCodeTestStep(__res, "Can't interpret response as diagnostic primitive 'RDBI_PR'.");
        break;
      }
      else
      {
        TestStepPass( "Received primitive can be interpreted as diagnostic primitive 'RDBI_PR'.");
      }
    }
  }
  while(0);


  // Response, check & read aspect
  {
    __res = 1;
    __tableHandle = ReportTableHead5Columns(__cCheckCaption, __cTSym, __cTOp, __cRefVal, __cActual, __cRes);
    {
      __bDiagValueArrayCtr = DiagGetParameterErrorHandled(__resp, "_Software_Supplier_Identification_24", __bDiagValueArray, elcount(__bDiagValueArray), __cDiagValueArray, elcount(__cDiagValueArray));
      {
        __bSetInCheckAlignment = 1;	
        {
          __bArrayCtr = __CopyBytes(__bDiagValueArray, __bDiagValueArrayCtr, __bArray);
          {
            sysvar * __systemVariable;
            __systemVariable = sysvarData::`PartNumber::`Part_Number;
            CheckSysVarSetBufferConsistency(sysSetVariableData(sysvarData::`PartNumber::`Part_Number, __bArray, __bArrayCtr), __systemVariable.name);
          }
          snprintf(__cArray, 8192, "%s", "Part_Number");
          snprintf(__cArray2, 8192, "%s '%s'", __cSysVar, __cArray);
          snprintf(__cArray3, 8192, "%s", "_Software_Supplier_Identification_24");
          
          ReportTableRow(__tableHandle, 0, __cArray2, __cAOp, __bArray, __bArrayCtr, __cArray3, __oneOfFlag, __bSetInCheckAlignment);
        
        }
    
        __bSetInCheckAlignment = 0;
      }
    }
    ReportTableEndVerdict(__tableHandle, __cEvaluateResponse, __res);
	__bVerdict = __bVerdict && __res;
  }
  if (__bVerdict == __eVerdictFail)
    TestReportWriteDiagObjectList();
}

void Tto7tsimc_F155_DID_with_Functional_Address()
{
  stack long __tableHandle;
  TestCommandBegin(__eDiagService, __cDiagService, "", "0");
  {
    if (DiagIsFunctionalGroup("CVADAS_0001_00000000_000"))
    {
      DiagResponse * __resp;
      DiagRequest CVADAS_0001_00000000_000._22F155_Software_Supplier_Identification __req;
      __diagServiceo7tsimc_16(__req, __resp);
    }
    else
    {
      DiagResponse CVADAS_0001_00000000_000.* __resp;
      DiagRequest CVADAS_0001_00000000_000._22F155_Software_Supplier_Identification __req;
      __diagServiceo7tsimc_16(__req, __resp);
    }
  }
  TestCommandEnd();


}

  
void __diagServiceo7tsimc_16(DiagRequest * __req, DiagResponse * __resp )
{
  stack long __tableHandle;
  long __res, __paramLen, __bytePos;

   __bVerdict = __eVerdictPass;

  do {
    TestReportResetDiagObjectList();
    DiagSetReportDetailLevel("CVADAS_0001_00000000_000", EnumServiceDetails_onfail);
    // Request aspect
    {

      if (0 >= DiagSendReqAndWaitForResp("CVADAS_0001_00000000_000", __req, __resp, __res, -1, -1, -1, -1, -1, EnumResult_pos, EnumServiceDetails_onfail, EnumSendingMode_physical, EnumSuppressPosResBit_asconfigured, EnumVerdictOnInvalidValues_fail))
        break;
    }

    __res = DiagErrCodeTestStep(__res, "Can't retrieve last response for request! No check possible.") < 0;
    if(__res)
    {
	  __bVerdict = __eVerdictFail;
      break;
    }
    {
      __res = DiagInterpretAs(__resp, "RDBI_PR");
      if(__res != 0)
      {
        __bVerdict = __eVerdictFail;
        DiagErrCodeTestStep(__res, "Can't interpret response as diagnostic primitive 'RDBI_PR'.");
        break;
      }
      else
      {
        TestStepPass( "Received primitive can be interpreted as diagnostic primitive 'RDBI_PR'.");
      }
    }
  }
  while(0);


  // Response, check & read aspect
  {
    __res = 1;
    __tableHandle = ReportTableHead5Columns(__cCheckCaption, __cTSym, __cTOp, __cRefVal, __cActual, __cRes);
    {
      __bDiagValueArrayCtr = DiagGetParameterErrorHandled(__resp, "_Software_Supplier_Identification_24", __bDiagValueArray, elcount(__bDiagValueArray), __cDiagValueArray, elcount(__cDiagValueArray));
      {
        __bSetInCheckAlignment = 1;	
        {
          __bArrayCtr = __CopyBytes(__bDiagValueArray, __bDiagValueArrayCtr, __bArray);
          {
            sysvar * __systemVariable;
            __systemVariable = sysvarData::`PartNumber::`Part_Number;
            CheckSysVarSetBufferConsistency(sysSetVariableData(sysvarData::`PartNumber::`Part_Number, __bArray, __bArrayCtr), __systemVariable.name);
          }
          snprintf(__cArray, 8192, "%s", "Part_Number");
          snprintf(__cArray2, 8192, "%s '%s'", __cSysVar, __cArray);
          snprintf(__cArray3, 8192, "%s", "_Software_Supplier_Identification_24");
          
          ReportTableRow(__tableHandle, 0, __cArray2, __cAOp, __bArray, __bArrayCtr, __cArray3, __oneOfFlag, __bSetInCheckAlignment);
        
        }
    
        __bSetInCheckAlignment = 0;
      }
    }
    ReportTableEndVerdict(__tableHandle, __cEvaluateResponse, __res);
	__bVerdict = __bVerdict && __res;
  }
  if (__bVerdict == __eVerdictFail)
    TestReportWriteDiagObjectList();
}

void Tto7tsimc_F155_DID_with_Standard_Physical_Address()
{
  stack long __tableHandle;
  TestCommandBegin(__eRequestResponse, __cRequestResponse, "", "0");
  {
  
    long __res;
    int64 __timeout;
    __res = 0;
    __nInt64 = 1;
    __timeout = syspar::`P2_Server * 1000000LL;
    {
    
      long __testStepInitOk;
      message `FDCAN2::`DIAGNOSTIC_REQUEST_PAM __output;
      message `FDCAN2::`DIAGNOSTIC_REQUEST_PAM __msgOrig;
      __output = __msgOrig;
      __testStepInitOk = 1;
      {
        int64 __dlc;
        __dlc = 4;
        if (__dlc >= 0 && __dlc <= (__output.EDL ? 15 : 8))
          __output.DLC = __dlc;
        else
        {
          testStepErrorInTestSystem(0, __cEmpty, "Unable to set DLC=%lld in message. Please check input parameter.", __dlc);
          __testStepInitOk = 0;
        }
      }
      if (__testStepInitOk)
      {
        snprintf(__cArray, elCount(__cArray), "CAN message '%s' ID = 416981233x (0x18DAA0F1x) on bus FDCAN2", "DIAGNOSTIC_REQUEST_PAM");
        snprintf(__cArray2, elCount(__cArray2), "Send %s", __cArray);
        __tableHandle = ReportTableHead3Columns(__cArray2, "Byte", __cTOp, __cAssigned);
        ReportByteIndex("", 0, __cArray, elCount(__cArray));
        snprintf(__cArray2, 8192, "%s", __cArray);
        snprintf(__cArray3, 8192, "%s", "");
        
        ReportTableRow(__tableHandle, 0, __cArray2, __cAOp, 0x3, __cArray3, __oneOfFlag, __bSetInCheckAlignment);
        
        if (0 >= 0 && 0 < 64)
        {
          __output.byte((word)0) = 0x3;
        }
        else
        {
          testStepErrorInTestSystem(0, __cEmpty, "Index out of range. Unable to set byte %lld in message. Please check input parameter.", (int64)0);
          __testStepInitOk = 0;
        }
        ReportByteIndex("", 1, __cArray, elCount(__cArray));
        snprintf(__cArray2, 8192, "%s", __cArray);
        snprintf(__cArray3, 8192, "%s", "");
        
        ReportTableRow(__tableHandle, 0, __cArray2, __cAOp, 0x22, __cArray3, __oneOfFlag, __bSetInCheckAlignment);
        
        if (1 >= 0 && 1 < 64)
        {
          __output.byte((word)1) = 0x22;
        }
        else
        {
          testStepErrorInTestSystem(0, __cEmpty, "Index out of range. Unable to set byte %lld in message. Please check input parameter.", (int64)1);
          __testStepInitOk = 0;
        }
        ReportByteIndex("", 2, __cArray, elCount(__cArray));
        snprintf(__cArray2, 8192, "%s", __cArray);
        snprintf(__cArray3, 8192, "%s", "");
        
        ReportTableRow(__tableHandle, 0, __cArray2, __cAOp, 0xF1, __cArray3, __oneOfFlag, __bSetInCheckAlignment);
        
        if (2 >= 0 && 2 < 64)
        {
          __output.byte((word)2) = 0xF1;
        }
        else
        {
          testStepErrorInTestSystem(0, __cEmpty, "Index out of range. Unable to set byte %lld in message. Please check input parameter.", (int64)2);
          __testStepInitOk = 0;
        }
        ReportByteIndex("", 3, __cArray, elCount(__cArray));
        snprintf(__cArray2, 8192, "%s", __cArray);
        snprintf(__cArray3, 8192, "%s", "");
        
        ReportTableRow(__tableHandle, 0, __cArray2, __cAOp, 0x55, __cArray3, __oneOfFlag, __bSetInCheckAlignment);
        
        if (3 >= 0 && 3 < 64)
        {
          __output.byte((word)3) = 0x55;
        }
        else
        {
          testStepErrorInTestSystem(0, __cEmpty, "Index out of range. Unable to set byte %lld in message. Please check input parameter.", (int64)3);
          __testStepInitOk = 0;
        }
      
        ReportTableEndTestStep(__tableHandle, "Req1");
      }
      if (__testStepInitOk)
      {
        output(__output);
      }
    }
    if (__timeout <= 0)
    {
      testStepErrorInTestSystem(0, "1", "Unable to wait for %.3f %s. Please check input parameter.", __timeout / ((float)1000000), "ms");
    }
    else
    {
      __tt8cnt_21 = 0;
      snprintf(__cArray, elCount(__cArray), "CAN message '%s' ID = 417001888x (0x18DAF1A0x) on bus FDCAN2", "DIAGNOSTIC_RESPONSE_PAM");
      if(SetBusContextByName("FDCAN2", __eSaveCurrent, __nBusContextNew, __nBusContextOld))
        testJoinMessageEvent(`FDCAN2::`DIAGNOSTIC_RESPONSE_PAM,  __cArray,
             delegate dword(message * __m)
             {
               dword __msg_callback_ret;
               if (__tt8cnt_21 == -1)
               {
                 return 1;
               }
               __msg_callback_ret = 1;
               __tt8cnt_21++;
               if (__msg_callback_ret)
               {
                 __tt8cnt_21 = -1;
                 return 1;
               }
               return 0;
             });
      __res = testWaitForAllJoinedEventsNS(__timeout);
      if (__nInt64 != 0)
      {
        snprintf(__cArray, elCount(__cArray), "CAN message '%s' ID = 417001888x (0x18DAF1A0x) on bus FDCAN2", "DIAGNOSTIC_RESPONSE_PAM");
        if(__tt8cnt_21 == -1)
        {
          snprintf(__cArray2, 8192, "Response of %s", __cArray);
        }
        else
        {
          snprintf(__cArray2, 8192, "Response of %s (received %d times)", __cArray, __tt8cnt_21);
        }
        if (__tt8cnt_21 == 0)
        {
          testStepFail(0, "Resp1", __cArray2);
        }
        else
        {
          testStepPass(2, "Resp1", __cArray2);
        }
        __ReportRequestResponseResult(__res, 0);
      }
      ResetBusContext(__nBusContextNew, __nBusContextOld);
    }
  }
  TestCommandEnd();

}

void Tto7tsimc_F187_DID_with_Physical_Address()
{
  stack long __tableHandle;
  TestCommandBegin(__eDiagService, __cDiagService, "", "0");
  {
    if (DiagIsFunctionalGroup("CVADAS_0001_00000000_000"))
    {
      DiagResponse * __resp;
      DiagRequest CVADAS_0001_00000000_000._22F187_CODEP_ECU_Part_Number __req;
      __diagServiceo7tsimc_17(__req, __resp);
    }
    else
    {
      DiagResponse CVADAS_0001_00000000_000.* __resp;
      DiagRequest CVADAS_0001_00000000_000._22F187_CODEP_ECU_Part_Number __req;
      __diagServiceo7tsimc_17(__req, __resp);
    }
  }
  TestCommandEnd();


}

  
void __diagServiceo7tsimc_17(DiagRequest * __req, DiagResponse * __resp )
{
  stack long __tableHandle;
  long __res, __paramLen, __bytePos;

   __bVerdict = __eVerdictPass;

  do {
    TestReportResetDiagObjectList();
    DiagSetReportDetailLevel("CVADAS_0001_00000000_000", EnumServiceDetails_onfail);
    // Request aspect
    {

      if (0 >= DiagSendReqAndWaitForResp("CVADAS_0001_00000000_000", __req, __resp, __res, -1, -1, -1, -1, -1, EnumResult_pos, EnumServiceDetails_onfail, EnumSendingMode_physical, EnumSuppressPosResBit_asconfigured, EnumVerdictOnInvalidValues_fail))
        break;
    }

    __res = DiagErrCodeTestStep(__res, "Can't retrieve last response for request! No check possible.") < 0;
    if(__res)
    {
	  __bVerdict = __eVerdictFail;
      break;
    }
    {
      __res = DiagInterpretAs(__resp, "RDBI_PR");
      if(__res != 0)
      {
        __bVerdict = __eVerdictFail;
        DiagErrCodeTestStep(__res, "Can't interpret response as diagnostic primitive 'RDBI_PR'.");
        break;
      }
      else
      {
        TestStepPass( "Received primitive can be interpreted as diagnostic primitive 'RDBI_PR'.");
      }
    }
  }
  while(0);


  // Response, check & read aspect
  {
    __res = 1;
    __tableHandle = ReportTableHead5Columns(__cCheckCaption, __cTSym, __cTOp, __cRefVal, __cActual, __cRes);
    {
      __bDiagValueArrayCtr = DiagGetParameterErrorHandled(__resp, "_CODEP_ECU_Part_Number_24", __bDiagValueArray, elcount(__bDiagValueArray), __cDiagValueArray, elcount(__cDiagValueArray));
      {
        __bSetInCheckAlignment = 1;	
        {
          __bArrayCtr = __CopyBytes(__bDiagValueArray, __bDiagValueArrayCtr, __bArray);
          {
            sysvar * __systemVariable;
            __systemVariable = sysvarData::`PartNumber::`Part_Number;
            CheckSysVarSetBufferConsistency(sysSetVariableData(sysvarData::`PartNumber::`Part_Number, __bArray, __bArrayCtr), __systemVariable.name);
          }
          snprintf(__cArray, 8192, "%s", "Part_Number");
          snprintf(__cArray2, 8192, "%s '%s'", __cSysVar, __cArray);
          snprintf(__cArray3, 8192, "%s", "_CODEP_ECU_Part_Number_24");
          
          ReportTableRow(__tableHandle, 0, __cArray2, __cAOp, __bArray, __bArrayCtr, __cArray3, __oneOfFlag, __bSetInCheckAlignment);
        
        }
    
        __bSetInCheckAlignment = 0;
      }
    }
    ReportTableEndVerdict(__tableHandle, __cEvaluateResponse, __res);
	__bVerdict = __bVerdict && __res;
  }
  if (__bVerdict == __eVerdictFail)
    TestReportWriteDiagObjectList();
}

void Tto7tsimc_F187_DID_with_Functional_Address()
{
  stack long __tableHandle;
  TestCommandBegin(__eDiagService, __cDiagService, "", "0");
  {
    if (DiagIsFunctionalGroup("CVADAS_0001_00000000_000"))
    {
      DiagResponse * __resp;
      DiagRequest CVADAS_0001_00000000_000._22F187_CODEP_ECU_Part_Number __req;
      __diagServiceo7tsimc_18(__req, __resp);
    }
    else
    {
      DiagResponse CVADAS_0001_00000000_000.* __resp;
      DiagRequest CVADAS_0001_00000000_000._22F187_CODEP_ECU_Part_Number __req;
      __diagServiceo7tsimc_18(__req, __resp);
    }
  }
  TestCommandEnd();


}

  
void __diagServiceo7tsimc_18(DiagRequest * __req, DiagResponse * __resp )
{
  stack long __tableHandle;
  long __res, __paramLen, __bytePos;

   __bVerdict = __eVerdictPass;

  do {
    TestReportResetDiagObjectList();
    DiagSetReportDetailLevel("CVADAS_0001_00000000_000", EnumServiceDetails_onfail);
    // Request aspect
    {

      if (0 >= DiagSendReqAndWaitForResp("CVADAS_0001_00000000_000", __req, __resp, __res, -1, -1, -1, -1, -1, EnumResult_pos, EnumServiceDetails_onfail, EnumSendingMode_physical, EnumSuppressPosResBit_asconfigured, EnumVerdictOnInvalidValues_fail))
        break;
    }

    __res = DiagErrCodeTestStep(__res, "Can't retrieve last response for request! No check possible.") < 0;
    if(__res)
    {
	  __bVerdict = __eVerdictFail;
      break;
    }
    {
      __res = DiagInterpretAs(__resp, "RDBI_PR");
      if(__res != 0)
      {
        __bVerdict = __eVerdictFail;
        DiagErrCodeTestStep(__res, "Can't interpret response as diagnostic primitive 'RDBI_PR'.");
        break;
      }
      else
      {
        TestStepPass( "Received primitive can be interpreted as diagnostic primitive 'RDBI_PR'.");
      }
    }
  }
  while(0);


  // Response, check & read aspect
  {
    __res = 1;
    __tableHandle = ReportTableHead5Columns(__cCheckCaption, __cTSym, __cTOp, __cRefVal, __cActual, __cRes);
    {
      __bDiagValueArrayCtr = DiagGetParameterErrorHandled(__resp, "_CODEP_ECU_Part_Number_24", __bDiagValueArray, elcount(__bDiagValueArray), __cDiagValueArray, elcount(__cDiagValueArray));
      {
        __bSetInCheckAlignment = 1;	
        {
          __bArrayCtr = __CopyBytes(__bDiagValueArray, __bDiagValueArrayCtr, __bArray);
          {
            sysvar * __systemVariable;
            __systemVariable = sysvarData::`PartNumber::`Part_Number;
            CheckSysVarSetBufferConsistency(sysSetVariableData(sysvarData::`PartNumber::`Part_Number, __bArray, __bArrayCtr), __systemVariable.name);
          }
          snprintf(__cArray, 8192, "%s", "Part_Number");
          snprintf(__cArray2, 8192, "%s '%s'", __cSysVar, __cArray);
          snprintf(__cArray3, 8192, "%s", "_CODEP_ECU_Part_Number_24");
          
          ReportTableRow(__tableHandle, 0, __cArray2, __cAOp, __bArray, __bArrayCtr, __cArray3, __oneOfFlag, __bSetInCheckAlignment);
        
        }
    
        __bSetInCheckAlignment = 0;
      }
    }
    ReportTableEndVerdict(__tableHandle, __cEvaluateResponse, __res);
	__bVerdict = __bVerdict && __res;
  }
  if (__bVerdict == __eVerdictFail)
    TestReportWriteDiagObjectList();
}

void Tto7tsimc_F187_DID_with_Standard_Physical_Address()
{
  stack long __tableHandle;
  TestCommandBegin(__eRequestResponse, __cRequestResponse, "", "0");
  {
  
    long __res;
    int64 __timeout;
    __res = 0;
    __nInt64 = 1;
    __timeout = syspar::`P2_Server * 1000000LL;
    {
    
      long __testStepInitOk;
      message `FDCAN2::`DIAGNOSTIC_REQUEST_PAM __output;
      message `FDCAN2::`DIAGNOSTIC_REQUEST_PAM __msgOrig;
      __output = __msgOrig;
      __testStepInitOk = 1;
      {
        int64 __dlc;
        __dlc = 4;
        if (__dlc >= 0 && __dlc <= (__output.EDL ? 15 : 8))
          __output.DLC = __dlc;
        else
        {
          testStepErrorInTestSystem(0, __cEmpty, "Unable to set DLC=%lld in message. Please check input parameter.", __dlc);
          __testStepInitOk = 0;
        }
      }
      if (__testStepInitOk)
      {
        snprintf(__cArray, elCount(__cArray), "CAN message '%s' ID = 416981233x (0x18DAA0F1x) on bus FDCAN2", "DIAGNOSTIC_REQUEST_PAM");
        snprintf(__cArray2, elCount(__cArray2), "Send %s", __cArray);
        __tableHandle = ReportTableHead3Columns(__cArray2, "Byte", __cTOp, __cAssigned);
        ReportByteIndex("", 0, __cArray, elCount(__cArray));
        snprintf(__cArray2, 8192, "%s", __cArray);
        snprintf(__cArray3, 8192, "%s", "");
        
        ReportTableRow(__tableHandle, 0, __cArray2, __cAOp, 0x3, __cArray3, __oneOfFlag, __bSetInCheckAlignment);
        
        if (0 >= 0 && 0 < 64)
        {
          __output.byte((word)0) = 0x3;
        }
        else
        {
          testStepErrorInTestSystem(0, __cEmpty, "Index out of range. Unable to set byte %lld in message. Please check input parameter.", (int64)0);
          __testStepInitOk = 0;
        }
        ReportByteIndex("", 1, __cArray, elCount(__cArray));
        snprintf(__cArray2, 8192, "%s", __cArray);
        snprintf(__cArray3, 8192, "%s", "");
        
        ReportTableRow(__tableHandle, 0, __cArray2, __cAOp, 0x22, __cArray3, __oneOfFlag, __bSetInCheckAlignment);
        
        if (1 >= 0 && 1 < 64)
        {
          __output.byte((word)1) = 0x22;
        }
        else
        {
          testStepErrorInTestSystem(0, __cEmpty, "Index out of range. Unable to set byte %lld in message. Please check input parameter.", (int64)1);
          __testStepInitOk = 0;
        }
        ReportByteIndex("", 2, __cArray, elCount(__cArray));
        snprintf(__cArray2, 8192, "%s", __cArray);
        snprintf(__cArray3, 8192, "%s", "");
        
        ReportTableRow(__tableHandle, 0, __cArray2, __cAOp, 0xF1, __cArray3, __oneOfFlag, __bSetInCheckAlignment);
        
        if (2 >= 0 && 2 < 64)
        {
          __output.byte((word)2) = 0xF1;
        }
        else
        {
          testStepErrorInTestSystem(0, __cEmpty, "Index out of range. Unable to set byte %lld in message. Please check input parameter.", (int64)2);
          __testStepInitOk = 0;
        }
        ReportByteIndex("", 3, __cArray, elCount(__cArray));
        snprintf(__cArray2, 8192, "%s", __cArray);
        snprintf(__cArray3, 8192, "%s", "");
        
        ReportTableRow(__tableHandle, 0, __cArray2, __cAOp, 0x87, __cArray3, __oneOfFlag, __bSetInCheckAlignment);
        
        if (3 >= 0 && 3 < 64)
        {
          __output.byte((word)3) = 0x87;
        }
        else
        {
          testStepErrorInTestSystem(0, __cEmpty, "Index out of range. Unable to set byte %lld in message. Please check input parameter.", (int64)3);
          __testStepInitOk = 0;
        }
      
        ReportTableEndTestStep(__tableHandle, "Req1");
      }
      if (__testStepInitOk)
      {
        output(__output);
      }
    }
    if (__timeout <= 0)
    {
      testStepErrorInTestSystem(0, "1", "Unable to wait for %.3f %s. Please check input parameter.", __timeout / ((float)1000000), "ms");
    }
    else
    {
      __tt8cnt_23 = 0;
      snprintf(__cArray, elCount(__cArray), "CAN message '%s' ID = 417001888x (0x18DAF1A0x) on bus FDCAN2", "DIAGNOSTIC_RESPONSE_PAM");
      if(SetBusContextByName("FDCAN2", __eSaveCurrent, __nBusContextNew, __nBusContextOld))
        testJoinMessageEvent(`FDCAN2::`DIAGNOSTIC_RESPONSE_PAM,  __cArray,
             delegate dword(message * __m)
             {
               dword __msg_callback_ret;
               if (__tt8cnt_23 == -1)
               {
                 return 1;
               }
               __msg_callback_ret = 1;
               __tt8cnt_23++;
               if (__msg_callback_ret)
               {
                 __tt8cnt_23 = -1;
                 return 1;
               }
               return 0;
             });
      __res = testWaitForAllJoinedEventsNS(__timeout);
      if (__nInt64 != 0)
      {
        snprintf(__cArray, elCount(__cArray), "CAN message '%s' ID = 417001888x (0x18DAF1A0x) on bus FDCAN2", "DIAGNOSTIC_RESPONSE_PAM");
        if(__tt8cnt_23 == -1)
        {
          snprintf(__cArray2, 8192, "Response of %s", __cArray);
        }
        else
        {
          snprintf(__cArray2, 8192, "Response of %s (received %d times)", __cArray, __tt8cnt_23);
        }
        if (__tt8cnt_23 == 0)
        {
          testStepFail(0, "Resp1", __cArray2);
        }
        else
        {
          testStepPass(2, "Resp1", __cArray2);
        }
        __ReportRequestResponseResult(__res, 0);
      }
      ResetBusContext(__nBusContextNew, __nBusContextOld);
    }
  }
  TestCommandEnd();

}

void Tto7tsimc_F110_DID_with_Physical_Address()
{
  stack long __tableHandle;
  TestCommandBegin(__eDiagService, __cDiagService, "", "0");
  {
    if (DiagIsFunctionalGroup("CVADAS_0001_00000000_000"))
    {
      DiagResponse * __resp;
      DiagRequest CVADAS_0001_00000000_000._22F110_ECU_Diagnostic_Identification __req;
      __diagServiceo7tsimc_19(__req, __resp);
    }
    else
    {
      DiagResponse CVADAS_0001_00000000_000.* __resp;
      DiagRequest CVADAS_0001_00000000_000._22F110_ECU_Diagnostic_Identification __req;
      __diagServiceo7tsimc_19(__req, __resp);
    }
  }
  TestCommandEnd();


}

  
void __diagServiceo7tsimc_19(DiagRequest * __req, DiagResponse * __resp )
{
  stack long __tableHandle;
  long __res, __paramLen, __bytePos;

   __bVerdict = __eVerdictPass;

  do {
    TestReportResetDiagObjectList();
    DiagSetReportDetailLevel("CVADAS_0001_00000000_000", EnumServiceDetails_onfail);
    // Request aspect
    {

      if (0 >= DiagSendReqAndWaitForResp("CVADAS_0001_00000000_000", __req, __resp, __res, -1, -1, -1, -1, -1, EnumResult_pos, EnumServiceDetails_onfail, EnumSendingMode_physical, EnumSuppressPosResBit_asconfigured, EnumVerdictOnInvalidValues_fail))
        break;
    }

    __res = DiagErrCodeTestStep(__res, "Can't retrieve last response for request! No check possible.") < 0;
    if(__res)
    {
	  __bVerdict = __eVerdictFail;
      break;
    }
    {
      __res = DiagInterpretAs(__resp, "RDBI_PR");
      if(__res != 0)
      {
        __bVerdict = __eVerdictFail;
        DiagErrCodeTestStep(__res, "Can't interpret response as diagnostic primitive 'RDBI_PR'.");
        break;
      }
      else
      {
        TestStepPass( "Received primitive can be interpreted as diagnostic primitive 'RDBI_PR'.");
      }
    }
  }
  while(0);


  // Response, check & read aspect
  {
    __res = 1;
    __tableHandle = ReportTableHead5Columns(__cCheckCaption, __cTSym, __cTOp, __cRefVal, __cActual, __cRes);
    {
      __bDiagValueArrayCtr = DiagGetParameterErrorHandled(__resp, "_Diagnostic_Variant_24", __bDiagValueArray, elcount(__bDiagValueArray), __cDiagValueArray, elcount(__cDiagValueArray));
      {
        __bSetInCheckAlignment = 1;	
        {
          __bArrayCtr = __CopyBytes(__bDiagValueArray, __bDiagValueArrayCtr, __bArray);
          {
            sysvar * __systemVariable;
            __systemVariable = sysvarData::`PartNumber::`Part_Number;
            CheckSysVarSetBufferConsistency(sysSetVariableData(sysvarData::`PartNumber::`Part_Number, __bArray, __bArrayCtr), __systemVariable.name);
          }
          snprintf(__cArray, 8192, "%s", "Part_Number");
          snprintf(__cArray2, 8192, "%s '%s'", __cSysVar, __cArray);
          snprintf(__cArray3, 8192, "%s", "_Diagnostic_Variant_24");
          
          ReportTableRow(__tableHandle, 0, __cArray2, __cAOp, __bArray, __bArrayCtr, __cArray3, __oneOfFlag, __bSetInCheckAlignment);
        
        }
    
        __bSetInCheckAlignment = 0;
      }
    }
    {
      __bDiagValueArrayCtr = DiagGetParameterErrorHandled(__resp, "_Diagnostic_Version_40", __bDiagValueArray, elcount(__bDiagValueArray), __cDiagValueArray, elcount(__cDiagValueArray));
      {
        __bSetInCheckAlignment = 1;	
        {
          __bArrayCtr = __CopyBytes(__bDiagValueArray, __bDiagValueArrayCtr, __bArray);
          {
            sysvar * __systemVariable;
            __systemVariable = sysvarData::`PartNumber::`Part_Number;
            CheckSysVarSetBufferConsistency(sysSetVariableData(sysvarData::`PartNumber::`Part_Number, __bArray, __bArrayCtr), __systemVariable.name);
          }
          snprintf(__cArray, 8192, "%s", "Part_Number");
          snprintf(__cArray2, 8192, "%s '%s'", __cSysVar, __cArray);
          snprintf(__cArray3, 8192, "%s", "_Diagnostic_Version_40");
          
          ReportTableRow(__tableHandle, 0, __cArray2, __cAOp, __bArray, __bArrayCtr, __cArray3, __oneOfFlag, __bSetInCheckAlignment);
        
        }
    
        __bSetInCheckAlignment = 0;
      }
    }
    {
      __bDiagValueArrayCtr = DiagGetParameterErrorHandled(__resp, "_Flash_Definition_Number_FDN_72", __bDiagValueArray, elcount(__bDiagValueArray), __cDiagValueArray, elcount(__cDiagValueArray));
      {
        __bSetInCheckAlignment = 1;	
        {
          __bArrayCtr = __CopyBytes(__bDiagValueArray, __bDiagValueArrayCtr, __bArray);
          {
            sysvar * __systemVariable;
            __systemVariable = sysvarData::`PartNumber::`Part_Number;
            CheckSysVarSetBufferConsistency(sysSetVariableData(sysvarData::`PartNumber::`Part_Number, __bArray, __bArrayCtr), __systemVariable.name);
          }
          snprintf(__cArray, 8192, "%s", "Part_Number");
          snprintf(__cArray2, 8192, "%s '%s'", __cSysVar, __cArray);
          snprintf(__cArray3, 8192, "%s", "_Flash_Definition_Number_FDN_72");
          
          ReportTableRow(__tableHandle, 0, __cArray2, __cAOp, __bArray, __bArrayCtr, __cArray3, __oneOfFlag, __bSetInCheckAlignment);
        
        }
    
        __bSetInCheckAlignment = 0;
      }
    }
    {
      __bDiagValueArrayCtr = DiagGetParameterErrorHandled(__resp, "_Supplier_ID_88", __bDiagValueArray, elcount(__bDiagValueArray), __cDiagValueArray, elcount(__cDiagValueArray));
      {
        __bSetInCheckAlignment = 1;	
        {
          __bArrayCtr = __CopyBytes(__bDiagValueArray, __bDiagValueArrayCtr, __bArray);
          {
            sysvar * __systemVariable;
            __systemVariable = sysvarData::`PartNumber::`Part_Number;
            CheckSysVarSetBufferConsistency(sysSetVariableData(sysvarData::`PartNumber::`Part_Number, __bArray, __bArrayCtr), __systemVariable.name);
          }
          snprintf(__cArray, 8192, "%s", "Part_Number");
          snprintf(__cArray2, 8192, "%s '%s'", __cSysVar, __cArray);
          snprintf(__cArray3, 8192, "%s", "_Supplier_ID_88");
          
          ReportTableRow(__tableHandle, 0, __cArray2, __cAOp, __bArray, __bArrayCtr, __cArray3, __oneOfFlag, __bSetInCheckAlignment);
        
        }
    
        __bSetInCheckAlignment = 0;
      }
    }
    ReportTableEndVerdict(__tableHandle, __cEvaluateResponse, __res);
	__bVerdict = __bVerdict && __res;
  }
  if (__bVerdict == __eVerdictFail)
    TestReportWriteDiagObjectList();
}

void Tto7tsimc_F110_DID_with_Functional_Address()
{
  stack long __tableHandle;
  TestCommandBegin(__eDiagService, __cDiagService, "", "0");
  {
    if (DiagIsFunctionalGroup("CVADAS_0001_00000000_000"))
    {
      DiagResponse * __resp;
      DiagRequest CVADAS_0001_00000000_000._22F110_ECU_Diagnostic_Identification __req;
      __diagServiceo7tsimc_20(__req, __resp);
    }
    else
    {
      DiagResponse CVADAS_0001_00000000_000.* __resp;
      DiagRequest CVADAS_0001_00000000_000._22F110_ECU_Diagnostic_Identification __req;
      __diagServiceo7tsimc_20(__req, __resp);
    }
  }
  TestCommandEnd();


}

  
void __diagServiceo7tsimc_20(DiagRequest * __req, DiagResponse * __resp )
{
  stack long __tableHandle;
  long __res, __paramLen, __bytePos;

   __bVerdict = __eVerdictPass;

  do {
    TestReportResetDiagObjectList();
    DiagSetReportDetailLevel("CVADAS_0001_00000000_000", EnumServiceDetails_onfail);
    // Request aspect
    {

      if (0 >= DiagSendReqAndWaitForResp("CVADAS_0001_00000000_000", __req, __resp, __res, -1, -1, -1, -1, -1, EnumResult_pos, EnumServiceDetails_onfail, EnumSendingMode_physical, EnumSuppressPosResBit_asconfigured, EnumVerdictOnInvalidValues_fail))
        break;
    }

    __res = DiagErrCodeTestStep(__res, "Can't retrieve last response for request! No check possible.") < 0;
    if(__res)
    {
	  __bVerdict = __eVerdictFail;
      break;
    }
    {
      __res = DiagInterpretAs(__resp, "RDBI_PR");
      if(__res != 0)
      {
        __bVerdict = __eVerdictFail;
        DiagErrCodeTestStep(__res, "Can't interpret response as diagnostic primitive 'RDBI_PR'.");
        break;
      }
      else
      {
        TestStepPass( "Received primitive can be interpreted as diagnostic primitive 'RDBI_PR'.");
      }
    }
  }
  while(0);


  // Response, check & read aspect
  {
    __res = 1;
    __tableHandle = ReportTableHead5Columns(__cCheckCaption, __cTSym, __cTOp, __cRefVal, __cActual, __cRes);
    {
      __bDiagValueArrayCtr = DiagGetParameterErrorHandled(__resp, "_Diagnostic_Variant_24", __bDiagValueArray, elcount(__bDiagValueArray), __cDiagValueArray, elcount(__cDiagValueArray));
      {
        __bSetInCheckAlignment = 1;	
        {
          __bArrayCtr = __CopyBytes(__bDiagValueArray, __bDiagValueArrayCtr, __bArray);
          {
            sysvar * __systemVariable;
            __systemVariable = sysvarData::`PartNumber::`Part_Number;
            CheckSysVarSetBufferConsistency(sysSetVariableData(sysvarData::`PartNumber::`Part_Number, __bArray, __bArrayCtr), __systemVariable.name);
          }
          snprintf(__cArray, 8192, "%s", "Part_Number");
          snprintf(__cArray2, 8192, "%s '%s'", __cSysVar, __cArray);
          snprintf(__cArray3, 8192, "%s", "_Diagnostic_Variant_24");
          
          ReportTableRow(__tableHandle, 0, __cArray2, __cAOp, __bArray, __bArrayCtr, __cArray3, __oneOfFlag, __bSetInCheckAlignment);
        
        }
    
        __bSetInCheckAlignment = 0;
      }
    }
    {
      __bDiagValueArrayCtr = DiagGetParameterErrorHandled(__resp, "_Diagnostic_Version_40", __bDiagValueArray, elcount(__bDiagValueArray), __cDiagValueArray, elcount(__cDiagValueArray));
      {
        __bSetInCheckAlignment = 1;	
        {
          __bArrayCtr = __CopyBytes(__bDiagValueArray, __bDiagValueArrayCtr, __bArray);
          {
            sysvar * __systemVariable;
            __systemVariable = sysvarData::`PartNumber::`Part_Number;
            CheckSysVarSetBufferConsistency(sysSetVariableData(sysvarData::`PartNumber::`Part_Number, __bArray, __bArrayCtr), __systemVariable.name);
          }
          snprintf(__cArray, 8192, "%s", "Part_Number");
          snprintf(__cArray2, 8192, "%s '%s'", __cSysVar, __cArray);
          snprintf(__cArray3, 8192, "%s", "_Diagnostic_Version_40");
          
          ReportTableRow(__tableHandle, 0, __cArray2, __cAOp, __bArray, __bArrayCtr, __cArray3, __oneOfFlag, __bSetInCheckAlignment);
        
        }
    
        __bSetInCheckAlignment = 0;
      }
    }
    {
      __bDiagValueArrayCtr = DiagGetParameterErrorHandled(__resp, "_Flash_Definition_Number_FDN_72", __bDiagValueArray, elcount(__bDiagValueArray), __cDiagValueArray, elcount(__cDiagValueArray));
      {
        __bSetInCheckAlignment = 1;	
        {
          __bArrayCtr = __CopyBytes(__bDiagValueArray, __bDiagValueArrayCtr, __bArray);
          {
            sysvar * __systemVariable;
            __systemVariable = sysvarData::`PartNumber::`Part_Number;
            CheckSysVarSetBufferConsistency(sysSetVariableData(sysvarData::`PartNumber::`Part_Number, __bArray, __bArrayCtr), __systemVariable.name);
          }
          snprintf(__cArray, 8192, "%s", "Part_Number");
          snprintf(__cArray2, 8192, "%s '%s'", __cSysVar, __cArray);
          snprintf(__cArray3, 8192, "%s", "_Flash_Definition_Number_FDN_72");
          
          ReportTableRow(__tableHandle, 0, __cArray2, __cAOp, __bArray, __bArrayCtr, __cArray3, __oneOfFlag, __bSetInCheckAlignment);
        
        }
    
        __bSetInCheckAlignment = 0;
      }
    }
    {
      __bDiagValueArrayCtr = DiagGetParameterErrorHandled(__resp, "_Supplier_ID_88", __bDiagValueArray, elcount(__bDiagValueArray), __cDiagValueArray, elcount(__cDiagValueArray));
      {
        __bSetInCheckAlignment = 1;	
        {
          __bArrayCtr = __CopyBytes(__bDiagValueArray, __bDiagValueArrayCtr, __bArray);
          {
            sysvar * __systemVariable;
            __systemVariable = sysvarData::`PartNumber::`Part_Number;
            CheckSysVarSetBufferConsistency(sysSetVariableData(sysvarData::`PartNumber::`Part_Number, __bArray, __bArrayCtr), __systemVariable.name);
          }
          snprintf(__cArray, 8192, "%s", "Part_Number");
          snprintf(__cArray2, 8192, "%s '%s'", __cSysVar, __cArray);
          snprintf(__cArray3, 8192, "%s", "_Supplier_ID_88");
          
          ReportTableRow(__tableHandle, 0, __cArray2, __cAOp, __bArray, __bArrayCtr, __cArray3, __oneOfFlag, __bSetInCheckAlignment);
        
        }
    
        __bSetInCheckAlignment = 0;
      }
    }
    ReportTableEndVerdict(__tableHandle, __cEvaluateResponse, __res);
	__bVerdict = __bVerdict && __res;
  }
  if (__bVerdict == __eVerdictFail)
    TestReportWriteDiagObjectList();
}

void Tto7tsimc_F110_DID_with_Standard_Physical_Address()
{
  stack long __tableHandle;
  TestCommandBegin(__eRequestResponse, __cRequestResponse, "", "0");
  {
  
    long __res;
    int64 __timeout;
    __res = 0;
    __nInt64 = 1;
    __timeout = syspar::`P2_Server * 1000000LL;
    {
    
      long __testStepInitOk;
      message `FDCAN2::`DIAGNOSTIC_REQUEST_PAM __output;
      message `FDCAN2::`DIAGNOSTIC_REQUEST_PAM __msgOrig;
      __output = __msgOrig;
      __testStepInitOk = 1;
      {
        int64 __dlc;
        __dlc = 8;
        if (__dlc >= 0 && __dlc <= (__output.EDL ? 15 : 8))
          __output.DLC = __dlc;
        else
        {
          testStepErrorInTestSystem(0, __cEmpty, "Unable to set DLC=%lld in message. Please check input parameter.", __dlc);
          __testStepInitOk = 0;
        }
      }
      if (__testStepInitOk)
      {
        snprintf(__cArray, elCount(__cArray), "CAN message '%s' ID = 416981233x (0x18DAA0F1x) on bus FDCAN2", "DIAGNOSTIC_REQUEST_PAM");
        snprintf(__cArray2, elCount(__cArray2), "Send %s", __cArray);
        __tableHandle = ReportTableHead3Columns(__cArray2, "Byte", __cTOp, __cAssigned);
        ReportByteIndex("", 0, __cArray, elCount(__cArray));
        snprintf(__cArray2, 8192, "%s", __cArray);
        snprintf(__cArray3, 8192, "%s", "");
        
        ReportTableRow(__tableHandle, 0, __cArray2, __cAOp, 0x3, __cArray3, __oneOfFlag, __bSetInCheckAlignment);
        
        if (0 >= 0 && 0 < 64)
        {
          __output.byte((word)0) = 0x3;
        }
        else
        {
          testStepErrorInTestSystem(0, __cEmpty, "Index out of range. Unable to set byte %lld in message. Please check input parameter.", (int64)0);
          __testStepInitOk = 0;
        }
        ReportByteIndex("", 1, __cArray, elCount(__cArray));
        snprintf(__cArray2, 8192, "%s", __cArray);
        snprintf(__cArray3, 8192, "%s", "");
        
        ReportTableRow(__tableHandle, 0, __cArray2, __cAOp, 0x22, __cArray3, __oneOfFlag, __bSetInCheckAlignment);
        
        if (1 >= 0 && 1 < 64)
        {
          __output.byte((word)1) = 0x22;
        }
        else
        {
          testStepErrorInTestSystem(0, __cEmpty, "Index out of range. Unable to set byte %lld in message. Please check input parameter.", (int64)1);
          __testStepInitOk = 0;
        }
        ReportByteIndex("", 2, __cArray, elCount(__cArray));
        snprintf(__cArray2, 8192, "%s", __cArray);
        snprintf(__cArray3, 8192, "%s", "");
        
        ReportTableRow(__tableHandle, 0, __cArray2, __cAOp, 0xF1, __cArray3, __oneOfFlag, __bSetInCheckAlignment);
        
        if (2 >= 0 && 2 < 64)
        {
          __output.byte((word)2) = 0xF1;
        }
        else
        {
          testStepErrorInTestSystem(0, __cEmpty, "Index out of range. Unable to set byte %lld in message. Please check input parameter.", (int64)2);
          __testStepInitOk = 0;
        }
        ReportByteIndex("", 3, __cArray, elCount(__cArray));
        snprintf(__cArray2, 8192, "%s", __cArray);
        snprintf(__cArray3, 8192, "%s", "");
        
        ReportTableRow(__tableHandle, 0, __cArray2, __cAOp, 0x10, __cArray3, __oneOfFlag, __bSetInCheckAlignment);
        
        if (3 >= 0 && 3 < 64)
        {
          __output.byte((word)3) = 0x10;
        }
        else
        {
          testStepErrorInTestSystem(0, __cEmpty, "Index out of range. Unable to set byte %lld in message. Please check input parameter.", (int64)3);
          __testStepInitOk = 0;
        }
      
        ReportTableEndTestStep(__tableHandle, "Req1");
      }
      if (__testStepInitOk)
      {
        output(__output);
      }
    }
    if (__timeout <= 0)
    {
      testStepErrorInTestSystem(0, "1", "Unable to wait for %.3f %s. Please check input parameter.", __timeout / ((float)1000000), "ms");
    }
    else
    {
      __tt8cnt_25 = 0;
      snprintf(__cArray, elCount(__cArray), "CAN message '%s' ID = 417001888x (0x18DAF1A0x) on bus FDCAN2", "DIAGNOSTIC_RESPONSE_PAM");
      if(SetBusContextByName("FDCAN2", __eSaveCurrent, __nBusContextNew, __nBusContextOld))
        testJoinMessageEvent(`FDCAN2::`DIAGNOSTIC_RESPONSE_PAM,  __cArray,
             delegate dword(message * __m)
             {
               dword __msg_callback_ret;
               if (__tt8cnt_25 == -1)
               {
                 return 1;
               }
               __msg_callback_ret = 1;
               __tt8cnt_25++;
               if (__msg_callback_ret)
               {
                 __tt8cnt_25 = -1;
                 return 1;
               }
               return 0;
             });
      __res = testWaitForAllJoinedEventsNS(__timeout);
      if (__nInt64 != 0)
      {
        snprintf(__cArray, elCount(__cArray), "CAN message '%s' ID = 417001888x (0x18DAF1A0x) on bus FDCAN2", "DIAGNOSTIC_RESPONSE_PAM");
        if(__tt8cnt_25 == -1)
        {
          snprintf(__cArray2, 8192, "Response of %s", __cArray);
        }
        else
        {
          snprintf(__cArray2, 8192, "Response of %s (received %d times)", __cArray, __tt8cnt_25);
        }
        if (__tt8cnt_25 == 0)
        {
          testStepFail(0, "Resp1", __cArray2);
        }
        else
        {
          testStepPass(2, "Resp1", __cArray2);
        }
        __ReportRequestResponseResult(__res, 0);
      }
      ResetBusContext(__nBusContextNew, __nBusContextOld);
    }
  }
  TestCommandEnd();

}

void Tto7tsimc_F186_DID_with_PhysicalAdd_DefaultSession()
{
  stack long __tableHandle;
  TestCommandBegin(__eDiagService, __cDiagService, "", "0");
  {
    if (DiagIsFunctionalGroup("CVADAS_0001_00000000_000"))
    {
      DiagResponse * __resp;
      DiagRequest CVADAS_0001_00000000_000._22F186_Active_Diagnostic_Session __req;
      __diagServiceo7tsimc_21(__req, __resp);
    }
    else
    {
      DiagResponse CVADAS_0001_00000000_000.* __resp;
      DiagRequest CVADAS_0001_00000000_000._22F186_Active_Diagnostic_Session __req;
      __diagServiceo7tsimc_21(__req, __resp);
    }
  }
  TestCommandEnd();


}

  
void __diagServiceo7tsimc_21(DiagRequest * __req, DiagResponse * __resp )
{
  stack long __tableHandle;
  long __res, __paramLen, __bytePos;

   __bVerdict = __eVerdictPass;

  do {
    TestReportResetDiagObjectList();
    DiagSetReportDetailLevel("CVADAS_0001_00000000_000", EnumServiceDetails_onfail);
    // Request aspect
    {

      if (0 >= DiagSendReqAndWaitForResp("CVADAS_0001_00000000_000", __req, __resp, __res, -1, -1, -1, -1, -1, EnumResult_pos, EnumServiceDetails_onfail, EnumSendingMode_physical, EnumSuppressPosResBit_asconfigured, EnumVerdictOnInvalidValues_fail))
        break;
    }

    __res = DiagErrCodeTestStep(__res, "Can't retrieve last response for request! No check possible.") < 0;
    if(__res)
    {
	  __bVerdict = __eVerdictFail;
      break;
    }
    {
      __res = DiagInterpretAs(__resp, "RDBI_PR");
      if(__res != 0)
      {
        __bVerdict = __eVerdictFail;
        DiagErrCodeTestStep(__res, "Can't interpret response as diagnostic primitive 'RDBI_PR'.");
        break;
      }
      else
      {
        TestStepPass( "Received primitive can be interpreted as diagnostic primitive 'RDBI_PR'.");
      }
    }
  }
  while(0);


  // Response, check & read aspect
  {
    __res = 1;
    __tableHandle = ReportTableHead5Columns(__cCheckCaption, __cTSym, __cTOp, __cRefVal, __cActual, __cRes);
    {
      __bDiagValueArrayCtr = DiagGetParameterErrorHandled(__resp, "_Active_Diagnostic_Session_24", __bDiagValueArray, elcount(__bDiagValueArray), __cDiagValueArray, elcount(__cDiagValueArray));
      {
        __bSetInCheckAlignment = 1;	
        {
          __bArrayCtr = __CopyBytes(__bDiagValueArray, __bDiagValueArrayCtr, __bArray);
          {
            sysvar * __systemVariable;
            __systemVariable = sysvarData::`PartNumber::`Part_Number;
            CheckSysVarSetBufferConsistency(sysSetVariableData(sysvarData::`PartNumber::`Part_Number, __bArray, __bArrayCtr), __systemVariable.name);
          }
          snprintf(__cArray, 8192, "%s", "Part_Number");
          snprintf(__cArray2, 8192, "%s '%s'", __cSysVar, __cArray);
          snprintf(__cArray3, 8192, "%s", "_Active_Diagnostic_Session_24");
          
          ReportTableRow(__tableHandle, 0, __cArray2, __cAOp, __bArray, __bArrayCtr, __cArray3, __oneOfFlag, __bSetInCheckAlignment);
        
        }
    
        __bSetInCheckAlignment = 0;
      }
    }
    {
      __bDiagValueArrayCtr = DiagGetParameterErrorHandled(__resp, "Authentication_Status", __bDiagValueArray, elcount(__bDiagValueArray), __cDiagValueArray, elcount(__cDiagValueArray));
      {
        __bSetInCheckAlignment = 1;	
        {
          __bArrayCtr = __CopyBytes(__bDiagValueArray, __bDiagValueArrayCtr, __bArray);
          {
            sysvar * __systemVariable;
            __systemVariable = sysvarData::`PartNumber::`Part_Number;
            CheckSysVarSetBufferConsistency(sysSetVariableData(sysvarData::`PartNumber::`Part_Number, __bArray, __bArrayCtr), __systemVariable.name);
          }
          snprintf(__cArray, 8192, "%s", "Part_Number");
          snprintf(__cArray2, 8192, "%s '%s'", __cSysVar, __cArray);
          snprintf(__cArray3, 8192, "%s", "Authentication_Status");
          
          ReportTableRow(__tableHandle, 0, __cArray2, __cAOp, __bArray, __bArrayCtr, __cArray3, __oneOfFlag, __bSetInCheckAlignment);
        
        }
    
        __bSetInCheckAlignment = 0;
      }
    }
    {
      __bDiagValueArrayCtr = DiagGetParameterErrorHandled(__resp, "Bitfield/Bitfield._Active_Diagnostic_Session_of_ECU__ECU_Software_Mode_32", __bDiagValueArray, elcount(__bDiagValueArray), __cDiagValueArray, elcount(__cDiagValueArray));
      {
        __bSetInCheckAlignment = 1;	
        {
          __bArrayCtr = __CopyBytes(__bDiagValueArray, __bDiagValueArrayCtr, __bArray);
          {
            sysvar * __systemVariable;
            __systemVariable = sysvarData::`PartNumber::`Part_Number;
            CheckSysVarSetBufferConsistency(sysSetVariableData(sysvarData::`PartNumber::`Part_Number, __bArray, __bArrayCtr), __systemVariable.name);
          }
          snprintf(__cArray, 8192, "%s", "Part_Number");
          snprintf(__cArray2, 8192, "%s '%s'", __cSysVar, __cArray);
          snprintf(__cArray3, 8192, "%s", "Bitfield/Bitfield._Active_Diagnostic_Session_of_ECU__ECU_Software_Mode_32");
          
          ReportTableRow(__tableHandle, 0, __cArray2, __cAOp, __bArray, __bArrayCtr, __cArray3, __oneOfFlag, __bSetInCheckAlignment);
        
        }
    
        __bSetInCheckAlignment = 0;
      }
    }
    ReportTableEndVerdict(__tableHandle, __cEvaluateResponse, __res);
	__bVerdict = __bVerdict && __res;
  }
  if (__bVerdict == __eVerdictFail)
    TestReportWriteDiagObjectList();
}

void Tto7tsimc_F186_DID_with_Standard_Physical_Address_Default_Session()
{
  stack long __tableHandle;
  TestCommandBegin(__eRequestResponse, __cRequestResponse, "", "0");
  {
    message `FDCAN2::`DIAGNOSTIC_RESPONSE_PAM __tt8msg_26;
  
    long __res;
    int64 __timeout;
    __res = 0;
    __nInt64 = 1;
    __timeout = syspar::`P2_Server * 1000000LL;
    {
    
      long __testStepInitOk;
      message `FDCAN2::`DIAGNOSTIC_REQUEST_PAM __output;
      message `FDCAN2::`DIAGNOSTIC_REQUEST_PAM __msgOrig;
      __output = __msgOrig;
      __testStepInitOk = 1;
      {
        int64 __dlc;
        __dlc = 8;
        if (__dlc >= 0 && __dlc <= (__output.EDL ? 15 : 8))
          __output.DLC = __dlc;
        else
        {
          testStepErrorInTestSystem(0, __cEmpty, "Unable to set DLC=%lld in message. Please check input parameter.", __dlc);
          __testStepInitOk = 0;
        }
      }
      if (__testStepInitOk)
      {
        snprintf(__cArray, elCount(__cArray), "CAN message '%s' ID = 416981233x (0x18DAA0F1x) on bus FDCAN2", "DIAGNOSTIC_REQUEST_PAM");
        snprintf(__cArray2, elCount(__cArray2), "Send %s", __cArray);
        __tableHandle = ReportTableHead3Columns(__cArray2, "Byte", __cTOp, __cAssigned);
        ReportByteIndex("", 0, __cArray, elCount(__cArray));
        snprintf(__cArray2, 8192, "%s", __cArray);
        snprintf(__cArray3, 8192, "%s", "");
        
        ReportTableRow(__tableHandle, 0, __cArray2, __cAOp, 0x3, __cArray3, __oneOfFlag, __bSetInCheckAlignment);
        
        if (0 >= 0 && 0 < 64)
        {
          __output.byte((word)0) = 0x3;
        }
        else
        {
          testStepErrorInTestSystem(0, __cEmpty, "Index out of range. Unable to set byte %lld in message. Please check input parameter.", (int64)0);
          __testStepInitOk = 0;
        }
        ReportByteIndex("", 1, __cArray, elCount(__cArray));
        snprintf(__cArray2, 8192, "%s", __cArray);
        snprintf(__cArray3, 8192, "%s", "");
        
        ReportTableRow(__tableHandle, 0, __cArray2, __cAOp, 0x22, __cArray3, __oneOfFlag, __bSetInCheckAlignment);
        
        if (1 >= 0 && 1 < 64)
        {
          __output.byte((word)1) = 0x22;
        }
        else
        {
          testStepErrorInTestSystem(0, __cEmpty, "Index out of range. Unable to set byte %lld in message. Please check input parameter.", (int64)1);
          __testStepInitOk = 0;
        }
        ReportByteIndex("", 2, __cArray, elCount(__cArray));
        snprintf(__cArray2, 8192, "%s", __cArray);
        snprintf(__cArray3, 8192, "%s", "");
        
        ReportTableRow(__tableHandle, 0, __cArray2, __cAOp, 0xF1, __cArray3, __oneOfFlag, __bSetInCheckAlignment);
        
        if (2 >= 0 && 2 < 64)
        {
          __output.byte((word)2) = 0xF1;
        }
        else
        {
          testStepErrorInTestSystem(0, __cEmpty, "Index out of range. Unable to set byte %lld in message. Please check input parameter.", (int64)2);
          __testStepInitOk = 0;
        }
        ReportByteIndex("", 3, __cArray, elCount(__cArray));
        snprintf(__cArray2, 8192, "%s", __cArray);
        snprintf(__cArray3, 8192, "%s", "");
        
        ReportTableRow(__tableHandle, 0, __cArray2, __cAOp, 0x86, __cArray3, __oneOfFlag, __bSetInCheckAlignment);
        
        if (3 >= 0 && 3 < 64)
        {
          __output.byte((word)3) = 0x86;
        }
        else
        {
          testStepErrorInTestSystem(0, __cEmpty, "Index out of range. Unable to set byte %lld in message. Please check input parameter.", (int64)3);
          __testStepInitOk = 0;
        }
      
        ReportTableEndTestStep(__tableHandle, "Req1");
      }
      if (__testStepInitOk)
      {
        output(__output);
      }
    }
    if (__timeout <= 0)
    {
      testStepErrorInTestSystem(0, "1", "Unable to wait for %.3f %s. Please check input parameter.", __timeout / ((float)1000000), "ms");
    }
    else
    {
      if (0 < 0 || 64 <= 0)
      {
        testStepErrorInTestSystem(0, __cEmpty, "Index out of range. Unable to get byte %lld in message.", (int64) 0);
        __nInt64 = 0;
      }
      if (1 < 0 || 64 <= 1)
      {
        testStepErrorInTestSystem(0, __cEmpty, "Index out of range. Unable to get byte %lld in message.", (int64) 1);
        __nInt64 = 0;
      }
      if (2 < 0 || 64 <= 2)
      {
        testStepErrorInTestSystem(0, __cEmpty, "Index out of range. Unable to get byte %lld in message.", (int64) 2);
        __nInt64 = 0;
      }
      if (3 < 0 || 64 <= 3)
      {
        testStepErrorInTestSystem(0, __cEmpty, "Index out of range. Unable to get byte %lld in message.", (int64) 3);
        __nInt64 = 0;
      }
      if (4 < 0 || 64 <= 4)
      {
        testStepErrorInTestSystem(0, __cEmpty, "Index out of range. Unable to get byte %lld in message.", (int64) 4);
        __nInt64 = 0;
      }
      if (5 < 0 || 64 <= 5)
      {
        testStepErrorInTestSystem(0, __cEmpty, "Index out of range. Unable to get byte %lld in message.", (int64) 5);
        __nInt64 = 0;
      }
      if (6 < 0 || 64 <= 6)
      {
        testStepErrorInTestSystem(0, __cEmpty, "Index out of range. Unable to get byte %lld in message.", (int64) 6);
        __nInt64 = 0;
      }
      __tt8cnt_27 = 0;
      snprintf(__cArray, elCount(__cArray), "CAN message '%s' ID = 417001888x (0x18DAF1A0x) on bus FDCAN2", "DIAGNOSTIC_RESPONSE_PAM");
      if(SetBusContextByName("FDCAN2", __eSaveCurrent, __nBusContextNew, __nBusContextOld))
        testJoinMessageEvent(`FDCAN2::`DIAGNOSTIC_RESPONSE_PAM,  __cArray,
             delegate dword(message * __m)
             {
               dword __msg_callback_ret;
               byte __b0;
               byte __b1;
               byte __b2;
               byte __b3;
               byte __b4;
               byte __b5;
               byte __b6;
               if (__tt8cnt_27 == -1)
               {
                 return 1;
               }
               __tt8msg_26 = __m;
               __msg_callback_ret = 1;
               __tt8cnt_27++;
               if (0 < 0 || 64 <= 0) return 0;
               __csr = CheckSignalMatch(__tt8msg_26.byte((word)0), 0x6, "==") == 1;
               __msg_callback_ret &= __csr;
               if (1 < 0 || 64 <= 1) return 0;
               __csr = CheckSignalMatch(__tt8msg_26.byte((word)1), 0x62, "==") == 1;
               __msg_callback_ret &= __csr;
               if (2 < 0 || 64 <= 2) return 0;
               __csr = CheckSignalMatch(__tt8msg_26.byte((word)2), 0xF1, "==") == 1;
               __msg_callback_ret &= __csr;
               if (3 < 0 || 64 <= 3) return 0;
               __csr = CheckSignalMatch(__tt8msg_26.byte((word)3), 0x86, "==") == 1;
               __msg_callback_ret &= __csr;
               if (4 < 0 || 64 <= 4) return 0;
               __csr = CheckSignalMatch(__tt8msg_26.byte((word)4), 0x1, "==") == 1;
               __msg_callback_ret &= __csr;
               if (5 < 0 || 64 <= 5) return 0;
               __csr = CheckSignalMatch(__tt8msg_26.byte((word)5), 0x5, "==") == 1;
               __msg_callback_ret &= __csr;
               if (6 < 0 || 64 <= 6) return 0;
               __csr = CheckSignalMatch(__tt8msg_26.byte((word)6), 0x0, "==") == 1;
               __msg_callback_ret &= __csr;
               if (__msg_callback_ret)
               {
                 __tt8cnt_27 = -1;
                 return 1;
               }
               return 0;
             });
      __res = testWaitForAllJoinedEventsNS(__timeout);
      if (__nInt64 != 0)
      {
        snprintf(__cArray, elCount(__cArray), "CAN message '%s' ID = 417001888x (0x18DAF1A0x) on bus FDCAN2", "DIAGNOSTIC_RESPONSE_PAM");
        if(__tt8cnt_27 == -1)
        {
          snprintf(__cArray2, 8192, "Response of %s", __cArray);
        snprintf(__cArray, 8192, "%s", __cActual);
        }
        else
        {
          snprintf(__cArray2, 8192, "Response of %s (received %d times)", __cArray, __tt8cnt_27);
          snprintf(__cArray, 8192, "Last Received");
        }
        if (__tt8cnt_27 == 0)
        {
          testStepFail(0, "Resp1", __cArray2);
        }
        else
        {
          byte __b0;
          byte __b1;
          byte __b2;
          byte __b3;
          byte __b4;
          byte __b5;
          byte __b6;
          __bVerdict = __eVerdictPass;
          __tableHandle = ReportTableHead5Columns(__cArray2, "Signal/Byte", __cTOp, __cRefVal, __cArray, __cRes);
        __csr = CheckSignalMatch(__tt8msg_26.byte((word)0), 0x6, "==") == 1;
        ReportByteIndex("", 0, __cArray, elCount(__cArray));
        snprintf(__cArray2, 8192, "%s", __cArray);
        snprintf(__cArray3, 8192, "%s", "");
        ReportTableRow(__tableHandle, 0, __cArray2, "==", 0x6, __cArray3, __oneOfFlag, __bSetInCheckAlignment);
        ReportCell(__tableHandle, __tt8msg_26.byte((word)0));
        ReportCellResult(__tableHandle, __csr, __ePassFail);
          __bVerdict &= __csr;
        __csr = CheckSignalMatch(__tt8msg_26.byte((word)1), 0x62, "==") == 1;
        ReportByteIndex("", 1, __cArray, elCount(__cArray));
        snprintf(__cArray2, 8192, "%s", __cArray);
        snprintf(__cArray3, 8192, "%s", "");
        ReportTableRow(__tableHandle, 0, __cArray2, "==", 0x62, __cArray3, __oneOfFlag, __bSetInCheckAlignment);
        ReportCell(__tableHandle, __tt8msg_26.byte((word)1));
        ReportCellResult(__tableHandle, __csr, __ePassFail);
          __bVerdict &= __csr;
        __csr = CheckSignalMatch(__tt8msg_26.byte((word)2), 0xF1, "==") == 1;
        ReportByteIndex("", 2, __cArray, elCount(__cArray));
        snprintf(__cArray2, 8192, "%s", __cArray);
        snprintf(__cArray3, 8192, "%s", "");
        ReportTableRow(__tableHandle, 0, __cArray2, "==", 0xF1, __cArray3, __oneOfFlag, __bSetInCheckAlignment);
        ReportCell(__tableHandle, __tt8msg_26.byte((word)2));
        ReportCellResult(__tableHandle, __csr, __ePassFail);
          __bVerdict &= __csr;
        __csr = CheckSignalMatch(__tt8msg_26.byte((word)3), 0x86, "==") == 1;
        ReportByteIndex("", 3, __cArray, elCount(__cArray));
        snprintf(__cArray2, 8192, "%s", __cArray);
        snprintf(__cArray3, 8192, "%s", "");
        ReportTableRow(__tableHandle, 0, __cArray2, "==", 0x86, __cArray3, __oneOfFlag, __bSetInCheckAlignment);
        ReportCell(__tableHandle, __tt8msg_26.byte((word)3));
        ReportCellResult(__tableHandle, __csr, __ePassFail);
          __bVerdict &= __csr;
        __csr = CheckSignalMatch(__tt8msg_26.byte((word)4), 0x1, "==") == 1;
        ReportByteIndex("", 4, __cArray, elCount(__cArray));
        snprintf(__cArray2, 8192, "%s", __cArray);
        snprintf(__cArray3, 8192, "%s", "");
        ReportTableRow(__tableHandle, 0, __cArray2, "==", 0x1, __cArray3, __oneOfFlag, __bSetInCheckAlignment);
        ReportCell(__tableHandle, __tt8msg_26.byte((word)4));
        ReportCellResult(__tableHandle, __csr, __ePassFail);
          __bVerdict &= __csr;
        __csr = CheckSignalMatch(__tt8msg_26.byte((word)5), 0x5, "==") == 1;
        ReportByteIndex("", 5, __cArray, elCount(__cArray));
        snprintf(__cArray2, 8192, "%s", __cArray);
        snprintf(__cArray3, 8192, "%s", "");
        ReportTableRow(__tableHandle, 0, __cArray2, "==", 0x5, __cArray3, __oneOfFlag, __bSetInCheckAlignment);
        ReportCell(__tableHandle, __tt8msg_26.byte((word)5));
        ReportCellResult(__tableHandle, __csr, __ePassFail);
          __bVerdict &= __csr;
        __csr = CheckSignalMatch(__tt8msg_26.byte((word)6), 0x0, "==") == 1;
        ReportByteIndex("", 6, __cArray, elCount(__cArray));
        snprintf(__cArray2, 8192, "%s", __cArray);
        snprintf(__cArray3, 8192, "%s", "");
        ReportTableRow(__tableHandle, 0, __cArray2, "==", 0x0, __cArray3, __oneOfFlag, __bSetInCheckAlignment);
        ReportCell(__tableHandle, __tt8msg_26.byte((word)6));
        ReportCellResult(__tableHandle, __csr, __ePassFail);
          __bVerdict &= __csr;
          ReportTableEndVerdict(__tableHandle, "Resp1", __bVerdict);
        }
        __ReportRequestResponseResult(__res, 0);
      }
      ResetBusContext(__nBusContextNew, __nBusContextOld);
    }
  }
  TestCommandEnd();

}

void Tto7tsimc_F186_DID_with_PhysicalAdd_ExtendedSession()
{
  stack long __tableHandle;
  TestCommandBegin(__eDiagService, __cDiagService, "", "0");
  {
    if (DiagIsFunctionalGroup("CVADAS_0001_00000000_000"))
    {
      DiagResponse * __resp;
      DiagRequest CVADAS_0001_00000000_000._22F186_Active_Diagnostic_Session __req;
      __diagServiceo7tsimc_22(__req, __resp);
    }
    else
    {
      DiagResponse CVADAS_0001_00000000_000.* __resp;
      DiagRequest CVADAS_0001_00000000_000._22F186_Active_Diagnostic_Session __req;
      __diagServiceo7tsimc_22(__req, __resp);
    }
  }
  TestCommandEnd();


}

  
void __diagServiceo7tsimc_22(DiagRequest * __req, DiagResponse * __resp )
{
  stack long __tableHandle;
  long __res, __paramLen, __bytePos;

   __bVerdict = __eVerdictPass;

  do {
    TestReportResetDiagObjectList();
    DiagSetReportDetailLevel("CVADAS_0001_00000000_000", EnumServiceDetails_onfail);
    // Request aspect
    {

      if (0 >= DiagSendReqAndWaitForResp("CVADAS_0001_00000000_000", __req, __resp, __res, -1, -1, -1, -1, -1, EnumResult_pos, EnumServiceDetails_onfail, EnumSendingMode_physical, EnumSuppressPosResBit_asconfigured, EnumVerdictOnInvalidValues_fail))
        break;
    }

    __res = DiagErrCodeTestStep(__res, "Can't retrieve last response for request! No check possible.") < 0;
    if(__res)
    {
	  __bVerdict = __eVerdictFail;
      break;
    }
    {
      __res = DiagInterpretAs(__resp, "RDBI_PR");
      if(__res != 0)
      {
        __bVerdict = __eVerdictFail;
        DiagErrCodeTestStep(__res, "Can't interpret response as diagnostic primitive 'RDBI_PR'.");
        break;
      }
      else
      {
        TestStepPass( "Received primitive can be interpreted as diagnostic primitive 'RDBI_PR'.");
      }
    }
  }
  while(0);


  // Response, check & read aspect
  {
    __res = 1;
    __tableHandle = ReportTableHead5Columns(__cCheckCaption, __cTSym, __cTOp, __cRefVal, __cActual, __cRes);
    {
      __bDiagValueArrayCtr = DiagGetParameterErrorHandled(__resp, "_Active_Diagnostic_Session_24", __bDiagValueArray, elcount(__bDiagValueArray), __cDiagValueArray, elcount(__cDiagValueArray));
      {
        __bSetInCheckAlignment = 1;	
        {
          __bArrayCtr = __CopyBytes(__bDiagValueArray, __bDiagValueArrayCtr, __bArray);
          {
            sysvar * __systemVariable;
            __systemVariable = sysvarData::`PartNumber::`Part_Number;
            CheckSysVarSetBufferConsistency(sysSetVariableData(sysvarData::`PartNumber::`Part_Number, __bArray, __bArrayCtr), __systemVariable.name);
          }
          snprintf(__cArray, 8192, "%s", "Part_Number");
          snprintf(__cArray2, 8192, "%s '%s'", __cSysVar, __cArray);
          snprintf(__cArray3, 8192, "%s", "_Active_Diagnostic_Session_24");
          
          ReportTableRow(__tableHandle, 0, __cArray2, __cAOp, __bArray, __bArrayCtr, __cArray3, __oneOfFlag, __bSetInCheckAlignment);
        
        }
    
        __bSetInCheckAlignment = 0;
      }
    }
    {
      __bDiagValueArrayCtr = DiagGetParameterErrorHandled(__resp, "Authentication_Status", __bDiagValueArray, elcount(__bDiagValueArray), __cDiagValueArray, elcount(__cDiagValueArray));
      {
        __bSetInCheckAlignment = 1;	
        {
          __bArrayCtr = __CopyBytes(__bDiagValueArray, __bDiagValueArrayCtr, __bArray);
          {
            sysvar * __systemVariable;
            __systemVariable = sysvarData::`PartNumber::`Part_Number;
            CheckSysVarSetBufferConsistency(sysSetVariableData(sysvarData::`PartNumber::`Part_Number, __bArray, __bArrayCtr), __systemVariable.name);
          }
          snprintf(__cArray, 8192, "%s", "Part_Number");
          snprintf(__cArray2, 8192, "%s '%s'", __cSysVar, __cArray);
          snprintf(__cArray3, 8192, "%s", "Authentication_Status");
          
          ReportTableRow(__tableHandle, 0, __cArray2, __cAOp, __bArray, __bArrayCtr, __cArray3, __oneOfFlag, __bSetInCheckAlignment);
        
        }
    
        __bSetInCheckAlignment = 0;
      }
    }
    {
      __bDiagValueArrayCtr = DiagGetParameterErrorHandled(__resp, "Bitfield/Bitfield._Active_Diagnostic_Session_of_ECU__ECU_Software_Mode_32", __bDiagValueArray, elcount(__bDiagValueArray), __cDiagValueArray, elcount(__cDiagValueArray));
      {
        __bSetInCheckAlignment = 1;	
        {
          __bArrayCtr = __CopyBytes(__bDiagValueArray, __bDiagValueArrayCtr, __bArray);
          {
            sysvar * __systemVariable;
            __systemVariable = sysvarData::`PartNumber::`Part_Number;
            CheckSysVarSetBufferConsistency(sysSetVariableData(sysvarData::`PartNumber::`Part_Number, __bArray, __bArrayCtr), __systemVariable.name);
          }
          snprintf(__cArray, 8192, "%s", "Part_Number");
          snprintf(__cArray2, 8192, "%s '%s'", __cSysVar, __cArray);
          snprintf(__cArray3, 8192, "%s", "Bitfield/Bitfield._Active_Diagnostic_Session_of_ECU__ECU_Software_Mode_32");
          
          ReportTableRow(__tableHandle, 0, __cArray2, __cAOp, __bArray, __bArrayCtr, __cArray3, __oneOfFlag, __bSetInCheckAlignment);
        
        }
    
        __bSetInCheckAlignment = 0;
      }
    }
    ReportTableEndVerdict(__tableHandle, __cEvaluateResponse, __res);
	__bVerdict = __bVerdict && __res;
  }
  if (__bVerdict == __eVerdictFail)
    TestReportWriteDiagObjectList();
}

void Tto7tsimc_F186_DID_with_Standard_Physical_Address_Extended_Session()
{
  stack long __tableHandle;
  TestCommandBegin(__eRequestResponse, __cRequestResponse, "", "0");
  {
    message `FDCAN2::`DIAGNOSTIC_RESPONSE_PAM __tt8msg_28;
  
    long __res;
    int64 __timeout;
    __res = 0;
    __nInt64 = 1;
    __timeout = syspar::`P2_Server * 1000000LL;
    {
    
      long __testStepInitOk;
      message `FDCAN2::`DIAGNOSTIC_REQUEST_PAM __output;
      message `FDCAN2::`DIAGNOSTIC_REQUEST_PAM __msgOrig;
      __output = __msgOrig;
      __testStepInitOk = 1;
      {
        int64 __dlc;
        __dlc = 8;
        if (__dlc >= 0 && __dlc <= (__output.EDL ? 15 : 8))
          __output.DLC = __dlc;
        else
        {
          testStepErrorInTestSystem(0, __cEmpty, "Unable to set DLC=%lld in message. Please check input parameter.", __dlc);
          __testStepInitOk = 0;
        }
      }
      if (__testStepInitOk)
      {
        snprintf(__cArray, elCount(__cArray), "CAN message '%s' ID = 416981233x (0x18DAA0F1x) on bus FDCAN2", "DIAGNOSTIC_REQUEST_PAM");
        snprintf(__cArray2, elCount(__cArray2), "Send %s", __cArray);
        __tableHandle = ReportTableHead3Columns(__cArray2, "Byte", __cTOp, __cAssigned);
        ReportByteIndex("", 0, __cArray, elCount(__cArray));
        snprintf(__cArray2, 8192, "%s", __cArray);
        snprintf(__cArray3, 8192, "%s", "");
        
        ReportTableRow(__tableHandle, 0, __cArray2, __cAOp, 0x3, __cArray3, __oneOfFlag, __bSetInCheckAlignment);
        
        if (0 >= 0 && 0 < 64)
        {
          __output.byte((word)0) = 0x3;
        }
        else
        {
          testStepErrorInTestSystem(0, __cEmpty, "Index out of range. Unable to set byte %lld in message. Please check input parameter.", (int64)0);
          __testStepInitOk = 0;
        }
        ReportByteIndex("", 1, __cArray, elCount(__cArray));
        snprintf(__cArray2, 8192, "%s", __cArray);
        snprintf(__cArray3, 8192, "%s", "");
        
        ReportTableRow(__tableHandle, 0, __cArray2, __cAOp, 0x22, __cArray3, __oneOfFlag, __bSetInCheckAlignment);
        
        if (1 >= 0 && 1 < 64)
        {
          __output.byte((word)1) = 0x22;
        }
        else
        {
          testStepErrorInTestSystem(0, __cEmpty, "Index out of range. Unable to set byte %lld in message. Please check input parameter.", (int64)1);
          __testStepInitOk = 0;
        }
        ReportByteIndex("", 2, __cArray, elCount(__cArray));
        snprintf(__cArray2, 8192, "%s", __cArray);
        snprintf(__cArray3, 8192, "%s", "");
        
        ReportTableRow(__tableHandle, 0, __cArray2, __cAOp, 0xF1, __cArray3, __oneOfFlag, __bSetInCheckAlignment);
        
        if (2 >= 0 && 2 < 64)
        {
          __output.byte((word)2) = 0xF1;
        }
        else
        {
          testStepErrorInTestSystem(0, __cEmpty, "Index out of range. Unable to set byte %lld in message. Please check input parameter.", (int64)2);
          __testStepInitOk = 0;
        }
        ReportByteIndex("", 3, __cArray, elCount(__cArray));
        snprintf(__cArray2, 8192, "%s", __cArray);
        snprintf(__cArray3, 8192, "%s", "");
        
        ReportTableRow(__tableHandle, 0, __cArray2, __cAOp, 0x86, __cArray3, __oneOfFlag, __bSetInCheckAlignment);
        
        if (3 >= 0 && 3 < 64)
        {
          __output.byte((word)3) = 0x86;
        }
        else
        {
          testStepErrorInTestSystem(0, __cEmpty, "Index out of range. Unable to set byte %lld in message. Please check input parameter.", (int64)3);
          __testStepInitOk = 0;
        }
      
        ReportTableEndTestStep(__tableHandle, "Req1");
      }
      if (__testStepInitOk)
      {
        output(__output);
      }
    }
    if (__timeout <= 0)
    {
      testStepErrorInTestSystem(0, "1", "Unable to wait for %.3f %s. Please check input parameter.", __timeout / ((float)1000000), "ms");
    }
    else
    {
      if (0 < 0 || 64 <= 0)
      {
        testStepErrorInTestSystem(0, __cEmpty, "Index out of range. Unable to get byte %lld in message.", (int64) 0);
        __nInt64 = 0;
      }
      if (1 < 0 || 64 <= 1)
      {
        testStepErrorInTestSystem(0, __cEmpty, "Index out of range. Unable to get byte %lld in message.", (int64) 1);
        __nInt64 = 0;
      }
      if (2 < 0 || 64 <= 2)
      {
        testStepErrorInTestSystem(0, __cEmpty, "Index out of range. Unable to get byte %lld in message.", (int64) 2);
        __nInt64 = 0;
      }
      if (3 < 0 || 64 <= 3)
      {
        testStepErrorInTestSystem(0, __cEmpty, "Index out of range. Unable to get byte %lld in message.", (int64) 3);
        __nInt64 = 0;
      }
      if (4 < 0 || 64 <= 4)
      {
        testStepErrorInTestSystem(0, __cEmpty, "Index out of range. Unable to get byte %lld in message.", (int64) 4);
        __nInt64 = 0;
      }
      if (5 < 0 || 64 <= 5)
      {
        testStepErrorInTestSystem(0, __cEmpty, "Index out of range. Unable to get byte %lld in message.", (int64) 5);
        __nInt64 = 0;
      }
      if (6 < 0 || 64 <= 6)
      {
        testStepErrorInTestSystem(0, __cEmpty, "Index out of range. Unable to get byte %lld in message.", (int64) 6);
        __nInt64 = 0;
      }
      __tt8cnt_29 = 0;
      snprintf(__cArray, elCount(__cArray), "CAN message '%s' ID = 417001888x (0x18DAF1A0x) on bus FDCAN2", "DIAGNOSTIC_RESPONSE_PAM");
      if(SetBusContextByName("FDCAN2", __eSaveCurrent, __nBusContextNew, __nBusContextOld))
        testJoinMessageEvent(`FDCAN2::`DIAGNOSTIC_RESPONSE_PAM,  __cArray,
             delegate dword(message * __m)
             {
               dword __msg_callback_ret;
               byte __b0;
               byte __b1;
               byte __b2;
               byte __b3;
               byte __b4;
               byte __b5;
               byte __b6;
               if (__tt8cnt_29 == -1)
               {
                 return 1;
               }
               __tt8msg_28 = __m;
               __msg_callback_ret = 1;
               __tt8cnt_29++;
               if (0 < 0 || 64 <= 0) return 0;
               __csr = CheckSignalMatch(__tt8msg_28.byte((word)0), 0x6, "==") == 1;
               __msg_callback_ret &= __csr;
               if (1 < 0 || 64 <= 1) return 0;
               __csr = CheckSignalMatch(__tt8msg_28.byte((word)1), 0x62, "==") == 1;
               __msg_callback_ret &= __csr;
               if (2 < 0 || 64 <= 2) return 0;
               __csr = CheckSignalMatch(__tt8msg_28.byte((word)2), 0xF1, "==") == 1;
               __msg_callback_ret &= __csr;
               if (3 < 0 || 64 <= 3) return 0;
               __csr = CheckSignalMatch(__tt8msg_28.byte((word)3), 0x86, "==") == 1;
               __msg_callback_ret &= __csr;
               if (4 < 0 || 64 <= 4) return 0;
               __csr = CheckSignalMatch(__tt8msg_28.byte((word)4), 0x3, "==") == 1;
               __msg_callback_ret &= __csr;
               if (5 < 0 || 64 <= 5) return 0;
               __csr = CheckSignalMatch(__tt8msg_28.byte((word)5), 0x5, "==") == 1;
               __msg_callback_ret &= __csr;
               if (6 < 0 || 64 <= 6) return 0;
               __csr = CheckSignalMatch(__tt8msg_28.byte((word)6), 0x0, "==") == 1;
               __msg_callback_ret &= __csr;
               if (__msg_callback_ret)
               {
                 __tt8cnt_29 = -1;
                 return 1;
               }
               return 0;
             });
      __res = testWaitForAllJoinedEventsNS(__timeout);
      if (__nInt64 != 0)
      {
        snprintf(__cArray, elCount(__cArray), "CAN message '%s' ID = 417001888x (0x18DAF1A0x) on bus FDCAN2", "DIAGNOSTIC_RESPONSE_PAM");
        if(__tt8cnt_29 == -1)
        {
          snprintf(__cArray2, 8192, "Response of %s", __cArray);
        snprintf(__cArray, 8192, "%s", __cActual);
        }
        else
        {
          snprintf(__cArray2, 8192, "Response of %s (received %d times)", __cArray, __tt8cnt_29);
          snprintf(__cArray, 8192, "Last Received");
        }
        if (__tt8cnt_29 == 0)
        {
          testStepFail(0, "Resp1", __cArray2);
        }
        else
        {
          byte __b0;
          byte __b1;
          byte __b2;
          byte __b3;
          byte __b4;
          byte __b5;
          byte __b6;
          __bVerdict = __eVerdictPass;
          __tableHandle = ReportTableHead5Columns(__cArray2, "Signal/Byte", __cTOp, __cRefVal, __cArray, __cRes);
        __csr = CheckSignalMatch(__tt8msg_28.byte((word)0), 0x6, "==") == 1;
        ReportByteIndex("", 0, __cArray, elCount(__cArray));
        snprintf(__cArray2, 8192, "%s", __cArray);
        snprintf(__cArray3, 8192, "%s", "");
        ReportTableRow(__tableHandle, 0, __cArray2, "==", 0x6, __cArray3, __oneOfFlag, __bSetInCheckAlignment);
        ReportCell(__tableHandle, __tt8msg_28.byte((word)0));
        ReportCellResult(__tableHandle, __csr, __ePassFail);
          __bVerdict &= __csr;
        __csr = CheckSignalMatch(__tt8msg_28.byte((word)1), 0x62, "==") == 1;
        ReportByteIndex("", 1, __cArray, elCount(__cArray));
        snprintf(__cArray2, 8192, "%s", __cArray);
        snprintf(__cArray3, 8192, "%s", "");
        ReportTableRow(__tableHandle, 0, __cArray2, "==", 0x62, __cArray3, __oneOfFlag, __bSetInCheckAlignment);
        ReportCell(__tableHandle, __tt8msg_28.byte((word)1));
        ReportCellResult(__tableHandle, __csr, __ePassFail);
          __bVerdict &= __csr;
        __csr = CheckSignalMatch(__tt8msg_28.byte((word)2), 0xF1, "==") == 1;
        ReportByteIndex("", 2, __cArray, elCount(__cArray));
        snprintf(__cArray2, 8192, "%s", __cArray);
        snprintf(__cArray3, 8192, "%s", "");
        ReportTableRow(__tableHandle, 0, __cArray2, "==", 0xF1, __cArray3, __oneOfFlag, __bSetInCheckAlignment);
        ReportCell(__tableHandle, __tt8msg_28.byte((word)2));
        ReportCellResult(__tableHandle, __csr, __ePassFail);
          __bVerdict &= __csr;
        __csr = CheckSignalMatch(__tt8msg_28.byte((word)3), 0x86, "==") == 1;
        ReportByteIndex("", 3, __cArray, elCount(__cArray));
        snprintf(__cArray2, 8192, "%s", __cArray);
        snprintf(__cArray3, 8192, "%s", "");
        ReportTableRow(__tableHandle, 0, __cArray2, "==", 0x86, __cArray3, __oneOfFlag, __bSetInCheckAlignment);
        ReportCell(__tableHandle, __tt8msg_28.byte((word)3));
        ReportCellResult(__tableHandle, __csr, __ePassFail);
          __bVerdict &= __csr;
        __csr = CheckSignalMatch(__tt8msg_28.byte((word)4), 0x3, "==") == 1;
        ReportByteIndex("", 4, __cArray, elCount(__cArray));
        snprintf(__cArray2, 8192, "%s", __cArray);
        snprintf(__cArray3, 8192, "%s", "");
        ReportTableRow(__tableHandle, 0, __cArray2, "==", 0x3, __cArray3, __oneOfFlag, __bSetInCheckAlignment);
        ReportCell(__tableHandle, __tt8msg_28.byte((word)4));
        ReportCellResult(__tableHandle, __csr, __ePassFail);
          __bVerdict &= __csr;
        __csr = CheckSignalMatch(__tt8msg_28.byte((word)5), 0x5, "==") == 1;
        ReportByteIndex("", 5, __cArray, elCount(__cArray));
        snprintf(__cArray2, 8192, "%s", __cArray);
        snprintf(__cArray3, 8192, "%s", "");
        ReportTableRow(__tableHandle, 0, __cArray2, "==", 0x5, __cArray3, __oneOfFlag, __bSetInCheckAlignment);
        ReportCell(__tableHandle, __tt8msg_28.byte((word)5));
        ReportCellResult(__tableHandle, __csr, __ePassFail);
          __bVerdict &= __csr;
        __csr = CheckSignalMatch(__tt8msg_28.byte((word)6), 0x0, "==") == 1;
        ReportByteIndex("", 6, __cArray, elCount(__cArray));
        snprintf(__cArray2, 8192, "%s", __cArray);
        snprintf(__cArray3, 8192, "%s", "");
        ReportTableRow(__tableHandle, 0, __cArray2, "==", 0x0, __cArray3, __oneOfFlag, __bSetInCheckAlignment);
        ReportCell(__tableHandle, __tt8msg_28.byte((word)6));
        ReportCellResult(__tableHandle, __csr, __ePassFail);
          __bVerdict &= __csr;
          ReportTableEndVerdict(__tableHandle, "Resp1", __bVerdict);
        }
        __ReportRequestResponseResult(__res, 0);
      }
      ResetBusContext(__nBusContextNew, __nBusContextOld);
    }
  }
  TestCommandEnd();

}

void Tto7tsimc_F186_DID_with_PhysicalAdd_ProgrammingSession()
{
  stack long __tableHandle;
  TestCommandBegin(__eWait, __cWait, "", "0");
  {
    Wait("1", (1100 * 1000000LL), 1000000, "");
  }
  TestCommandEnd();

  TestCommandBegin(__eDiagService, __cDiagService, "", "1");
  {
    if (DiagIsFunctionalGroup("CVADAS_0001_00000000_000"))
    {
      DiagResponse * __resp;
      DiagRequest CVADAS_0001_00000000_000._22F186_Active_Diagnostic_Session __req;
      __diagServiceo7tsimc_23(__req, __resp);
    }
    else
    {
      DiagResponse CVADAS_0001_00000000_000.* __resp;
      DiagRequest CVADAS_0001_00000000_000._22F186_Active_Diagnostic_Session __req;
      __diagServiceo7tsimc_23(__req, __resp);
    }
  }
  TestCommandEnd();


}

  
void __diagServiceo7tsimc_23(DiagRequest * __req, DiagResponse * __resp )
{
  stack long __tableHandle;
  long __res, __paramLen, __bytePos;

   __bVerdict = __eVerdictPass;

  do {
    TestReportResetDiagObjectList();
    DiagSetReportDetailLevel("CVADAS_0001_00000000_000", EnumServiceDetails_onfail);
    // Request aspect
    {

      if (0 >= DiagSendReqAndWaitForResp("CVADAS_0001_00000000_000", __req, __resp, __res, -1, -1, -1, -1, -1, EnumResult_pos, EnumServiceDetails_onfail, EnumSendingMode_physical, EnumSuppressPosResBit_asconfigured, EnumVerdictOnInvalidValues_fail))
        break;
    }

    __res = DiagErrCodeTestStep(__res, "Can't retrieve last response for request! No check possible.") < 0;
    if(__res)
    {
	  __bVerdict = __eVerdictFail;
      break;
    }
    {
      __res = DiagInterpretAs(__resp, "RDBI_PR");
      if(__res != 0)
      {
        __bVerdict = __eVerdictFail;
        DiagErrCodeTestStep(__res, "Can't interpret response as diagnostic primitive 'RDBI_PR'.");
        break;
      }
      else
      {
        TestStepPass( "Received primitive can be interpreted as diagnostic primitive 'RDBI_PR'.");
      }
    }
  }
  while(0);


  // Response, check & read aspect
  {
    __res = 1;
    __tableHandle = ReportTableHead5Columns(__cCheckCaption, __cTSym, __cTOp, __cRefVal, __cActual, __cRes);
    {
      __bDiagValueArrayCtr = DiagGetParameterErrorHandled(__resp, "_Active_Diagnostic_Session_24", __bDiagValueArray, elcount(__bDiagValueArray), __cDiagValueArray, elcount(__cDiagValueArray));
      {
        __bSetInCheckAlignment = 1;	
        {
          __bArrayCtr = __CopyBytes(__bDiagValueArray, __bDiagValueArrayCtr, __bArray);
          {
            sysvar * __systemVariable;
            __systemVariable = sysvarData::`PartNumber::`Part_Number;
            CheckSysVarSetBufferConsistency(sysSetVariableData(sysvarData::`PartNumber::`Part_Number, __bArray, __bArrayCtr), __systemVariable.name);
          }
          snprintf(__cArray, 8192, "%s", "Part_Number");
          snprintf(__cArray2, 8192, "%s '%s'", __cSysVar, __cArray);
          snprintf(__cArray3, 8192, "%s", "_Active_Diagnostic_Session_24");
          
          ReportTableRow(__tableHandle, 0, __cArray2, __cAOp, __bArray, __bArrayCtr, __cArray3, __oneOfFlag, __bSetInCheckAlignment);
        
        }
    
        __bSetInCheckAlignment = 0;
      }
    }
    {
      __bDiagValueArrayCtr = DiagGetParameterErrorHandled(__resp, "Authentication_Status", __bDiagValueArray, elcount(__bDiagValueArray), __cDiagValueArray, elcount(__cDiagValueArray));
      {
        __bSetInCheckAlignment = 1;	
        {
          __bArrayCtr = __CopyBytes(__bDiagValueArray, __bDiagValueArrayCtr, __bArray);
          {
            sysvar * __systemVariable;
            __systemVariable = sysvarData::`PartNumber::`Part_Number;
            CheckSysVarSetBufferConsistency(sysSetVariableData(sysvarData::`PartNumber::`Part_Number, __bArray, __bArrayCtr), __systemVariable.name);
          }
          snprintf(__cArray, 8192, "%s", "Part_Number");
          snprintf(__cArray2, 8192, "%s '%s'", __cSysVar, __cArray);
          snprintf(__cArray3, 8192, "%s", "Authentication_Status");
          
          ReportTableRow(__tableHandle, 0, __cArray2, __cAOp, __bArray, __bArrayCtr, __cArray3, __oneOfFlag, __bSetInCheckAlignment);
        
        }
    
        __bSetInCheckAlignment = 0;
      }
    }
    {
      __bDiagValueArrayCtr = DiagGetParameterErrorHandled(__resp, "Bitfield/Bitfield._Active_Diagnostic_Session_of_ECU__ECU_Software_Mode_32", __bDiagValueArray, elcount(__bDiagValueArray), __cDiagValueArray, elcount(__cDiagValueArray));
      {
        __bSetInCheckAlignment = 1;	
        {
          __bArrayCtr = __CopyBytes(__bDiagValueArray, __bDiagValueArrayCtr, __bArray);
          {
            sysvar * __systemVariable;
            __systemVariable = sysvarData::`PartNumber::`Part_Number;
            CheckSysVarSetBufferConsistency(sysSetVariableData(sysvarData::`PartNumber::`Part_Number, __bArray, __bArrayCtr), __systemVariable.name);
          }
          snprintf(__cArray, 8192, "%s", "Part_Number");
          snprintf(__cArray2, 8192, "%s '%s'", __cSysVar, __cArray);
          snprintf(__cArray3, 8192, "%s", "Bitfield/Bitfield._Active_Diagnostic_Session_of_ECU__ECU_Software_Mode_32");
          
          ReportTableRow(__tableHandle, 0, __cArray2, __cAOp, __bArray, __bArrayCtr, __cArray3, __oneOfFlag, __bSetInCheckAlignment);
        
        }
    
        __bSetInCheckAlignment = 0;
      }
    }
    ReportTableEndVerdict(__tableHandle, __cEvaluateResponse, __res);
	__bVerdict = __bVerdict && __res;
  }
  if (__bVerdict == __eVerdictFail)
    TestReportWriteDiagObjectList();
}

void Tto7tsimc_F186_DID_with_Standard_Physical_Address_Programming_Session()
{
  stack long __tableHandle;
  TestCommandBegin(__eRequestResponse, __cRequestResponse, "", "0");
  {
    message `FDCAN2::`DIAGNOSTIC_RESPONSE_PAM __tt8msg_30;
  
    long __res;
    int64 __timeout;
    __res = 0;
    __nInt64 = 1;
    __timeout = syspar::`P2_Server * 1000000LL;
    {
    
      long __testStepInitOk;
      message `FDCAN2::`DIAGNOSTIC_REQUEST_PAM __output;
      message `FDCAN2::`DIAGNOSTIC_REQUEST_PAM __msgOrig;
      __output = __msgOrig;
      __testStepInitOk = 1;
      {
        int64 __dlc;
        __dlc = 8;
        if (__dlc >= 0 && __dlc <= (__output.EDL ? 15 : 8))
          __output.DLC = __dlc;
        else
        {
          testStepErrorInTestSystem(0, __cEmpty, "Unable to set DLC=%lld in message. Please check input parameter.", __dlc);
          __testStepInitOk = 0;
        }
      }
      if (__testStepInitOk)
      {
        snprintf(__cArray, elCount(__cArray), "CAN message '%s' ID = 416981233x (0x18DAA0F1x) on bus FDCAN2", "DIAGNOSTIC_REQUEST_PAM");
        snprintf(__cArray2, elCount(__cArray2), "Send %s", __cArray);
        __tableHandle = ReportTableHead3Columns(__cArray2, "Byte", __cTOp, __cAssigned);
        ReportByteIndex("", 0, __cArray, elCount(__cArray));
        snprintf(__cArray2, 8192, "%s", __cArray);
        snprintf(__cArray3, 8192, "%s", "");
        
        ReportTableRow(__tableHandle, 0, __cArray2, __cAOp, 0x3, __cArray3, __oneOfFlag, __bSetInCheckAlignment);
        
        if (0 >= 0 && 0 < 64)
        {
          __output.byte((word)0) = 0x3;
        }
        else
        {
          testStepErrorInTestSystem(0, __cEmpty, "Index out of range. Unable to set byte %lld in message. Please check input parameter.", (int64)0);
          __testStepInitOk = 0;
        }
        ReportByteIndex("", 1, __cArray, elCount(__cArray));
        snprintf(__cArray2, 8192, "%s", __cArray);
        snprintf(__cArray3, 8192, "%s", "");
        
        ReportTableRow(__tableHandle, 0, __cArray2, __cAOp, 0x22, __cArray3, __oneOfFlag, __bSetInCheckAlignment);
        
        if (1 >= 0 && 1 < 64)
        {
          __output.byte((word)1) = 0x22;
        }
        else
        {
          testStepErrorInTestSystem(0, __cEmpty, "Index out of range. Unable to set byte %lld in message. Please check input parameter.", (int64)1);
          __testStepInitOk = 0;
        }
        ReportByteIndex("", 2, __cArray, elCount(__cArray));
        snprintf(__cArray2, 8192, "%s", __cArray);
        snprintf(__cArray3, 8192, "%s", "");
        
        ReportTableRow(__tableHandle, 0, __cArray2, __cAOp, 0xF1, __cArray3, __oneOfFlag, __bSetInCheckAlignment);
        
        if (2 >= 0 && 2 < 64)
        {
          __output.byte((word)2) = 0xF1;
        }
        else
        {
          testStepErrorInTestSystem(0, __cEmpty, "Index out of range. Unable to set byte %lld in message. Please check input parameter.", (int64)2);
          __testStepInitOk = 0;
        }
        ReportByteIndex("", 3, __cArray, elCount(__cArray));
        snprintf(__cArray2, 8192, "%s", __cArray);
        snprintf(__cArray3, 8192, "%s", "");
        
        ReportTableRow(__tableHandle, 0, __cArray2, __cAOp, 0x86, __cArray3, __oneOfFlag, __bSetInCheckAlignment);
        
        if (3 >= 0 && 3 < 64)
        {
          __output.byte((word)3) = 0x86;
        }
        else
        {
          testStepErrorInTestSystem(0, __cEmpty, "Index out of range. Unable to set byte %lld in message. Please check input parameter.", (int64)3);
          __testStepInitOk = 0;
        }
      
        ReportTableEndTestStep(__tableHandle, "Req1");
      }
      if (__testStepInitOk)
      {
        output(__output);
      }
    }
    if (__timeout <= 0)
    {
      testStepErrorInTestSystem(0, "1", "Unable to wait for %.3f %s. Please check input parameter.", __timeout / ((float)1000000), "ms");
    }
    else
    {
      if (0 < 0 || 64 <= 0)
      {
        testStepErrorInTestSystem(0, __cEmpty, "Index out of range. Unable to get byte %lld in message.", (int64) 0);
        __nInt64 = 0;
      }
      if (1 < 0 || 64 <= 1)
      {
        testStepErrorInTestSystem(0, __cEmpty, "Index out of range. Unable to get byte %lld in message.", (int64) 1);
        __nInt64 = 0;
      }
      if (2 < 0 || 64 <= 2)
      {
        testStepErrorInTestSystem(0, __cEmpty, "Index out of range. Unable to get byte %lld in message.", (int64) 2);
        __nInt64 = 0;
      }
      if (3 < 0 || 64 <= 3)
      {
        testStepErrorInTestSystem(0, __cEmpty, "Index out of range. Unable to get byte %lld in message.", (int64) 3);
        __nInt64 = 0;
      }
      if (4 < 0 || 64 <= 4)
      {
        testStepErrorInTestSystem(0, __cEmpty, "Index out of range. Unable to get byte %lld in message.", (int64) 4);
        __nInt64 = 0;
      }
      if (5 < 0 || 64 <= 5)
      {
        testStepErrorInTestSystem(0, __cEmpty, "Index out of range. Unable to get byte %lld in message.", (int64) 5);
        __nInt64 = 0;
      }
      if (6 < 0 || 64 <= 6)
      {
        testStepErrorInTestSystem(0, __cEmpty, "Index out of range. Unable to get byte %lld in message.", (int64) 6);
        __nInt64 = 0;
      }
      __tt8cnt_31 = 0;
      snprintf(__cArray, elCount(__cArray), "CAN message '%s' ID = 417001888x (0x18DAF1A0x) on bus FDCAN2", "DIAGNOSTIC_RESPONSE_PAM");
      if(SetBusContextByName("FDCAN2", __eSaveCurrent, __nBusContextNew, __nBusContextOld))
        testJoinMessageEvent(`FDCAN2::`DIAGNOSTIC_RESPONSE_PAM,  __cArray,
             delegate dword(message * __m)
             {
               dword __msg_callback_ret;
               byte __b0;
               byte __b1;
               byte __b2;
               byte __b3;
               byte __b4;
               byte __b5;
               byte __b6;
               if (__tt8cnt_31 == -1)
               {
                 return 1;
               }
               __tt8msg_30 = __m;
               __msg_callback_ret = 1;
               __tt8cnt_31++;
               if (0 < 0 || 64 <= 0) return 0;
               __csr = CheckSignalMatch(__tt8msg_30.byte((word)0), 0x6, "==") == 1;
               __msg_callback_ret &= __csr;
               if (1 < 0 || 64 <= 1) return 0;
               __csr = CheckSignalMatch(__tt8msg_30.byte((word)1), 0x62, "==") == 1;
               __msg_callback_ret &= __csr;
               if (2 < 0 || 64 <= 2) return 0;
               __csr = CheckSignalMatch(__tt8msg_30.byte((word)2), 0xF1, "==") == 1;
               __msg_callback_ret &= __csr;
               if (3 < 0 || 64 <= 3) return 0;
               __csr = CheckSignalMatch(__tt8msg_30.byte((word)3), 0x86, "==") == 1;
               __msg_callback_ret &= __csr;
               if (4 < 0 || 64 <= 4) return 0;
               __csr = CheckSignalMatch(__tt8msg_30.byte((word)4), 0x2, "==") == 1;
               __msg_callback_ret &= __csr;
               if (5 < 0 || 64 <= 5) return 0;
               __csr = CheckSignalMatch(__tt8msg_30.byte((word)5), 0x5, "==") == 1;
               __msg_callback_ret &= __csr;
               if (6 < 0 || 64 <= 6) return 0;
               __csr = CheckSignalMatch(__tt8msg_30.byte((word)6), 0x0, "==") == 1;
               __msg_callback_ret &= __csr;
               if (__msg_callback_ret)
               {
                 __tt8cnt_31 = -1;
                 return 1;
               }
               return 0;
             });
      __res = testWaitForAllJoinedEventsNS(__timeout);
      if (__nInt64 != 0)
      {
        snprintf(__cArray, elCount(__cArray), "CAN message '%s' ID = 417001888x (0x18DAF1A0x) on bus FDCAN2", "DIAGNOSTIC_RESPONSE_PAM");
        if(__tt8cnt_31 == -1)
        {
          snprintf(__cArray2, 8192, "Response of %s", __cArray);
        snprintf(__cArray, 8192, "%s", __cActual);
        }
        else
        {
          snprintf(__cArray2, 8192, "Response of %s (received %d times)", __cArray, __tt8cnt_31);
          snprintf(__cArray, 8192, "Last Received");
        }
        if (__tt8cnt_31 == 0)
        {
          testStepFail(0, "Resp1", __cArray2);
        }
        else
        {
          byte __b0;
          byte __b1;
          byte __b2;
          byte __b3;
          byte __b4;
          byte __b5;
          byte __b6;
          __bVerdict = __eVerdictPass;
          __tableHandle = ReportTableHead5Columns(__cArray2, "Signal/Byte", __cTOp, __cRefVal, __cArray, __cRes);
        __csr = CheckSignalMatch(__tt8msg_30.byte((word)0), 0x6, "==") == 1;
        ReportByteIndex("", 0, __cArray, elCount(__cArray));
        snprintf(__cArray2, 8192, "%s", __cArray);
        snprintf(__cArray3, 8192, "%s", "");
        ReportTableRow(__tableHandle, 0, __cArray2, "==", 0x6, __cArray3, __oneOfFlag, __bSetInCheckAlignment);
        ReportCell(__tableHandle, __tt8msg_30.byte((word)0));
        ReportCellResult(__tableHandle, __csr, __ePassFail);
          __bVerdict &= __csr;
        __csr = CheckSignalMatch(__tt8msg_30.byte((word)1), 0x62, "==") == 1;
        ReportByteIndex("", 1, __cArray, elCount(__cArray));
        snprintf(__cArray2, 8192, "%s", __cArray);
        snprintf(__cArray3, 8192, "%s", "");
        ReportTableRow(__tableHandle, 0, __cArray2, "==", 0x62, __cArray3, __oneOfFlag, __bSetInCheckAlignment);
        ReportCell(__tableHandle, __tt8msg_30.byte((word)1));
        ReportCellResult(__tableHandle, __csr, __ePassFail);
          __bVerdict &= __csr;
        __csr = CheckSignalMatch(__tt8msg_30.byte((word)2), 0xF1, "==") == 1;
        ReportByteIndex("", 2, __cArray, elCount(__cArray));
        snprintf(__cArray2, 8192, "%s", __cArray);
        snprintf(__cArray3, 8192, "%s", "");
        ReportTableRow(__tableHandle, 0, __cArray2, "==", 0xF1, __cArray3, __oneOfFlag, __bSetInCheckAlignment);
        ReportCell(__tableHandle, __tt8msg_30.byte((word)2));
        ReportCellResult(__tableHandle, __csr, __ePassFail);
          __bVerdict &= __csr;
        __csr = CheckSignalMatch(__tt8msg_30.byte((word)3), 0x86, "==") == 1;
        ReportByteIndex("", 3, __cArray, elCount(__cArray));
        snprintf(__cArray2, 8192, "%s", __cArray);
        snprintf(__cArray3, 8192, "%s", "");
        ReportTableRow(__tableHandle, 0, __cArray2, "==", 0x86, __cArray3, __oneOfFlag, __bSetInCheckAlignment);
        ReportCell(__tableHandle, __tt8msg_30.byte((word)3));
        ReportCellResult(__tableHandle, __csr, __ePassFail);
          __bVerdict &= __csr;
        __csr = CheckSignalMatch(__tt8msg_30.byte((word)4), 0x2, "==") == 1;
        ReportByteIndex("", 4, __cArray, elCount(__cArray));
        snprintf(__cArray2, 8192, "%s", __cArray);
        snprintf(__cArray3, 8192, "%s", "");
        ReportTableRow(__tableHandle, 0, __cArray2, "==", 0x2, __cArray3, __oneOfFlag, __bSetInCheckAlignment);
        ReportCell(__tableHandle, __tt8msg_30.byte((word)4));
        ReportCellResult(__tableHandle, __csr, __ePassFail);
          __bVerdict &= __csr;
        __csr = CheckSignalMatch(__tt8msg_30.byte((word)5), 0x5, "==") == 1;
        ReportByteIndex("", 5, __cArray, elCount(__cArray));
        snprintf(__cArray2, 8192, "%s", __cArray);
        snprintf(__cArray3, 8192, "%s", "");
        ReportTableRow(__tableHandle, 0, __cArray2, "==", 0x5, __cArray3, __oneOfFlag, __bSetInCheckAlignment);
        ReportCell(__tableHandle, __tt8msg_30.byte((word)5));
        ReportCellResult(__tableHandle, __csr, __ePassFail);
          __bVerdict &= __csr;
        __csr = CheckSignalMatch(__tt8msg_30.byte((word)6), 0x0, "==") == 1;
        ReportByteIndex("", 6, __cArray, elCount(__cArray));
        snprintf(__cArray2, 8192, "%s", __cArray);
        snprintf(__cArray3, 8192, "%s", "");
        ReportTableRow(__tableHandle, 0, __cArray2, "==", 0x0, __cArray3, __oneOfFlag, __bSetInCheckAlignment);
        ReportCell(__tableHandle, __tt8msg_30.byte((word)6));
        ReportCellResult(__tableHandle, __csr, __ePassFail);
          __bVerdict &= __csr;
          ReportTableEndVerdict(__tableHandle, "Resp1", __bVerdict);
        }
        __ReportRequestResponseResult(__res, 0);
      }
      ResetBusContext(__nBusContextNew, __nBusContextOld);
    }
  }
  TestCommandEnd();

}

void Tto7tsimc_F186_DID_with_FunctionalAdd_DefaultSession()
{
  stack long __tableHandle;
  TestCommandBegin(__eDiagService, __cDiagService, "", "0");
  {
    if (DiagIsFunctionalGroup("CVADAS_0001_00000000_000"))
    {
      DiagResponse * __resp;
      DiagRequest CVADAS_0001_00000000_000._22F186_Active_Diagnostic_Session __req;
      __diagServiceo7tsimc_24(__req, __resp);
    }
    else
    {
      DiagResponse CVADAS_0001_00000000_000.* __resp;
      DiagRequest CVADAS_0001_00000000_000._22F186_Active_Diagnostic_Session __req;
      __diagServiceo7tsimc_24(__req, __resp);
    }
  }
  TestCommandEnd();


}

  
void __diagServiceo7tsimc_24(DiagRequest * __req, DiagResponse * __resp )
{
  stack long __tableHandle;
  long __res, __paramLen, __bytePos;

   __bVerdict = __eVerdictPass;

  do {
    TestReportResetDiagObjectList();
    DiagSetReportDetailLevel("CVADAS_0001_00000000_000", EnumServiceDetails_onfail);
    // Request aspect
    {

      if (0 >= DiagSendReqAndWaitForResp("CVADAS_0001_00000000_000", __req, __resp, __res, -1, -1, -1, -1, -1, EnumResult_pos, EnumServiceDetails_onfail, EnumSendingMode_physical, EnumSuppressPosResBit_asconfigured, EnumVerdictOnInvalidValues_fail))
        break;
    }

    __res = DiagErrCodeTestStep(__res, "Can't retrieve last response for request! No check possible.") < 0;
    if(__res)
    {
	  __bVerdict = __eVerdictFail;
      break;
    }
    {
      __res = DiagInterpretAs(__resp, "RDBI_PR");
      if(__res != 0)
      {
        __bVerdict = __eVerdictFail;
        DiagErrCodeTestStep(__res, "Can't interpret response as diagnostic primitive 'RDBI_PR'.");
        break;
      }
      else
      {
        TestStepPass( "Received primitive can be interpreted as diagnostic primitive 'RDBI_PR'.");
      }
    }
  }
  while(0);


  // Response, check & read aspect
  {
    __res = 1;
    __tableHandle = ReportTableHead5Columns(__cCheckCaption, __cTSym, __cTOp, __cRefVal, __cActual, __cRes);
    {
      __bDiagValueArrayCtr = DiagGetParameterErrorHandled(__resp, "_Active_Diagnostic_Session_24", __bDiagValueArray, elcount(__bDiagValueArray), __cDiagValueArray, elcount(__cDiagValueArray));
      {
        __bSetInCheckAlignment = 1;	
        {
          __bArrayCtr = __CopyBytes(__bDiagValueArray, __bDiagValueArrayCtr, __bArray);
          {
            sysvar * __systemVariable;
            __systemVariable = sysvarData::`PartNumber::`Part_Number;
            CheckSysVarSetBufferConsistency(sysSetVariableData(sysvarData::`PartNumber::`Part_Number, __bArray, __bArrayCtr), __systemVariable.name);
          }
          snprintf(__cArray, 8192, "%s", "Part_Number");
          snprintf(__cArray2, 8192, "%s '%s'", __cSysVar, __cArray);
          snprintf(__cArray3, 8192, "%s", "_Active_Diagnostic_Session_24");
          
          ReportTableRow(__tableHandle, 0, __cArray2, __cAOp, __bArray, __bArrayCtr, __cArray3, __oneOfFlag, __bSetInCheckAlignment);
        
        }
    
        __bSetInCheckAlignment = 0;
      }
    }
    {
      __bDiagValueArrayCtr = DiagGetParameterErrorHandled(__resp, "Authentication_Status", __bDiagValueArray, elcount(__bDiagValueArray), __cDiagValueArray, elcount(__cDiagValueArray));
      {
        __bSetInCheckAlignment = 1;	
        {
          __bArrayCtr = __CopyBytes(__bDiagValueArray, __bDiagValueArrayCtr, __bArray);
          {
            sysvar * __systemVariable;
            __systemVariable = sysvarData::`PartNumber::`Part_Number;
            CheckSysVarSetBufferConsistency(sysSetVariableData(sysvarData::`PartNumber::`Part_Number, __bArray, __bArrayCtr), __systemVariable.name);
          }
          snprintf(__cArray, 8192, "%s", "Part_Number");
          snprintf(__cArray2, 8192, "%s '%s'", __cSysVar, __cArray);
          snprintf(__cArray3, 8192, "%s", "Authentication_Status");
          
          ReportTableRow(__tableHandle, 0, __cArray2, __cAOp, __bArray, __bArrayCtr, __cArray3, __oneOfFlag, __bSetInCheckAlignment);
        
        }
    
        __bSetInCheckAlignment = 0;
      }
    }
    {
      __bDiagValueArrayCtr = DiagGetParameterErrorHandled(__resp, "Bitfield/Bitfield._Active_Diagnostic_Session_of_ECU__ECU_Software_Mode_32", __bDiagValueArray, elcount(__bDiagValueArray), __cDiagValueArray, elcount(__cDiagValueArray));
      {
        __bSetInCheckAlignment = 1;	
        {
          __bArrayCtr = __CopyBytes(__bDiagValueArray, __bDiagValueArrayCtr, __bArray);
          {
            sysvar * __systemVariable;
            __systemVariable = sysvarData::`PartNumber::`Part_Number;
            CheckSysVarSetBufferConsistency(sysSetVariableData(sysvarData::`PartNumber::`Part_Number, __bArray, __bArrayCtr), __systemVariable.name);
          }
          snprintf(__cArray, 8192, "%s", "Part_Number");
          snprintf(__cArray2, 8192, "%s '%s'", __cSysVar, __cArray);
          snprintf(__cArray3, 8192, "%s", "Bitfield/Bitfield._Active_Diagnostic_Session_of_ECU__ECU_Software_Mode_32");
          
          ReportTableRow(__tableHandle, 0, __cArray2, __cAOp, __bArray, __bArrayCtr, __cArray3, __oneOfFlag, __bSetInCheckAlignment);
        
        }
    
        __bSetInCheckAlignment = 0;
      }
    }
    ReportTableEndVerdict(__tableHandle, __cEvaluateResponse, __res);
	__bVerdict = __bVerdict && __res;
  }
  if (__bVerdict == __eVerdictFail)
    TestReportWriteDiagObjectList();
}

void Tto7tsimc_F186_DID_with_FunctionalAdd_ExtendedSession()
{
  stack long __tableHandle;
  TestCommandBegin(__eDiagService, __cDiagService, "", "0");
  {
    if (DiagIsFunctionalGroup("CVADAS_0001_00000000_000"))
    {
      DiagResponse * __resp;
      DiagRequest CVADAS_0001_00000000_000._22F186_Active_Diagnostic_Session __req;
      __diagServiceo7tsimc_25(__req, __resp);
    }
    else
    {
      DiagResponse CVADAS_0001_00000000_000.* __resp;
      DiagRequest CVADAS_0001_00000000_000._22F186_Active_Diagnostic_Session __req;
      __diagServiceo7tsimc_25(__req, __resp);
    }
  }
  TestCommandEnd();


}

  
void __diagServiceo7tsimc_25(DiagRequest * __req, DiagResponse * __resp )
{
  stack long __tableHandle;
  long __res, __paramLen, __bytePos;

   __bVerdict = __eVerdictPass;

  do {
    TestReportResetDiagObjectList();
    DiagSetReportDetailLevel("CVADAS_0001_00000000_000", EnumServiceDetails_onfail);
    // Request aspect
    {

      if (0 >= DiagSendReqAndWaitForResp("CVADAS_0001_00000000_000", __req, __resp, __res, -1, -1, -1, -1, -1, EnumResult_pos, EnumServiceDetails_onfail, EnumSendingMode_physical, EnumSuppressPosResBit_asconfigured, EnumVerdictOnInvalidValues_fail))
        break;
    }

    __res = DiagErrCodeTestStep(__res, "Can't retrieve last response for request! No check possible.") < 0;
    if(__res)
    {
	  __bVerdict = __eVerdictFail;
      break;
    }
    {
      __res = DiagInterpretAs(__resp, "RDBI_PR");
      if(__res != 0)
      {
        __bVerdict = __eVerdictFail;
        DiagErrCodeTestStep(__res, "Can't interpret response as diagnostic primitive 'RDBI_PR'.");
        break;
      }
      else
      {
        TestStepPass( "Received primitive can be interpreted as diagnostic primitive 'RDBI_PR'.");
      }
    }
  }
  while(0);


  // Response, check & read aspect
  {
    __res = 1;
    __tableHandle = ReportTableHead5Columns(__cCheckCaption, __cTSym, __cTOp, __cRefVal, __cActual, __cRes);
    {
      __bDiagValueArrayCtr = DiagGetParameterErrorHandled(__resp, "_Active_Diagnostic_Session_24", __bDiagValueArray, elcount(__bDiagValueArray), __cDiagValueArray, elcount(__cDiagValueArray));
      {
        __bSetInCheckAlignment = 1;	
        {
          __bArrayCtr = __CopyBytes(__bDiagValueArray, __bDiagValueArrayCtr, __bArray);
          {
            sysvar * __systemVariable;
            __systemVariable = sysvarData::`PartNumber::`Part_Number;
            CheckSysVarSetBufferConsistency(sysSetVariableData(sysvarData::`PartNumber::`Part_Number, __bArray, __bArrayCtr), __systemVariable.name);
          }
          snprintf(__cArray, 8192, "%s", "Part_Number");
          snprintf(__cArray2, 8192, "%s '%s'", __cSysVar, __cArray);
          snprintf(__cArray3, 8192, "%s", "_Active_Diagnostic_Session_24");
          
          ReportTableRow(__tableHandle, 0, __cArray2, __cAOp, __bArray, __bArrayCtr, __cArray3, __oneOfFlag, __bSetInCheckAlignment);
        
        }
    
        __bSetInCheckAlignment = 0;
      }
    }
    {
      __bDiagValueArrayCtr = DiagGetParameterErrorHandled(__resp, "Authentication_Status", __bDiagValueArray, elcount(__bDiagValueArray), __cDiagValueArray, elcount(__cDiagValueArray));
      {
        __bSetInCheckAlignment = 1;	
        {
          __bArrayCtr = __CopyBytes(__bDiagValueArray, __bDiagValueArrayCtr, __bArray);
          {
            sysvar * __systemVariable;
            __systemVariable = sysvarData::`PartNumber::`Part_Number;
            CheckSysVarSetBufferConsistency(sysSetVariableData(sysvarData::`PartNumber::`Part_Number, __bArray, __bArrayCtr), __systemVariable.name);
          }
          snprintf(__cArray, 8192, "%s", "Part_Number");
          snprintf(__cArray2, 8192, "%s '%s'", __cSysVar, __cArray);
          snprintf(__cArray3, 8192, "%s", "Authentication_Status");
          
          ReportTableRow(__tableHandle, 0, __cArray2, __cAOp, __bArray, __bArrayCtr, __cArray3, __oneOfFlag, __bSetInCheckAlignment);
        
        }
    
        __bSetInCheckAlignment = 0;
      }
    }
    {
      __bDiagValueArrayCtr = DiagGetParameterErrorHandled(__resp, "Bitfield/Bitfield._Active_Diagnostic_Session_of_ECU__ECU_Software_Mode_32", __bDiagValueArray, elcount(__bDiagValueArray), __cDiagValueArray, elcount(__cDiagValueArray));
      {
        __bSetInCheckAlignment = 1;	
        {
          __bArrayCtr = __CopyBytes(__bDiagValueArray, __bDiagValueArrayCtr, __bArray);
          {
            sysvar * __systemVariable;
            __systemVariable = sysvarData::`PartNumber::`Part_Number;
            CheckSysVarSetBufferConsistency(sysSetVariableData(sysvarData::`PartNumber::`Part_Number, __bArray, __bArrayCtr), __systemVariable.name);
          }
          snprintf(__cArray, 8192, "%s", "Part_Number");
          snprintf(__cArray2, 8192, "%s '%s'", __cSysVar, __cArray);
          snprintf(__cArray3, 8192, "%s", "Bitfield/Bitfield._Active_Diagnostic_Session_of_ECU__ECU_Software_Mode_32");
          
          ReportTableRow(__tableHandle, 0, __cArray2, __cAOp, __bArray, __bArrayCtr, __cArray3, __oneOfFlag, __bSetInCheckAlignment);
        
        }
    
        __bSetInCheckAlignment = 0;
      }
    }
    ReportTableEndVerdict(__tableHandle, __cEvaluateResponse, __res);
	__bVerdict = __bVerdict && __res;
  }
  if (__bVerdict == __eVerdictFail)
    TestReportWriteDiagObjectList();
}

void Tto7tsimc_F186_DID_with_FunctionalAdd_ProgrammingSession()
{
  stack long __tableHandle;
  TestCommandBegin(__eWait, __cWait, "", "0");
  {
    Wait("1", (1100 * 1000000LL), 1000000, "");
  }
  TestCommandEnd();

  TestCommandBegin(__eDiagService, __cDiagService, "", "1");
  {
    if (DiagIsFunctionalGroup("CVADAS_0001_00000000_000"))
    {
      DiagResponse * __resp;
      DiagRequest CVADAS_0001_00000000_000._22F186_Active_Diagnostic_Session __req;
      __diagServiceo7tsimc_26(__req, __resp);
    }
    else
    {
      DiagResponse CVADAS_0001_00000000_000.* __resp;
      DiagRequest CVADAS_0001_00000000_000._22F186_Active_Diagnostic_Session __req;
      __diagServiceo7tsimc_26(__req, __resp);
    }
  }
  TestCommandEnd();


}

  
void __diagServiceo7tsimc_26(DiagRequest * __req, DiagResponse * __resp )
{
  stack long __tableHandle;
  long __res, __paramLen, __bytePos;

   __bVerdict = __eVerdictPass;

  do {
    TestReportResetDiagObjectList();
    DiagSetReportDetailLevel("CVADAS_0001_00000000_000", EnumServiceDetails_onfail);
    // Request aspect
    {

      if (0 >= DiagSendReqAndWaitForResp("CVADAS_0001_00000000_000", __req, __resp, __res, -1, -1, -1, -1, -1, EnumResult_pos, EnumServiceDetails_onfail, EnumSendingMode_physical, EnumSuppressPosResBit_asconfigured, EnumVerdictOnInvalidValues_fail))
        break;
    }

    __res = DiagErrCodeTestStep(__res, "Can't retrieve last response for request! No check possible.") < 0;
    if(__res)
    {
	  __bVerdict = __eVerdictFail;
      break;
    }
    {
      __res = DiagInterpretAs(__resp, "RDBI_PR");
      if(__res != 0)
      {
        __bVerdict = __eVerdictFail;
        DiagErrCodeTestStep(__res, "Can't interpret response as diagnostic primitive 'RDBI_PR'.");
        break;
      }
      else
      {
        TestStepPass( "Received primitive can be interpreted as diagnostic primitive 'RDBI_PR'.");
      }
    }
  }
  while(0);


  // Response, check & read aspect
  {
    __res = 1;
    __tableHandle = ReportTableHead5Columns(__cCheckCaption, __cTSym, __cTOp, __cRefVal, __cActual, __cRes);
    {
      __bDiagValueArrayCtr = DiagGetParameterErrorHandled(__resp, "_Active_Diagnostic_Session_24", __bDiagValueArray, elcount(__bDiagValueArray), __cDiagValueArray, elcount(__cDiagValueArray));
      {
        __bSetInCheckAlignment = 1;	
        {
          __bArrayCtr = __CopyBytes(__bDiagValueArray, __bDiagValueArrayCtr, __bArray);
          {
            sysvar * __systemVariable;
            __systemVariable = sysvarData::`PartNumber::`Part_Number;
            CheckSysVarSetBufferConsistency(sysSetVariableData(sysvarData::`PartNumber::`Part_Number, __bArray, __bArrayCtr), __systemVariable.name);
          }
          snprintf(__cArray, 8192, "%s", "Part_Number");
          snprintf(__cArray2, 8192, "%s '%s'", __cSysVar, __cArray);
          snprintf(__cArray3, 8192, "%s", "_Active_Diagnostic_Session_24");
          
          ReportTableRow(__tableHandle, 0, __cArray2, __cAOp, __bArray, __bArrayCtr, __cArray3, __oneOfFlag, __bSetInCheckAlignment);
        
        }
    
        __bSetInCheckAlignment = 0;
      }
    }
    {
      __bDiagValueArrayCtr = DiagGetParameterErrorHandled(__resp, "Authentication_Status", __bDiagValueArray, elcount(__bDiagValueArray), __cDiagValueArray, elcount(__cDiagValueArray));
      {
        __bSetInCheckAlignment = 1;	
        {
          __bArrayCtr = __CopyBytes(__bDiagValueArray, __bDiagValueArrayCtr, __bArray);
          {
            sysvar * __systemVariable;
            __systemVariable = sysvarData::`PartNumber::`Part_Number;
            CheckSysVarSetBufferConsistency(sysSetVariableData(sysvarData::`PartNumber::`Part_Number, __bArray, __bArrayCtr), __systemVariable.name);
          }
          snprintf(__cArray, 8192, "%s", "Part_Number");
          snprintf(__cArray2, 8192, "%s '%s'", __cSysVar, __cArray);
          snprintf(__cArray3, 8192, "%s", "Authentication_Status");
          
          ReportTableRow(__tableHandle, 0, __cArray2, __cAOp, __bArray, __bArrayCtr, __cArray3, __oneOfFlag, __bSetInCheckAlignment);
        
        }
    
        __bSetInCheckAlignment = 0;
      }
    }
    {
      __bDiagValueArrayCtr = DiagGetParameterErrorHandled(__resp, "Bitfield/Bitfield._Active_Diagnostic_Session_of_ECU__ECU_Software_Mode_32", __bDiagValueArray, elcount(__bDiagValueArray), __cDiagValueArray, elcount(__cDiagValueArray));
      {
        __bSetInCheckAlignment = 1;	
        {
          __bArrayCtr = __CopyBytes(__bDiagValueArray, __bDiagValueArrayCtr, __bArray);
          {
            sysvar * __systemVariable;
            __systemVariable = sysvarData::`PartNumber::`Part_Number;
            CheckSysVarSetBufferConsistency(sysSetVariableData(sysvarData::`PartNumber::`Part_Number, __bArray, __bArrayCtr), __systemVariable.name);
          }
          snprintf(__cArray, 8192, "%s", "Part_Number");
          snprintf(__cArray2, 8192, "%s '%s'", __cSysVar, __cArray);
          snprintf(__cArray3, 8192, "%s", "Bitfield/Bitfield._Active_Diagnostic_Session_of_ECU__ECU_Software_Mode_32");
          
          ReportTableRow(__tableHandle, 0, __cArray2, __cAOp, __bArray, __bArrayCtr, __cArray3, __oneOfFlag, __bSetInCheckAlignment);
        
        }
    
        __bSetInCheckAlignment = 0;
      }
    }
    ReportTableEndVerdict(__tableHandle, __cEvaluateResponse, __res);
	__bVerdict = __bVerdict && __res;
  }
  if (__bVerdict == __eVerdictFail)
    TestReportWriteDiagObjectList();
}

void Tto7tsimc_F10D_DID_with_Physical_Address()
{
  stack long __tableHandle;
  TestCommandBegin(__eDiagService, __cDiagService, "", "0");
  {
    if (DiagIsFunctionalGroup("CVADAS_0001_00000000_000"))
    {
      DiagResponse * __resp;
      DiagRequest CVADAS_0001_00000000_000._22F10D_Diagnostic_Specification_Information __req;
      __diagServiceo7tsimc_27(__req, __resp);
    }
    else
    {
      DiagResponse CVADAS_0001_00000000_000.* __resp;
      DiagRequest CVADAS_0001_00000000_000._22F10D_Diagnostic_Specification_Information __req;
      __diagServiceo7tsimc_27(__req, __resp);
    }
  }
  TestCommandEnd();


}

  
void __diagServiceo7tsimc_27(DiagRequest * __req, DiagResponse * __resp )
{
  stack long __tableHandle;
  long __res, __paramLen, __bytePos;

   __bVerdict = __eVerdictPass;

  do {
    TestReportResetDiagObjectList();
    DiagSetReportDetailLevel("CVADAS_0001_00000000_000", EnumServiceDetails_onfail);
    // Request aspect
    {

      if (0 >= DiagSendReqAndWaitForResp("CVADAS_0001_00000000_000", __req, __resp, __res, -1, -1, -1, -1, -1, EnumResult_pos, EnumServiceDetails_onfail, EnumSendingMode_functional, EnumSuppressPosResBit_asconfigured, EnumVerdictOnInvalidValues_fail))
        break;
    }

    __res = DiagErrCodeTestStep(__res, "Can't retrieve last response for request! No check possible.") < 0;
    if(__res)
    {
	  __bVerdict = __eVerdictFail;
      break;
    }
    {
      __res = DiagInterpretAs(__resp, "RDBI_PR");
      if(__res != 0)
      {
        __bVerdict = __eVerdictFail;
        DiagErrCodeTestStep(__res, "Can't interpret response as diagnostic primitive 'RDBI_PR'.");
        break;
      }
      else
      {
        TestStepPass( "Received primitive can be interpreted as diagnostic primitive 'RDBI_PR'.");
      }
    }
  }
  while(0);


  // Response, check & read aspect
  {
    __res = 1;
    __tableHandle = ReportTableHead5Columns(__cCheckCaption, __cTSym, __cTOp, __cRefVal, __cActual, __cRes);
    {
      __bDiagValueArrayCtr = DiagGetParameterErrorHandled(__resp, "_Diagnostic_Requirements_Standard_Version_48", __bDiagValueArray, elcount(__bDiagValueArray), __cDiagValueArray, elcount(__cDiagValueArray));
      {
        __bSetInCheckAlignment = 1;	
        {
          __bArrayCtr = __CopyBytes(__bDiagValueArray, __bDiagValueArrayCtr, __bArray);
          {
            sysvar * __systemVariable;
            __systemVariable = sysvarData::`PartNumber::`Part_Number;
            CheckSysVarSetBufferConsistency(sysSetVariableData(sysvarData::`PartNumber::`Part_Number, __bArray, __bArrayCtr), __systemVariable.name);
          }
          snprintf(__cArray, 8192, "%s", "Part_Number");
          snprintf(__cArray2, 8192, "%s '%s'", __cSysVar, __cArray);
          snprintf(__cArray3, 8192, "%s", "_Diagnostic_Requirements_Standard_Version_48");
          
          ReportTableRow(__tableHandle, 0, __cArray2, __cAOp, __bArray, __bArrayCtr, __cArray3, __oneOfFlag, __bSetInCheckAlignment);
        
        }
    
        __bSetInCheckAlignment = 0;
      }
    }
    {
      __bDiagValueArrayCtr = DiagGetParameterErrorHandled(__resp, "_ECU_Flash_Reprogramming_Requirements_Version_32", __bDiagValueArray, elcount(__bDiagValueArray), __cDiagValueArray, elcount(__cDiagValueArray));
      {
        __bSetInCheckAlignment = 1;	
        {
          __bArrayCtr = __CopyBytes(__bDiagValueArray, __bDiagValueArrayCtr, __bArray);
          {
            sysvar * __systemVariable;
            __systemVariable = sysvarData::`PartNumber::`Part_Number;
            CheckSysVarSetBufferConsistency(sysSetVariableData(sysvarData::`PartNumber::`Part_Number, __bArray, __bArrayCtr), __systemVariable.name);
          }
          snprintf(__cArray, 8192, "%s", "Part_Number");
          snprintf(__cArray2, 8192, "%s '%s'", __cSysVar, __cArray);
          snprintf(__cArray3, 8192, "%s", "_ECU_Flash_Reprogramming_Requirements_Version_32");
          
          ReportTableRow(__tableHandle, 0, __cArray2, __cAOp, __bArray, __bArrayCtr, __cArray3, __oneOfFlag, __bSetInCheckAlignment);
        
        }
    
        __bSetInCheckAlignment = 0;
      }
    }
    {
      __bDiagValueArrayCtr = DiagGetParameterErrorHandled(__resp, "_Standard_Diagnostic_Data_UDS_Version_40", __bDiagValueArray, elcount(__bDiagValueArray), __cDiagValueArray, elcount(__cDiagValueArray));
      {
        __bSetInCheckAlignment = 1;	
        {
          __bArrayCtr = __CopyBytes(__bDiagValueArray, __bDiagValueArrayCtr, __bArray);
          {
            sysvar * __systemVariable;
            __systemVariable = sysvarData::`PartNumber::`Part_Number;
            CheckSysVarSetBufferConsistency(sysSetVariableData(sysvarData::`PartNumber::`Part_Number, __bArray, __bArrayCtr), __systemVariable.name);
          }
          snprintf(__cArray, 8192, "%s", "Part_Number");
          snprintf(__cArray2, 8192, "%s '%s'", __cSysVar, __cArray);
          snprintf(__cArray3, 8192, "%s", "_Standard_Diagnostic_Data_UDS_Version_40");
          
          ReportTableRow(__tableHandle, 0, __cArray2, __cAOp, __bArray, __bArrayCtr, __cArray3, __oneOfFlag, __bSetInCheckAlignment);
        
        }
    
        __bSetInCheckAlignment = 0;
      }
    }
    {
      __bDiagValueArrayCtr = DiagGetParameterErrorHandled(__resp, "_Standard_Diagnostic_Data_UDS_Version_40", __bDiagValueArray, elcount(__bDiagValueArray), __cDiagValueArray, elcount(__cDiagValueArray));
      {
        __bSetInCheckAlignment = 1;	
        {
          __bArrayCtr = __CopyBytes(__bDiagValueArray, __bDiagValueArrayCtr, __bArray);
          {
            sysvar * __systemVariable;
            __systemVariable = sysvarData::`PartNumber::`Part_Number;
            CheckSysVarSetBufferConsistency(sysSetVariableData(sysvarData::`PartNumber::`Part_Number, __bArray, __bArrayCtr), __systemVariable.name);
          }
          snprintf(__cArray, 8192, "%s", "Part_Number");
          snprintf(__cArray2, 8192, "%s '%s'", __cSysVar, __cArray);
          snprintf(__cArray3, 8192, "%s", "_Standard_Diagnostic_Data_UDS_Version_40");
          
          ReportTableRow(__tableHandle, 0, __cArray2, __cAOp, __bArray, __bArrayCtr, __cArray3, __oneOfFlag, __bSetInCheckAlignment);
        
        }
    
        __bSetInCheckAlignment = 0;
      }
    }
    ReportTableEndVerdict(__tableHandle, __cEvaluateResponse, __res);
	__bVerdict = __bVerdict && __res;
  }
  if (__bVerdict == __eVerdictFail)
    TestReportWriteDiagObjectList();
}

void Tto7tsimc_F10D_DID_with_Functional_Address()
{
  stack long __tableHandle;
  TestCommandBegin(__eDiagService, __cDiagService, "", "0");
  {
    if (DiagIsFunctionalGroup("CVADAS_0001_00000000_000"))
    {
      DiagResponse * __resp;
      DiagRequest CVADAS_0001_00000000_000._22F10D_Diagnostic_Specification_Information __req;
      __diagServiceo7tsimc_28(__req, __resp);
    }
    else
    {
      DiagResponse CVADAS_0001_00000000_000.* __resp;
      DiagRequest CVADAS_0001_00000000_000._22F10D_Diagnostic_Specification_Information __req;
      __diagServiceo7tsimc_28(__req, __resp);
    }
  }
  TestCommandEnd();


}

  
void __diagServiceo7tsimc_28(DiagRequest * __req, DiagResponse * __resp )
{
  stack long __tableHandle;
  long __res, __paramLen, __bytePos;

   __bVerdict = __eVerdictPass;

  do {
    TestReportResetDiagObjectList();
    DiagSetReportDetailLevel("CVADAS_0001_00000000_000", EnumServiceDetails_onfail);
    // Request aspect
    {

      if (0 >= DiagSendReqAndWaitForResp("CVADAS_0001_00000000_000", __req, __resp, __res, -1, -1, -1, -1, -1, EnumResult_pos, EnumServiceDetails_onfail, EnumSendingMode_physical, EnumSuppressPosResBit_asconfigured, EnumVerdictOnInvalidValues_fail))
        break;
    }

    __res = DiagErrCodeTestStep(__res, "Can't retrieve last response for request! No check possible.") < 0;
    if(__res)
    {
	  __bVerdict = __eVerdictFail;
      break;
    }
    {
      __res = DiagInterpretAs(__resp, "RDBI_PR");
      if(__res != 0)
      {
        __bVerdict = __eVerdictFail;
        DiagErrCodeTestStep(__res, "Can't interpret response as diagnostic primitive 'RDBI_PR'.");
        break;
      }
      else
      {
        TestStepPass( "Received primitive can be interpreted as diagnostic primitive 'RDBI_PR'.");
      }
    }
  }
  while(0);


  // Response, check & read aspect
  {
    __res = 1;
    __tableHandle = ReportTableHead5Columns(__cCheckCaption, __cTSym, __cTOp, __cRefVal, __cActual, __cRes);
    {
      __bDiagValueArrayCtr = DiagGetParameterErrorHandled(__resp, "_Diagnostic_Requirements_Standard_Version_48", __bDiagValueArray, elcount(__bDiagValueArray), __cDiagValueArray, elcount(__cDiagValueArray));
      {
        __bSetInCheckAlignment = 1;	
        {
          __bArrayCtr = __CopyBytes(__bDiagValueArray, __bDiagValueArrayCtr, __bArray);
          {
            sysvar * __systemVariable;
            __systemVariable = sysvarData::`PartNumber::`Part_Number;
            CheckSysVarSetBufferConsistency(sysSetVariableData(sysvarData::`PartNumber::`Part_Number, __bArray, __bArrayCtr), __systemVariable.name);
          }
          snprintf(__cArray, 8192, "%s", "Part_Number");
          snprintf(__cArray2, 8192, "%s '%s'", __cSysVar, __cArray);
          snprintf(__cArray3, 8192, "%s", "_Diagnostic_Requirements_Standard_Version_48");
          
          ReportTableRow(__tableHandle, 0, __cArray2, __cAOp, __bArray, __bArrayCtr, __cArray3, __oneOfFlag, __bSetInCheckAlignment);
        
        }
    
        __bSetInCheckAlignment = 0;
      }
    }
    {
      __bDiagValueArrayCtr = DiagGetParameterErrorHandled(__resp, "_ECU_Flash_Reprogramming_Requirements_Version_32", __bDiagValueArray, elcount(__bDiagValueArray), __cDiagValueArray, elcount(__cDiagValueArray));
      {
        __bSetInCheckAlignment = 1;	
        {
          __bArrayCtr = __CopyBytes(__bDiagValueArray, __bDiagValueArrayCtr, __bArray);
          {
            sysvar * __systemVariable;
            __systemVariable = sysvarData::`PartNumber::`Part_Number;
            CheckSysVarSetBufferConsistency(sysSetVariableData(sysvarData::`PartNumber::`Part_Number, __bArray, __bArrayCtr), __systemVariable.name);
          }
          snprintf(__cArray, 8192, "%s", "Part_Number");
          snprintf(__cArray2, 8192, "%s '%s'", __cSysVar, __cArray);
          snprintf(__cArray3, 8192, "%s", "_ECU_Flash_Reprogramming_Requirements_Version_32");
          
          ReportTableRow(__tableHandle, 0, __cArray2, __cAOp, __bArray, __bArrayCtr, __cArray3, __oneOfFlag, __bSetInCheckAlignment);
        
        }
    
        __bSetInCheckAlignment = 0;
      }
    }
    {
      __bDiagValueArrayCtr = DiagGetParameterErrorHandled(__resp, "_Standard_Diagnostic_Data_UDS_Version_40", __bDiagValueArray, elcount(__bDiagValueArray), __cDiagValueArray, elcount(__cDiagValueArray));
      {
        __bSetInCheckAlignment = 1;	
        {
          __bArrayCtr = __CopyBytes(__bDiagValueArray, __bDiagValueArrayCtr, __bArray);
          {
            sysvar * __systemVariable;
            __systemVariable = sysvarData::`PartNumber::`Part_Number;
            CheckSysVarSetBufferConsistency(sysSetVariableData(sysvarData::`PartNumber::`Part_Number, __bArray, __bArrayCtr), __systemVariable.name);
          }
          snprintf(__cArray, 8192, "%s", "Part_Number");
          snprintf(__cArray2, 8192, "%s '%s'", __cSysVar, __cArray);
          snprintf(__cArray3, 8192, "%s", "_Standard_Diagnostic_Data_UDS_Version_40");
          
          ReportTableRow(__tableHandle, 0, __cArray2, __cAOp, __bArray, __bArrayCtr, __cArray3, __oneOfFlag, __bSetInCheckAlignment);
        
        }
    
        __bSetInCheckAlignment = 0;
      }
    }
    {
      __bDiagValueArrayCtr = DiagGetParameterErrorHandled(__resp, "_Standard_Diagnostic_Data_UDS_Version_40", __bDiagValueArray, elcount(__bDiagValueArray), __cDiagValueArray, elcount(__cDiagValueArray));
      {
        __bSetInCheckAlignment = 1;	
        {
          __bArrayCtr = __CopyBytes(__bDiagValueArray, __bDiagValueArrayCtr, __bArray);
          {
            sysvar * __systemVariable;
            __systemVariable = sysvarData::`PartNumber::`Part_Number;
            CheckSysVarSetBufferConsistency(sysSetVariableData(sysvarData::`PartNumber::`Part_Number, __bArray, __bArrayCtr), __systemVariable.name);
          }
          snprintf(__cArray, 8192, "%s", "Part_Number");
          snprintf(__cArray2, 8192, "%s '%s'", __cSysVar, __cArray);
          snprintf(__cArray3, 8192, "%s", "_Standard_Diagnostic_Data_UDS_Version_40");
          
          ReportTableRow(__tableHandle, 0, __cArray2, __cAOp, __bArray, __bArrayCtr, __cArray3, __oneOfFlag, __bSetInCheckAlignment);
        
        }
    
        __bSetInCheckAlignment = 0;
      }
    }
    ReportTableEndVerdict(__tableHandle, __cEvaluateResponse, __res);
	__bVerdict = __bVerdict && __res;
  }
  if (__bVerdict == __eVerdictFail)
    TestReportWriteDiagObjectList();
}

void Tto7tsimc_F10D_DID_with_Standard_Physical_Address()
{
  stack long __tableHandle;
  TestCommandBegin(__eRequestResponse, __cRequestResponse, "", "0");
  {
  
    long __res;
    int64 __timeout;
    __res = 0;
    __nInt64 = 1;
    __timeout = syspar::`P2_Server * 1000000LL;
    {
    
      long __testStepInitOk;
      message `FDCAN2::`DIAGNOSTIC_REQUEST_PAM __output;
      message `FDCAN2::`DIAGNOSTIC_REQUEST_PAM __msgOrig;
      __output = __msgOrig;
      __testStepInitOk = 1;
      snprintf(__cArray, elCount(__cArray), "CAN message '%s' ID = 416981233x (0x18DAA0F1x) on bus FDCAN2", "DIAGNOSTIC_REQUEST_PAM");
      snprintf(__cArray2, elCount(__cArray2), "Send %s", __cArray);
      __tableHandle = ReportTableHead3Columns(__cArray2, "Byte", __cTOp, __cAssigned);
      ReportByteIndex("", 0, __cArray, elCount(__cArray));
      snprintf(__cArray2, 8192, "%s", __cArray);
      snprintf(__cArray3, 8192, "%s", "");
      
      ReportTableRow(__tableHandle, 0, __cArray2, __cAOp, 0x3, __cArray3, __oneOfFlag, __bSetInCheckAlignment);
      
      if (0 >= 0 && 0 < 64)
      {
        __output.byte((word)0) = 0x3;
      }
      else
      {
        testStepErrorInTestSystem(0, __cEmpty, "Index out of range. Unable to set byte %lld in message. Please check input parameter.", (int64)0);
        __testStepInitOk = 0;
      }
      ReportByteIndex("", 1, __cArray, elCount(__cArray));
      snprintf(__cArray2, 8192, "%s", __cArray);
      snprintf(__cArray3, 8192, "%s", "");
      
      ReportTableRow(__tableHandle, 0, __cArray2, __cAOp, 0x22, __cArray3, __oneOfFlag, __bSetInCheckAlignment);
      
      if (1 >= 0 && 1 < 64)
      {
        __output.byte((word)1) = 0x22;
      }
      else
      {
        testStepErrorInTestSystem(0, __cEmpty, "Index out of range. Unable to set byte %lld in message. Please check input parameter.", (int64)1);
        __testStepInitOk = 0;
      }
      ReportByteIndex("", 2, __cArray, elCount(__cArray));
      snprintf(__cArray2, 8192, "%s", __cArray);
      snprintf(__cArray3, 8192, "%s", "");
      
      ReportTableRow(__tableHandle, 0, __cArray2, __cAOp, 0xF1, __cArray3, __oneOfFlag, __bSetInCheckAlignment);
      
      if (2 >= 0 && 2 < 64)
      {
        __output.byte((word)2) = 0xF1;
      }
      else
      {
        testStepErrorInTestSystem(0, __cEmpty, "Index out of range. Unable to set byte %lld in message. Please check input parameter.", (int64)2);
        __testStepInitOk = 0;
      }
      ReportByteIndex("", 3, __cArray, elCount(__cArray));
      snprintf(__cArray2, 8192, "%s", __cArray);
      snprintf(__cArray3, 8192, "%s", "");
      
      ReportTableRow(__tableHandle, 0, __cArray2, __cAOp, 0xD, __cArray3, __oneOfFlag, __bSetInCheckAlignment);
      
      if (3 >= 0 && 3 < 64)
      {
        __output.byte((word)3) = 0xD;
      }
      else
      {
        testStepErrorInTestSystem(0, __cEmpty, "Index out of range. Unable to set byte %lld in message. Please check input parameter.", (int64)3);
        __testStepInitOk = 0;
      }
    
      ReportTableEndTestStep(__tableHandle, "Req1");
      if (__testStepInitOk)
      {
        output(__output);
      }
    }
    if (__timeout <= 0)
    {
      testStepErrorInTestSystem(0, "1", "Unable to wait for %.3f %s. Please check input parameter.", __timeout / ((float)1000000), "ms");
    }
    else
    {
      __tt8cnt_33 = 0;
      snprintf(__cArray, elCount(__cArray), "CAN message '%s' ID = 417001888x (0x18DAF1A0x) on bus FDCAN2", "DIAGNOSTIC_RESPONSE_PAM");
      if(SetBusContextByName("FDCAN2", __eSaveCurrent, __nBusContextNew, __nBusContextOld))
        testJoinMessageEvent(`FDCAN2::`DIAGNOSTIC_RESPONSE_PAM,  __cArray,
             delegate dword(message * __m)
             {
               dword __msg_callback_ret;
               if (__tt8cnt_33 == -1)
               {
                 return 1;
               }
               __msg_callback_ret = 1;
               __tt8cnt_33++;
               if (__msg_callback_ret)
               {
                 __tt8cnt_33 = -1;
                 return 1;
               }
               return 0;
             });
      __res = testWaitForAllJoinedEventsNS(__timeout);
      if (__nInt64 != 0)
      {
        snprintf(__cArray, elCount(__cArray), "CAN message '%s' ID = 417001888x (0x18DAF1A0x) on bus FDCAN2", "DIAGNOSTIC_RESPONSE_PAM");
        if(__tt8cnt_33 == -1)
        {
          snprintf(__cArray2, 8192, "Response of %s", __cArray);
        }
        else
        {
          snprintf(__cArray2, 8192, "Response of %s (received %d times)", __cArray, __tt8cnt_33);
        }
        if (__tt8cnt_33 == 0)
        {
          testStepFail(0, "Resp1", __cArray2);
        }
        else
        {
          testStepPass(2, "Resp1", __cArray2);
        }
        __ReportRequestResponseResult(__res, 0);
      }
      ResetBusContext(__nBusContextNew, __nBusContextOld);
    }
  }
  TestCommandEnd();

}

void Tto7tsimc_F112_DID_with_Physical_Addressing()
{
  stack long __tableHandle;
  TestCommandBegin(__eDiagService, __cDiagService, "", "0");
  {
    if (DiagIsFunctionalGroup("CVADAS_0001_00000000_000"))
    {
      DiagResponse * __resp;
      DiagRequest CVADAS_0001_00000000_000._22F112_PTESLM_Hardware_Number __req;
      __diagServiceo7tsimc_29(__req, __resp);
    }
    else
    {
      DiagResponse CVADAS_0001_00000000_000.* __resp;
      DiagRequest CVADAS_0001_00000000_000._22F112_PTESLM_Hardware_Number __req;
      __diagServiceo7tsimc_29(__req, __resp);
    }
  }
  TestCommandEnd();


}

  
void __diagServiceo7tsimc_29(DiagRequest * __req, DiagResponse * __resp )
{
  stack long __tableHandle;
  long __res, __paramLen, __bytePos;

   __bVerdict = __eVerdictPass;

  do {
    TestReportResetDiagObjectList();
    DiagSetReportDetailLevel("CVADAS_0001_00000000_000", EnumServiceDetails_onfail);
    // Request aspect
    {

      if (0 >= DiagSendReqAndWaitForResp("CVADAS_0001_00000000_000", __req, __resp, __res, -1, -1, -1, -1, -1, EnumResult_pos, EnumServiceDetails_onfail, EnumSendingMode_physical, EnumSuppressPosResBit_asconfigured, EnumVerdictOnInvalidValues_fail))
        break;
    }

    __res = DiagErrCodeTestStep(__res, "Can't retrieve last response for request! No check possible.") < 0;
    if(__res)
    {
	  __bVerdict = __eVerdictFail;
      break;
    }
    {
      __res = DiagInterpretAs(__resp, "RDBI_PR");
      if(__res != 0)
      {
        __bVerdict = __eVerdictFail;
        DiagErrCodeTestStep(__res, "Can't interpret response as diagnostic primitive 'RDBI_PR'.");
        break;
      }
      else
      {
        TestStepPass( "Received primitive can be interpreted as diagnostic primitive 'RDBI_PR'.");
      }
    }
  }
  while(0);


  // Response, check & read aspect
  {
    __res = 1;
    __tableHandle = ReportTableHead5Columns(__cCheckCaption, __cTSym, __cTOp, __cRefVal, __cActual, __cRes);
    {
      __bDiagValueArrayCtr = DiagGetParameterErrorHandled(__resp, "_Hardware_EBOM_Part_Number_24", __bDiagValueArray, elcount(__bDiagValueArray), __cDiagValueArray, elcount(__cDiagValueArray));
      {
        __bSetInCheckAlignment = 1;	
        {
          __bArrayCtr = __CopyBytes(__bDiagValueArray, __bDiagValueArrayCtr, __bArray);
          {
            sysvar * __systemVariable;
            __systemVariable = sysvarData::`PartNumber::`Part_Number;
            CheckSysVarSetBufferConsistency(sysSetVariableData(sysvarData::`PartNumber::`Part_Number, __bArray, __bArrayCtr), __systemVariable.name);
          }
          snprintf(__cArray, 8192, "%s", "Part_Number");
          snprintf(__cArray2, 8192, "%s '%s'", __cSysVar, __cArray);
          snprintf(__cArray3, 8192, "%s", "_Hardware_EBOM_Part_Number_24");
          
          ReportTableRow(__tableHandle, 0, __cArray2, __cAOp, __bArray, __bArrayCtr, __cArray3, __oneOfFlag, __bSetInCheckAlignment);
        
        }
    
        __bSetInCheckAlignment = 0;
      }
    }
    ReportTableEndVerdict(__tableHandle, __cEvaluateResponse, __res);
	__bVerdict = __bVerdict && __res;
  }
  if (__bVerdict == __eVerdictFail)
    TestReportWriteDiagObjectList();
}

void Tto7tsimc_F112_DID_with_Functional_Address()
{
  stack long __tableHandle;
  TestCommandBegin(__eDiagService, __cDiagService, "", "0");
  {
    if (DiagIsFunctionalGroup("CVADAS_0001_00000000_000"))
    {
      DiagResponse * __resp;
      DiagRequest CVADAS_0001_00000000_000._22F112_PTESLM_Hardware_Number __req;
      __diagServiceo7tsimc_30(__req, __resp);
    }
    else
    {
      DiagResponse CVADAS_0001_00000000_000.* __resp;
      DiagRequest CVADAS_0001_00000000_000._22F112_PTESLM_Hardware_Number __req;
      __diagServiceo7tsimc_30(__req, __resp);
    }
  }
  TestCommandEnd();


}

  
void __diagServiceo7tsimc_30(DiagRequest * __req, DiagResponse * __resp )
{
  stack long __tableHandle;
  long __res, __paramLen, __bytePos;

   __bVerdict = __eVerdictPass;

  do {
    TestReportResetDiagObjectList();
    DiagSetReportDetailLevel("CVADAS_0001_00000000_000", EnumServiceDetails_onfail);
    // Request aspect
    {

      if (0 >= DiagSendReqAndWaitForResp("CVADAS_0001_00000000_000", __req, __resp, __res, -1, -1, -1, -1, -1, EnumResult_pos, EnumServiceDetails_onfail, EnumSendingMode_physical, EnumSuppressPosResBit_asconfigured, EnumVerdictOnInvalidValues_fail))
        break;
    }

    __res = DiagErrCodeTestStep(__res, "Can't retrieve last response for request! No check possible.") < 0;
    if(__res)
    {
	  __bVerdict = __eVerdictFail;
      break;
    }
    {
      __res = DiagInterpretAs(__resp, "RDBI_PR");
      if(__res != 0)
      {
        __bVerdict = __eVerdictFail;
        DiagErrCodeTestStep(__res, "Can't interpret response as diagnostic primitive 'RDBI_PR'.");
        break;
      }
      else
      {
        TestStepPass( "Received primitive can be interpreted as diagnostic primitive 'RDBI_PR'.");
      }
    }
  }
  while(0);


  // Response, check & read aspect
  {
    __res = 1;
    __tableHandle = ReportTableHead5Columns(__cCheckCaption, __cTSym, __cTOp, __cRefVal, __cActual, __cRes);
    {
      __bDiagValueArrayCtr = DiagGetParameterErrorHandled(__resp, "_Hardware_EBOM_Part_Number_24", __bDiagValueArray, elcount(__bDiagValueArray), __cDiagValueArray, elcount(__cDiagValueArray));
      {
        __bSetInCheckAlignment = 1;	
        {
          __bArrayCtr = __CopyBytes(__bDiagValueArray, __bDiagValueArrayCtr, __bArray);
          {
            sysvar * __systemVariable;
            __systemVariable = sysvarData::`PartNumber::`Part_Number;
            CheckSysVarSetBufferConsistency(sysSetVariableData(sysvarData::`PartNumber::`Part_Number, __bArray, __bArrayCtr), __systemVariable.name);
          }
          snprintf(__cArray, 8192, "%s", "Part_Number");
          snprintf(__cArray2, 8192, "%s '%s'", __cSysVar, __cArray);
          snprintf(__cArray3, 8192, "%s", "_Hardware_EBOM_Part_Number_24");
          
          ReportTableRow(__tableHandle, 0, __cArray2, __cAOp, __bArray, __bArrayCtr, __cArray3, __oneOfFlag, __bSetInCheckAlignment);
        
        }
    
        __bSetInCheckAlignment = 0;
      }
    }
    ReportTableEndVerdict(__tableHandle, __cEvaluateResponse, __res);
	__bVerdict = __bVerdict && __res;
  }
  if (__bVerdict == __eVerdictFail)
    TestReportWriteDiagObjectList();
}

void Tto7tsimc_F112_DID_with_Standard_Physical_Address()
{
  stack long __tableHandle;
  TestCommandBegin(__eRequestResponse, __cRequestResponse, "", "0");
  {
  
    long __res;
    int64 __timeout;
    __res = 0;
    __nInt64 = 1;
    __timeout = syspar::`P2_Server * 1000000LL;
    {
    
      long __testStepInitOk;
      message `FDCAN2::`DIAGNOSTIC_REQUEST_PAM __output;
      message `FDCAN2::`DIAGNOSTIC_REQUEST_PAM __msgOrig;
      __output = __msgOrig;
      __testStepInitOk = 1;
      {
        int64 __dlc;
        __dlc = 4;
        if (__dlc >= 0 && __dlc <= (__output.EDL ? 15 : 8))
          __output.DLC = __dlc;
        else
        {
          testStepErrorInTestSystem(0, __cEmpty, "Unable to set DLC=%lld in message. Please check input parameter.", __dlc);
          __testStepInitOk = 0;
        }
      }
      if (__testStepInitOk)
      {
        snprintf(__cArray, elCount(__cArray), "CAN message '%s' ID = 416981233x (0x18DAA0F1x) on bus FDCAN2", "DIAGNOSTIC_REQUEST_PAM");
        snprintf(__cArray2, elCount(__cArray2), "Send %s", __cArray);
        __tableHandle = ReportTableHead3Columns(__cArray2, "Byte", __cTOp, __cAssigned);
        ReportByteIndex("", 0, __cArray, elCount(__cArray));
        snprintf(__cArray2, 8192, "%s", __cArray);
        snprintf(__cArray3, 8192, "%s", "");
        
        ReportTableRow(__tableHandle, 0, __cArray2, __cAOp, 0x3, __cArray3, __oneOfFlag, __bSetInCheckAlignment);
        
        if (0 >= 0 && 0 < 64)
        {
          __output.byte((word)0) = 0x3;
        }
        else
        {
          testStepErrorInTestSystem(0, __cEmpty, "Index out of range. Unable to set byte %lld in message. Please check input parameter.", (int64)0);
          __testStepInitOk = 0;
        }
        ReportByteIndex("", 1, __cArray, elCount(__cArray));
        snprintf(__cArray2, 8192, "%s", __cArray);
        snprintf(__cArray3, 8192, "%s", "");
        
        ReportTableRow(__tableHandle, 0, __cArray2, __cAOp, 0x22, __cArray3, __oneOfFlag, __bSetInCheckAlignment);
        
        if (1 >= 0 && 1 < 64)
        {
          __output.byte((word)1) = 0x22;
        }
        else
        {
          testStepErrorInTestSystem(0, __cEmpty, "Index out of range. Unable to set byte %lld in message. Please check input parameter.", (int64)1);
          __testStepInitOk = 0;
        }
        ReportByteIndex("", 2, __cArray, elCount(__cArray));
        snprintf(__cArray2, 8192, "%s", __cArray);
        snprintf(__cArray3, 8192, "%s", "");
        
        ReportTableRow(__tableHandle, 0, __cArray2, __cAOp, 0xF1, __cArray3, __oneOfFlag, __bSetInCheckAlignment);
        
        if (2 >= 0 && 2 < 64)
        {
          __output.byte((word)2) = 0xF1;
        }
        else
        {
          testStepErrorInTestSystem(0, __cEmpty, "Index out of range. Unable to set byte %lld in message. Please check input parameter.", (int64)2);
          __testStepInitOk = 0;
        }
        ReportByteIndex("", 3, __cArray, elCount(__cArray));
        snprintf(__cArray2, 8192, "%s", __cArray);
        snprintf(__cArray3, 8192, "%s", "");
        
        ReportTableRow(__tableHandle, 0, __cArray2, __cAOp, 0x12, __cArray3, __oneOfFlag, __bSetInCheckAlignment);
        
        if (3 >= 0 && 3 < 64)
        {
          __output.byte((word)3) = 0x12;
        }
        else
        {
          testStepErrorInTestSystem(0, __cEmpty, "Index out of range. Unable to set byte %lld in message. Please check input parameter.", (int64)3);
          __testStepInitOk = 0;
        }
      
        ReportTableEndTestStep(__tableHandle, "Req1");
      }
      if (__testStepInitOk)
      {
        output(__output);
      }
    }
    if (__timeout <= 0)
    {
      testStepErrorInTestSystem(0, "1", "Unable to wait for %.3f %s. Please check input parameter.", __timeout / ((float)1000000), "ms");
    }
    else
    {
      __tt8cnt_35 = 0;
      snprintf(__cArray, elCount(__cArray), "CAN message '%s' ID = 417001888x (0x18DAF1A0x) on bus FDCAN2", "DIAGNOSTIC_RESPONSE_PAM");
      if(SetBusContextByName("FDCAN2", __eSaveCurrent, __nBusContextNew, __nBusContextOld))
        testJoinMessageEvent(`FDCAN2::`DIAGNOSTIC_RESPONSE_PAM,  __cArray,
             delegate dword(message * __m)
             {
               dword __msg_callback_ret;
               if (__tt8cnt_35 == -1)
               {
                 return 1;
               }
               __msg_callback_ret = 1;
               __tt8cnt_35++;
               if (__msg_callback_ret)
               {
                 __tt8cnt_35 = -1;
                 return 1;
               }
               return 0;
             });
      __res = testWaitForAllJoinedEventsNS(__timeout);
      if (__nInt64 != 0)
      {
        snprintf(__cArray, elCount(__cArray), "CAN message '%s' ID = 417001888x (0x18DAF1A0x) on bus FDCAN2", "DIAGNOSTIC_RESPONSE_PAM");
        if(__tt8cnt_35 == -1)
        {
          snprintf(__cArray2, 8192, "Response of %s", __cArray);
        }
        else
        {
          snprintf(__cArray2, 8192, "Response of %s (received %d times)", __cArray, __tt8cnt_35);
        }
        if (__tt8cnt_35 == 0)
        {
          testStepFail(0, "Resp1", __cArray2);
        }
        else
        {
          testStepPass(2, "Resp1", __cArray2);
        }
        __ReportRequestResponseResult(__res, 0);
      }
      ResetBusContext(__nBusContextNew, __nBusContextOld);
    }
  }
  TestCommandEnd();

}

void Tto7tsimc_FD1D_DID_with_Physical_Address()
{
  stack long __tableHandle;
  TestCommandBegin(__eDiagService, __cDiagService, "", "0");
  {
    if (DiagIsFunctionalGroup("CVADAS_0001_00000000_000"))
    {
      DiagResponse * __resp;
      DiagRequest CVADAS_0001_00000000_000._22FD1D_PCB_Serial_Number __req;
      __diagServiceo7tsimc_31(__req, __resp);
    }
    else
    {
      DiagResponse CVADAS_0001_00000000_000.* __resp;
      DiagRequest CVADAS_0001_00000000_000._22FD1D_PCB_Serial_Number __req;
      __diagServiceo7tsimc_31(__req, __resp);
    }
  }
  TestCommandEnd();


}

  
void __diagServiceo7tsimc_31(DiagRequest * __req, DiagResponse * __resp )
{
  stack long __tableHandle;
  long __res, __paramLen, __bytePos;

   __bVerdict = __eVerdictPass;

  do {
    TestReportResetDiagObjectList();
    DiagSetReportDetailLevel("CVADAS_0001_00000000_000", EnumServiceDetails_onfail);
    // Request aspect
    {
      {
        CheckLiteralGetStringBufferConsistency("FD1D", 8192);
      snprintf(__cDiagValueArray, 8192, "%s", "FD1D");
        __bDiagValueArrayCtr = __MapChar2ByteAtDiagSet(__cDiagValueArray, __bDiagValueArray);
        if (__bDiagValueArrayCtr >= 0)
        {
          __res = DiagSetParameterErrorHandled(__req, "RecordDataIdentifier", __bDiagValueArray, __bDiagValueArrayCtr);
          if(__res < 0)
          {
            __bVerdict = __eVerdictFail;
            DiagErrCodeTestStep(__res, "Cannot set diagnostic parameter 'RecordDataIdentifier'");
            break;
          }
        }
        else
        {
      	__bVerdict = __eVerdictFail;
          snprintf(__cArray2, 8192, "SetParameter: illegal byte sequence: '%s' (parameter %s). Use hex tuples like '01 AF ...'", __cDiagValueArray, "RecordDataIdentifier");
          DiagErrCodeTestStep(__bDiagValueArrayCtr, __cArray2);
          DiagErrCodeTestStep(-1, "Cannot set diagnostic parameter 'RecordDataIdentifier'");
      	break;
        }
      }

      if (0 >= DiagSendReqAndWaitForResp("CVADAS_0001_00000000_000", __req, __resp, __res, -1, -1, -1, -1, -1, EnumResult_pos, EnumServiceDetails_onfail, EnumSendingMode_physical, EnumSuppressPosResBit_asconfigured, EnumVerdictOnInvalidValues_fail))
        break;
    }

    __res = DiagErrCodeTestStep(__res, "Can't retrieve last response for request! No check possible.") < 0;
    if(__res)
    {
	  __bVerdict = __eVerdictFail;
      break;
    }
    {
      __res = DiagInterpretAs(__resp, "RDBI_PR");
      if(__res != 0)
      {
        __bVerdict = __eVerdictFail;
        DiagErrCodeTestStep(__res, "Can't interpret response as diagnostic primitive 'RDBI_PR'.");
        break;
      }
      else
      {
        TestStepPass( "Received primitive can be interpreted as diagnostic primitive 'RDBI_PR'.");
      }
    }
  }
  while(0);


  // Response, check & read aspect
  {
    __res = 1;
    __tableHandle = ReportTableHead5Columns(__cCheckCaption, __cTSym, __cTOp, __cRefVal, __cActual, __cRes);
    {
      __bDiagValueArrayCtr = DiagGetParameterErrorHandled(__resp, "PCB_Serial_Number_0xFD1D", __bDiagValueArray, elcount(__bDiagValueArray), __cDiagValueArray, elcount(__cDiagValueArray));
      {
        __bSetInCheckAlignment = 1;	
        {
          __bArrayCtr = __CopyBytes(__bDiagValueArray, __bDiagValueArrayCtr, __bArray);
          {
            sysvar * __systemVariable;
            __systemVariable = sysvarData::`PartNumber::`Part_Number;
            CheckSysVarSetBufferConsistency(sysSetVariableData(sysvarData::`PartNumber::`Part_Number, __bArray, __bArrayCtr), __systemVariable.name);
          }
          snprintf(__cArray, 8192, "%s", "Part_Number");
          snprintf(__cArray2, 8192, "%s '%s'", __cSysVar, __cArray);
          snprintf(__cArray3, 8192, "%s", "PCB_Serial_Number_0xFD1D");
          
          ReportTableRow(__tableHandle, 0, __cArray2, __cAOp, __bArray, __bArrayCtr, __cArray3, __oneOfFlag, __bSetInCheckAlignment);
        
        }
    
        __bSetInCheckAlignment = 0;
      }
    }
    {
      __bDiagValueArrayCtr = DiagGetParameterErrorHandled(__resp, "PCB_Serial_Number_0xFD1D/PCB_Serial_Number", __bDiagValueArray, elcount(__bDiagValueArray), __cDiagValueArray, elcount(__cDiagValueArray));
      {
        __bSetInCheckAlignment = 1;	
        {
          __bArrayCtr = __CopyBytes(__bDiagValueArray, __bDiagValueArrayCtr, __bArray);
          {
            sysvar * __systemVariable;
            __systemVariable = sysvarData::`PartNumber::`Part_Number;
            CheckSysVarSetBufferConsistency(sysSetVariableData(sysvarData::`PartNumber::`Part_Number, __bArray, __bArrayCtr), __systemVariable.name);
          }
          snprintf(__cArray, 8192, "%s", "Part_Number");
          snprintf(__cArray2, 8192, "%s '%s'", __cSysVar, __cArray);
          snprintf(__cArray3, 8192, "%s", "PCB_Serial_Number_0xFD1D/PCB_Serial_Number");
          
          ReportTableRow(__tableHandle, 0, __cArray2, __cAOp, __bArray, __bArrayCtr, __cArray3, __oneOfFlag, __bSetInCheckAlignment);
        
        }
    
        __bSetInCheckAlignment = 0;
      }
    }
    ReportTableEndVerdict(__tableHandle, __cEvaluateResponse, __res);
	__bVerdict = __bVerdict && __res;
  }
  if (__bVerdict == __eVerdictFail)
    TestReportWriteDiagObjectList();
}

void Tto7tsimc_FD1D_DID_with_Functional_Address()
{
  stack long __tableHandle;
  TestCommandBegin(__eDiagService, __cDiagService, "", "0");
  {
    if (DiagIsFunctionalGroup("CVADAS_0001_00000000_000"))
    {
      DiagResponse * __resp;
      DiagRequest CVADAS_0001_00000000_000._22FD1D_PCB_Serial_Number __req;
      __diagServiceo7tsimc_32(__req, __resp);
    }
    else
    {
      DiagResponse CVADAS_0001_00000000_000.* __resp;
      DiagRequest CVADAS_0001_00000000_000._22FD1D_PCB_Serial_Number __req;
      __diagServiceo7tsimc_32(__req, __resp);
    }
  }
  TestCommandEnd();


}

  
void __diagServiceo7tsimc_32(DiagRequest * __req, DiagResponse * __resp )
{
  stack long __tableHandle;
  long __res, __paramLen, __bytePos;

   __bVerdict = __eVerdictPass;

  do {
    TestReportResetDiagObjectList();
    DiagSetReportDetailLevel("CVADAS_0001_00000000_000", EnumServiceDetails_onfail);
    // Request aspect
    {
      {
        CheckLiteralGetStringBufferConsistency("FD1D", 8192);
      snprintf(__cDiagValueArray, 8192, "%s", "FD1D");
        __bDiagValueArrayCtr = __MapChar2ByteAtDiagSet(__cDiagValueArray, __bDiagValueArray);
        if (__bDiagValueArrayCtr >= 0)
        {
          __res = DiagSetParameterErrorHandled(__req, "RecordDataIdentifier", __bDiagValueArray, __bDiagValueArrayCtr);
          if(__res < 0)
          {
            __bVerdict = __eVerdictFail;
            DiagErrCodeTestStep(__res, "Cannot set diagnostic parameter 'RecordDataIdentifier'");
            break;
          }
        }
        else
        {
      	__bVerdict = __eVerdictFail;
          snprintf(__cArray2, 8192, "SetParameter: illegal byte sequence: '%s' (parameter %s). Use hex tuples like '01 AF ...'", __cDiagValueArray, "RecordDataIdentifier");
          DiagErrCodeTestStep(__bDiagValueArrayCtr, __cArray2);
          DiagErrCodeTestStep(-1, "Cannot set diagnostic parameter 'RecordDataIdentifier'");
      	break;
        }
      }

      if (0 >= DiagSendReqAndWaitForResp("CVADAS_0001_00000000_000", __req, __resp, __res, -1, -1, -1, -1, -1, EnumResult_pos, EnumServiceDetails_onfail, EnumSendingMode_physical, EnumSuppressPosResBit_asconfigured, EnumVerdictOnInvalidValues_fail))
        break;
    }

    __res = DiagErrCodeTestStep(__res, "Can't retrieve last response for request! No check possible.") < 0;
    if(__res)
    {
	  __bVerdict = __eVerdictFail;
      break;
    }
    {
      __res = DiagInterpretAs(__resp, "RDBI_PR");
      if(__res != 0)
      {
        __bVerdict = __eVerdictFail;
        DiagErrCodeTestStep(__res, "Can't interpret response as diagnostic primitive 'RDBI_PR'.");
        break;
      }
      else
      {
        TestStepPass( "Received primitive can be interpreted as diagnostic primitive 'RDBI_PR'.");
      }
    }
  }
  while(0);


  // Response, check & read aspect
  {
    __res = 1;
    __tableHandle = ReportTableHead5Columns(__cCheckCaption, __cTSym, __cTOp, __cRefVal, __cActual, __cRes);
    {
      __bDiagValueArrayCtr = DiagGetParameterErrorHandled(__resp, "PCB_Serial_Number_0xFD1D", __bDiagValueArray, elcount(__bDiagValueArray), __cDiagValueArray, elcount(__cDiagValueArray));
      {
        __bSetInCheckAlignment = 1;	
        {
          __bArrayCtr = __CopyBytes(__bDiagValueArray, __bDiagValueArrayCtr, __bArray);
          {
            sysvar * __systemVariable;
            __systemVariable = sysvarData::`PartNumber::`Part_Number;
            CheckSysVarSetBufferConsistency(sysSetVariableData(sysvarData::`PartNumber::`Part_Number, __bArray, __bArrayCtr), __systemVariable.name);
          }
          snprintf(__cArray, 8192, "%s", "Part_Number");
          snprintf(__cArray2, 8192, "%s '%s'", __cSysVar, __cArray);
          snprintf(__cArray3, 8192, "%s", "PCB_Serial_Number_0xFD1D");
          
          ReportTableRow(__tableHandle, 0, __cArray2, __cAOp, __bArray, __bArrayCtr, __cArray3, __oneOfFlag, __bSetInCheckAlignment);
        
        }
    
        __bSetInCheckAlignment = 0;
      }
    }
    {
      __bDiagValueArrayCtr = DiagGetParameterErrorHandled(__resp, "PCB_Serial_Number_0xFD1D/PCB_Serial_Number", __bDiagValueArray, elcount(__bDiagValueArray), __cDiagValueArray, elcount(__cDiagValueArray));
      {
        __bSetInCheckAlignment = 1;	
        {
          __bArrayCtr = __CopyBytes(__bDiagValueArray, __bDiagValueArrayCtr, __bArray);
          {
            sysvar * __systemVariable;
            __systemVariable = sysvarData::`PartNumber::`Part_Number;
            CheckSysVarSetBufferConsistency(sysSetVariableData(sysvarData::`PartNumber::`Part_Number, __bArray, __bArrayCtr), __systemVariable.name);
          }
          snprintf(__cArray, 8192, "%s", "Part_Number");
          snprintf(__cArray2, 8192, "%s '%s'", __cSysVar, __cArray);
          snprintf(__cArray3, 8192, "%s", "PCB_Serial_Number_0xFD1D/PCB_Serial_Number");
          
          ReportTableRow(__tableHandle, 0, __cArray2, __cAOp, __bArray, __bArrayCtr, __cArray3, __oneOfFlag, __bSetInCheckAlignment);
        
        }
    
        __bSetInCheckAlignment = 0;
      }
    }
    ReportTableEndVerdict(__tableHandle, __cEvaluateResponse, __res);
	__bVerdict = __bVerdict && __res;
  }
  if (__bVerdict == __eVerdictFail)
    TestReportWriteDiagObjectList();
}

void Tto7tsimc_FD1D_DID_with_Standard_Physical_Address()
{
  stack long __tableHandle;
  TestCommandBegin(__eRequestResponse, __cRequestResponse, "", "0");
  {
  
    long __res;
    int64 __timeout;
    __res = 0;
    __nInt64 = 1;
    __timeout = syspar::`P2_Server * 1000000LL;
    {
    
      long __testStepInitOk;
      message `FDCAN2::`DIAGNOSTIC_REQUEST_PAM __output;
      message `FDCAN2::`DIAGNOSTIC_REQUEST_PAM __msgOrig;
      __output = __msgOrig;
      __testStepInitOk = 1;
      {
        int64 __dlc;
        __dlc = 4;
        if (__dlc >= 0 && __dlc <= (__output.EDL ? 15 : 8))
          __output.DLC = __dlc;
        else
        {
          testStepErrorInTestSystem(0, __cEmpty, "Unable to set DLC=%lld in message. Please check input parameter.", __dlc);
          __testStepInitOk = 0;
        }
      }
      if (__testStepInitOk)
      {
        snprintf(__cArray, elCount(__cArray), "CAN message '%s' ID = 416981233x (0x18DAA0F1x) on bus FDCAN2", "DIAGNOSTIC_REQUEST_PAM");
        snprintf(__cArray2, elCount(__cArray2), "Send %s", __cArray);
        __tableHandle = ReportTableHead3Columns(__cArray2, "Byte", __cTOp, __cAssigned);
        ReportByteIndex("", 0, __cArray, elCount(__cArray));
        snprintf(__cArray2, 8192, "%s", __cArray);
        snprintf(__cArray3, 8192, "%s", "");
        
        ReportTableRow(__tableHandle, 0, __cArray2, __cAOp, 0x3, __cArray3, __oneOfFlag, __bSetInCheckAlignment);
        
        if (0 >= 0 && 0 < 64)
        {
          __output.byte((word)0) = 0x3;
        }
        else
        {
          testStepErrorInTestSystem(0, __cEmpty, "Index out of range. Unable to set byte %lld in message. Please check input parameter.", (int64)0);
          __testStepInitOk = 0;
        }
        ReportByteIndex("", 1, __cArray, elCount(__cArray));
        snprintf(__cArray2, 8192, "%s", __cArray);
        snprintf(__cArray3, 8192, "%s", "");
        
        ReportTableRow(__tableHandle, 0, __cArray2, __cAOp, 0x22, __cArray3, __oneOfFlag, __bSetInCheckAlignment);
        
        if (1 >= 0 && 1 < 64)
        {
          __output.byte((word)1) = 0x22;
        }
        else
        {
          testStepErrorInTestSystem(0, __cEmpty, "Index out of range. Unable to set byte %lld in message. Please check input parameter.", (int64)1);
          __testStepInitOk = 0;
        }
        ReportByteIndex("", 2, __cArray, elCount(__cArray));
        snprintf(__cArray2, 8192, "%s", __cArray);
        snprintf(__cArray3, 8192, "%s", "");
        
        ReportTableRow(__tableHandle, 0, __cArray2, __cAOp, 0xFD, __cArray3, __oneOfFlag, __bSetInCheckAlignment);
        
        if (2 >= 0 && 2 < 64)
        {
          __output.byte((word)2) = 0xFD;
        }
        else
        {
          testStepErrorInTestSystem(0, __cEmpty, "Index out of range. Unable to set byte %lld in message. Please check input parameter.", (int64)2);
          __testStepInitOk = 0;
        }
        ReportByteIndex("", 3, __cArray, elCount(__cArray));
        snprintf(__cArray2, 8192, "%s", __cArray);
        snprintf(__cArray3, 8192, "%s", "");
        
        ReportTableRow(__tableHandle, 0, __cArray2, __cAOp, 0x1D, __cArray3, __oneOfFlag, __bSetInCheckAlignment);
        
        if (3 >= 0 && 3 < 64)
        {
          __output.byte((word)3) = 0x1D;
        }
        else
        {
          testStepErrorInTestSystem(0, __cEmpty, "Index out of range. Unable to set byte %lld in message. Please check input parameter.", (int64)3);
          __testStepInitOk = 0;
        }
      
        ReportTableEndTestStep(__tableHandle, "Req1");
      }
      if (__testStepInitOk)
      {
        output(__output);
      }
    }
    if (__timeout <= 0)
    {
      testStepErrorInTestSystem(0, "1", "Unable to wait for %.3f %s. Please check input parameter.", __timeout / ((float)1000000), "ms");
    }
    else
    {
      __tt8cnt_37 = 0;
      snprintf(__cArray, elCount(__cArray), "CAN message '%s' ID = 417001888x (0x18DAF1A0x) on bus FDCAN2", "DIAGNOSTIC_RESPONSE_PAM");
      if(SetBusContextByName("FDCAN2", __eSaveCurrent, __nBusContextNew, __nBusContextOld))
        testJoinMessageEvent(`FDCAN2::`DIAGNOSTIC_RESPONSE_PAM,  __cArray,
             delegate dword(message * __m)
             {
               dword __msg_callback_ret;
               if (__tt8cnt_37 == -1)
               {
                 return 1;
               }
               __msg_callback_ret = 1;
               __tt8cnt_37++;
               if (__msg_callback_ret)
               {
                 __tt8cnt_37 = -1;
                 return 1;
               }
               return 0;
             });
      __res = testWaitForAllJoinedEventsNS(__timeout);
      if (__nInt64 != 0)
      {
        snprintf(__cArray, elCount(__cArray), "CAN message '%s' ID = 417001888x (0x18DAF1A0x) on bus FDCAN2", "DIAGNOSTIC_RESPONSE_PAM");
        if(__tt8cnt_37 == -1)
        {
          snprintf(__cArray2, 8192, "Response of %s", __cArray);
        }
        else
        {
          snprintf(__cArray2, 8192, "Response of %s (received %d times)", __cArray, __tt8cnt_37);
        }
        if (__tt8cnt_37 == 0)
        {
          testStepFail(0, "Resp1", __cArray2);
        }
        else
        {
          testStepPass(2, "Resp1", __cArray2);
        }
        __ReportRequestResponseResult(__res, 0);
      }
      ResetBusContext(__nBusContextNew, __nBusContextOld);
    }
  }
  TestCommandEnd();

}

void Tto7tsimc_F11D_DID_with_Standard_Physical_Address()
{
  stack long __tableHandle;
  TestCommandBegin(__eRequestResponse, __cRequestResponse, "", "0");
  {
  
    long __res;
    int64 __timeout;
    __res = 0;
    __nInt64 = 1;
    __timeout = syspar::`P2_Server * 1000000LL;
    {
    
      long __testStepInitOk;
      message `FDCAN2::`DIAGNOSTIC_REQUEST_PAM __output;
      message `FDCAN2::`DIAGNOSTIC_REQUEST_PAM __msgOrig;
      __output = __msgOrig;
      __testStepInitOk = 1;
      {
        int64 __dlc;
        __dlc = 4;
        if (__dlc >= 0 && __dlc <= (__output.EDL ? 15 : 8))
          __output.DLC = __dlc;
        else
        {
          testStepErrorInTestSystem(0, __cEmpty, "Unable to set DLC=%lld in message. Please check input parameter.", __dlc);
          __testStepInitOk = 0;
        }
      }
      if (__testStepInitOk)
      {
        snprintf(__cArray, elCount(__cArray), "CAN message '%s' ID = 416981233x (0x18DAA0F1x) on bus FDCAN2", "DIAGNOSTIC_REQUEST_PAM");
        snprintf(__cArray2, elCount(__cArray2), "Send %s", __cArray);
        __tableHandle = ReportTableHead3Columns(__cArray2, "Byte", __cTOp, __cAssigned);
        ReportByteIndex("", 0, __cArray, elCount(__cArray));
        snprintf(__cArray2, 8192, "%s", __cArray);
        snprintf(__cArray3, 8192, "%s", "");
        
        ReportTableRow(__tableHandle, 0, __cArray2, __cAOp, 0x3, __cArray3, __oneOfFlag, __bSetInCheckAlignment);
        
        if (0 >= 0 && 0 < 64)
        {
          __output.byte((word)0) = 0x3;
        }
        else
        {
          testStepErrorInTestSystem(0, __cEmpty, "Index out of range. Unable to set byte %lld in message. Please check input parameter.", (int64)0);
          __testStepInitOk = 0;
        }
        ReportByteIndex("", 1, __cArray, elCount(__cArray));
        snprintf(__cArray2, 8192, "%s", __cArray);
        snprintf(__cArray3, 8192, "%s", "");
        
        ReportTableRow(__tableHandle, 0, __cArray2, __cAOp, 0x22, __cArray3, __oneOfFlag, __bSetInCheckAlignment);
        
        if (1 >= 0 && 1 < 64)
        {
          __output.byte((word)1) = 0x22;
        }
        else
        {
          testStepErrorInTestSystem(0, __cEmpty, "Index out of range. Unable to set byte %lld in message. Please check input parameter.", (int64)1);
          __testStepInitOk = 0;
        }
        ReportByteIndex("", 2, __cArray, elCount(__cArray));
        snprintf(__cArray2, 8192, "%s", __cArray);
        snprintf(__cArray3, 8192, "%s", "");
        
        ReportTableRow(__tableHandle, 0, __cArray2, __cAOp, 0xF1, __cArray3, __oneOfFlag, __bSetInCheckAlignment);
        
        if (2 >= 0 && 2 < 64)
        {
          __output.byte((word)2) = 0xF1;
        }
        else
        {
          testStepErrorInTestSystem(0, __cEmpty, "Index out of range. Unable to set byte %lld in message. Please check input parameter.", (int64)2);
          __testStepInitOk = 0;
        }
        ReportByteIndex("", 3, __cArray, elCount(__cArray));
        snprintf(__cArray2, 8192, "%s", __cArray);
        snprintf(__cArray3, 8192, "%s", "");
        
        ReportTableRow(__tableHandle, 0, __cArray2, __cAOp, 0x1D, __cArray3, __oneOfFlag, __bSetInCheckAlignment);
        
        if (3 >= 0 && 3 < 64)
        {
          __output.byte((word)3) = 0x1D;
        }
        else
        {
          testStepErrorInTestSystem(0, __cEmpty, "Index out of range. Unable to set byte %lld in message. Please check input parameter.", (int64)3);
          __testStepInitOk = 0;
        }
      
        ReportTableEndTestStep(__tableHandle, "Req1");
      }
      if (__testStepInitOk)
      {
        output(__output);
      }
    }
    if (__timeout <= 0)
    {
      testStepErrorInTestSystem(0, "1", "Unable to wait for %.3f %s. Please check input parameter.", __timeout / ((float)1000000), "ms");
    }
    else
    {
      __tt8cnt_39 = 0;
      snprintf(__cArray, elCount(__cArray), "CAN message '%s' ID = 417001888x (0x18DAF1A0x) on bus FDCAN2", "DIAGNOSTIC_RESPONSE_PAM");
      if(SetBusContextByName("FDCAN2", __eSaveCurrent, __nBusContextNew, __nBusContextOld))
        testJoinMessageEvent(`FDCAN2::`DIAGNOSTIC_RESPONSE_PAM,  __cArray,
             delegate dword(message * __m)
             {
               dword __msg_callback_ret;
               if (__tt8cnt_39 == -1)
               {
                 return 1;
               }
               __msg_callback_ret = 1;
               __tt8cnt_39++;
               if (__msg_callback_ret)
               {
                 __tt8cnt_39 = -1;
                 return 1;
               }
               return 0;
             });
      __res = testWaitForAllJoinedEventsNS(__timeout);
      if (__nInt64 != 0)
      {
        snprintf(__cArray, elCount(__cArray), "CAN message '%s' ID = 417001888x (0x18DAF1A0x) on bus FDCAN2", "DIAGNOSTIC_RESPONSE_PAM");
        if(__tt8cnt_39 == -1)
        {
          snprintf(__cArray2, 8192, "Response of %s", __cArray);
        }
        else
        {
          snprintf(__cArray2, 8192, "Response of %s (received %d times)", __cArray, __tt8cnt_39);
        }
        if (__tt8cnt_39 == 0)
        {
          testStepFail(0, "Resp1", __cArray2);
        }
        else
        {
          testStepPass(2, "Resp1", __cArray2);
        }
        __ReportRequestResponseResult(__res, 0);
      }
      ResetBusContext(__nBusContextNew, __nBusContextOld);
    }
  }
  TestCommandEnd();

}

void Tto7tsimc_FD38_DID_with_Physical_Address()
{
  stack long __tableHandle;
  TestCommandBegin(__eDiagService, __cDiagService, "", "0");
  {
    if (DiagIsFunctionalGroup("CVADAS_0001_00000000_000"))
    {
      DiagResponse * __resp;
      DiagRequest CVADAS_0001_00000000_000._22FD38_Programmed_Assembly __req;
      __diagServiceo7tsimc_33(__req, __resp);
    }
    else
    {
      DiagResponse CVADAS_0001_00000000_000.* __resp;
      DiagRequest CVADAS_0001_00000000_000._22FD38_Programmed_Assembly __req;
      __diagServiceo7tsimc_33(__req, __resp);
    }
  }
  TestCommandEnd();


}

  
void __diagServiceo7tsimc_33(DiagRequest * __req, DiagResponse * __resp )
{
  stack long __tableHandle;
  long __res, __paramLen, __bytePos;

   __bVerdict = __eVerdictPass;

  do {
    TestReportResetDiagObjectList();
    DiagSetReportDetailLevel("CVADAS_0001_00000000_000", EnumServiceDetails_onfail);
    // Request aspect
    {
      {
        CheckLiteralGetStringBufferConsistency("FD38", 8192);
      snprintf(__cDiagValueArray, 8192, "%s", "FD38");
        __bDiagValueArrayCtr = __MapChar2ByteAtDiagSet(__cDiagValueArray, __bDiagValueArray);
        if (__bDiagValueArrayCtr >= 0)
        {
          __res = DiagSetParameterErrorHandled(__req, "RecordDataIdentifier", __bDiagValueArray, __bDiagValueArrayCtr);
          if(__res < 0)
          {
            __bVerdict = __eVerdictFail;
            DiagErrCodeTestStep(__res, "Cannot set diagnostic parameter 'RecordDataIdentifier'");
            break;
          }
        }
        else
        {
      	__bVerdict = __eVerdictFail;
          snprintf(__cArray2, 8192, "SetParameter: illegal byte sequence: '%s' (parameter %s). Use hex tuples like '01 AF ...'", __cDiagValueArray, "RecordDataIdentifier");
          DiagErrCodeTestStep(__bDiagValueArrayCtr, __cArray2);
          DiagErrCodeTestStep(-1, "Cannot set diagnostic parameter 'RecordDataIdentifier'");
      	break;
        }
      }

      if (0 >= DiagSendReqAndWaitForResp("CVADAS_0001_00000000_000", __req, __resp, __res, -1, -1, -1, -1, -1, EnumResult_pos, EnumServiceDetails_onfail, EnumSendingMode_physical, EnumSuppressPosResBit_asconfigured, EnumVerdictOnInvalidValues_fail))
        break;
    }

    __res = DiagErrCodeTestStep(__res, "Can't retrieve last response for request! No check possible.") < 0;
    if(__res)
    {
	  __bVerdict = __eVerdictFail;
      break;
    }
    {
      __res = DiagInterpretAs(__resp, "RDBI_PR");
      if(__res != 0)
      {
        __bVerdict = __eVerdictFail;
        DiagErrCodeTestStep(__res, "Can't interpret response as diagnostic primitive 'RDBI_PR'.");
        break;
      }
      else
      {
        TestStepPass( "Received primitive can be interpreted as diagnostic primitive 'RDBI_PR'.");
      }
    }
  }
  while(0);


  // Response, check & read aspect
  {
    __res = 1;
    __tableHandle = ReportTableHead5Columns(__cCheckCaption, __cTSym, __cTOp, __cRefVal, __cActual, __cRes);
    {
      __bDiagValueArrayCtr = DiagGetParameterErrorHandled(__resp, "Programmed_Assembly_0xFD38", __bDiagValueArray, elcount(__bDiagValueArray), __cDiagValueArray, elcount(__cDiagValueArray));
      {
        __bSetInCheckAlignment = 1;	
        {
          __bArrayCtr = __CopyBytes(__bDiagValueArray, __bDiagValueArrayCtr, __bArray);
          {
            sysvar * __systemVariable;
            __systemVariable = sysvarData::`PartNumber::`Part_Number;
            CheckSysVarSetBufferConsistency(sysSetVariableData(sysvarData::`PartNumber::`Part_Number, __bArray, __bArrayCtr), __systemVariable.name);
          }
          snprintf(__cArray, 8192, "%s", "Part_Number");
          snprintf(__cArray2, 8192, "%s '%s'", __cSysVar, __cArray);
          snprintf(__cArray3, 8192, "%s", "Programmed_Assembly_0xFD38");
          
          ReportTableRow(__tableHandle, 0, __cArray2, __cAOp, __bArray, __bArrayCtr, __cArray3, __oneOfFlag, __bSetInCheckAlignment);
        
        }
    
        __bSetInCheckAlignment = 0;
      }
    }
    {
      __bDiagValueArrayCtr = DiagGetParameterErrorHandled(__resp, "Programmed_Assembly_0xFD38/Programmed_Assembly", __bDiagValueArray, elcount(__bDiagValueArray), __cDiagValueArray, elcount(__cDiagValueArray));
      {
        __bSetInCheckAlignment = 1;	
        {
          __bArrayCtr = __CopyBytes(__bDiagValueArray, __bDiagValueArrayCtr, __bArray);
          {
            sysvar * __systemVariable;
            __systemVariable = sysvarData::`PartNumber::`Part_Number;
            CheckSysVarSetBufferConsistency(sysSetVariableData(sysvarData::`PartNumber::`Part_Number, __bArray, __bArrayCtr), __systemVariable.name);
          }
          snprintf(__cArray, 8192, "%s", "Part_Number");
          snprintf(__cArray2, 8192, "%s '%s'", __cSysVar, __cArray);
          snprintf(__cArray3, 8192, "%s", "Programmed_Assembly_0xFD38/Programmed_Assembly");
          
          ReportTableRow(__tableHandle, 0, __cArray2, __cAOp, __bArray, __bArrayCtr, __cArray3, __oneOfFlag, __bSetInCheckAlignment);
        
        }
    
        __bSetInCheckAlignment = 0;
      }
    }
    ReportTableEndVerdict(__tableHandle, __cEvaluateResponse, __res);
	__bVerdict = __bVerdict && __res;
  }
  if (__bVerdict == __eVerdictFail)
    TestReportWriteDiagObjectList();
}

void Tto7tsimc_FD38_DID_with_Functional_Address()
{
  stack long __tableHandle;
  TestCommandBegin(__eDiagService, __cDiagService, "", "0");
  {
    if (DiagIsFunctionalGroup("CVADAS_0001_00000000_000"))
    {
      DiagResponse * __resp;
      DiagRequest CVADAS_0001_00000000_000._22FD38_Programmed_Assembly __req;
      __diagServiceo7tsimc_34(__req, __resp);
    }
    else
    {
      DiagResponse CVADAS_0001_00000000_000.* __resp;
      DiagRequest CVADAS_0001_00000000_000._22FD38_Programmed_Assembly __req;
      __diagServiceo7tsimc_34(__req, __resp);
    }
  }
  TestCommandEnd();


}

  
void __diagServiceo7tsimc_34(DiagRequest * __req, DiagResponse * __resp )
{
  stack long __tableHandle;
  long __res, __paramLen, __bytePos;

   __bVerdict = __eVerdictPass;

  do {
    TestReportResetDiagObjectList();
    DiagSetReportDetailLevel("CVADAS_0001_00000000_000", EnumServiceDetails_onfail);
    // Request aspect
    {
      {
        CheckLiteralGetStringBufferConsistency("FD38", 8192);
      snprintf(__cDiagValueArray, 8192, "%s", "FD38");
        __bDiagValueArrayCtr = __MapChar2ByteAtDiagSet(__cDiagValueArray, __bDiagValueArray);
        if (__bDiagValueArrayCtr >= 0)
        {
          __res = DiagSetParameterErrorHandled(__req, "RecordDataIdentifier", __bDiagValueArray, __bDiagValueArrayCtr);
          if(__res < 0)
          {
            __bVerdict = __eVerdictFail;
            DiagErrCodeTestStep(__res, "Cannot set diagnostic parameter 'RecordDataIdentifier'");
            break;
          }
        }
        else
        {
      	__bVerdict = __eVerdictFail;
          snprintf(__cArray2, 8192, "SetParameter: illegal byte sequence: '%s' (parameter %s). Use hex tuples like '01 AF ...'", __cDiagValueArray, "RecordDataIdentifier");
          DiagErrCodeTestStep(__bDiagValueArrayCtr, __cArray2);
          DiagErrCodeTestStep(-1, "Cannot set diagnostic parameter 'RecordDataIdentifier'");
      	break;
        }
      }

      if (0 >= DiagSendReqAndWaitForResp("CVADAS_0001_00000000_000", __req, __resp, __res, -1, -1, -1, -1, -1, EnumResult_pos, EnumServiceDetails_onfail, EnumSendingMode_physical, EnumSuppressPosResBit_asconfigured, EnumVerdictOnInvalidValues_fail))
        break;
    }

    __res = DiagErrCodeTestStep(__res, "Can't retrieve last response for request! No check possible.") < 0;
    if(__res)
    {
	  __bVerdict = __eVerdictFail;
      break;
    }
    {
      __res = DiagInterpretAs(__resp, "RDBI_PR");
      if(__res != 0)
      {
        __bVerdict = __eVerdictFail;
        DiagErrCodeTestStep(__res, "Can't interpret response as diagnostic primitive 'RDBI_PR'.");
        break;
      }
      else
      {
        TestStepPass( "Received primitive can be interpreted as diagnostic primitive 'RDBI_PR'.");
      }
    }
  }
  while(0);


  // Response, check & read aspect
  {
    __res = 1;
    __tableHandle = ReportTableHead5Columns(__cCheckCaption, __cTSym, __cTOp, __cRefVal, __cActual, __cRes);
    {
      __bDiagValueArrayCtr = DiagGetParameterErrorHandled(__resp, "Programmed_Assembly_0xFD38", __bDiagValueArray, elcount(__bDiagValueArray), __cDiagValueArray, elcount(__cDiagValueArray));
      {
        __bSetInCheckAlignment = 1;	
        {
          __bArrayCtr = __CopyBytes(__bDiagValueArray, __bDiagValueArrayCtr, __bArray);
          {
            sysvar * __systemVariable;
            __systemVariable = sysvarData::`PartNumber::`Part_Number;
            CheckSysVarSetBufferConsistency(sysSetVariableData(sysvarData::`PartNumber::`Part_Number, __bArray, __bArrayCtr), __systemVariable.name);
          }
          snprintf(__cArray, 8192, "%s", "Part_Number");
          snprintf(__cArray2, 8192, "%s '%s'", __cSysVar, __cArray);
          snprintf(__cArray3, 8192, "%s", "Programmed_Assembly_0xFD38");
          
          ReportTableRow(__tableHandle, 0, __cArray2, __cAOp, __bArray, __bArrayCtr, __cArray3, __oneOfFlag, __bSetInCheckAlignment);
        
        }
    
        __bSetInCheckAlignment = 0;
      }
    }
    {
      __bDiagValueArrayCtr = DiagGetParameterErrorHandled(__resp, "Programmed_Assembly_0xFD38/Programmed_Assembly", __bDiagValueArray, elcount(__bDiagValueArray), __cDiagValueArray, elcount(__cDiagValueArray));
      {
        __bSetInCheckAlignment = 1;	
        {
          __bArrayCtr = __CopyBytes(__bDiagValueArray, __bDiagValueArrayCtr, __bArray);
          {
            sysvar * __systemVariable;
            __systemVariable = sysvarData::`PartNumber::`Part_Number;
            CheckSysVarSetBufferConsistency(sysSetVariableData(sysvarData::`PartNumber::`Part_Number, __bArray, __bArrayCtr), __systemVariable.name);
          }
          snprintf(__cArray, 8192, "%s", "Part_Number");
          snprintf(__cArray2, 8192, "%s '%s'", __cSysVar, __cArray);
          snprintf(__cArray3, 8192, "%s", "Programmed_Assembly_0xFD38/Programmed_Assembly");
          
          ReportTableRow(__tableHandle, 0, __cArray2, __cAOp, __bArray, __bArrayCtr, __cArray3, __oneOfFlag, __bSetInCheckAlignment);
        
        }
    
        __bSetInCheckAlignment = 0;
      }
    }
    ReportTableEndVerdict(__tableHandle, __cEvaluateResponse, __res);
	__bVerdict = __bVerdict && __res;
  }
  if (__bVerdict == __eVerdictFail)
    TestReportWriteDiagObjectList();
}

void Tto7tsimc_FD38_DID_with_Standard_Physical_Address()
{
  stack long __tableHandle;
  TestCommandBegin(__eRequestResponse, __cRequestResponse, "", "0");
  {
  
    long __res;
    int64 __timeout;
    __res = 0;
    __nInt64 = 1;
    __timeout = syspar::`P2_Server * 1000000LL;
    {
    
      long __testStepInitOk;
      message `FDCAN2::`DIAGNOSTIC_REQUEST_PAM __output;
      message `FDCAN2::`DIAGNOSTIC_REQUEST_PAM __msgOrig;
      __output = __msgOrig;
      __testStepInitOk = 1;
      {
        int64 __dlc;
        __dlc = 4;
        if (__dlc >= 0 && __dlc <= (__output.EDL ? 15 : 8))
          __output.DLC = __dlc;
        else
        {
          testStepErrorInTestSystem(0, __cEmpty, "Unable to set DLC=%lld in message. Please check input parameter.", __dlc);
          __testStepInitOk = 0;
        }
      }
      if (__testStepInitOk)
      {
        snprintf(__cArray, elCount(__cArray), "CAN message '%s' ID = 416981233x (0x18DAA0F1x) on bus FDCAN2", "DIAGNOSTIC_REQUEST_PAM");
        snprintf(__cArray2, elCount(__cArray2), "Send %s", __cArray);
        __tableHandle = ReportTableHead3Columns(__cArray2, "Byte", __cTOp, __cAssigned);
        ReportByteIndex("", 0, __cArray, elCount(__cArray));
        snprintf(__cArray2, 8192, "%s", __cArray);
        snprintf(__cArray3, 8192, "%s", "");
        
        ReportTableRow(__tableHandle, 0, __cArray2, __cAOp, 0x3, __cArray3, __oneOfFlag, __bSetInCheckAlignment);
        
        if (0 >= 0 && 0 < 64)
        {
          __output.byte((word)0) = 0x3;
        }
        else
        {
          testStepErrorInTestSystem(0, __cEmpty, "Index out of range. Unable to set byte %lld in message. Please check input parameter.", (int64)0);
          __testStepInitOk = 0;
        }
        ReportByteIndex("", 1, __cArray, elCount(__cArray));
        snprintf(__cArray2, 8192, "%s", __cArray);
        snprintf(__cArray3, 8192, "%s", "");
        
        ReportTableRow(__tableHandle, 0, __cArray2, __cAOp, 0x22, __cArray3, __oneOfFlag, __bSetInCheckAlignment);
        
        if (1 >= 0 && 1 < 64)
        {
          __output.byte((word)1) = 0x22;
        }
        else
        {
          testStepErrorInTestSystem(0, __cEmpty, "Index out of range. Unable to set byte %lld in message. Please check input parameter.", (int64)1);
          __testStepInitOk = 0;
        }
        ReportByteIndex("", 2, __cArray, elCount(__cArray));
        snprintf(__cArray2, 8192, "%s", __cArray);
        snprintf(__cArray3, 8192, "%s", "");
        
        ReportTableRow(__tableHandle, 0, __cArray2, __cAOp, 0xFD, __cArray3, __oneOfFlag, __bSetInCheckAlignment);
        
        if (2 >= 0 && 2 < 64)
        {
          __output.byte((word)2) = 0xFD;
        }
        else
        {
          testStepErrorInTestSystem(0, __cEmpty, "Index out of range. Unable to set byte %lld in message. Please check input parameter.", (int64)2);
          __testStepInitOk = 0;
        }
        ReportByteIndex("", 3, __cArray, elCount(__cArray));
        snprintf(__cArray2, 8192, "%s", __cArray);
        snprintf(__cArray3, 8192, "%s", "");
        
        ReportTableRow(__tableHandle, 0, __cArray2, __cAOp, 0x38, __cArray3, __oneOfFlag, __bSetInCheckAlignment);
        
        if (3 >= 0 && 3 < 64)
        {
          __output.byte((word)3) = 0x38;
        }
        else
        {
          testStepErrorInTestSystem(0, __cEmpty, "Index out of range. Unable to set byte %lld in message. Please check input parameter.", (int64)3);
          __testStepInitOk = 0;
        }
      
        ReportTableEndTestStep(__tableHandle, "Req1");
      }
      if (__testStepInitOk)
      {
        output(__output);
      }
    }
    if (__timeout <= 0)
    {
      testStepErrorInTestSystem(0, "1", "Unable to wait for %.3f %s. Please check input parameter.", __timeout / ((float)1000000), "ms");
    }
    else
    {
      __tt8cnt_41 = 0;
      snprintf(__cArray, elCount(__cArray), "CAN message '%s' ID = 417001888x (0x18DAF1A0x) on bus FDCAN2", "DIAGNOSTIC_RESPONSE_PAM");
      if(SetBusContextByName("FDCAN2", __eSaveCurrent, __nBusContextNew, __nBusContextOld))
        testJoinMessageEvent(`FDCAN2::`DIAGNOSTIC_RESPONSE_PAM,  __cArray,
             delegate dword(message * __m)
             {
               dword __msg_callback_ret;
               if (__tt8cnt_41 == -1)
               {
                 return 1;
               }
               __msg_callback_ret = 1;
               __tt8cnt_41++;
               if (__msg_callback_ret)
               {
                 __tt8cnt_41 = -1;
                 return 1;
               }
               return 0;
             });
      __res = testWaitForAllJoinedEventsNS(__timeout);
      if (__nInt64 != 0)
      {
        snprintf(__cArray, elCount(__cArray), "CAN message '%s' ID = 417001888x (0x18DAF1A0x) on bus FDCAN2", "DIAGNOSTIC_RESPONSE_PAM");
        if(__tt8cnt_41 == -1)
        {
          snprintf(__cArray2, 8192, "Response of %s", __cArray);
        }
        else
        {
          snprintf(__cArray2, 8192, "Response of %s (received %d times)", __cArray, __tt8cnt_41);
        }
        if (__tt8cnt_41 == 0)
        {
          testStepFail(0, "Resp1", __cArray2);
        }
        else
        {
          testStepPass(2, "Resp1", __cArray2);
        }
        __ReportRequestResponseResult(__res, 0);
      }
      ResetBusContext(__nBusContextNew, __nBusContextOld);
    }
  }
  TestCommandEnd();

}

void Tto7tsimc_FD13_DID_with_Physical_Address()
{
  stack long __tableHandle;
  TestCommandBegin(__eDiagService, __cDiagService, "", "0");
  {
    if (DiagIsFunctionalGroup("CVADAS_0001_00000000_000"))
    {
      DiagResponse * __resp;
      DiagRequest CVADAS_0001_00000000_000._22FD13_Magna_Software_Version __req;
      __diagServiceo7tsimc_35(__req, __resp);
    }
    else
    {
      DiagResponse CVADAS_0001_00000000_000.* __resp;
      DiagRequest CVADAS_0001_00000000_000._22FD13_Magna_Software_Version __req;
      __diagServiceo7tsimc_35(__req, __resp);
    }
  }
  TestCommandEnd();


}

  
void __diagServiceo7tsimc_35(DiagRequest * __req, DiagResponse * __resp )
{
  stack long __tableHandle;
  long __res, __paramLen, __bytePos;

   __bVerdict = __eVerdictPass;

  do {
    TestReportResetDiagObjectList();
    DiagSetReportDetailLevel("CVADAS_0001_00000000_000", EnumServiceDetails_onfail);
    // Request aspect
    {
      {
        CheckLiteralGetStringBufferConsistency("FD13", 8192);
      snprintf(__cDiagValueArray, 8192, "%s", "FD13");
        __bDiagValueArrayCtr = __MapChar2ByteAtDiagSet(__cDiagValueArray, __bDiagValueArray);
        if (__bDiagValueArrayCtr >= 0)
        {
          __res = DiagSetParameterErrorHandled(__req, "RecordDataIdentifier", __bDiagValueArray, __bDiagValueArrayCtr);
          if(__res < 0)
          {
            __bVerdict = __eVerdictFail;
            DiagErrCodeTestStep(__res, "Cannot set diagnostic parameter 'RecordDataIdentifier'");
            break;
          }
        }
        else
        {
      	__bVerdict = __eVerdictFail;
          snprintf(__cArray2, 8192, "SetParameter: illegal byte sequence: '%s' (parameter %s). Use hex tuples like '01 AF ...'", __cDiagValueArray, "RecordDataIdentifier");
          DiagErrCodeTestStep(__bDiagValueArrayCtr, __cArray2);
          DiagErrCodeTestStep(-1, "Cannot set diagnostic parameter 'RecordDataIdentifier'");
      	break;
        }
      }

      if (0 >= DiagSendReqAndWaitForResp("CVADAS_0001_00000000_000", __req, __resp, __res, -1, -1, -1, -1, -1, EnumResult_pos, EnumServiceDetails_onfail, EnumSendingMode_functional, EnumSuppressPosResBit_asconfigured, EnumVerdictOnInvalidValues_fail))
        break;
    }

    __res = DiagErrCodeTestStep(__res, "Can't retrieve last response for request! No check possible.") < 0;
    if(__res)
    {
	  __bVerdict = __eVerdictFail;
      break;
    }
    {
      __res = DiagInterpretAs(__resp, "RDBI_PR");
      if(__res != 0)
      {
        __bVerdict = __eVerdictFail;
        DiagErrCodeTestStep(__res, "Can't interpret response as diagnostic primitive 'RDBI_PR'.");
        break;
      }
      else
      {
        TestStepPass( "Received primitive can be interpreted as diagnostic primitive 'RDBI_PR'.");
      }
    }
  }
  while(0);


  // Response, check & read aspect
  {
    __res = 1;
    __tableHandle = ReportTableHead5Columns(__cCheckCaption, __cTSym, __cTOp, __cRefVal, __cActual, __cRes);
    {
      __bDiagValueArrayCtr = DiagGetParameterErrorHandled(__resp, "Magna_Software_Version/CVADAS_DC_Applicaion_SW_Build_Number", __bDiagValueArray, elcount(__bDiagValueArray), __cDiagValueArray, elcount(__cDiagValueArray));
      {
        __bSetInCheckAlignment = 1;	
        {
          __bArrayCtr = __CopyBytes(__bDiagValueArray, __bDiagValueArrayCtr, __bArray);
          {
            sysvar * __systemVariable;
            __systemVariable = sysvarData::`PartNumber::`Part_Number;
            CheckSysVarSetBufferConsistency(sysSetVariableData(sysvarData::`PartNumber::`Part_Number, __bArray, __bArrayCtr), __systemVariable.name);
          }
          snprintf(__cArray, 8192, "%s", "Part_Number");
          snprintf(__cArray2, 8192, "%s '%s'", __cSysVar, __cArray);
          snprintf(__cArray3, 8192, "%s", "Magna_Software_Version/CVADAS_DC_Applicaion_SW_Build_Number");
          
          ReportTableRow(__tableHandle, 0, __cArray2, __cAOp, __bArray, __bArrayCtr, __cArray3, __oneOfFlag, __bSetInCheckAlignment);
        
        }
    
        __bSetInCheckAlignment = 0;
      }
    }
    {
      __bDiagValueArrayCtr = DiagGetParameterErrorHandled(__resp, "Magna_Software_Version/CVADAS_DC_Applicaion_SW_Week", __bDiagValueArray, elcount(__bDiagValueArray), __cDiagValueArray, elcount(__cDiagValueArray));
      {
        __bSetInCheckAlignment = 1;	
        {
          __bArrayCtr = __CopyBytes(__bDiagValueArray, __bDiagValueArrayCtr, __bArray);
          {
            sysvar * __systemVariable;
            __systemVariable = sysvarData::`PartNumber::`Part_Number;
            CheckSysVarSetBufferConsistency(sysSetVariableData(sysvarData::`PartNumber::`Part_Number, __bArray, __bArrayCtr), __systemVariable.name);
          }
          snprintf(__cArray, 8192, "%s", "Part_Number");
          snprintf(__cArray2, 8192, "%s '%s'", __cSysVar, __cArray);
          snprintf(__cArray3, 8192, "%s", "Magna_Software_Version/CVADAS_DC_Applicaion_SW_Week");
          
          ReportTableRow(__tableHandle, 0, __cArray2, __cAOp, __bArray, __bArrayCtr, __cArray3, __oneOfFlag, __bSetInCheckAlignment);
        
        }
    
        __bSetInCheckAlignment = 0;
      }
    }
    {
      __bDiagValueArrayCtr = DiagGetParameterErrorHandled(__resp, "Magna_Software_Version/CVADAS_DC_Applicaion_SW_Year", __bDiagValueArray, elcount(__bDiagValueArray), __cDiagValueArray, elcount(__cDiagValueArray));
      {
        __bSetInCheckAlignment = 1;	
        {
          __bArrayCtr = __CopyBytes(__bDiagValueArray, __bDiagValueArrayCtr, __bArray);
          {
            sysvar * __systemVariable;
            __systemVariable = sysvarData::`PartNumber::`Part_Number;
            CheckSysVarSetBufferConsistency(sysSetVariableData(sysvarData::`PartNumber::`Part_Number, __bArray, __bArrayCtr), __systemVariable.name);
          }
          snprintf(__cArray, 8192, "%s", "Part_Number");
          snprintf(__cArray2, 8192, "%s '%s'", __cSysVar, __cArray);
          snprintf(__cArray3, 8192, "%s", "Magna_Software_Version/CVADAS_DC_Applicaion_SW_Year");
          
          ReportTableRow(__tableHandle, 0, __cArray2, __cAOp, __bArray, __bArrayCtr, __cArray3, __oneOfFlag, __bSetInCheckAlignment);
        
        }
    
        __bSetInCheckAlignment = 0;
      }
    }
    {
      __bDiagValueArrayCtr = DiagGetParameterErrorHandled(__resp, "Magna_Software_Version/CVADAS_DC_Application_SW_Day_1", __bDiagValueArray, elcount(__bDiagValueArray), __cDiagValueArray, elcount(__cDiagValueArray));
      {
        __bSetInCheckAlignment = 1;	
        {
          __bArrayCtr = __CopyBytes(__bDiagValueArray, __bDiagValueArrayCtr, __bArray);
          {
            sysvar * __systemVariable;
            __systemVariable = sysvarData::`PartNumber::`Part_Number;
            CheckSysVarSetBufferConsistency(sysSetVariableData(sysvarData::`PartNumber::`Part_Number, __bArray, __bArrayCtr), __systemVariable.name);
          }
          snprintf(__cArray, 8192, "%s", "Part_Number");
          snprintf(__cArray2, 8192, "%s '%s'", __cSysVar, __cArray);
          snprintf(__cArray3, 8192, "%s", "Magna_Software_Version/CVADAS_DC_Application_SW_Day_1");
          
          ReportTableRow(__tableHandle, 0, __cArray2, __cAOp, __bArray, __bArrayCtr, __cArray3, __oneOfFlag, __bSetInCheckAlignment);
        
        }
    
        __bSetInCheckAlignment = 0;
      }
    }
    {
      __bDiagValueArrayCtr = DiagGetParameterErrorHandled(__resp, "Magna_Software_Version/CVADAS_DC_Bootloader_SW_Build_Number", __bDiagValueArray, elcount(__bDiagValueArray), __cDiagValueArray, elcount(__cDiagValueArray));
      {
        __bSetInCheckAlignment = 1;	
        {
          __bArrayCtr = __CopyBytes(__bDiagValueArray, __bDiagValueArrayCtr, __bArray);
          {
            sysvar * __systemVariable;
            __systemVariable = sysvarData::`PartNumber::`Part_Number;
            CheckSysVarSetBufferConsistency(sysSetVariableData(sysvarData::`PartNumber::`Part_Number, __bArray, __bArrayCtr), __systemVariable.name);
          }
          snprintf(__cArray, 8192, "%s", "Part_Number");
          snprintf(__cArray2, 8192, "%s '%s'", __cSysVar, __cArray);
          snprintf(__cArray3, 8192, "%s", "Magna_Software_Version/CVADAS_DC_Bootloader_SW_Build_Number");
          
          ReportTableRow(__tableHandle, 0, __cArray2, __cAOp, __bArray, __bArrayCtr, __cArray3, __oneOfFlag, __bSetInCheckAlignment);
        
        }
    
        __bSetInCheckAlignment = 0;
      }
    }
    {
      __bDiagValueArrayCtr = DiagGetParameterErrorHandled(__resp, "Magna_Software_Version/CVADAS_DC_Bootloader_SW_Day", __bDiagValueArray, elcount(__bDiagValueArray), __cDiagValueArray, elcount(__cDiagValueArray));
      {
        __bSetInCheckAlignment = 1;	
        {
          __bArrayCtr = __CopyBytes(__bDiagValueArray, __bDiagValueArrayCtr, __bArray);
          {
            sysvar * __systemVariable;
            __systemVariable = sysvarData::`PartNumber::`Part_Number;
            CheckSysVarSetBufferConsistency(sysSetVariableData(sysvarData::`PartNumber::`Part_Number, __bArray, __bArrayCtr), __systemVariable.name);
          }
          snprintf(__cArray, 8192, "%s", "Part_Number");
          snprintf(__cArray2, 8192, "%s '%s'", __cSysVar, __cArray);
          snprintf(__cArray3, 8192, "%s", "Magna_Software_Version/CVADAS_DC_Bootloader_SW_Day");
          
          ReportTableRow(__tableHandle, 0, __cArray2, __cAOp, __bArray, __bArrayCtr, __cArray3, __oneOfFlag, __bSetInCheckAlignment);
        
        }
    
        __bSetInCheckAlignment = 0;
      }
    }
    {
      __bDiagValueArrayCtr = DiagGetParameterErrorHandled(__resp, "Magna_Software_Version/CVADAS_DC_Bootloader_SW_Week", __bDiagValueArray, elcount(__bDiagValueArray), __cDiagValueArray, elcount(__cDiagValueArray));
      {
        __bSetInCheckAlignment = 1;	
        {
          __bArrayCtr = __CopyBytes(__bDiagValueArray, __bDiagValueArrayCtr, __bArray);
          {
            sysvar * __systemVariable;
            __systemVariable = sysvarData::`PartNumber::`Part_Number;
            CheckSysVarSetBufferConsistency(sysSetVariableData(sysvarData::`PartNumber::`Part_Number, __bArray, __bArrayCtr), __systemVariable.name);
          }
          snprintf(__cArray, 8192, "%s", "Part_Number");
          snprintf(__cArray2, 8192, "%s '%s'", __cSysVar, __cArray);
          snprintf(__cArray3, 8192, "%s", "Magna_Software_Version/CVADAS_DC_Bootloader_SW_Week");
          
          ReportTableRow(__tableHandle, 0, __cArray2, __cAOp, __bArray, __bArrayCtr, __cArray3, __oneOfFlag, __bSetInCheckAlignment);
        
        }
    
        __bSetInCheckAlignment = 0;
      }
    }
    {
      __bDiagValueArrayCtr = DiagGetParameterErrorHandled(__resp, "Magna_Software_Version/CVADAS_DC_Bootloader_SW_Year", __bDiagValueArray, elcount(__bDiagValueArray), __cDiagValueArray, elcount(__cDiagValueArray));
      {
        __bSetInCheckAlignment = 1;	
        {
          __bArrayCtr = __CopyBytes(__bDiagValueArray, __bDiagValueArrayCtr, __bArray);
          {
            sysvar * __systemVariable;
            __systemVariable = sysvarData::`PartNumber::`Part_Number;
            CheckSysVarSetBufferConsistency(sysSetVariableData(sysvarData::`PartNumber::`Part_Number, __bArray, __bArrayCtr), __systemVariable.name);
          }
          snprintf(__cArray, 8192, "%s", "Part_Number");
          snprintf(__cArray2, 8192, "%s '%s'", __cSysVar, __cArray);
          snprintf(__cArray3, 8192, "%s", "Magna_Software_Version/CVADAS_DC_Bootloader_SW_Year");
          
          ReportTableRow(__tableHandle, 0, __cArray2, __cAOp, __bArray, __bArrayCtr, __cArray3, __oneOfFlag, __bSetInCheckAlignment);
        
        }
    
        __bSetInCheckAlignment = 0;
      }
    }
    {
      __bDiagValueArrayCtr = DiagGetParameterErrorHandled(__resp, "Magna_Software_Version/CVADAS_DC_HSM_High_Security_Module_SW_Build_Number", __bDiagValueArray, elcount(__bDiagValueArray), __cDiagValueArray, elcount(__cDiagValueArray));
      {
        __bSetInCheckAlignment = 1;	
        {
          __bArrayCtr = __CopyBytes(__bDiagValueArray, __bDiagValueArrayCtr, __bArray);
          {
            sysvar * __systemVariable;
            __systemVariable = sysvarData::`PartNumber::`Part_Number;
            CheckSysVarSetBufferConsistency(sysSetVariableData(sysvarData::`PartNumber::`Part_Number, __bArray, __bArrayCtr), __systemVariable.name);
          }
          snprintf(__cArray, 8192, "%s", "Part_Number");
          snprintf(__cArray2, 8192, "%s '%s'", __cSysVar, __cArray);
          snprintf(__cArray3, 8192, "%s", "Magna_Software_Version/CVADAS_DC_HSM_High_Security_Module_SW_Build_Number");
          
          ReportTableRow(__tableHandle, 0, __cArray2, __cAOp, __bArray, __bArrayCtr, __cArray3, __oneOfFlag, __bSetInCheckAlignment);
        
        }
    
        __bSetInCheckAlignment = 0;
      }
    }
    {
      __bDiagValueArrayCtr = DiagGetParameterErrorHandled(__resp, "Magna_Software_Version/CVADAS_DC_HSM_High_Security_Module_SW_Day", __bDiagValueArray, elcount(__bDiagValueArray), __cDiagValueArray, elcount(__cDiagValueArray));
      {
        __bSetInCheckAlignment = 1;	
        {
          __bArrayCtr = __CopyBytes(__bDiagValueArray, __bDiagValueArrayCtr, __bArray);
          {
            sysvar * __systemVariable;
            __systemVariable = sysvarData::`PartNumber::`Part_Number;
            CheckSysVarSetBufferConsistency(sysSetVariableData(sysvarData::`PartNumber::`Part_Number, __bArray, __bArrayCtr), __systemVariable.name);
          }
          snprintf(__cArray, 8192, "%s", "Part_Number");
          snprintf(__cArray2, 8192, "%s '%s'", __cSysVar, __cArray);
          snprintf(__cArray3, 8192, "%s", "Magna_Software_Version/CVADAS_DC_HSM_High_Security_Module_SW_Day");
          
          ReportTableRow(__tableHandle, 0, __cArray2, __cAOp, __bArray, __bArrayCtr, __cArray3, __oneOfFlag, __bSetInCheckAlignment);
        
        }
    
        __bSetInCheckAlignment = 0;
      }
    }
    {
      __bDiagValueArrayCtr = DiagGetParameterErrorHandled(__resp, "Magna_Software_Version/CVADAS_DC_HSM_High_Security_Module_SW_Week", __bDiagValueArray, elcount(__bDiagValueArray), __cDiagValueArray, elcount(__cDiagValueArray));
      {
        __bSetInCheckAlignment = 1;	
        {
          __bArrayCtr = __CopyBytes(__bDiagValueArray, __bDiagValueArrayCtr, __bArray);
          {
            sysvar * __systemVariable;
            __systemVariable = sysvarData::`PartNumber::`Part_Number;
            CheckSysVarSetBufferConsistency(sysSetVariableData(sysvarData::`PartNumber::`Part_Number, __bArray, __bArrayCtr), __systemVariable.name);
          }
          snprintf(__cArray, 8192, "%s", "Part_Number");
          snprintf(__cArray2, 8192, "%s '%s'", __cSysVar, __cArray);
          snprintf(__cArray3, 8192, "%s", "Magna_Software_Version/CVADAS_DC_HSM_High_Security_Module_SW_Week");
          
          ReportTableRow(__tableHandle, 0, __cArray2, __cAOp, __bArray, __bArrayCtr, __cArray3, __oneOfFlag, __bSetInCheckAlignment);
        
        }
    
        __bSetInCheckAlignment = 0;
      }
    }
    {
      __bDiagValueArrayCtr = DiagGetParameterErrorHandled(__resp, "Magna_Software_Version/CVADAS_DC_Bootloader_SW_Year", __bDiagValueArray, elcount(__bDiagValueArray), __cDiagValueArray, elcount(__cDiagValueArray));
      {
        __bSetInCheckAlignment = 1;	
        {
          __bArrayCtr = __CopyBytes(__bDiagValueArray, __bDiagValueArrayCtr, __bArray);
          {
            sysvar * __systemVariable;
            __systemVariable = sysvarData::`PartNumber::`Part_Number;
            CheckSysVarSetBufferConsistency(sysSetVariableData(sysvarData::`PartNumber::`Part_Number, __bArray, __bArrayCtr), __systemVariable.name);
          }
          snprintf(__cArray, 8192, "%s", "Part_Number");
          snprintf(__cArray2, 8192, "%s '%s'", __cSysVar, __cArray);
          snprintf(__cArray3, 8192, "%s", "Magna_Software_Version/CVADAS_DC_Bootloader_SW_Year");
          
          ReportTableRow(__tableHandle, 0, __cArray2, __cAOp, __bArray, __bArrayCtr, __cArray3, __oneOfFlag, __bSetInCheckAlignment);
        
        }
    
        __bSetInCheckAlignment = 0;
      }
    }
    {
      __bDiagValueArrayCtr = DiagGetParameterErrorHandled(__resp, "Magna_Software_Version", __bDiagValueArray, elcount(__bDiagValueArray), __cDiagValueArray, elcount(__cDiagValueArray));
      {
        __bSetInCheckAlignment = 1;	
        {
          __bArrayCtr = __CopyBytes(__bDiagValueArray, __bDiagValueArrayCtr, __bArray);
          {
            sysvar * __systemVariable;
            __systemVariable = sysvarData::`PartNumber::`Part_Number;
            CheckSysVarSetBufferConsistency(sysSetVariableData(sysvarData::`PartNumber::`Part_Number, __bArray, __bArrayCtr), __systemVariable.name);
          }
          snprintf(__cArray, 8192, "%s", "Part_Number");
          snprintf(__cArray2, 8192, "%s '%s'", __cSysVar, __cArray);
          snprintf(__cArray3, 8192, "%s", "Magna_Software_Version");
          
          ReportTableRow(__tableHandle, 0, __cArray2, __cAOp, __bArray, __bArrayCtr, __cArray3, __oneOfFlag, __bSetInCheckAlignment);
        
        }
    
        __bSetInCheckAlignment = 0;
      }
    }
    {
      __bDiagValueArrayCtr = DiagGetParameterErrorHandled(__resp, "Magna_Software_Version/Planned_Release", __bDiagValueArray, elcount(__bDiagValueArray), __cDiagValueArray, elcount(__cDiagValueArray));
      {
        __bSetInCheckAlignment = 1;	
        {
          __bArrayCtr = __CopyBytes(__bDiagValueArray, __bDiagValueArrayCtr, __bArray);
          {
            sysvar * __systemVariable;
            __systemVariable = sysvarData::`PartNumber::`Part_Number;
            CheckSysVarSetBufferConsistency(sysSetVariableData(sysvarData::`PartNumber::`Part_Number, __bArray, __bArrayCtr), __systemVariable.name);
          }
          snprintf(__cArray, 8192, "%s", "Part_Number");
          snprintf(__cArray2, 8192, "%s '%s'", __cSysVar, __cArray);
          snprintf(__cArray3, 8192, "%s", "Magna_Software_Version/Planned_Release");
          
          ReportTableRow(__tableHandle, 0, __cArray2, __cAOp, __bArray, __bArrayCtr, __cArray3, __oneOfFlag, __bSetInCheckAlignment);
        
        }
    
        __bSetInCheckAlignment = 0;
      }
    }
    {
      __bDiagValueArrayCtr = DiagGetParameterErrorHandled(__resp, "Magna_Software_Version/USS_Firmware_version", __bDiagValueArray, elcount(__bDiagValueArray), __cDiagValueArray, elcount(__cDiagValueArray));
      {
        __bSetInCheckAlignment = 1;	
        {
          __bArrayCtr = __CopyBytes(__bDiagValueArray, __bDiagValueArrayCtr, __bArray);
          {
            sysvar * __systemVariable;
            __systemVariable = sysvarData::`PartNumber::`Part_Number;
            CheckSysVarSetBufferConsistency(sysSetVariableData(sysvarData::`PartNumber::`Part_Number, __bArray, __bArrayCtr), __systemVariable.name);
          }
          snprintf(__cArray, 8192, "%s", "Part_Number");
          snprintf(__cArray2, 8192, "%s '%s'", __cSysVar, __cArray);
          snprintf(__cArray3, 8192, "%s", "Magna_Software_Version/USS_Firmware_version");
          
          ReportTableRow(__tableHandle, 0, __cArray2, __cAOp, __bArray, __bArrayCtr, __cArray3, __oneOfFlag, __bSetInCheckAlignment);
        
        }
    
        __bSetInCheckAlignment = 0;
      }
    }
    {
      __bDiagValueArrayCtr = DiagGetParameterErrorHandled(__resp, "Magna_Software_Version/USS_SW_Build_Number", __bDiagValueArray, elcount(__bDiagValueArray), __cDiagValueArray, elcount(__cDiagValueArray));
      {
        __bSetInCheckAlignment = 1;	
        {
          __bArrayCtr = __CopyBytes(__bDiagValueArray, __bDiagValueArrayCtr, __bArray);
          {
            sysvar * __systemVariable;
            __systemVariable = sysvarData::`PartNumber::`Part_Number;
            CheckSysVarSetBufferConsistency(sysSetVariableData(sysvarData::`PartNumber::`Part_Number, __bArray, __bArrayCtr), __systemVariable.name);
          }
          snprintf(__cArray, 8192, "%s", "Part_Number");
          snprintf(__cArray2, 8192, "%s '%s'", __cSysVar, __cArray);
          snprintf(__cArray3, 8192, "%s", "Magna_Software_Version/USS_SW_Build_Number");
          
          ReportTableRow(__tableHandle, 0, __cArray2, __cAOp, __bArray, __bArrayCtr, __cArray3, __oneOfFlag, __bSetInCheckAlignment);
        
        }
    
        __bSetInCheckAlignment = 0;
      }
    }
    {
      __bDiagValueArrayCtr = DiagGetParameterErrorHandled(__resp, "Magna_Software_Version/USS_SW_Day", __bDiagValueArray, elcount(__bDiagValueArray), __cDiagValueArray, elcount(__cDiagValueArray));
      {
        __bSetInCheckAlignment = 1;	
        {
          __bArrayCtr = __CopyBytes(__bDiagValueArray, __bDiagValueArrayCtr, __bArray);
          {
            sysvar * __systemVariable;
            __systemVariable = sysvarData::`PartNumber::`Part_Number;
            CheckSysVarSetBufferConsistency(sysSetVariableData(sysvarData::`PartNumber::`Part_Number, __bArray, __bArrayCtr), __systemVariable.name);
          }
          snprintf(__cArray, 8192, "%s", "Part_Number");
          snprintf(__cArray2, 8192, "%s '%s'", __cSysVar, __cArray);
          snprintf(__cArray3, 8192, "%s", "Magna_Software_Version/USS_SW_Day");
          
          ReportTableRow(__tableHandle, 0, __cArray2, __cAOp, __bArray, __bArrayCtr, __cArray3, __oneOfFlag, __bSetInCheckAlignment);
        
        }
    
        __bSetInCheckAlignment = 0;
      }
    }
    {
      __bDiagValueArrayCtr = DiagGetParameterErrorHandled(__resp, "Magna_Software_Version/USS_SW_Week", __bDiagValueArray, elcount(__bDiagValueArray), __cDiagValueArray, elcount(__cDiagValueArray));
      {
        __bSetInCheckAlignment = 1;	
        {
          __bArrayCtr = __CopyBytes(__bDiagValueArray, __bDiagValueArrayCtr, __bArray);
          {
            sysvar * __systemVariable;
            __systemVariable = sysvarData::`PartNumber::`Part_Number;
            CheckSysVarSetBufferConsistency(sysSetVariableData(sysvarData::`PartNumber::`Part_Number, __bArray, __bArrayCtr), __systemVariable.name);
          }
          snprintf(__cArray, 8192, "%s", "Part_Number");
          snprintf(__cArray2, 8192, "%s '%s'", __cSysVar, __cArray);
          snprintf(__cArray3, 8192, "%s", "Magna_Software_Version/USS_SW_Week");
          
          ReportTableRow(__tableHandle, 0, __cArray2, __cAOp, __bArray, __bArrayCtr, __cArray3, __oneOfFlag, __bSetInCheckAlignment);
        
        }
    
        __bSetInCheckAlignment = 0;
      }
    }
    {
      __bDiagValueArrayCtr = DiagGetParameterErrorHandled(__resp, "Magna_Software_Version/USS_SW_Year", __bDiagValueArray, elcount(__bDiagValueArray), __cDiagValueArray, elcount(__cDiagValueArray));
      {
        __bSetInCheckAlignment = 1;	
        {
          __bArrayCtr = __CopyBytes(__bDiagValueArray, __bDiagValueArrayCtr, __bArray);
          {
            sysvar * __systemVariable;
            __systemVariable = sysvarData::`PartNumber::`Part_Number;
            CheckSysVarSetBufferConsistency(sysSetVariableData(sysvarData::`PartNumber::`Part_Number, __bArray, __bArrayCtr), __systemVariable.name);
          }
          snprintf(__cArray, 8192, "%s", "Part_Number");
          snprintf(__cArray2, 8192, "%s '%s'", __cSysVar, __cArray);
          snprintf(__cArray3, 8192, "%s", "Magna_Software_Version/USS_SW_Year");
          
          ReportTableRow(__tableHandle, 0, __cArray2, __cAOp, __bArray, __bArrayCtr, __cArray3, __oneOfFlag, __bSetInCheckAlignment);
        
        }
    
        __bSetInCheckAlignment = 0;
      }
    }
    ReportTableEndVerdict(__tableHandle, __cEvaluateResponse, __res);
	__bVerdict = __bVerdict && __res;
  }
  if (__bVerdict == __eVerdictFail)
    TestReportWriteDiagObjectList();
}

void Tto7tsimc_FD13_DID_with_Functional_Address()
{
  stack long __tableHandle;
  TestCommandBegin(__eDiagService, __cDiagService, "", "0");
  {
    if (DiagIsFunctionalGroup("CVADAS_0001_00000000_000"))
    {
      DiagResponse * __resp;
      DiagRequest CVADAS_0001_00000000_000._22FD13_Magna_Software_Version __req;
      __diagServiceo7tsimc_36(__req, __resp);
    }
    else
    {
      DiagResponse CVADAS_0001_00000000_000.* __resp;
      DiagRequest CVADAS_0001_00000000_000._22FD13_Magna_Software_Version __req;
      __diagServiceo7tsimc_36(__req, __resp);
    }
  }
  TestCommandEnd();


}

  
void __diagServiceo7tsimc_36(DiagRequest * __req, DiagResponse * __resp )
{
  stack long __tableHandle;
  long __res, __paramLen, __bytePos;

   __bVerdict = __eVerdictPass;

  do {
    TestReportResetDiagObjectList();
    DiagSetReportDetailLevel("CVADAS_0001_00000000_000", EnumServiceDetails_onfail);
    // Request aspect
    {
      {
        CheckLiteralGetStringBufferConsistency("FD13", 8192);
      snprintf(__cDiagValueArray, 8192, "%s", "FD13");
        __bDiagValueArrayCtr = __MapChar2ByteAtDiagSet(__cDiagValueArray, __bDiagValueArray);
        if (__bDiagValueArrayCtr >= 0)
        {
          __res = DiagSetParameterErrorHandled(__req, "RecordDataIdentifier", __bDiagValueArray, __bDiagValueArrayCtr);
          if(__res < 0)
          {
            __bVerdict = __eVerdictFail;
            DiagErrCodeTestStep(__res, "Cannot set diagnostic parameter 'RecordDataIdentifier'");
            break;
          }
        }
        else
        {
      	__bVerdict = __eVerdictFail;
          snprintf(__cArray2, 8192, "SetParameter: illegal byte sequence: '%s' (parameter %s). Use hex tuples like '01 AF ...'", __cDiagValueArray, "RecordDataIdentifier");
          DiagErrCodeTestStep(__bDiagValueArrayCtr, __cArray2);
          DiagErrCodeTestStep(-1, "Cannot set diagnostic parameter 'RecordDataIdentifier'");
      	break;
        }
      }

      if (0 >= DiagSendReqAndWaitForResp("CVADAS_0001_00000000_000", __req, __resp, __res, -1, -1, -1, -1, -1, EnumResult_pos, EnumServiceDetails_onfail, EnumSendingMode_functional, EnumSuppressPosResBit_asconfigured, EnumVerdictOnInvalidValues_fail))
        break;
    }

    __res = DiagErrCodeTestStep(__res, "Can't retrieve last response for request! No check possible.") < 0;
    if(__res)
    {
	  __bVerdict = __eVerdictFail;
      break;
    }
    {
      __res = DiagInterpretAs(__resp, "RDBI_PR");
      if(__res != 0)
      {
        __bVerdict = __eVerdictFail;
        DiagErrCodeTestStep(__res, "Can't interpret response as diagnostic primitive 'RDBI_PR'.");
        break;
      }
      else
      {
        TestStepPass( "Received primitive can be interpreted as diagnostic primitive 'RDBI_PR'.");
      }
    }
  }
  while(0);


  // Response, check & read aspect
  {
    __res = 1;
    __tableHandle = ReportTableHead5Columns(__cCheckCaption, __cTSym, __cTOp, __cRefVal, __cActual, __cRes);
    {
      __bDiagValueArrayCtr = DiagGetParameterErrorHandled(__resp, "Magna_Software_Version/CVADAS_DC_Applicaion_SW_Build_Number", __bDiagValueArray, elcount(__bDiagValueArray), __cDiagValueArray, elcount(__cDiagValueArray));
      {
        __bSetInCheckAlignment = 1;	
        {
          __bArrayCtr = __CopyBytes(__bDiagValueArray, __bDiagValueArrayCtr, __bArray);
          {
            sysvar * __systemVariable;
            __systemVariable = sysvarData::`PartNumber::`Part_Number;
            CheckSysVarSetBufferConsistency(sysSetVariableData(sysvarData::`PartNumber::`Part_Number, __bArray, __bArrayCtr), __systemVariable.name);
          }
          snprintf(__cArray, 8192, "%s", "Part_Number");
          snprintf(__cArray2, 8192, "%s '%s'", __cSysVar, __cArray);
          snprintf(__cArray3, 8192, "%s", "Magna_Software_Version/CVADAS_DC_Applicaion_SW_Build_Number");
          
          ReportTableRow(__tableHandle, 0, __cArray2, __cAOp, __bArray, __bArrayCtr, __cArray3, __oneOfFlag, __bSetInCheckAlignment);
        
        }
    
        __bSetInCheckAlignment = 0;
      }
    }
    {
      __bDiagValueArrayCtr = DiagGetParameterErrorHandled(__resp, "Magna_Software_Version/CVADAS_DC_Applicaion_SW_Week", __bDiagValueArray, elcount(__bDiagValueArray), __cDiagValueArray, elcount(__cDiagValueArray));
      {
        __bSetInCheckAlignment = 1;	
        {
          __bArrayCtr = __CopyBytes(__bDiagValueArray, __bDiagValueArrayCtr, __bArray);
          {
            sysvar * __systemVariable;
            __systemVariable = sysvarData::`PartNumber::`Part_Number;
            CheckSysVarSetBufferConsistency(sysSetVariableData(sysvarData::`PartNumber::`Part_Number, __bArray, __bArrayCtr), __systemVariable.name);
          }
          snprintf(__cArray, 8192, "%s", "Part_Number");
          snprintf(__cArray2, 8192, "%s '%s'", __cSysVar, __cArray);
          snprintf(__cArray3, 8192, "%s", "Magna_Software_Version/CVADAS_DC_Applicaion_SW_Week");
          
          ReportTableRow(__tableHandle, 0, __cArray2, __cAOp, __bArray, __bArrayCtr, __cArray3, __oneOfFlag, __bSetInCheckAlignment);
        
        }
    
        __bSetInCheckAlignment = 0;
      }
    }
    {
      __bDiagValueArrayCtr = DiagGetParameterErrorHandled(__resp, "Magna_Software_Version/CVADAS_DC_Applicaion_SW_Year", __bDiagValueArray, elcount(__bDiagValueArray), __cDiagValueArray, elcount(__cDiagValueArray));
      {
        __bSetInCheckAlignment = 1;	
        {
          __bArrayCtr = __CopyBytes(__bDiagValueArray, __bDiagValueArrayCtr, __bArray);
          {
            sysvar * __systemVariable;
            __systemVariable = sysvarData::`PartNumber::`Part_Number;
            CheckSysVarSetBufferConsistency(sysSetVariableData(sysvarData::`PartNumber::`Part_Number, __bArray, __bArrayCtr), __systemVariable.name);
          }
          snprintf(__cArray, 8192, "%s", "Part_Number");
          snprintf(__cArray2, 8192, "%s '%s'", __cSysVar, __cArray);
          snprintf(__cArray3, 8192, "%s", "Magna_Software_Version/CVADAS_DC_Applicaion_SW_Year");
          
          ReportTableRow(__tableHandle, 0, __cArray2, __cAOp, __bArray, __bArrayCtr, __cArray3, __oneOfFlag, __bSetInCheckAlignment);
        
        }
    
        __bSetInCheckAlignment = 0;
      }
    }
    {
      __bDiagValueArrayCtr = DiagGetParameterErrorHandled(__resp, "Magna_Software_Version/CVADAS_DC_Application_SW_Day_1", __bDiagValueArray, elcount(__bDiagValueArray), __cDiagValueArray, elcount(__cDiagValueArray));
      {
        __bSetInCheckAlignment = 1;	
        {
          __bArrayCtr = __CopyBytes(__bDiagValueArray, __bDiagValueArrayCtr, __bArray);
          {
            sysvar * __systemVariable;
            __systemVariable = sysvarData::`PartNumber::`Part_Number;
            CheckSysVarSetBufferConsistency(sysSetVariableData(sysvarData::`PartNumber::`Part_Number, __bArray, __bArrayCtr), __systemVariable.name);
          }
          snprintf(__cArray, 8192, "%s", "Part_Number");
          snprintf(__cArray2, 8192, "%s '%s'", __cSysVar, __cArray);
          snprintf(__cArray3, 8192, "%s", "Magna_Software_Version/CVADAS_DC_Application_SW_Day_1");
          
          ReportTableRow(__tableHandle, 0, __cArray2, __cAOp, __bArray, __bArrayCtr, __cArray3, __oneOfFlag, __bSetInCheckAlignment);
        
        }
    
        __bSetInCheckAlignment = 0;
      }
    }
    {
      __bDiagValueArrayCtr = DiagGetParameterErrorHandled(__resp, "Magna_Software_Version/CVADAS_DC_Bootloader_SW_Build_Number", __bDiagValueArray, elcount(__bDiagValueArray), __cDiagValueArray, elcount(__cDiagValueArray));
      {
        __bSetInCheckAlignment = 1;	
        {
          __bArrayCtr = __CopyBytes(__bDiagValueArray, __bDiagValueArrayCtr, __bArray);
          {
            sysvar * __systemVariable;
            __systemVariable = sysvarData::`PartNumber::`Part_Number;
            CheckSysVarSetBufferConsistency(sysSetVariableData(sysvarData::`PartNumber::`Part_Number, __bArray, __bArrayCtr), __systemVariable.name);
          }
          snprintf(__cArray, 8192, "%s", "Part_Number");
          snprintf(__cArray2, 8192, "%s '%s'", __cSysVar, __cArray);
          snprintf(__cArray3, 8192, "%s", "Magna_Software_Version/CVADAS_DC_Bootloader_SW_Build_Number");
          
          ReportTableRow(__tableHandle, 0, __cArray2, __cAOp, __bArray, __bArrayCtr, __cArray3, __oneOfFlag, __bSetInCheckAlignment);
        
        }
    
        __bSetInCheckAlignment = 0;
      }
    }
    {
      __bDiagValueArrayCtr = DiagGetParameterErrorHandled(__resp, "Magna_Software_Version/CVADAS_DC_Bootloader_SW_Day", __bDiagValueArray, elcount(__bDiagValueArray), __cDiagValueArray, elcount(__cDiagValueArray));
      {
        __bSetInCheckAlignment = 1;	
        {
          __bArrayCtr = __CopyBytes(__bDiagValueArray, __bDiagValueArrayCtr, __bArray);
          {
            sysvar * __systemVariable;
            __systemVariable = sysvarData::`PartNumber::`Part_Number;
            CheckSysVarSetBufferConsistency(sysSetVariableData(sysvarData::`PartNumber::`Part_Number, __bArray, __bArrayCtr), __systemVariable.name);
          }
          snprintf(__cArray, 8192, "%s", "Part_Number");
          snprintf(__cArray2, 8192, "%s '%s'", __cSysVar, __cArray);
          snprintf(__cArray3, 8192, "%s", "Magna_Software_Version/CVADAS_DC_Bootloader_SW_Day");
          
          ReportTableRow(__tableHandle, 0, __cArray2, __cAOp, __bArray, __bArrayCtr, __cArray3, __oneOfFlag, __bSetInCheckAlignment);
        
        }
    
        __bSetInCheckAlignment = 0;
      }
    }
    {
      __bDiagValueArrayCtr = DiagGetParameterErrorHandled(__resp, "Magna_Software_Version/CVADAS_DC_Bootloader_SW_Week", __bDiagValueArray, elcount(__bDiagValueArray), __cDiagValueArray, elcount(__cDiagValueArray));
      {
        __bSetInCheckAlignment = 1;	
        {
          __bArrayCtr = __CopyBytes(__bDiagValueArray, __bDiagValueArrayCtr, __bArray);
          {
            sysvar * __systemVariable;
            __systemVariable = sysvarData::`PartNumber::`Part_Number;
            CheckSysVarSetBufferConsistency(sysSetVariableData(sysvarData::`PartNumber::`Part_Number, __bArray, __bArrayCtr), __systemVariable.name);
          }
          snprintf(__cArray, 8192, "%s", "Part_Number");
          snprintf(__cArray2, 8192, "%s '%s'", __cSysVar, __cArray);
          snprintf(__cArray3, 8192, "%s", "Magna_Software_Version/CVADAS_DC_Bootloader_SW_Week");
          
          ReportTableRow(__tableHandle, 0, __cArray2, __cAOp, __bArray, __bArrayCtr, __cArray3, __oneOfFlag, __bSetInCheckAlignment);
        
        }
    
        __bSetInCheckAlignment = 0;
      }
    }
    {
      __bDiagValueArrayCtr = DiagGetParameterErrorHandled(__resp, "Magna_Software_Version/CVADAS_DC_Bootloader_SW_Year", __bDiagValueArray, elcount(__bDiagValueArray), __cDiagValueArray, elcount(__cDiagValueArray));
      {
        __bSetInCheckAlignment = 1;	
        {
          __bArrayCtr = __CopyBytes(__bDiagValueArray, __bDiagValueArrayCtr, __bArray);
          {
            sysvar * __systemVariable;
            __systemVariable = sysvarData::`PartNumber::`Part_Number;
            CheckSysVarSetBufferConsistency(sysSetVariableData(sysvarData::`PartNumber::`Part_Number, __bArray, __bArrayCtr), __systemVariable.name);
          }
          snprintf(__cArray, 8192, "%s", "Part_Number");
          snprintf(__cArray2, 8192, "%s '%s'", __cSysVar, __cArray);
          snprintf(__cArray3, 8192, "%s", "Magna_Software_Version/CVADAS_DC_Bootloader_SW_Year");
          
          ReportTableRow(__tableHandle, 0, __cArray2, __cAOp, __bArray, __bArrayCtr, __cArray3, __oneOfFlag, __bSetInCheckAlignment);
        
        }
    
        __bSetInCheckAlignment = 0;
      }
    }
    {
      __bDiagValueArrayCtr = DiagGetParameterErrorHandled(__resp, "Magna_Software_Version/CVADAS_DC_HSM_High_Security_Module_SW_Build_Number", __bDiagValueArray, elcount(__bDiagValueArray), __cDiagValueArray, elcount(__cDiagValueArray));
      {
        __bSetInCheckAlignment = 1;	
        {
          __bArrayCtr = __CopyBytes(__bDiagValueArray, __bDiagValueArrayCtr, __bArray);
          {
            sysvar * __systemVariable;
            __systemVariable = sysvarData::`PartNumber::`Part_Number;
            CheckSysVarSetBufferConsistency(sysSetVariableData(sysvarData::`PartNumber::`Part_Number, __bArray, __bArrayCtr), __systemVariable.name);
          }
          snprintf(__cArray, 8192, "%s", "Part_Number");
          snprintf(__cArray2, 8192, "%s '%s'", __cSysVar, __cArray);
          snprintf(__cArray3, 8192, "%s", "Magna_Software_Version/CVADAS_DC_HSM_High_Security_Module_SW_Build_Number");
          
          ReportTableRow(__tableHandle, 0, __cArray2, __cAOp, __bArray, __bArrayCtr, __cArray3, __oneOfFlag, __bSetInCheckAlignment);
        
        }
    
        __bSetInCheckAlignment = 0;
      }
    }
    {
      __bDiagValueArrayCtr = DiagGetParameterErrorHandled(__resp, "Magna_Software_Version/CVADAS_DC_HSM_High_Security_Module_SW_Day", __bDiagValueArray, elcount(__bDiagValueArray), __cDiagValueArray, elcount(__cDiagValueArray));
      {
        __bSetInCheckAlignment = 1;	
        {
          __bArrayCtr = __CopyBytes(__bDiagValueArray, __bDiagValueArrayCtr, __bArray);
          {
            sysvar * __systemVariable;
            __systemVariable = sysvarData::`PartNumber::`Part_Number;
            CheckSysVarSetBufferConsistency(sysSetVariableData(sysvarData::`PartNumber::`Part_Number, __bArray, __bArrayCtr), __systemVariable.name);
          }
          snprintf(__cArray, 8192, "%s", "Part_Number");
          snprintf(__cArray2, 8192, "%s '%s'", __cSysVar, __cArray);
          snprintf(__cArray3, 8192, "%s", "Magna_Software_Version/CVADAS_DC_HSM_High_Security_Module_SW_Day");
          
          ReportTableRow(__tableHandle, 0, __cArray2, __cAOp, __bArray, __bArrayCtr, __cArray3, __oneOfFlag, __bSetInCheckAlignment);
        
        }
    
        __bSetInCheckAlignment = 0;
      }
    }
    {
      __bDiagValueArrayCtr = DiagGetParameterErrorHandled(__resp, "Magna_Software_Version/CVADAS_DC_HSM_High_Security_Module_SW_Week", __bDiagValueArray, elcount(__bDiagValueArray), __cDiagValueArray, elcount(__cDiagValueArray));
      {
        __bSetInCheckAlignment = 1;	
        {
          __bArrayCtr = __CopyBytes(__bDiagValueArray, __bDiagValueArrayCtr, __bArray);
          {
            sysvar * __systemVariable;
            __systemVariable = sysvarData::`PartNumber::`Part_Number;
            CheckSysVarSetBufferConsistency(sysSetVariableData(sysvarData::`PartNumber::`Part_Number, __bArray, __bArrayCtr), __systemVariable.name);
          }
          snprintf(__cArray, 8192, "%s", "Part_Number");
          snprintf(__cArray2, 8192, "%s '%s'", __cSysVar, __cArray);
          snprintf(__cArray3, 8192, "%s", "Magna_Software_Version/CVADAS_DC_HSM_High_Security_Module_SW_Week");
          
          ReportTableRow(__tableHandle, 0, __cArray2, __cAOp, __bArray, __bArrayCtr, __cArray3, __oneOfFlag, __bSetInCheckAlignment);
        
        }
    
        __bSetInCheckAlignment = 0;
      }
    }
    {
      __bDiagValueArrayCtr = DiagGetParameterErrorHandled(__resp, "Magna_Software_Version/CVADAS_DC_Bootloader_SW_Year", __bDiagValueArray, elcount(__bDiagValueArray), __cDiagValueArray, elcount(__cDiagValueArray));
      {
        __bSetInCheckAlignment = 1;	
        {
          __bArrayCtr = __CopyBytes(__bDiagValueArray, __bDiagValueArrayCtr, __bArray);
          {
            sysvar * __systemVariable;
            __systemVariable = sysvarData::`PartNumber::`Part_Number;
            CheckSysVarSetBufferConsistency(sysSetVariableData(sysvarData::`PartNumber::`Part_Number, __bArray, __bArrayCtr), __systemVariable.name);
          }
          snprintf(__cArray, 8192, "%s", "Part_Number");
          snprintf(__cArray2, 8192, "%s '%s'", __cSysVar, __cArray);
          snprintf(__cArray3, 8192, "%s", "Magna_Software_Version/CVADAS_DC_Bootloader_SW_Year");
          
          ReportTableRow(__tableHandle, 0, __cArray2, __cAOp, __bArray, __bArrayCtr, __cArray3, __oneOfFlag, __bSetInCheckAlignment);
        
        }
    
        __bSetInCheckAlignment = 0;
      }
    }
    {
      __bDiagValueArrayCtr = DiagGetParameterErrorHandled(__resp, "Magna_Software_Version", __bDiagValueArray, elcount(__bDiagValueArray), __cDiagValueArray, elcount(__cDiagValueArray));
      {
        __bSetInCheckAlignment = 1;	
        {
          __bArrayCtr = __CopyBytes(__bDiagValueArray, __bDiagValueArrayCtr, __bArray);
          {
            sysvar * __systemVariable;
            __systemVariable = sysvarData::`PartNumber::`Part_Number;
            CheckSysVarSetBufferConsistency(sysSetVariableData(sysvarData::`PartNumber::`Part_Number, __bArray, __bArrayCtr), __systemVariable.name);
          }
          snprintf(__cArray, 8192, "%s", "Part_Number");
          snprintf(__cArray2, 8192, "%s '%s'", __cSysVar, __cArray);
          snprintf(__cArray3, 8192, "%s", "Magna_Software_Version");
          
          ReportTableRow(__tableHandle, 0, __cArray2, __cAOp, __bArray, __bArrayCtr, __cArray3, __oneOfFlag, __bSetInCheckAlignment);
        
        }
    
        __bSetInCheckAlignment = 0;
      }
    }
    {
      __bDiagValueArrayCtr = DiagGetParameterErrorHandled(__resp, "Magna_Software_Version/Planned_Release", __bDiagValueArray, elcount(__bDiagValueArray), __cDiagValueArray, elcount(__cDiagValueArray));
      {
        __bSetInCheckAlignment = 1;	
        {
          __bArrayCtr = __CopyBytes(__bDiagValueArray, __bDiagValueArrayCtr, __bArray);
          {
            sysvar * __systemVariable;
            __systemVariable = sysvarData::`PartNumber::`Part_Number;
            CheckSysVarSetBufferConsistency(sysSetVariableData(sysvarData::`PartNumber::`Part_Number, __bArray, __bArrayCtr), __systemVariable.name);
          }
          snprintf(__cArray, 8192, "%s", "Part_Number");
          snprintf(__cArray2, 8192, "%s '%s'", __cSysVar, __cArray);
          snprintf(__cArray3, 8192, "%s", "Magna_Software_Version/Planned_Release");
          
          ReportTableRow(__tableHandle, 0, __cArray2, __cAOp, __bArray, __bArrayCtr, __cArray3, __oneOfFlag, __bSetInCheckAlignment);
        
        }
    
        __bSetInCheckAlignment = 0;
      }
    }
    {
      __bDiagValueArrayCtr = DiagGetParameterErrorHandled(__resp, "Magna_Software_Version/USS_Firmware_version", __bDiagValueArray, elcount(__bDiagValueArray), __cDiagValueArray, elcount(__cDiagValueArray));
      {
        __bSetInCheckAlignment = 1;	
        {
          __bArrayCtr = __CopyBytes(__bDiagValueArray, __bDiagValueArrayCtr, __bArray);
          {
            sysvar * __systemVariable;
            __systemVariable = sysvarData::`PartNumber::`Part_Number;
            CheckSysVarSetBufferConsistency(sysSetVariableData(sysvarData::`PartNumber::`Part_Number, __bArray, __bArrayCtr), __systemVariable.name);
          }
          snprintf(__cArray, 8192, "%s", "Part_Number");
          snprintf(__cArray2, 8192, "%s '%s'", __cSysVar, __cArray);
          snprintf(__cArray3, 8192, "%s", "Magna_Software_Version/USS_Firmware_version");
          
          ReportTableRow(__tableHandle, 0, __cArray2, __cAOp, __bArray, __bArrayCtr, __cArray3, __oneOfFlag, __bSetInCheckAlignment);
        
        }
    
        __bSetInCheckAlignment = 0;
      }
    }
    {
      __bDiagValueArrayCtr = DiagGetParameterErrorHandled(__resp, "Magna_Software_Version/USS_SW_Build_Number", __bDiagValueArray, elcount(__bDiagValueArray), __cDiagValueArray, elcount(__cDiagValueArray));
      {
        __bSetInCheckAlignment = 1;	
        {
          __bArrayCtr = __CopyBytes(__bDiagValueArray, __bDiagValueArrayCtr, __bArray);
          {
            sysvar * __systemVariable;
            __systemVariable = sysvarData::`PartNumber::`Part_Number;
            CheckSysVarSetBufferConsistency(sysSetVariableData(sysvarData::`PartNumber::`Part_Number, __bArray, __bArrayCtr), __systemVariable.name);
          }
          snprintf(__cArray, 8192, "%s", "Part_Number");
          snprintf(__cArray2, 8192, "%s '%s'", __cSysVar, __cArray);
          snprintf(__cArray3, 8192, "%s", "Magna_Software_Version/USS_SW_Build_Number");
          
          ReportTableRow(__tableHandle, 0, __cArray2, __cAOp, __bArray, __bArrayCtr, __cArray3, __oneOfFlag, __bSetInCheckAlignment);
        
        }
    
        __bSetInCheckAlignment = 0;
      }
    }
    {
      __bDiagValueArrayCtr = DiagGetParameterErrorHandled(__resp, "Magna_Software_Version/USS_SW_Day", __bDiagValueArray, elcount(__bDiagValueArray), __cDiagValueArray, elcount(__cDiagValueArray));
      {
        __bSetInCheckAlignment = 1;	
        {
          __bArrayCtr = __CopyBytes(__bDiagValueArray, __bDiagValueArrayCtr, __bArray);
          {
            sysvar * __systemVariable;
            __systemVariable = sysvarData::`PartNumber::`Part_Number;
            CheckSysVarSetBufferConsistency(sysSetVariableData(sysvarData::`PartNumber::`Part_Number, __bArray, __bArrayCtr), __systemVariable.name);
          }
          snprintf(__cArray, 8192, "%s", "Part_Number");
          snprintf(__cArray2, 8192, "%s '%s'", __cSysVar, __cArray);
          snprintf(__cArray3, 8192, "%s", "Magna_Software_Version/USS_SW_Day");
          
          ReportTableRow(__tableHandle, 0, __cArray2, __cAOp, __bArray, __bArrayCtr, __cArray3, __oneOfFlag, __bSetInCheckAlignment);
        
        }
    
        __bSetInCheckAlignment = 0;
      }
    }
    {
      __bDiagValueArrayCtr = DiagGetParameterErrorHandled(__resp, "Magna_Software_Version/USS_SW_Week", __bDiagValueArray, elcount(__bDiagValueArray), __cDiagValueArray, elcount(__cDiagValueArray));
      {
        __bSetInCheckAlignment = 1;	
        {
          __bArrayCtr = __CopyBytes(__bDiagValueArray, __bDiagValueArrayCtr, __bArray);
          {
            sysvar * __systemVariable;
            __systemVariable = sysvarData::`PartNumber::`Part_Number;
            CheckSysVarSetBufferConsistency(sysSetVariableData(sysvarData::`PartNumber::`Part_Number, __bArray, __bArrayCtr), __systemVariable.name);
          }
          snprintf(__cArray, 8192, "%s", "Part_Number");
          snprintf(__cArray2, 8192, "%s '%s'", __cSysVar, __cArray);
          snprintf(__cArray3, 8192, "%s", "Magna_Software_Version/USS_SW_Week");
          
          ReportTableRow(__tableHandle, 0, __cArray2, __cAOp, __bArray, __bArrayCtr, __cArray3, __oneOfFlag, __bSetInCheckAlignment);
        
        }
    
        __bSetInCheckAlignment = 0;
      }
    }
    {
      __bDiagValueArrayCtr = DiagGetParameterErrorHandled(__resp, "Magna_Software_Version/USS_SW_Year", __bDiagValueArray, elcount(__bDiagValueArray), __cDiagValueArray, elcount(__cDiagValueArray));
      {
        __bSetInCheckAlignment = 1;	
        {
          __bArrayCtr = __CopyBytes(__bDiagValueArray, __bDiagValueArrayCtr, __bArray);
          {
            sysvar * __systemVariable;
            __systemVariable = sysvarData::`PartNumber::`Part_Number;
            CheckSysVarSetBufferConsistency(sysSetVariableData(sysvarData::`PartNumber::`Part_Number, __bArray, __bArrayCtr), __systemVariable.name);
          }
          snprintf(__cArray, 8192, "%s", "Part_Number");
          snprintf(__cArray2, 8192, "%s '%s'", __cSysVar, __cArray);
          snprintf(__cArray3, 8192, "%s", "Magna_Software_Version/USS_SW_Year");
          
          ReportTableRow(__tableHandle, 0, __cArray2, __cAOp, __bArray, __bArrayCtr, __cArray3, __oneOfFlag, __bSetInCheckAlignment);
        
        }
    
        __bSetInCheckAlignment = 0;
      }
    }
    ReportTableEndVerdict(__tableHandle, __cEvaluateResponse, __res);
	__bVerdict = __bVerdict && __res;
  }
  if (__bVerdict == __eVerdictFail)
    TestReportWriteDiagObjectList();
}

void Tto7tsimc_FD13_DID_with_Standard_Physical_Address()
{
  stack long __tableHandle;
  TestCommandBegin(__eRequestResponse, __cRequestResponse, "", "0");
  {
  
    long __res;
    int64 __timeout;
    __res = 0;
    __nInt64 = 1;
    __timeout = syspar::`P2_Server * 1000000LL;
    {
    
      long __testStepInitOk;
      message `FDCAN2::`DIAGNOSTIC_REQUEST_PAM __output;
      message `FDCAN2::`DIAGNOSTIC_REQUEST_PAM __msgOrig;
      __output = __msgOrig;
      __testStepInitOk = 1;
      {
        int64 __dlc;
        __dlc = 4;
        if (__dlc >= 0 && __dlc <= (__output.EDL ? 15 : 8))
          __output.DLC = __dlc;
        else
        {
          testStepErrorInTestSystem(0, __cEmpty, "Unable to set DLC=%lld in message. Please check input parameter.", __dlc);
          __testStepInitOk = 0;
        }
      }
      if (__testStepInitOk)
      {
        snprintf(__cArray, elCount(__cArray), "CAN message '%s' ID = 416981233x (0x18DAA0F1x) on bus FDCAN2", "DIAGNOSTIC_REQUEST_PAM");
        snprintf(__cArray2, elCount(__cArray2), "Send %s", __cArray);
        __tableHandle = ReportTableHead3Columns(__cArray2, "Byte", __cTOp, __cAssigned);
        ReportByteIndex("", 0, __cArray, elCount(__cArray));
        snprintf(__cArray2, 8192, "%s", __cArray);
        snprintf(__cArray3, 8192, "%s", "");
        
        ReportTableRow(__tableHandle, 0, __cArray2, __cAOp, 0x3, __cArray3, __oneOfFlag, __bSetInCheckAlignment);
        
        if (0 >= 0 && 0 < 64)
        {
          __output.byte((word)0) = 0x3;
        }
        else
        {
          testStepErrorInTestSystem(0, __cEmpty, "Index out of range. Unable to set byte %lld in message. Please check input parameter.", (int64)0);
          __testStepInitOk = 0;
        }
        ReportByteIndex("", 1, __cArray, elCount(__cArray));
        snprintf(__cArray2, 8192, "%s", __cArray);
        snprintf(__cArray3, 8192, "%s", "");
        
        ReportTableRow(__tableHandle, 0, __cArray2, __cAOp, 0x22, __cArray3, __oneOfFlag, __bSetInCheckAlignment);
        
        if (1 >= 0 && 1 < 64)
        {
          __output.byte((word)1) = 0x22;
        }
        else
        {
          testStepErrorInTestSystem(0, __cEmpty, "Index out of range. Unable to set byte %lld in message. Please check input parameter.", (int64)1);
          __testStepInitOk = 0;
        }
        ReportByteIndex("", 2, __cArray, elCount(__cArray));
        snprintf(__cArray2, 8192, "%s", __cArray);
        snprintf(__cArray3, 8192, "%s", "");
        
        ReportTableRow(__tableHandle, 0, __cArray2, __cAOp, 0xFD, __cArray3, __oneOfFlag, __bSetInCheckAlignment);
        
        if (2 >= 0 && 2 < 64)
        {
          __output.byte((word)2) = 0xFD;
        }
        else
        {
          testStepErrorInTestSystem(0, __cEmpty, "Index out of range. Unable to set byte %lld in message. Please check input parameter.", (int64)2);
          __testStepInitOk = 0;
        }
        ReportByteIndex("", 3, __cArray, elCount(__cArray));
        snprintf(__cArray2, 8192, "%s", __cArray);
        snprintf(__cArray3, 8192, "%s", "");
        
        ReportTableRow(__tableHandle, 0, __cArray2, __cAOp, 0x13, __cArray3, __oneOfFlag, __bSetInCheckAlignment);
        
        if (3 >= 0 && 3 < 64)
        {
          __output.byte((word)3) = 0x13;
        }
        else
        {
          testStepErrorInTestSystem(0, __cEmpty, "Index out of range. Unable to set byte %lld in message. Please check input parameter.", (int64)3);
          __testStepInitOk = 0;
        }
      
        ReportTableEndTestStep(__tableHandle, "Req1");
      }
      if (__testStepInitOk)
      {
        output(__output);
      }
    }
    if (__timeout <= 0)
    {
      testStepErrorInTestSystem(0, "1", "Unable to wait for %.3f %s. Please check input parameter.", __timeout / ((float)1000000), "ms");
    }
    else
    {
      __tt8cnt_43 = 0;
      snprintf(__cArray, elCount(__cArray), "CAN message '%s' ID = 417001888x (0x18DAF1A0x) on bus FDCAN2", "DIAGNOSTIC_RESPONSE_PAM");
      if(SetBusContextByName("FDCAN2", __eSaveCurrent, __nBusContextNew, __nBusContextOld))
        testJoinMessageEvent(`FDCAN2::`DIAGNOSTIC_RESPONSE_PAM,  __cArray,
             delegate dword(message * __m)
             {
               dword __msg_callback_ret;
               if (__tt8cnt_43 == -1)
               {
                 return 1;
               }
               __msg_callback_ret = 1;
               __tt8cnt_43++;
               if (__msg_callback_ret)
               {
                 __tt8cnt_43 = -1;
                 return 1;
               }
               return 0;
             });
      __res = testWaitForAllJoinedEventsNS(__timeout);
      if (__nInt64 != 0)
      {
        snprintf(__cArray, elCount(__cArray), "CAN message '%s' ID = 417001888x (0x18DAF1A0x) on bus FDCAN2", "DIAGNOSTIC_RESPONSE_PAM");
        if(__tt8cnt_43 == -1)
        {
          snprintf(__cArray2, 8192, "Response of %s", __cArray);
        }
        else
        {
          snprintf(__cArray2, 8192, "Response of %s (received %d times)", __cArray, __tt8cnt_43);
        }
        if (__tt8cnt_43 == 0)
        {
          testStepFail(0, "Resp1", __cArray2);
        }
        else
        {
          testStepPass(2, "Resp1", __cArray2);
        }
        __ReportRequestResponseResult(__res, 0);
      }
      ResetBusContext(__nBusContextNew, __nBusContextOld);
    }
  }
  TestCommandEnd();

}

void Tto7tsimc_F18C_DID_with_Physical_Addressing()
{
  stack long __tableHandle;
  TestCommandBegin(__eRequestResponse, __cRequestResponse, "", "0");
  {
  
    long __res;
    int64 __timeout;
    __res = 0;
    __nInt64 = 1;
    __timeout = syspar::`P2_Server * 1000000LL;
    {
    
      long __testStepInitOk;
      message `FDCAN2::`DIAGNOSTIC_REQUEST_FD_PAM __output;
      message `FDCAN2::`DIAGNOSTIC_REQUEST_FD_PAM __msgOrig;
      __output = __msgOrig;
      __testStepInitOk = 1;
      {
        int64 __dlc;
        __dlc = 4;
        if (__dlc >= 0 && __dlc <= (__output.EDL ? 15 : 8))
          __output.DLC = __dlc;
        else
        {
          testStepErrorInTestSystem(0, __cEmpty, "Unable to set DLC=%lld in message. Please check input parameter.", __dlc);
          __testStepInitOk = 0;
        }
      }
      if (__testStepInitOk)
      {
        snprintf(__cArray, elCount(__cArray), "CAN message '%s' ID = 416981234x (0x18DAA0F2x) on bus FDCAN2", "DIAGNOSTIC_REQUEST_FD_PAM");
        snprintf(__cArray2, elCount(__cArray2), "Send %s", __cArray);
        __tableHandle = ReportTableHead3Columns(__cArray2, "Byte", __cTOp, __cAssigned);
        ReportByteIndex("", 0, __cArray, elCount(__cArray));
        snprintf(__cArray2, 8192, "%s", __cArray);
        snprintf(__cArray3, 8192, "%s", "");
        
        ReportTableRow(__tableHandle, 0, __cArray2, __cAOp, 0x3, __cArray3, __oneOfFlag, __bSetInCheckAlignment);
        
        if (0 >= 0 && 0 < 64)
        {
          __output.byte((word)0) = 0x3;
        }
        else
        {
          testStepErrorInTestSystem(0, __cEmpty, "Index out of range. Unable to set byte %lld in message. Please check input parameter.", (int64)0);
          __testStepInitOk = 0;
        }
        ReportByteIndex("", 1, __cArray, elCount(__cArray));
        snprintf(__cArray2, 8192, "%s", __cArray);
        snprintf(__cArray3, 8192, "%s", "");
        
        ReportTableRow(__tableHandle, 0, __cArray2, __cAOp, 0x22, __cArray3, __oneOfFlag, __bSetInCheckAlignment);
        
        if (1 >= 0 && 1 < 64)
        {
          __output.byte((word)1) = 0x22;
        }
        else
        {
          testStepErrorInTestSystem(0, __cEmpty, "Index out of range. Unable to set byte %lld in message. Please check input parameter.", (int64)1);
          __testStepInitOk = 0;
        }
        ReportByteIndex("", 2, __cArray, elCount(__cArray));
        snprintf(__cArray2, 8192, "%s", __cArray);
        snprintf(__cArray3, 8192, "%s", "");
        
        ReportTableRow(__tableHandle, 0, __cArray2, __cAOp, 0xF1, __cArray3, __oneOfFlag, __bSetInCheckAlignment);
        
        if (2 >= 0 && 2 < 64)
        {
          __output.byte((word)2) = 0xF1;
        }
        else
        {
          testStepErrorInTestSystem(0, __cEmpty, "Index out of range. Unable to set byte %lld in message. Please check input parameter.", (int64)2);
          __testStepInitOk = 0;
        }
        ReportByteIndex("", 3, __cArray, elCount(__cArray));
        snprintf(__cArray2, 8192, "%s", __cArray);
        snprintf(__cArray3, 8192, "%s", "");
        
        ReportTableRow(__tableHandle, 0, __cArray2, __cAOp, 0x8C, __cArray3, __oneOfFlag, __bSetInCheckAlignment);
        
        if (3 >= 0 && 3 < 64)
        {
          __output.byte((word)3) = 0x8C;
        }
        else
        {
          testStepErrorInTestSystem(0, __cEmpty, "Index out of range. Unable to set byte %lld in message. Please check input parameter.", (int64)3);
          __testStepInitOk = 0;
        }
      
        ReportTableEndTestStep(__tableHandle, "Req1");
      }
      if (__testStepInitOk)
      {
        output(__output);
      }
    }
    if (__timeout <= 0)
    {
      testStepErrorInTestSystem(0, "1", "Unable to wait for %.3f %s. Please check input parameter.", __timeout / ((float)1000000), "ms");
    }
    else
    {
      __tt8cnt_45 = 0;
      snprintf(__cArray, elCount(__cArray), "CAN message '%s' ID = 417002144x (0x18DAF2A0x) on bus FDCAN2", "DIAGNOSTIC_RESPONSE_FD_PAM");
      if(SetBusContextByName("FDCAN2", __eSaveCurrent, __nBusContextNew, __nBusContextOld))
        testJoinMessageEvent(`FDCAN2::`DIAGNOSTIC_RESPONSE_FD_PAM,  __cArray,
             delegate dword(message * __m)
             {
               dword __msg_callback_ret;
               if (__tt8cnt_45 == -1)
               {
                 return 1;
               }
               __msg_callback_ret = 1;
               __tt8cnt_45++;
               if (__msg_callback_ret)
               {
                 __tt8cnt_45 = -1;
                 return 1;
               }
               return 0;
             });
      __res = testWaitForAllJoinedEventsNS(__timeout);
      if (__nInt64 != 0)
      {
        snprintf(__cArray, elCount(__cArray), "CAN message '%s' ID = 417002144x (0x18DAF2A0x) on bus FDCAN2", "DIAGNOSTIC_RESPONSE_FD_PAM");
        if(__tt8cnt_45 == -1)
        {
          snprintf(__cArray2, 8192, "Response of %s", __cArray);
        }
        else
        {
          snprintf(__cArray2, 8192, "Response of %s (received %d times)", __cArray, __tt8cnt_45);
        }
        if (__tt8cnt_45 == 0)
        {
          testStepFail(0, "Resp1", __cArray2);
        }
        else
        {
          testStepPass(2, "Resp1", __cArray2);
        }
        __ReportRequestResponseResult(__res, 0);
      }
      ResetBusContext(__nBusContextNew, __nBusContextOld);
    }
  }
  TestCommandEnd();

}

void Tto7tsimc_F18C_DID_with_Functional_Addressing()
{
  stack long __tableHandle;
  TestCommandBegin(__eDiagService, __cDiagService, "", "0");
  {
    if (DiagIsFunctionalGroup("CVADAS_0001_00000000_000"))
    {
      DiagResponse * __resp;
      DiagRequest CVADAS_0001_00000000_000._22F18C_ECU_Serial_Number __req;
      __diagServiceo7tsimc_37(__req, __resp);
    }
    else
    {
      DiagResponse CVADAS_0001_00000000_000.* __resp;
      DiagRequest CVADAS_0001_00000000_000._22F18C_ECU_Serial_Number __req;
      __diagServiceo7tsimc_37(__req, __resp);
    }
  }
  TestCommandEnd();


}

  
void __diagServiceo7tsimc_37(DiagRequest * __req, DiagResponse * __resp )
{
  stack long __tableHandle;
  long __res, __paramLen, __bytePos;

   __bVerdict = __eVerdictPass;

  do {
    TestReportResetDiagObjectList();
    DiagSetReportDetailLevel("CVADAS_0001_00000000_000", EnumServiceDetails_onfail);
    // Request aspect
    {

      if (0 >= DiagSendReqAndWaitForResp("CVADAS_0001_00000000_000", __req, __resp, __res, -1, -1, -1, -1, -1, EnumResult_pos, EnumServiceDetails_onfail, EnumSendingMode_functional, EnumSuppressPosResBit_asconfigured, EnumVerdictOnInvalidValues_fail))
        break;
    }

    __res = DiagErrCodeTestStep(__res, "Can't retrieve last response for request! No check possible.") < 0;
    if(__res)
    {
	  __bVerdict = __eVerdictFail;
      break;
    }
    {
      __res = DiagInterpretAs(__resp, "RDBI_PR");
      if(__res != 0)
      {
        __bVerdict = __eVerdictFail;
        DiagErrCodeTestStep(__res, "Can't interpret response as diagnostic primitive 'RDBI_PR'.");
        break;
      }
      else
      {
        TestStepPass( "Received primitive can be interpreted as diagnostic primitive 'RDBI_PR'.");
      }
    }
  }
  while(0);


  // Response, check & read aspect
  {
    __res = 1;
    __tableHandle = ReportTableHead5Columns(__cCheckCaption, __cTSym, __cTOp, __cRefVal, __cActual, __cRes);
    {
      __bDiagValueArrayCtr = DiagGetParameterErrorHandled(__resp, "_Calendar_Year_88", __bDiagValueArray, elcount(__bDiagValueArray), __cDiagValueArray, elcount(__cDiagValueArray));
      {
        __bSetInCheckAlignment = 1;	
        {
          __bArrayCtr = __CopyBytes(__bDiagValueArray, __bDiagValueArrayCtr, __bArray);
          {
            sysvar * __systemVariable;
            __systemVariable = sysvarData::`PartNumber::`Part_Number;
            CheckSysVarSetBufferConsistency(sysSetVariableData(sysvarData::`PartNumber::`Part_Number, __bArray, __bArrayCtr), __systemVariable.name);
          }
          snprintf(__cArray, 8192, "%s", "Part_Number");
          snprintf(__cArray2, 8192, "%s '%s'", __cSysVar, __cArray);
          snprintf(__cArray3, 8192, "%s", "_Calendar_Year_88");
          
          ReportTableRow(__tableHandle, 0, __cArray2, __cAOp, __bArray, __bArrayCtr, __cArray3, __oneOfFlag, __bSetInCheckAlignment);
        
        }
    
        __bSetInCheckAlignment = 0;
      }
    }
    {
      __bDiagValueArrayCtr = DiagGetParameterErrorHandled(__resp, "_Component_Code_48", __bDiagValueArray, elcount(__bDiagValueArray), __cDiagValueArray, elcount(__cDiagValueArray));
      {
        __bSetInCheckAlignment = 1;	
        {
          __bArrayCtr = __CopyBytes(__bDiagValueArray, __bDiagValueArrayCtr, __bArray);
          {
            sysvar * __systemVariable;
            __systemVariable = sysvarData::`PartNumber::`Part_Number;
            CheckSysVarSetBufferConsistency(sysSetVariableData(sysvarData::`PartNumber::`Part_Number, __bArray, __bArrayCtr), __systemVariable.name);
          }
          snprintf(__cArray, 8192, "%s", "Part_Number");
          snprintf(__cArray2, 8192, "%s '%s'", __cSysVar, __cArray);
          snprintf(__cArray3, 8192, "%s", "_Component_Code_48");
          
          ReportTableRow(__tableHandle, 0, __cArray2, __cAOp, __bArray, __bArrayCtr, __cArray3, __oneOfFlag, __bSetInCheckAlignment);
        
        }
    
        __bSetInCheckAlignment = 0;
      }
    }
    {
      __bDiagValueArrayCtr = DiagGetParameterErrorHandled(__resp, "_Data_Identifier_24", __bDiagValueArray, elcount(__bDiagValueArray), __cDiagValueArray, elcount(__cDiagValueArray));
      {
        __bSetInCheckAlignment = 1;	
        {
          __bArrayCtr = __CopyBytes(__bDiagValueArray, __bDiagValueArrayCtr, __bArray);
          {
            sysvar * __systemVariable;
            __systemVariable = sysvarData::`PartNumber::`Part_Number;
            CheckSysVarSetBufferConsistency(sysSetVariableData(sysvarData::`PartNumber::`Part_Number, __bArray, __bArrayCtr), __systemVariable.name);
          }
          snprintf(__cArray, 8192, "%s", "Part_Number");
          snprintf(__cArray2, 8192, "%s '%s'", __cSysVar, __cArray);
          snprintf(__cArray3, 8192, "%s", "_Data_Identifier_24");
          
          ReportTableRow(__tableHandle, 0, __cArray2, __cAOp, __bArray, __bArrayCtr, __cArray3, __oneOfFlag, __bSetInCheckAlignment);
        
        }
    
        __bSetInCheckAlignment = 0;
      }
    }
    {
      __bDiagValueArrayCtr = DiagGetParameterErrorHandled(__resp, "_Day_of_Year_64", __bDiagValueArray, elcount(__bDiagValueArray), __cDiagValueArray, elcount(__cDiagValueArray));
      {
        __bSetInCheckAlignment = 1;	
        {
          __bArrayCtr = __CopyBytes(__bDiagValueArray, __bDiagValueArrayCtr, __bArray);
          {
            sysvar * __systemVariable;
            __systemVariable = sysvarData::`PartNumber::`Part_Number;
            CheckSysVarSetBufferConsistency(sysSetVariableData(sysvarData::`PartNumber::`Part_Number, __bArray, __bArrayCtr), __systemVariable.name);
          }
          snprintf(__cArray, 8192, "%s", "Part_Number");
          snprintf(__cArray2, 8192, "%s '%s'", __cSysVar, __cArray);
          snprintf(__cArray3, 8192, "%s", "_Day_of_Year_64");
          
          ReportTableRow(__tableHandle, 0, __cArray2, __cAOp, __bArray, __bArrayCtr, __cArray3, __oneOfFlag, __bSetInCheckAlignment);
        
        }
    
        __bSetInCheckAlignment = 0;
      }
    }
    {
      __bDiagValueArrayCtr = DiagGetParameterErrorHandled(__resp, "_Sequence_Number_96", __bDiagValueArray, elcount(__bDiagValueArray), __cDiagValueArray, elcount(__cDiagValueArray));
      {
        __bSetInCheckAlignment = 1;	
        {
          __bArrayCtr = __CopyBytes(__bDiagValueArray, __bDiagValueArrayCtr, __bArray);
          {
            sysvar * __systemVariable;
            __systemVariable = sysvarData::`PartNumber::`Part_Number;
            CheckSysVarSetBufferConsistency(sysSetVariableData(sysvarData::`PartNumber::`Part_Number, __bArray, __bArrayCtr), __systemVariable.name);
          }
          snprintf(__cArray, 8192, "%s", "Part_Number");
          snprintf(__cArray2, 8192, "%s '%s'", __cSysVar, __cArray);
          snprintf(__cArray3, 8192, "%s", "_Sequence_Number_96");
          
          ReportTableRow(__tableHandle, 0, __cArray2, __cAOp, __bArray, __bArrayCtr, __cArray3, __oneOfFlag, __bSetInCheckAlignment);
        
        }
    
        __bSetInCheckAlignment = 0;
      }
    }
    {
      __bDiagValueArrayCtr = DiagGetParameterErrorHandled(__resp, "_Supplier_Option_32", __bDiagValueArray, elcount(__bDiagValueArray), __cDiagValueArray, elcount(__cDiagValueArray));
      {
        __bSetInCheckAlignment = 1;	
        {
          __bArrayCtr = __CopyBytes(__bDiagValueArray, __bDiagValueArrayCtr, __bArray);
          {
            sysvar * __systemVariable;
            __systemVariable = sysvarData::`PartNumber::`Part_Number;
            CheckSysVarSetBufferConsistency(sysSetVariableData(sysvarData::`PartNumber::`Part_Number, __bArray, __bArrayCtr), __systemVariable.name);
          }
          snprintf(__cArray, 8192, "%s", "Part_Number");
          snprintf(__cArray2, 8192, "%s '%s'", __cSysVar, __cArray);
          snprintf(__cArray3, 8192, "%s", "_Supplier_Option_32");
          
          ReportTableRow(__tableHandle, 0, __cArray2, __cAOp, __bArray, __bArrayCtr, __cArray3, __oneOfFlag, __bSetInCheckAlignment);
        
        }
    
        __bSetInCheckAlignment = 0;
      }
    }
    ReportTableEndVerdict(__tableHandle, __cEvaluateResponse, __res);
	__bVerdict = __bVerdict && __res;
  }
  if (__bVerdict == __eVerdictFail)
    TestReportWriteDiagObjectList();
}

void Tto7tsimc_F192_DID_with_Physical_Addressing()
{
  stack long __tableHandle;
  TestCommandBegin(__eDiagService, __cDiagService, "", "0");
  {
    if (DiagIsFunctionalGroup("CVADAS_0001_00000000_000"))
    {
      DiagResponse * __resp;
      DiagRequest CVADAS_0001_00000000_000._22F192_Supplier_ECU_Hardware_Part_Number __req;
      __diagServiceo7tsimc_38(__req, __resp);
    }
    else
    {
      DiagResponse CVADAS_0001_00000000_000.* __resp;
      DiagRequest CVADAS_0001_00000000_000._22F192_Supplier_ECU_Hardware_Part_Number __req;
      __diagServiceo7tsimc_38(__req, __resp);
    }
  }
  TestCommandEnd();


}

  
void __diagServiceo7tsimc_38(DiagRequest * __req, DiagResponse * __resp )
{
  stack long __tableHandle;
  long __res, __paramLen, __bytePos;

   __bVerdict = __eVerdictPass;

  do {
    TestReportResetDiagObjectList();
    DiagSetReportDetailLevel("CVADAS_0001_00000000_000", EnumServiceDetails_onfail);
    // Request aspect
    {
      {
        CheckLiteralGetStringBufferConsistency("F192", 8192);
      snprintf(__cDiagValueArray, 8192, "%s", "F192");
        __bDiagValueArrayCtr = __MapChar2ByteAtDiagSet(__cDiagValueArray, __bDiagValueArray);
        if (__bDiagValueArrayCtr >= 0)
        {
          __res = DiagSetParameterErrorHandled(__req, "RecordDataIdentifier", __bDiagValueArray, __bDiagValueArrayCtr);
          if(__res < 0)
          {
            __bVerdict = __eVerdictFail;
            DiagErrCodeTestStep(__res, "Cannot set diagnostic parameter 'RecordDataIdentifier'");
            break;
          }
        }
        else
        {
      	__bVerdict = __eVerdictFail;
          snprintf(__cArray2, 8192, "SetParameter: illegal byte sequence: '%s' (parameter %s). Use hex tuples like '01 AF ...'", __cDiagValueArray, "RecordDataIdentifier");
          DiagErrCodeTestStep(__bDiagValueArrayCtr, __cArray2);
          DiagErrCodeTestStep(-1, "Cannot set diagnostic parameter 'RecordDataIdentifier'");
      	break;
        }
      }

      if (0 >= DiagSendReqAndWaitForResp("CVADAS_0001_00000000_000", __req, __resp, __res, -1, -1, -1, -1, -1, EnumResult_pos, EnumServiceDetails_onfail, EnumSendingMode_physical, EnumSuppressPosResBit_asconfigured, EnumVerdictOnInvalidValues_fail))
        break;
    }

    __res = DiagErrCodeTestStep(__res, "Can't retrieve last response for request! No check possible.") < 0;
    if(__res)
    {
	  __bVerdict = __eVerdictFail;
      break;
    }
    {
      __res = DiagInterpretAs(__resp, "RDBI_PR");
      if(__res != 0)
      {
        __bVerdict = __eVerdictFail;
        DiagErrCodeTestStep(__res, "Can't interpret response as diagnostic primitive 'RDBI_PR'.");
        break;
      }
      else
      {
        TestStepPass( "Received primitive can be interpreted as diagnostic primitive 'RDBI_PR'.");
      }
    }
  }
  while(0);


  // Response, check & read aspect
  {
    __res = 1;
    __tableHandle = ReportTableHead5Columns(__cCheckCaption, __cTSym, __cTOp, __cRefVal, __cActual, __cRes);
    {
      __bDiagValueArrayCtr = DiagGetParameterErrorHandled(__resp, "_Supplier_Manufacturer_ECU_Hardware_Part_Number_24", __bDiagValueArray, elcount(__bDiagValueArray), __cDiagValueArray, elcount(__cDiagValueArray));
      {
        __bSetInCheckAlignment = 1;	
        {
          __bArrayCtr = __CopyBytes(__bDiagValueArray, __bDiagValueArrayCtr, __bArray);
          {
            sysvar * __systemVariable;
            __systemVariable = sysvarData::`PartNumber::`Part_Number;
            CheckSysVarSetBufferConsistency(sysSetVariableData(sysvarData::`PartNumber::`Part_Number, __bArray, __bArrayCtr), __systemVariable.name);
          }
          snprintf(__cArray, 8192, "%s", "Part_Number");
          snprintf(__cArray2, 8192, "%s '%s'", __cSysVar, __cArray);
          snprintf(__cArray3, 8192, "%s", "_Supplier_Manufacturer_ECU_Hardware_Part_Number_24");
          
          ReportTableRow(__tableHandle, 0, __cArray2, __cAOp, __bArray, __bArrayCtr, __cArray3, __oneOfFlag, __bSetInCheckAlignment);
        
        }
    
        __bSetInCheckAlignment = 0;
      }
    }
    ReportTableEndVerdict(__tableHandle, __cEvaluateResponse, __res);
	__bVerdict = __bVerdict && __res;
  }
  if (__bVerdict == __eVerdictFail)
    TestReportWriteDiagObjectList();
}

void Tto7tsimc_F193_DID_with_Physical_Addressing()
{
  stack long __tableHandle;
  TestCommandBegin(__eDiagService, __cDiagService, "", "0");
  {
    if (DiagIsFunctionalGroup("CVADAS_0001_00000000_000"))
    {
      DiagResponse * __resp;
      DiagRequest CVADAS_0001_00000000_000._22F193_Supplier_ECU_Hardware_Version_Number __req;
      __diagServiceo7tsimc_39(__req, __resp);
    }
    else
    {
      DiagResponse CVADAS_0001_00000000_000.* __resp;
      DiagRequest CVADAS_0001_00000000_000._22F193_Supplier_ECU_Hardware_Version_Number __req;
      __diagServiceo7tsimc_39(__req, __resp);
    }
  }
  TestCommandEnd();


}

  
void __diagServiceo7tsimc_39(DiagRequest * __req, DiagResponse * __resp )
{
  stack long __tableHandle;
  long __res, __paramLen, __bytePos;

   __bVerdict = __eVerdictPass;

  do {
    TestReportResetDiagObjectList();
    DiagSetReportDetailLevel("CVADAS_0001_00000000_000", EnumServiceDetails_onfail);
    // Request aspect
    {
      {
        CheckLiteralGetStringBufferConsistency("F193", 8192);
      snprintf(__cDiagValueArray, 8192, "%s", "F193");
        __bDiagValueArrayCtr = __MapChar2ByteAtDiagSet(__cDiagValueArray, __bDiagValueArray);
        if (__bDiagValueArrayCtr >= 0)
        {
          __res = DiagSetParameterErrorHandled(__req, "RecordDataIdentifier", __bDiagValueArray, __bDiagValueArrayCtr);
          if(__res < 0)
          {
            __bVerdict = __eVerdictFail;
            DiagErrCodeTestStep(__res, "Cannot set diagnostic parameter 'RecordDataIdentifier'");
            break;
          }
        }
        else
        {
      	__bVerdict = __eVerdictFail;
          snprintf(__cArray2, 8192, "SetParameter: illegal byte sequence: '%s' (parameter %s). Use hex tuples like '01 AF ...'", __cDiagValueArray, "RecordDataIdentifier");
          DiagErrCodeTestStep(__bDiagValueArrayCtr, __cArray2);
          DiagErrCodeTestStep(-1, "Cannot set diagnostic parameter 'RecordDataIdentifier'");
      	break;
        }
      }

      if (0 >= DiagSendReqAndWaitForResp("CVADAS_0001_00000000_000", __req, __resp, __res, -1, -1, -1, -1, -1, EnumResult_pos, EnumServiceDetails_onfail, EnumSendingMode_physical, EnumSuppressPosResBit_asconfigured, EnumVerdictOnInvalidValues_fail))
        break;
    }

    __res = DiagErrCodeTestStep(__res, "Can't retrieve last response for request! No check possible.") < 0;
    if(__res)
    {
	  __bVerdict = __eVerdictFail;
      break;
    }
    {
      __res = DiagInterpretAs(__resp, "RDBI_PR");
      if(__res != 0)
      {
        __bVerdict = __eVerdictFail;
        DiagErrCodeTestStep(__res, "Can't interpret response as diagnostic primitive 'RDBI_PR'.");
        break;
      }
      else
      {
        TestStepPass( "Received primitive can be interpreted as diagnostic primitive 'RDBI_PR'.");
      }
    }
  }
  while(0);


  // Response, check & read aspect
  {
    __res = 1;
    __tableHandle = ReportTableHead5Columns(__cCheckCaption, __cTSym, __cTOp, __cRefVal, __cActual, __cRes);
    {
      __bDiagValueArrayCtr = DiagGetParameterErrorHandled(__resp, "_Supplier_Manufacturer_ECU_Hardware_Version_Number_24", __bDiagValueArray, elcount(__bDiagValueArray), __cDiagValueArray, elcount(__cDiagValueArray));
      {
        __bSetInCheckAlignment = 1;	
        {
          __bArrayCtr = __CopyBytes(__bDiagValueArray, __bDiagValueArrayCtr, __bArray);
          {
            sysvar * __systemVariable;
            __systemVariable = sysvarData::`PartNumber::`Part_Number;
            CheckSysVarSetBufferConsistency(sysSetVariableData(sysvarData::`PartNumber::`Part_Number, __bArray, __bArrayCtr), __systemVariable.name);
          }
          snprintf(__cArray, 8192, "%s", "Part_Number");
          snprintf(__cArray2, 8192, "%s '%s'", __cSysVar, __cArray);
          snprintf(__cArray3, 8192, "%s", "_Supplier_Manufacturer_ECU_Hardware_Version_Number_24");
          
          ReportTableRow(__tableHandle, 0, __cArray2, __cAOp, __bArray, __bArrayCtr, __cArray3, __oneOfFlag, __bSetInCheckAlignment);
        
        }
    
        __bSetInCheckAlignment = 0;
      }
    }
    ReportTableEndVerdict(__tableHandle, __cEvaluateResponse, __res);
	__bVerdict = __bVerdict && __res;
  }
  if (__bVerdict == __eVerdictFail)
    TestReportWriteDiagObjectList();
}

void Tto7tsimc_FD15_DID_with_Physical_Address()
{
  stack long __tableHandle;
  TestCommandBegin(__eDiagService, __cDiagService, "", "0");
  {
    if (DiagIsFunctionalGroup("CVADAS_0001_00000000_000"))
    {
      DiagResponse * __resp;
      DiagRequest CVADAS_0001_00000000_000._22FD15_Magna_Production_HW_Number_Read __req;
      __diagServiceo7tsimc_40(__req, __resp);
    }
    else
    {
      DiagResponse CVADAS_0001_00000000_000.* __resp;
      DiagRequest CVADAS_0001_00000000_000._22FD15_Magna_Production_HW_Number_Read __req;
      __diagServiceo7tsimc_40(__req, __resp);
    }
  }
  TestCommandEnd();


}

  
void __diagServiceo7tsimc_40(DiagRequest * __req, DiagResponse * __resp )
{
  stack long __tableHandle;
  long __res, __paramLen, __bytePos;

   __bVerdict = __eVerdictPass;

  do {
    TestReportResetDiagObjectList();
    DiagSetReportDetailLevel("CVADAS_0001_00000000_000", EnumServiceDetails_onfail);
    // Request aspect
    {
      {
        CheckLiteralGetStringBufferConsistency("FD15", 8192);
      snprintf(__cDiagValueArray, 8192, "%s", "FD15");
        __bDiagValueArrayCtr = __MapChar2ByteAtDiagSet(__cDiagValueArray, __bDiagValueArray);
        if (__bDiagValueArrayCtr >= 0)
        {
          __res = DiagSetParameterErrorHandled(__req, "RecordDataIdentifier", __bDiagValueArray, __bDiagValueArrayCtr);
          if(__res < 0)
          {
            __bVerdict = __eVerdictFail;
            DiagErrCodeTestStep(__res, "Cannot set diagnostic parameter 'RecordDataIdentifier'");
            break;
          }
        }
        else
        {
      	__bVerdict = __eVerdictFail;
          snprintf(__cArray2, 8192, "SetParameter: illegal byte sequence: '%s' (parameter %s). Use hex tuples like '01 AF ...'", __cDiagValueArray, "RecordDataIdentifier");
          DiagErrCodeTestStep(__bDiagValueArrayCtr, __cArray2);
          DiagErrCodeTestStep(-1, "Cannot set diagnostic parameter 'RecordDataIdentifier'");
      	break;
        }
      }

      if (0 >= DiagSendReqAndWaitForResp("CVADAS_0001_00000000_000", __req, __resp, __res, -1, -1, -1, -1, -1, EnumResult_pos, EnumServiceDetails_onfail, EnumSendingMode_physical, EnumSuppressPosResBit_asconfigured, EnumVerdictOnInvalidValues_fail))
        break;
    }

    __res = DiagErrCodeTestStep(__res, "Can't retrieve last response for request! No check possible.") < 0;
    if(__res)
    {
	  __bVerdict = __eVerdictFail;
      break;
    }
    {
      __res = DiagInterpretAs(__resp, "RDBI_PR");
      if(__res != 0)
      {
        __bVerdict = __eVerdictFail;
        DiagErrCodeTestStep(__res, "Can't interpret response as diagnostic primitive 'RDBI_PR'.");
        break;
      }
      else
      {
        TestStepPass( "Received primitive can be interpreted as diagnostic primitive 'RDBI_PR'.");
      }
    }
  }
  while(0);


  // Response, check & read aspect
  {
    __res = 1;
    __tableHandle = ReportTableHead5Columns(__cCheckCaption, __cTSym, __cTOp, __cRefVal, __cActual, __cRes);
    {
      __bDiagValueArrayCtr = DiagGetParameterErrorHandled(__resp, "Magna_ProdHWNum", __bDiagValueArray, elcount(__bDiagValueArray), __cDiagValueArray, elcount(__cDiagValueArray));
      {
        __bSetInCheckAlignment = 1;	
        {
          __bArrayCtr = __CopyBytes(__bDiagValueArray, __bDiagValueArrayCtr, __bArray);
          {
            sysvar * __systemVariable;
            __systemVariable = sysvarData::`PartNumber::`Part_Number;
            CheckSysVarSetBufferConsistency(sysSetVariableData(sysvarData::`PartNumber::`Part_Number, __bArray, __bArrayCtr), __systemVariable.name);
          }
          snprintf(__cArray, 8192, "%s", "Part_Number");
          snprintf(__cArray2, 8192, "%s '%s'", __cSysVar, __cArray);
          snprintf(__cArray3, 8192, "%s", "Magna_ProdHWNum");
          
          ReportTableRow(__tableHandle, 0, __cArray2, __cAOp, __bArray, __bArrayCtr, __cArray3, __oneOfFlag, __bSetInCheckAlignment);
        
        }
    
        __bSetInCheckAlignment = 0;
      }
    }
    ReportTableEndVerdict(__tableHandle, __cEvaluateResponse, __res);
	__bVerdict = __bVerdict && __res;
  }
  if (__bVerdict == __eVerdictFail)
    TestReportWriteDiagObjectList();
}

void Tto7tsimc_FD15_DID_with_Standard_Physical_Address()
{
  stack long __tableHandle;
  TestCommandBegin(__eRequestResponse, __cRequestResponse, "", "0");
  {
  
    long __res;
    int64 __timeout;
    __res = 0;
    __nInt64 = 1;
    __timeout = syspar::`P2_Server * 1000000LL;
    {
    
      long __testStepInitOk;
      message `FDCAN2::`DIAGNOSTIC_REQUEST_PAM __output;
      message `FDCAN2::`DIAGNOSTIC_REQUEST_PAM __msgOrig;
      __output = __msgOrig;
      __testStepInitOk = 1;
      {
        int64 __dlc;
        __dlc = 4;
        if (__dlc >= 0 && __dlc <= (__output.EDL ? 15 : 8))
          __output.DLC = __dlc;
        else
        {
          testStepErrorInTestSystem(0, __cEmpty, "Unable to set DLC=%lld in message. Please check input parameter.", __dlc);
          __testStepInitOk = 0;
        }
      }
      if (__testStepInitOk)
      {
        snprintf(__cArray, elCount(__cArray), "CAN message '%s' ID = 416981233x (0x18DAA0F1x) on bus FDCAN2", "DIAGNOSTIC_REQUEST_PAM");
        snprintf(__cArray2, elCount(__cArray2), "Send %s", __cArray);
        __tableHandle = ReportTableHead3Columns(__cArray2, "Byte", __cTOp, __cAssigned);
        ReportByteIndex("", 0, __cArray, elCount(__cArray));
        snprintf(__cArray2, 8192, "%s", __cArray);
        snprintf(__cArray3, 8192, "%s", "");
        
        ReportTableRow(__tableHandle, 0, __cArray2, __cAOp, 0x3, __cArray3, __oneOfFlag, __bSetInCheckAlignment);
        
        if (0 >= 0 && 0 < 64)
        {
          __output.byte((word)0) = 0x3;
        }
        else
        {
          testStepErrorInTestSystem(0, __cEmpty, "Index out of range. Unable to set byte %lld in message. Please check input parameter.", (int64)0);
          __testStepInitOk = 0;
        }
        ReportByteIndex("", 1, __cArray, elCount(__cArray));
        snprintf(__cArray2, 8192, "%s", __cArray);
        snprintf(__cArray3, 8192, "%s", "");
        
        ReportTableRow(__tableHandle, 0, __cArray2, __cAOp, 0x22, __cArray3, __oneOfFlag, __bSetInCheckAlignment);
        
        if (1 >= 0 && 1 < 64)
        {
          __output.byte((word)1) = 0x22;
        }
        else
        {
          testStepErrorInTestSystem(0, __cEmpty, "Index out of range. Unable to set byte %lld in message. Please check input parameter.", (int64)1);
          __testStepInitOk = 0;
        }
        ReportByteIndex("", 2, __cArray, elCount(__cArray));
        snprintf(__cArray2, 8192, "%s", __cArray);
        snprintf(__cArray3, 8192, "%s", "");
        
        ReportTableRow(__tableHandle, 0, __cArray2, __cAOp, 0xFD, __cArray3, __oneOfFlag, __bSetInCheckAlignment);
        
        if (2 >= 0 && 2 < 64)
        {
          __output.byte((word)2) = 0xFD;
        }
        else
        {
          testStepErrorInTestSystem(0, __cEmpty, "Index out of range. Unable to set byte %lld in message. Please check input parameter.", (int64)2);
          __testStepInitOk = 0;
        }
        ReportByteIndex("", 3, __cArray, elCount(__cArray));
        snprintf(__cArray2, 8192, "%s", __cArray);
        snprintf(__cArray3, 8192, "%s", "");
        
        ReportTableRow(__tableHandle, 0, __cArray2, __cAOp, 0x15, __cArray3, __oneOfFlag, __bSetInCheckAlignment);
        
        if (3 >= 0 && 3 < 64)
        {
          __output.byte((word)3) = 0x15;
        }
        else
        {
          testStepErrorInTestSystem(0, __cEmpty, "Index out of range. Unable to set byte %lld in message. Please check input parameter.", (int64)3);
          __testStepInitOk = 0;
        }
      
        ReportTableEndTestStep(__tableHandle, "Req1");
      }
      if (__testStepInitOk)
      {
        output(__output);
      }
    }
    if (__timeout <= 0)
    {
      testStepErrorInTestSystem(0, "1", "Unable to wait for %.3f %s. Please check input parameter.", __timeout / ((float)1000000), "ms");
    }
    else
    {
      __tt8cnt_47 = 0;
      snprintf(__cArray, elCount(__cArray), "CAN message '%s' ID = 417001888x (0x18DAF1A0x) on bus FDCAN2", "DIAGNOSTIC_RESPONSE_PAM");
      if(SetBusContextByName("FDCAN2", __eSaveCurrent, __nBusContextNew, __nBusContextOld))
        testJoinMessageEvent(`FDCAN2::`DIAGNOSTIC_RESPONSE_PAM,  __cArray,
             delegate dword(message * __m)
             {
               dword __msg_callback_ret;
               if (__tt8cnt_47 == -1)
               {
                 return 1;
               }
               __msg_callback_ret = 1;
               __tt8cnt_47++;
               if (__msg_callback_ret)
               {
                 __tt8cnt_47 = -1;
                 return 1;
               }
               return 0;
             });
      __res = testWaitForAllJoinedEventsNS(__timeout);
      if (__nInt64 != 0)
      {
        snprintf(__cArray, elCount(__cArray), "CAN message '%s' ID = 417001888x (0x18DAF1A0x) on bus FDCAN2", "DIAGNOSTIC_RESPONSE_PAM");
        if(__tt8cnt_47 == -1)
        {
          snprintf(__cArray2, 8192, "Response of %s", __cArray);
        }
        else
        {
          snprintf(__cArray2, 8192, "Response of %s (received %d times)", __cArray, __tt8cnt_47);
        }
        if (__tt8cnt_47 == 0)
        {
          testStepFail(0, "Resp1", __cArray2);
        }
        else
        {
          testStepPass(2, "Resp1", __cArray2);
        }
        __ReportRequestResponseResult(__res, 0);
      }
      ResetBusContext(__nBusContextNew, __nBusContextOld);
    }
  }
  TestCommandEnd();

}

void Tto7tsimc_FD17_DID_with_Physical_Address()
{
  stack long __tableHandle;
  TestCommandBegin(__eDiagService, __cDiagService, "", "0");
  {
    if (DiagIsFunctionalGroup("CVADAS_0001_00000000_000"))
    {
      DiagResponse * __resp;
      DiagRequest CVADAS_0001_00000000_000._22FD17_Magna_Production_HW_Version_information_Read __req;
      __diagServiceo7tsimc_41(__req, __resp);
    }
    else
    {
      DiagResponse CVADAS_0001_00000000_000.* __resp;
      DiagRequest CVADAS_0001_00000000_000._22FD17_Magna_Production_HW_Version_information_Read __req;
      __diagServiceo7tsimc_41(__req, __resp);
    }
  }
  TestCommandEnd();


}

  
void __diagServiceo7tsimc_41(DiagRequest * __req, DiagResponse * __resp )
{
  stack long __tableHandle;
  long __res, __paramLen, __bytePos;

   __bVerdict = __eVerdictPass;

  do {
    TestReportResetDiagObjectList();
    DiagSetReportDetailLevel("CVADAS_0001_00000000_000", EnumServiceDetails_onfail);
    // Request aspect
    {
      {
        CheckLiteralGetStringBufferConsistency("FD17", 8192);
      snprintf(__cDiagValueArray, 8192, "%s", "FD17");
        __bDiagValueArrayCtr = __MapChar2ByteAtDiagSet(__cDiagValueArray, __bDiagValueArray);
        if (__bDiagValueArrayCtr >= 0)
        {
          __res = DiagSetParameterErrorHandled(__req, "RecordDataIdentifier", __bDiagValueArray, __bDiagValueArrayCtr);
          if(__res < 0)
          {
            __bVerdict = __eVerdictFail;
            DiagErrCodeTestStep(__res, "Cannot set diagnostic parameter 'RecordDataIdentifier'");
            break;
          }
        }
        else
        {
      	__bVerdict = __eVerdictFail;
          snprintf(__cArray2, 8192, "SetParameter: illegal byte sequence: '%s' (parameter %s). Use hex tuples like '01 AF ...'", __cDiagValueArray, "RecordDataIdentifier");
          DiagErrCodeTestStep(__bDiagValueArrayCtr, __cArray2);
          DiagErrCodeTestStep(-1, "Cannot set diagnostic parameter 'RecordDataIdentifier'");
      	break;
        }
      }

      if (0 >= DiagSendReqAndWaitForResp("CVADAS_0001_00000000_000", __req, __resp, __res, -1, -1, -1, -1, -1, EnumResult_pos, EnumServiceDetails_onfail, EnumSendingMode_physical, EnumSuppressPosResBit_asconfigured, EnumVerdictOnInvalidValues_fail))
        break;
    }

    __res = DiagErrCodeTestStep(__res, "Can't retrieve last response for request! No check possible.") < 0;
    if(__res)
    {
	  __bVerdict = __eVerdictFail;
      break;
    }
    {
      __res = DiagInterpretAs(__resp, "RDBI_PR");
      if(__res != 0)
      {
        __bVerdict = __eVerdictFail;
        DiagErrCodeTestStep(__res, "Can't interpret response as diagnostic primitive 'RDBI_PR'.");
        break;
      }
      else
      {
        TestStepPass( "Received primitive can be interpreted as diagnostic primitive 'RDBI_PR'.");
      }
    }
  }
  while(0);


  // Response, check & read aspect
  {
    __res = 1;
    __tableHandle = ReportTableHead5Columns(__cCheckCaption, __cTSym, __cTOp, __cRefVal, __cActual, __cRes);
    {
      __bDiagValueArrayCtr = DiagGetParameterErrorHandled(__resp, "Magna_ProdHwVerInfo_HW_PatchLvl", __bDiagValueArray, elcount(__bDiagValueArray), __cDiagValueArray, elcount(__cDiagValueArray));
      {
        __bSetInCheckAlignment = 1;	
        {
          __bArrayCtr = __CopyBytes(__bDiagValueArray, __bDiagValueArrayCtr, __bArray);
          {
            sysvar * __systemVariable;
            __systemVariable = sysvarData::`PartNumber::`Part_Number;
            CheckSysVarSetBufferConsistency(sysSetVariableData(sysvarData::`PartNumber::`Part_Number, __bArray, __bArrayCtr), __systemVariable.name);
          }
          snprintf(__cArray, 8192, "%s", "Part_Number");
          snprintf(__cArray2, 8192, "%s '%s'", __cSysVar, __cArray);
          snprintf(__cArray3, 8192, "%s", "Magna_ProdHwVerInfo_HW_PatchLvl");
          
          ReportTableRow(__tableHandle, 0, __cArray2, __cAOp, __bArray, __bArrayCtr, __cArray3, __oneOfFlag, __bSetInCheckAlignment);
        
        }
    
        __bSetInCheckAlignment = 0;
      }
    }
    {
      __bDiagValueArrayCtr = DiagGetParameterErrorHandled(__resp, "Magna_ProdHwVerInfo_HW_Week", __bDiagValueArray, elcount(__bDiagValueArray), __cDiagValueArray, elcount(__cDiagValueArray));
      {
        __bSetInCheckAlignment = 1;	
        {
          __bArrayCtr = __CopyBytes(__bDiagValueArray, __bDiagValueArrayCtr, __bArray);
          {
            sysvar * __systemVariable;
            __systemVariable = sysvarData::`PartNumber::`Part_Number;
            CheckSysVarSetBufferConsistency(sysSetVariableData(sysvarData::`PartNumber::`Part_Number, __bArray, __bArrayCtr), __systemVariable.name);
          }
          snprintf(__cArray, 8192, "%s", "Part_Number");
          snprintf(__cArray2, 8192, "%s '%s'", __cSysVar, __cArray);
          snprintf(__cArray3, 8192, "%s", "Magna_ProdHwVerInfo_HW_Week");
          
          ReportTableRow(__tableHandle, 0, __cArray2, __cAOp, __bArray, __bArrayCtr, __cArray3, __oneOfFlag, __bSetInCheckAlignment);
        
        }
    
        __bSetInCheckAlignment = 0;
      }
    }
    {
      __bDiagValueArrayCtr = DiagGetParameterErrorHandled(__resp, "Magna_ProdHwVerInfo_HW_Year", __bDiagValueArray, elcount(__bDiagValueArray), __cDiagValueArray, elcount(__cDiagValueArray));
      {
        __bSetInCheckAlignment = 1;	
        {
          __bArrayCtr = __CopyBytes(__bDiagValueArray, __bDiagValueArrayCtr, __bArray);
          {
            sysvar * __systemVariable;
            __systemVariable = sysvarData::`PartNumber::`Part_Number;
            CheckSysVarSetBufferConsistency(sysSetVariableData(sysvarData::`PartNumber::`Part_Number, __bArray, __bArrayCtr), __systemVariable.name);
          }
          snprintf(__cArray, 8192, "%s", "Part_Number");
          snprintf(__cArray2, 8192, "%s '%s'", __cSysVar, __cArray);
          snprintf(__cArray3, 8192, "%s", "Magna_ProdHwVerInfo_HW_Year");
          
          ReportTableRow(__tableHandle, 0, __cArray2, __cAOp, __bArray, __bArrayCtr, __cArray3, __oneOfFlag, __bSetInCheckAlignment);
        
        }
    
        __bSetInCheckAlignment = 0;
      }
    }
    ReportTableEndVerdict(__tableHandle, __cEvaluateResponse, __res);
	__bVerdict = __bVerdict && __res;
  }
  if (__bVerdict == __eVerdictFail)
    TestReportWriteDiagObjectList();
}

void Tto7tsimc_FD17_DID_with_Standard_Physical_Address()
{
  stack long __tableHandle;
  TestCommandBegin(__eRequestResponse, __cRequestResponse, "", "0");
  {
  
    long __res;
    int64 __timeout;
    __res = 0;
    __nInt64 = 1;
    __timeout = syspar::`P2_Server * 1000000LL;
    {
    
      long __testStepInitOk;
      message `FDCAN2::`DIAGNOSTIC_REQUEST_PAM __output;
      message `FDCAN2::`DIAGNOSTIC_REQUEST_PAM __msgOrig;
      __output = __msgOrig;
      __testStepInitOk = 1;
      {
        int64 __dlc;
        __dlc = 4;
        if (__dlc >= 0 && __dlc <= (__output.EDL ? 15 : 8))
          __output.DLC = __dlc;
        else
        {
          testStepErrorInTestSystem(0, __cEmpty, "Unable to set DLC=%lld in message. Please check input parameter.", __dlc);
          __testStepInitOk = 0;
        }
      }
      if (__testStepInitOk)
      {
        snprintf(__cArray, elCount(__cArray), "CAN message '%s' ID = 416981233x (0x18DAA0F1x) on bus FDCAN2", "DIAGNOSTIC_REQUEST_PAM");
        snprintf(__cArray2, elCount(__cArray2), "Send %s", __cArray);
        __tableHandle = ReportTableHead3Columns(__cArray2, "Byte", __cTOp, __cAssigned);
        ReportByteIndex("", 0, __cArray, elCount(__cArray));
        snprintf(__cArray2, 8192, "%s", __cArray);
        snprintf(__cArray3, 8192, "%s", "");
        
        ReportTableRow(__tableHandle, 0, __cArray2, __cAOp, 0x3, __cArray3, __oneOfFlag, __bSetInCheckAlignment);
        
        if (0 >= 0 && 0 < 64)
        {
          __output.byte((word)0) = 0x3;
        }
        else
        {
          testStepErrorInTestSystem(0, __cEmpty, "Index out of range. Unable to set byte %lld in message. Please check input parameter.", (int64)0);
          __testStepInitOk = 0;
        }
        ReportByteIndex("", 1, __cArray, elCount(__cArray));
        snprintf(__cArray2, 8192, "%s", __cArray);
        snprintf(__cArray3, 8192, "%s", "");
        
        ReportTableRow(__tableHandle, 0, __cArray2, __cAOp, 0x22, __cArray3, __oneOfFlag, __bSetInCheckAlignment);
        
        if (1 >= 0 && 1 < 64)
        {
          __output.byte((word)1) = 0x22;
        }
        else
        {
          testStepErrorInTestSystem(0, __cEmpty, "Index out of range. Unable to set byte %lld in message. Please check input parameter.", (int64)1);
          __testStepInitOk = 0;
        }
        ReportByteIndex("", 2, __cArray, elCount(__cArray));
        snprintf(__cArray2, 8192, "%s", __cArray);
        snprintf(__cArray3, 8192, "%s", "");
        
        ReportTableRow(__tableHandle, 0, __cArray2, __cAOp, 0xFD, __cArray3, __oneOfFlag, __bSetInCheckAlignment);
        
        if (2 >= 0 && 2 < 64)
        {
          __output.byte((word)2) = 0xFD;
        }
        else
        {
          testStepErrorInTestSystem(0, __cEmpty, "Index out of range. Unable to set byte %lld in message. Please check input parameter.", (int64)2);
          __testStepInitOk = 0;
        }
        ReportByteIndex("", 3, __cArray, elCount(__cArray));
        snprintf(__cArray2, 8192, "%s", __cArray);
        snprintf(__cArray3, 8192, "%s", "");
        
        ReportTableRow(__tableHandle, 0, __cArray2, __cAOp, 0x17, __cArray3, __oneOfFlag, __bSetInCheckAlignment);
        
        if (3 >= 0 && 3 < 64)
        {
          __output.byte((word)3) = 0x17;
        }
        else
        {
          testStepErrorInTestSystem(0, __cEmpty, "Index out of range. Unable to set byte %lld in message. Please check input parameter.", (int64)3);
          __testStepInitOk = 0;
        }
      
        ReportTableEndTestStep(__tableHandle, "Req1");
      }
      if (__testStepInitOk)
      {
        output(__output);
      }
    }
    if (__timeout <= 0)
    {
      testStepErrorInTestSystem(0, "1", "Unable to wait for %.3f %s. Please check input parameter.", __timeout / ((float)1000000), "ms");
    }
    else
    {
      __tt8cnt_49 = 0;
      snprintf(__cArray, elCount(__cArray), "CAN message '%s' ID = 417001888x (0x18DAF1A0x) on bus FDCAN2", "DIAGNOSTIC_RESPONSE_PAM");
      if(SetBusContextByName("FDCAN2", __eSaveCurrent, __nBusContextNew, __nBusContextOld))
        testJoinMessageEvent(`FDCAN2::`DIAGNOSTIC_RESPONSE_PAM,  __cArray,
             delegate dword(message * __m)
             {
               dword __msg_callback_ret;
               if (__tt8cnt_49 == -1)
               {
                 return 1;
               }
               __msg_callback_ret = 1;
               __tt8cnt_49++;
               if (__msg_callback_ret)
               {
                 __tt8cnt_49 = -1;
                 return 1;
               }
               return 0;
             });
      __res = testWaitForAllJoinedEventsNS(__timeout);
      if (__nInt64 != 0)
      {
        snprintf(__cArray, elCount(__cArray), "CAN message '%s' ID = 417001888x (0x18DAF1A0x) on bus FDCAN2", "DIAGNOSTIC_RESPONSE_PAM");
        if(__tt8cnt_49 == -1)
        {
          snprintf(__cArray2, 8192, "Response of %s", __cArray);
        }
        else
        {
          snprintf(__cArray2, 8192, "Response of %s (received %d times)", __cArray, __tt8cnt_49);
        }
        if (__tt8cnt_49 == 0)
        {
          testStepFail(0, "Resp1", __cArray2);
        }
        else
        {
          testStepPass(2, "Resp1", __cArray2);
        }
        __ReportRequestResponseResult(__res, 0);
      }
      ResetBusContext(__nBusContextNew, __nBusContextOld);
    }
  }
  TestCommandEnd();

}

void Tto7tsimc_FD16_DID_with_Physical_Address()
{
  stack long __tableHandle;
  TestCommandBegin(__eDiagService, __cDiagService, "", "0");
  {
    if (DiagIsFunctionalGroup("CVADAS_0001_00000000_000"))
    {
      DiagResponse * __resp;
      DiagRequest CVADAS_0001_00000000_000._22FD16_Magna_Production_ICT_Data_Read __req;
      __diagServiceo7tsimc_42(__req, __resp);
    }
    else
    {
      DiagResponse CVADAS_0001_00000000_000.* __resp;
      DiagRequest CVADAS_0001_00000000_000._22FD16_Magna_Production_ICT_Data_Read __req;
      __diagServiceo7tsimc_42(__req, __resp);
    }
  }
  TestCommandEnd();


}

  
void __diagServiceo7tsimc_42(DiagRequest * __req, DiagResponse * __resp )
{
  stack long __tableHandle;
  long __res, __paramLen, __bytePos;

   __bVerdict = __eVerdictPass;

  do {
    TestReportResetDiagObjectList();
    DiagSetReportDetailLevel("CVADAS_0001_00000000_000", EnumServiceDetails_onfail);
    // Request aspect
    {
      {
        CheckLiteralGetStringBufferConsistency("FD16", 8192);
      snprintf(__cDiagValueArray, 8192, "%s", "FD16");
        __bDiagValueArrayCtr = __MapChar2ByteAtDiagSet(__cDiagValueArray, __bDiagValueArray);
        if (__bDiagValueArrayCtr >= 0)
        {
          __res = DiagSetParameterErrorHandled(__req, "RecordDataIdentifier", __bDiagValueArray, __bDiagValueArrayCtr);
          if(__res < 0)
          {
            __bVerdict = __eVerdictFail;
            DiagErrCodeTestStep(__res, "Cannot set diagnostic parameter 'RecordDataIdentifier'");
            break;
          }
        }
        else
        {
      	__bVerdict = __eVerdictFail;
          snprintf(__cArray2, 8192, "SetParameter: illegal byte sequence: '%s' (parameter %s). Use hex tuples like '01 AF ...'", __cDiagValueArray, "RecordDataIdentifier");
          DiagErrCodeTestStep(__bDiagValueArrayCtr, __cArray2);
          DiagErrCodeTestStep(-1, "Cannot set diagnostic parameter 'RecordDataIdentifier'");
      	break;
        }
      }

      if (0 >= DiagSendReqAndWaitForResp("CVADAS_0001_00000000_000", __req, __resp, __res, -1, -1, -1, -1, -1, EnumResult_pos, EnumServiceDetails_onfail, EnumSendingMode_physical, EnumSuppressPosResBit_asconfigured, EnumVerdictOnInvalidValues_fail))
        break;
    }

    __res = DiagErrCodeTestStep(__res, "Can't retrieve last response for request! No check possible.") < 0;
    if(__res)
    {
	  __bVerdict = __eVerdictFail;
      break;
    }
    {
      __res = DiagInterpretAs(__resp, "RDBI_PR");
      if(__res != 0)
      {
        __bVerdict = __eVerdictFail;
        DiagErrCodeTestStep(__res, "Can't interpret response as diagnostic primitive 'RDBI_PR'.");
        break;
      }
      else
      {
        TestStepPass( "Received primitive can be interpreted as diagnostic primitive 'RDBI_PR'.");
      }
    }
  }
  while(0);


  // Response, check & read aspect
  {
    __res = 1;
    __tableHandle = ReportTableHead5Columns(__cCheckCaption, __cTSym, __cTOp, __cRefVal, __cActual, __cRes);
    {
      __bDiagValueArrayCtr = DiagGetParameterErrorHandled(__resp, "Magna_ProdHWNum", __bDiagValueArray, elcount(__bDiagValueArray), __cDiagValueArray, elcount(__cDiagValueArray));
      {
        __bSetInCheckAlignment = 1;	
        {
          __bArrayCtr = __CopyBytes(__bDiagValueArray, __bDiagValueArrayCtr, __bArray);
          {
            sysvar * __systemVariable;
            __systemVariable = sysvarData::`PartNumber::`Part_Number;
            CheckSysVarSetBufferConsistency(sysSetVariableData(sysvarData::`PartNumber::`Part_Number, __bArray, __bArrayCtr), __systemVariable.name);
          }
          snprintf(__cArray, 8192, "%s", "Part_Number");
          snprintf(__cArray2, 8192, "%s '%s'", __cSysVar, __cArray);
          snprintf(__cArray3, 8192, "%s", "Magna_ProdHWNum");
          
          ReportTableRow(__tableHandle, 0, __cArray2, __cAOp, __bArray, __bArrayCtr, __cArray3, __oneOfFlag, __bSetInCheckAlignment);
        
        }
    
        __bSetInCheckAlignment = 0;
      }
    }
    ReportTableEndVerdict(__tableHandle, __cEvaluateResponse, __res);
	__bVerdict = __bVerdict && __res;
  }
  if (__bVerdict == __eVerdictFail)
    TestReportWriteDiagObjectList();
}

void Tto7tsimc_FD16_DID_with_Standard_Physical_Address()
{
  stack long __tableHandle;
  TestCommandBegin(__eRequestResponse, __cRequestResponse, "", "0");
  {
  
    long __res;
    int64 __timeout;
    __res = 0;
    __nInt64 = 1;
    __timeout = syspar::`P2_Server * 1000000LL;
    {
    
      long __testStepInitOk;
      message `FDCAN2::`DIAGNOSTIC_REQUEST_PAM __output;
      message `FDCAN2::`DIAGNOSTIC_REQUEST_PAM __msgOrig;
      __output = __msgOrig;
      __testStepInitOk = 1;
      {
        int64 __dlc;
        __dlc = 4;
        if (__dlc >= 0 && __dlc <= (__output.EDL ? 15 : 8))
          __output.DLC = __dlc;
        else
        {
          testStepErrorInTestSystem(0, __cEmpty, "Unable to set DLC=%lld in message. Please check input parameter.", __dlc);
          __testStepInitOk = 0;
        }
      }
      if (__testStepInitOk)
      {
        snprintf(__cArray, elCount(__cArray), "CAN message '%s' ID = 416981233x (0x18DAA0F1x) on bus FDCAN2", "DIAGNOSTIC_REQUEST_PAM");
        snprintf(__cArray2, elCount(__cArray2), "Send %s", __cArray);
        __tableHandle = ReportTableHead3Columns(__cArray2, "Byte", __cTOp, __cAssigned);
        ReportByteIndex("", 0, __cArray, elCount(__cArray));
        snprintf(__cArray2, 8192, "%s", __cArray);
        snprintf(__cArray3, 8192, "%s", "");
        
        ReportTableRow(__tableHandle, 0, __cArray2, __cAOp, 0x3, __cArray3, __oneOfFlag, __bSetInCheckAlignment);
        
        if (0 >= 0 && 0 < 64)
        {
          __output.byte((word)0) = 0x3;
        }
        else
        {
          testStepErrorInTestSystem(0, __cEmpty, "Index out of range. Unable to set byte %lld in message. Please check input parameter.", (int64)0);
          __testStepInitOk = 0;
        }
        ReportByteIndex("", 1, __cArray, elCount(__cArray));
        snprintf(__cArray2, 8192, "%s", __cArray);
        snprintf(__cArray3, 8192, "%s", "");
        
        ReportTableRow(__tableHandle, 0, __cArray2, __cAOp, 0x22, __cArray3, __oneOfFlag, __bSetInCheckAlignment);
        
        if (1 >= 0 && 1 < 64)
        {
          __output.byte((word)1) = 0x22;
        }
        else
        {
          testStepErrorInTestSystem(0, __cEmpty, "Index out of range. Unable to set byte %lld in message. Please check input parameter.", (int64)1);
          __testStepInitOk = 0;
        }
        ReportByteIndex("", 2, __cArray, elCount(__cArray));
        snprintf(__cArray2, 8192, "%s", __cArray);
        snprintf(__cArray3, 8192, "%s", "");
        
        ReportTableRow(__tableHandle, 0, __cArray2, __cAOp, 0xFD, __cArray3, __oneOfFlag, __bSetInCheckAlignment);
        
        if (2 >= 0 && 2 < 64)
        {
          __output.byte((word)2) = 0xFD;
        }
        else
        {
          testStepErrorInTestSystem(0, __cEmpty, "Index out of range. Unable to set byte %lld in message. Please check input parameter.", (int64)2);
          __testStepInitOk = 0;
        }
        ReportByteIndex("", 3, __cArray, elCount(__cArray));
        snprintf(__cArray2, 8192, "%s", __cArray);
        snprintf(__cArray3, 8192, "%s", "");
        
        ReportTableRow(__tableHandle, 0, __cArray2, __cAOp, 0x16, __cArray3, __oneOfFlag, __bSetInCheckAlignment);
        
        if (3 >= 0 && 3 < 64)
        {
          __output.byte((word)3) = 0x16;
        }
        else
        {
          testStepErrorInTestSystem(0, __cEmpty, "Index out of range. Unable to set byte %lld in message. Please check input parameter.", (int64)3);
          __testStepInitOk = 0;
        }
      
        ReportTableEndTestStep(__tableHandle, "Req1");
      }
      if (__testStepInitOk)
      {
        output(__output);
      }
    }
    if (__timeout <= 0)
    {
      testStepErrorInTestSystem(0, "1", "Unable to wait for %.3f %s. Please check input parameter.", __timeout / ((float)1000000), "ms");
    }
    else
    {
      __tt8cnt_51 = 0;
      snprintf(__cArray, elCount(__cArray), "CAN message '%s' ID = 417001888x (0x18DAF1A0x) on bus FDCAN2", "DIAGNOSTIC_RESPONSE_PAM");
      if(SetBusContextByName("FDCAN2", __eSaveCurrent, __nBusContextNew, __nBusContextOld))
        testJoinMessageEvent(`FDCAN2::`DIAGNOSTIC_RESPONSE_PAM,  __cArray,
             delegate dword(message * __m)
             {
               dword __msg_callback_ret;
               if (__tt8cnt_51 == -1)
               {
                 return 1;
               }
               __msg_callback_ret = 1;
               __tt8cnt_51++;
               if (__msg_callback_ret)
               {
                 __tt8cnt_51 = -1;
                 return 1;
               }
               return 0;
             });
      __res = testWaitForAllJoinedEventsNS(__timeout);
      if (__nInt64 != 0)
      {
        snprintf(__cArray, elCount(__cArray), "CAN message '%s' ID = 417001888x (0x18DAF1A0x) on bus FDCAN2", "DIAGNOSTIC_RESPONSE_PAM");
        if(__tt8cnt_51 == -1)
        {
          snprintf(__cArray2, 8192, "Response of %s", __cArray);
        }
        else
        {
          snprintf(__cArray2, 8192, "Response of %s (received %d times)", __cArray, __tt8cnt_51);
        }
        if (__tt8cnt_51 == 0)
        {
          testStepFail(0, "Resp1", __cArray2);
        }
        else
        {
          testStepPass(2, "Resp1", __cArray2);
        }
        __ReportRequestResponseResult(__res, 0);
      }
      ResetBusContext(__nBusContextNew, __nBusContextOld);
    }
  }
  TestCommandEnd();

}

void Tto7tsimc_Hard_Reset_with_Physical_Address()
{
  stack long __tableHandle;
  TestCommandBegin(__eDiagService, __cDiagService, "", "0");
  {
    if (DiagIsFunctionalGroup("CVADAS_0001_00000000_000"))
    {
      DiagResponse * __resp;
      DiagRequest CVADAS_0001_00000000_000.HardReset_Reset __req;
      __diagServiceo7tsimc_43(__req, __resp);
    }
    else
    {
      DiagResponse CVADAS_0001_00000000_000.* __resp;
      DiagRequest CVADAS_0001_00000000_000.HardReset_Reset __req;
      __diagServiceo7tsimc_43(__req, __resp);
    }
  }
  TestCommandEnd();


}

  
void __diagServiceo7tsimc_43(DiagRequest * __req, DiagResponse * __resp )
{
  stack long __tableHandle;
  long __res, __paramLen, __bytePos;

   __bVerdict = __eVerdictPass;

  do {
    TestReportResetDiagObjectList();
    DiagSetReportDetailLevel("CVADAS_0001_00000000_000", EnumServiceDetails_onfail);
    // Request aspect
    {

      if (0 >= DiagSendReqAndWaitForResp("CVADAS_0001_00000000_000", __req, __resp, __res, -1, -1, -1, -1, -1, EnumResult_pos, EnumServiceDetails_onfail, EnumSendingMode_physical, EnumSuppressPosResBit_clear, EnumVerdictOnInvalidValues_fail))
        break;
    }

    __res = DiagErrCodeTestStep(__res, "Can't retrieve last response for request! No check possible.") < 0;
    if(__res)
    {
	  __bVerdict = __eVerdictFail;
      break;
    }
    {
      __res = DiagInterpretAs(__resp, "ER_PR");
      if(__res != 0)
      {
        __bVerdict = __eVerdictFail;
        DiagErrCodeTestStep(__res, "Can't interpret response as diagnostic primitive 'ER_PR'.");
        break;
      }
      else
      {
        TestStepPass( "Received primitive can be interpreted as diagnostic primitive 'ER_PR'.");
      }
    }
  }
  while(0);


  // Response, check & read aspect
  {
    __res = 1;
    __tableHandle = ReportTableHead5Columns(__cCheckCaption, __cTSym, __cTOp, __cRefVal, __cActual, __cRes);
    {
      double __nDiagValue;
      DiagGetParameterErrorHandled(__resp, "ResetType", __nDiagValue);
      __csr = CheckSignalMatch(__nDiagValue, syspar::`ECU_Reset::`Hard_Reset, "==") == 1;
      snprintf(__cArray, 8192, "%s", "Diagnostic parameter \'ResetType\'");
      snprintf(__cArray2, 8192, "%s", __cArray);
      snprintf(__cArray3, 8192, "%s", "Hard_Reset");
      ReportTableRow(__tableHandle, 0, __cArray2, "==", syspar::`ECU_Reset::`Hard_Reset, __cArray3, __oneOfFlag, __bSetInCheckAlignment);
      ReportCell(__tableHandle, __nDiagValue);
      ReportCellResult(__tableHandle, __csr, __ePassFail);
    
      __res = __res && __csr;
    
    }
    ReportTableEndVerdict(__tableHandle, __cEvaluateResponse, __res);
	__bVerdict = __bVerdict && __res;
  }
  if (__bVerdict == __eVerdictFail)
    TestReportWriteDiagObjectList();
}

void Tto7tsimc_Hard_Reset_with_Functional_Address()
{
  stack long __tableHandle;
  TestCommandBegin(__eDiagService, __cDiagService, "", "0");
  {
    if (DiagIsFunctionalGroup("CVADAS_0001_00000000_000"))
    {
      DiagResponse * __resp;
      DiagRequest CVADAS_0001_00000000_000.HardReset_Reset __req;
      __diagServiceo7tsimc_44(__req, __resp);
    }
    else
    {
      DiagResponse CVADAS_0001_00000000_000.* __resp;
      DiagRequest CVADAS_0001_00000000_000.HardReset_Reset __req;
      __diagServiceo7tsimc_44(__req, __resp);
    }
  }
  TestCommandEnd();


}

  
void __diagServiceo7tsimc_44(DiagRequest * __req, DiagResponse * __resp )
{
  stack long __tableHandle;
  long __res, __paramLen, __bytePos;

   __bVerdict = __eVerdictPass;

  do {
    TestReportResetDiagObjectList();
    DiagSetReportDetailLevel("CVADAS_0001_00000000_000", EnumServiceDetails_onfail);
    // Request aspect
    {

      if (0 >= DiagSendReqAndWaitForResp("CVADAS_0001_00000000_000", __req, __resp, __res, -1, -1, -1, -1, -1, EnumResult_pos, EnumServiceDetails_onfail, EnumSendingMode_functional, EnumSuppressPosResBit_clear, EnumVerdictOnInvalidValues_fail))
        break;
    }

    __res = DiagErrCodeTestStep(__res, "Can't retrieve last response for request! No check possible.") < 0;
    if(__res)
    {
	  __bVerdict = __eVerdictFail;
      break;
    }
    {
      __res = DiagInterpretAs(__resp, "ER_PR");
      if(__res != 0)
      {
        __bVerdict = __eVerdictFail;
        DiagErrCodeTestStep(__res, "Can't interpret response as diagnostic primitive 'ER_PR'.");
        break;
      }
      else
      {
        TestStepPass( "Received primitive can be interpreted as diagnostic primitive 'ER_PR'.");
      }
    }
  }
  while(0);


  // Response, check & read aspect
  {
    __res = 1;
    __tableHandle = ReportTableHead5Columns(__cCheckCaption, __cTSym, __cTOp, __cRefVal, __cActual, __cRes);
    {
      double __nDiagValue;
      DiagGetParameterErrorHandled(__resp, "ResetType", __nDiagValue);
      __csr = CheckSignalMatch(__nDiagValue, syspar::`ECU_Reset::`Hard_Reset, "==") == 1;
      snprintf(__cArray, 8192, "%s", "Diagnostic parameter \'ResetType\'");
      snprintf(__cArray2, 8192, "%s", __cArray);
      snprintf(__cArray3, 8192, "%s", "Hard_Reset");
      ReportTableRow(__tableHandle, 0, __cArray2, "==", syspar::`ECU_Reset::`Hard_Reset, __cArray3, __oneOfFlag, __bSetInCheckAlignment);
      ReportCell(__tableHandle, __nDiagValue);
      ReportCellResult(__tableHandle, __csr, __ePassFail);
    
      __res = __res && __csr;
    
    }
    ReportTableEndVerdict(__tableHandle, __cEvaluateResponse, __res);
	__bVerdict = __bVerdict && __res;
  }
  if (__bVerdict == __eVerdictFail)
    TestReportWriteDiagObjectList();
}

void Tto7tsimc__19_02_Report_DTC_By_Status_Mask_Physical_Add()
{
  stack long __tableHandle;
  TestCommandBegin(__eDiagService, __cDiagService, "", "0");
  {
    if (DiagIsFunctionalGroup("CVADAS_0001_00000000_000"))
    {
      DiagResponse * __resp;
      DiagRequest CVADAS_0001_00000000_000.FaultMemory_ReadAllIdentified __req;
      __diagServiceo7tsimc_45(__req, __resp);
    }
    else
    {
      DiagResponse CVADAS_0001_00000000_000.* __resp;
      DiagRequest CVADAS_0001_00000000_000.FaultMemory_ReadAllIdentified __req;
      __diagServiceo7tsimc_45(__req, __resp);
    }
  }
  TestCommandEnd();


}

  
void __diagServiceo7tsimc_45(DiagRequest * __req, DiagResponse * __resp )
{
  stack long __tableHandle;
  long __res, __paramLen, __bytePos;

   __bVerdict = __eVerdictPass;

  do {
    TestReportResetDiagObjectList();
    DiagSetReportDetailLevel("CVADAS_0001_00000000_000", EnumServiceDetails_onfail);
    // Request aspect
    {
      {
        {
          byte __bArray[1] = { 0x02 };
          __bArrayCtr = elCount(__bArray);
          __bDiagValueArrayCtr = __CopyBytes(__bArray, __bArrayCtr, __bDiagValueArray);
        }
      
        __res = DiagSetParameterErrorHandled(__req, "ReportDtcByStatusMask", __bDiagValueArray, __bDiagValueArrayCtr);
        if(__res < 0)
        {
          __bVerdict = __eVerdictFail;
          DiagErrCodeTestStep(__res, "Cannot set diagnostic parameter 'ReportDtcByStatusMask'");
          break;
        }
      }
      {
        {
          byte __bArray[1] = { 0x7F };
          __bArrayCtr = elCount(__bArray);
          __bDiagValueArrayCtr = __CopyBytes(__bArray, __bArrayCtr, __bDiagValueArray);
        }
      
        __res = DiagSetParameterErrorHandled(__req, "DTCStatusMask", __bDiagValueArray, __bDiagValueArrayCtr);
        if(__res < 0)
        {
          __bVerdict = __eVerdictFail;
          DiagErrCodeTestStep(__res, "Cannot set diagnostic parameter 'DTCStatusMask'");
          break;
        }
      }

      if (0 >= DiagSendReqAndWaitForResp("CVADAS_0001_00000000_000", __req, __resp, __res, -1, -1, -1, -1, -1, EnumResult_pos, EnumServiceDetails_onfail, EnumSendingMode_physical, EnumSuppressPosResBit_asconfigured, EnumVerdictOnInvalidValues_fail))
        break;
    }

    __res = DiagErrCodeTestStep(__res, "Can't retrieve last response for request! No check possible.") < 0;
    if(__res)
    {
	  __bVerdict = __eVerdictFail;
      break;
    }
    {
      __res = DiagInterpretAs(__resp, "RDI_RDTCBSM_PR");
      if(__res != 0)
      {
        __bVerdict = __eVerdictFail;
        DiagErrCodeTestStep(__res, "Can't interpret response as diagnostic primitive 'RDI_RDTCBSM_PR'.");
        break;
      }
      else
      {
        TestStepPass( "Received primitive can be interpreted as diagnostic primitive 'RDI_RDTCBSM_PR'.");
      }
    }
  }
  while(0);


  // Response, check & read aspect
  {
    __res = 1;
    __tableHandle = ReportTableHead5Columns(__cCheckCaption, __cTSym, __cTOp, __cRefVal, __cActual, __cRes);
    {
      __bDiagValueArrayCtr = DiagGetParameterErrorHandled(__resp, "ReportDtcByStatusMask", __bDiagValueArray, elcount(__bDiagValueArray), __cDiagValueArray, elcount(__cDiagValueArray));
      {
        byte __bArray2[1] = { 0x02 };
        __bArrayCtr = __CopyBytes(__bDiagValueArray, __bDiagValueArrayCtr, __bArray);
        __bArrayCtr2 = elCount(__bArray2);
        __csr = CompareBytes(__bArray, __bArrayCtr, __bArray2, __bArrayCtr2) == 0;
        snprintf(__cArray, 8192, "%s", "Diagnostic parameter \'ReportDtcByStatusMask\'");
        snprintf(__cArray2, 8192, "%s", __cArray);
        snprintf(__cArray3, 8192, "%s", "");
        ReportTableRow(__tableHandle, 0, __cArray2, "Bytes", __bArray2, __bArrayCtr2, __cArray3, __oneOfFlag, __bSetInCheckAlignment);
        ReportCell(__tableHandle, __bArray, __bArrayCtr);
        ReportCellResult(__tableHandle, __csr, __ePassFail);
      }
    
      __res = __res && __csr;
    
    }
    {
      __bDiagValueArrayCtr = DiagGetParameterErrorHandled(__resp, "DtcAvailabilityMask", __bDiagValueArray, elcount(__bDiagValueArray), __cDiagValueArray, elcount(__cDiagValueArray));
      {
        byte __bArray2[1] = { 0x7F };
        __bArrayCtr = __CopyBytes(__bDiagValueArray, __bDiagValueArrayCtr, __bArray);
        __bArrayCtr2 = elCount(__bArray2);
        __csr = CompareBytes(__bArray, __bArrayCtr, __bArray2, __bArrayCtr2) == 0;
        snprintf(__cArray, 8192, "%s", "Diagnostic parameter \'DtcAvailabilityMask\'");
        snprintf(__cArray2, 8192, "%s", __cArray);
        snprintf(__cArray3, 8192, "%s", "");
        ReportTableRow(__tableHandle, 0, __cArray2, "Bytes", __bArray2, __bArrayCtr2, __cArray3, __oneOfFlag, __bSetInCheckAlignment);
        ReportCell(__tableHandle, __bArray, __bArrayCtr);
        ReportCellResult(__tableHandle, __csr, __ePassFail);
      }
    
      __res = __res && __csr;
    
    }
    ReportTableEndVerdict(__tableHandle, __cEvaluateResponse, __res);
	__bVerdict = __bVerdict && __res;
  }
  if (__bVerdict == __eVerdictFail)
    TestReportWriteDiagObjectList();
}

void Tto7tsimc__14_Clear_Diag_Info_Physical_Add()
{
  stack long __tableHandle;
  TestCommandBegin(__eDiagService, __cDiagService, "", "0");
  {
    if (DiagIsFunctionalGroup("CVADAS_0001_00000000_000"))
    {
      DiagResponse * __resp;
      DiagRequest CVADAS_0001_00000000_000.FaultMemory_Clear __req;
      __diagServiceo7tsimc_46(__req, __resp);
    }
    else
    {
      DiagResponse CVADAS_0001_00000000_000.* __resp;
      DiagRequest CVADAS_0001_00000000_000.FaultMemory_Clear __req;
      __diagServiceo7tsimc_46(__req, __resp);
    }
  }
  TestCommandEnd();


}

  
void __diagServiceo7tsimc_46(DiagRequest * __req, DiagResponse * __resp )
{
  stack long __tableHandle;
  long __res, __paramLen, __bytePos;

   __bVerdict = __eVerdictPass;

  do {
    TestReportResetDiagObjectList();
    DiagSetReportDetailLevel("CVADAS_0001_00000000_000", EnumServiceDetails_onfail);
    // Request aspect
    {
      {
        CheckLiteralGetStringBufferConsistency("FFFFFF", 8192);
      snprintf(__cDiagValueArray, 8192, "%s", "FFFFFF");
        __bDiagValueArrayCtr = __MapChar2ByteAtDiagSet(__cDiagValueArray, __bDiagValueArray);
        if (__bDiagValueArrayCtr >= 0)
        {
          __res = DiagSetParameterErrorHandled(__req, "GroupOfDtc", __bDiagValueArray, __bDiagValueArrayCtr);
          if(__res < 0)
          {
            __bVerdict = __eVerdictFail;
            DiagErrCodeTestStep(__res, "Cannot set diagnostic parameter 'GroupOfDtc'");
            break;
          }
        }
        else
        {
      	__bVerdict = __eVerdictFail;
          snprintf(__cArray2, 8192, "SetParameter: illegal byte sequence: '%s' (parameter %s). Use hex tuples like '01 AF ...'", __cDiagValueArray, "GroupOfDtc");
          DiagErrCodeTestStep(__bDiagValueArrayCtr, __cArray2);
          DiagErrCodeTestStep(-1, "Cannot set diagnostic parameter 'GroupOfDtc'");
      	break;
        }
      }

      if (0 >= DiagSendReqAndWaitForResp("CVADAS_0001_00000000_000", __req, __resp, __res, -1, -1, -1, -1, -1, EnumResult_pos, EnumServiceDetails_onfail, EnumSendingMode_physical, EnumSuppressPosResBit_asconfigured, EnumVerdictOnInvalidValues_fail))
        break;
    }

    __res = DiagErrCodeTestStep(__res, "Can't retrieve last response for request! No check possible.") < 0;
    if(__res)
    {
	  __bVerdict = __eVerdictFail;
      break;
    }
    {
      __res = DiagInterpretAs(__resp, "CDI_PR");
      if(__res != 0)
      {
        __bVerdict = __eVerdictFail;
        DiagErrCodeTestStep(__res, "Can't interpret response as diagnostic primitive 'CDI_PR'.");
        break;
      }
      else
      {
        TestStepPass( "Received primitive can be interpreted as diagnostic primitive 'CDI_PR'.");
      }
    }
  }
  while(0);


  if (__bVerdict == __eVerdictFail)
    TestReportWriteDiagObjectList();
}

void Tto7tsimc_CaptureMasterImage()
{
  stack long __tableHandle;
  TestCommandBegin(__eCAPLInline, __cCAPLInline, "CaptureImage", "0");
  {
    __cio7tsimcCaplInline0();
  }
  TestCommandEnd();

}

void __cio7tsimcCaplInline0()
{
  stack long __tableHandle;
  {
    long response;
response = testWaitForSyscall("pythonw Image_Comparison.py --capture_image --master_frame_mode", 0, 10000);

if (response == 2)
{
  testStepFail("Check Image");
}
else{
testStepPass();
}

  }
}

void Tto7tsimc_CaptureImage()
{
  stack long __tableHandle;
  TestCommandBegin(__eCAPLInline, __cCAPLInline, "CaptureImage", "0");
  {
    __cio7tsimcCaplInline1();
  }
  TestCommandEnd();

}

void __cio7tsimcCaplInline1()
{
  stack long __tableHandle;
  {
    long response;
response = testWaitForSyscall("pythonw Image_Comparison.py --capture_image", 0, 10000);

if (response == 2)
{
  testStepFail("Check Image");
}
else{
testStepPass();
}

  }
}

void Tto7tsimc_General_Precondition()
{
  stack long __tableHandle;
  TestCommandBegin(__eWait, __cWait, "", "0");
  {
    Wait("1", (8000 * 1000000LL), 1000000, "");
  }
  TestCommandEnd();

  TestCommandBegin(__eDiagService, __cDiagService, "", "1");
  {
    if (DiagIsFunctionalGroup("CVADAS_0001_00000000_000"))
    {
      DiagResponse * __resp;
      DiagRequest CVADAS_0001_00000000_000.Default_Session_Start __req;
      __diagServiceo7tsimc_47(__req, __resp);
    }
    else
    {
      DiagResponse CVADAS_0001_00000000_000.* __resp;
      DiagRequest CVADAS_0001_00000000_000.Default_Session_Start __req;
      __diagServiceo7tsimc_47(__req, __resp);
    }
  }
  TestCommandEnd();


  TestCommandBegin(__eWait, __cWait, "", "2");
  {
    Wait("1", (1000 * 1000000LL), 1000000, "");
  }
  TestCommandEnd();

  TestCommandBegin(__eDiagService, __cDiagService, "", "3");
  {
    if (DiagIsFunctionalGroup("CVADAS_0001_00000000_000"))
    {
      DiagResponse * __resp;
      DiagRequest CVADAS_0001_00000000_000.FaultMemory_Clear __req;
      __diagServiceo7tsimc_48(__req, __resp);
    }
    else
    {
      DiagResponse CVADAS_0001_00000000_000.* __resp;
      DiagRequest CVADAS_0001_00000000_000.FaultMemory_Clear __req;
      __diagServiceo7tsimc_48(__req, __resp);
    }
  }
  TestCommandEnd();


  TestCommandBegin(__eWait, __cWait, "", "4");
  {
    Wait("1", (1000 * 1000000LL), 1000000, "");
  }
  TestCommandEnd();

  TestCommandBegin(__eDiagService, __cDiagService, "", "5");
  {
    if (DiagIsFunctionalGroup("CVADAS_0001_00000000_000"))
    {
      DiagResponse * __resp;
      DiagRequest CVADAS_0001_00000000_000._22FDF2_Reset_Reason_Read __req;
      __diagServiceo7tsimc_49(__req, __resp);
    }
    else
    {
      DiagResponse CVADAS_0001_00000000_000.* __resp;
      DiagRequest CVADAS_0001_00000000_000._22FDF2_Reset_Reason_Read __req;
      __diagServiceo7tsimc_49(__req, __resp);
    }
  }
  TestCommandEnd();


  TestCommandBegin(__eWait, __cWait, "", "6");
  {
    Wait("1", (1000 * 1000000LL), 1000000, "");
  }
  TestCommandEnd();

  TestCommandBegin(__eDiagService, __cDiagService, "", "7");
  {
    if (DiagIsFunctionalGroup("CVADAS_0001_00000000_000"))
    {
      DiagResponse * __resp;
      DiagRequest CVADAS_0001_00000000_000._22FD44_Error_Flags_Read __req;
      __diagServiceo7tsimc_50(__req, __resp);
    }
    else
    {
      DiagResponse CVADAS_0001_00000000_000.* __resp;
      DiagRequest CVADAS_0001_00000000_000._22FD44_Error_Flags_Read __req;
      __diagServiceo7tsimc_50(__req, __resp);
    }
  }
  TestCommandEnd();


  TestCommandBegin(__eWait, __cWait, "", "8");
  {
    Wait("1", (1000 * 1000000LL), 1000000, "");
  }
  TestCommandEnd();

  TestCommandBegin(__eDiagService, __cDiagService, "", "9");
  {
    if (DiagIsFunctionalGroup("CVADAS_0001_00000000_000"))
    {
      DiagResponse * __resp;
      DiagRequest CVADAS_0001_00000000_000._22FD64_ASIL_B_Fault_Status_Read __req;
      __diagServiceo7tsimc_51(__req, __resp);
    }
    else
    {
      DiagResponse CVADAS_0001_00000000_000.* __resp;
      DiagRequest CVADAS_0001_00000000_000._22FD64_ASIL_B_Fault_Status_Read __req;
      __diagServiceo7tsimc_51(__req, __resp);
    }
  }
  TestCommandEnd();


  TestCommandBegin(__eWait, __cWait, "", "10");
  {
    Wait("1", (1000 * 1000000LL), 1000000, "");
  }
  TestCommandEnd();

  TestCommandBegin(__eDiagService, __cDiagService, "", "11");
  {
    if (DiagIsFunctionalGroup("CVADAS_0001_00000000_000"))
    {
      DiagResponse * __resp;
      DiagRequest CVADAS_0001_00000000_000._22FD62_ASIL_QM_Fault_Status_Read __req;
      __diagServiceo7tsimc_52(__req, __resp);
    }
    else
    {
      DiagResponse CVADAS_0001_00000000_000.* __resp;
      DiagRequest CVADAS_0001_00000000_000._22FD62_ASIL_QM_Fault_Status_Read __req;
      __diagServiceo7tsimc_52(__req, __resp);
    }
  }
  TestCommandEnd();


  TestCommandBegin(__eWait, __cWait, "", "12");
  {
    Wait("1", (1000 * 1000000LL), 1000000, "");
  }
  TestCommandEnd();

}

  
void __diagServiceo7tsimc_47(DiagRequest * __req, DiagResponse * __resp )
{
  stack long __tableHandle;
  long __res, __paramLen, __bytePos;

   __bVerdict = __eVerdictPass;

  do {
    TestReportResetDiagObjectList();
    DiagSetReportDetailLevel("CVADAS_0001_00000000_000", EnumServiceDetails_onfail);
    // Request aspect
    {
      {
        {
          byte __bArray[1] = { 0x01 };
          __bArrayCtr = elCount(__bArray);
          __bDiagValueArrayCtr = __CopyBytes(__bArray, __bArrayCtr, __bDiagValueArray);
        }
      
        __res = DiagSetParameterErrorHandled(__req, "DiagSessionType", __bDiagValueArray, __bDiagValueArrayCtr);
        if(__res < 0)
        {
          __bVerdict = __eVerdictFail;
          DiagErrCodeTestStep(__res, "Cannot set diagnostic parameter 'DiagSessionType'");
          break;
        }
      }

      if (0 >= DiagSendReqAndWaitForResp("CVADAS_0001_00000000_000", __req, __resp, __res, -1, -1, -1, -1, -1, EnumResult_pos, EnumServiceDetails_onfail, EnumSendingMode_physical, EnumSuppressPosResBit_asconfigured, EnumVerdictOnInvalidValues_fail))
        break;
    }

    __res = DiagErrCodeTestStep(__res, "Can't retrieve last response for request! No check possible.") < 0;
    if(__res)
    {
	  __bVerdict = __eVerdictFail;
      break;
    }
    {
      __res = DiagInterpretAs(__resp, "DSC_PR");
      if(__res != 0)
      {
        __bVerdict = __eVerdictFail;
        DiagErrCodeTestStep(__res, "Can't interpret response as diagnostic primitive 'DSC_PR'.");
        break;
      }
      else
      {
        TestStepPass( "Received primitive can be interpreted as diagnostic primitive 'DSC_PR'.");
      }
    }
  }
  while(0);


  // Response, check & read aspect
  {
    __res = 1;
    __tableHandle = ReportTableHead5Columns(__cCheckCaption, __cTSym, __cTOp, __cRefVal, __cActual, __cRes);
    {
      __bDiagValueArrayCtr = DiagGetParameterErrorHandled(__resp, "DiagSessionType", __bDiagValueArray, elcount(__bDiagValueArray), __cDiagValueArray, elcount(__cDiagValueArray));
      {
        byte __bArray2[1] = { 0x01 };
        __bArrayCtr = __CopyBytes(__bDiagValueArray, __bDiagValueArrayCtr, __bArray);
        __bArrayCtr2 = elCount(__bArray2);
        __csr = CompareBytes(__bArray, __bArrayCtr, __bArray2, __bArrayCtr2) == 0;
        snprintf(__cArray, 8192, "%s", "Diagnostic parameter \'DiagSessionType\'");
        snprintf(__cArray2, 8192, "%s", __cArray);
        snprintf(__cArray3, 8192, "%s", "");
        ReportTableRow(__tableHandle, 0, __cArray2, "Bytes", __bArray2, __bArrayCtr2, __cArray3, __oneOfFlag, __bSetInCheckAlignment);
        ReportCell(__tableHandle, __bArray, __bArrayCtr);
        ReportCellResult(__tableHandle, __csr, __ePassFail);
      }
    
      __res = __res && __csr;
    
    }
    ReportTableEndVerdict(__tableHandle, __cEvaluateResponse, __res);
	__bVerdict = __bVerdict && __res;
  }
  if (__bVerdict == __eVerdictFail)
    TestReportWriteDiagObjectList();
}
  
void __diagServiceo7tsimc_48(DiagRequest * __req, DiagResponse * __resp )
{
  stack long __tableHandle;
  long __res, __paramLen, __bytePos;

   __bVerdict = __eVerdictPass;

  do {
    TestReportResetDiagObjectList();
    DiagSetReportDetailLevel("CVADAS_0001_00000000_000", EnumServiceDetails_onfail);
    // Request aspect
    {
      {
        CheckLiteralGetStringBufferConsistency("FFFFFF", 8192);
      snprintf(__cDiagValueArray, 8192, "%s", "FFFFFF");
        __bDiagValueArrayCtr = __MapChar2ByteAtDiagSet(__cDiagValueArray, __bDiagValueArray);
        if (__bDiagValueArrayCtr >= 0)
        {
          __res = DiagSetParameterErrorHandled(__req, "GroupOfDtc", __bDiagValueArray, __bDiagValueArrayCtr);
          if(__res < 0)
          {
            __bVerdict = __eVerdictFail;
            DiagErrCodeTestStep(__res, "Cannot set diagnostic parameter 'GroupOfDtc'");
            break;
          }
        }
        else
        {
      	__bVerdict = __eVerdictFail;
          snprintf(__cArray2, 8192, "SetParameter: illegal byte sequence: '%s' (parameter %s). Use hex tuples like '01 AF ...'", __cDiagValueArray, "GroupOfDtc");
          DiagErrCodeTestStep(__bDiagValueArrayCtr, __cArray2);
          DiagErrCodeTestStep(-1, "Cannot set diagnostic parameter 'GroupOfDtc'");
      	break;
        }
      }

      if (0 >= DiagSendReqAndWaitForResp("CVADAS_0001_00000000_000", __req, __resp, __res, -1, -1, -1, -1, -1, EnumResult_pos, EnumServiceDetails_onfail, EnumSendingMode_physical, EnumSuppressPosResBit_asconfigured, EnumVerdictOnInvalidValues_fail))
        break;
    }

    __res = DiagErrCodeTestStep(__res, "Can't retrieve last response for request! No check possible.") < 0;
    if(__res)
    {
	  __bVerdict = __eVerdictFail;
      break;
    }
    {
      __res = DiagInterpretAs(__resp, "CDI_PR");
      if(__res != 0)
      {
        __bVerdict = __eVerdictFail;
        DiagErrCodeTestStep(__res, "Can't interpret response as diagnostic primitive 'CDI_PR'.");
        break;
      }
      else
      {
        TestStepPass( "Received primitive can be interpreted as diagnostic primitive 'CDI_PR'.");
      }
    }
  }
  while(0);


  if (__bVerdict == __eVerdictFail)
    TestReportWriteDiagObjectList();
}
  
void __diagServiceo7tsimc_49(DiagRequest * __req, DiagResponse * __resp )
{
  stack long __tableHandle;
  long __res, __paramLen, __bytePos;

   __bVerdict = __eVerdictPass;

  do {
    TestReportResetDiagObjectList();
    DiagSetReportDetailLevel("CVADAS_0001_00000000_000", EnumServiceDetails_onfail);
    // Request aspect
    {

      if (0 >= DiagSendReqAndWaitForResp("CVADAS_0001_00000000_000", __req, __resp, __res, -1, -1, -1, -1, -1, EnumResult_pos, EnumServiceDetails_onfail, EnumSendingMode_physical, EnumSuppressPosResBit_asconfigured, EnumVerdictOnInvalidValues_fail))
        break;
    }

    __res = DiagErrCodeTestStep(__res, "Can't retrieve last response for request! No check possible.") < 0;
    if(__res)
    {
	  __bVerdict = __eVerdictFail;
      break;
    }
    {
      __res = DiagInterpretAs(__resp, "RDBI_PR");
      if(__res != 0)
      {
        __bVerdict = __eVerdictFail;
        DiagErrCodeTestStep(__res, "Can't interpret response as diagnostic primitive 'RDBI_PR'.");
        break;
      }
      else
      {
        TestStepPass( "Received primitive can be interpreted as diagnostic primitive 'RDBI_PR'.");
      }
    }
  }
  while(0);


  if (__bVerdict == __eVerdictFail)
    TestReportWriteDiagObjectList();
}
  
void __diagServiceo7tsimc_50(DiagRequest * __req, DiagResponse * __resp )
{
  stack long __tableHandle;
  long __res, __paramLen, __bytePos;

   __bVerdict = __eVerdictPass;

  do {
    TestReportResetDiagObjectList();
    DiagSetReportDetailLevel("CVADAS_0001_00000000_000", EnumServiceDetails_onfail);
    // Request aspect
    {

      if (0 >= DiagSendReqAndWaitForResp("CVADAS_0001_00000000_000", __req, __resp, __res, -1, -1, -1, -1, -1, EnumResult_pos, EnumServiceDetails_onfail, EnumSendingMode_physical, EnumSuppressPosResBit_asconfigured, EnumVerdictOnInvalidValues_fail))
        break;
    }

    __res = DiagErrCodeTestStep(__res, "Can't retrieve last response for request! No check possible.") < 0;
    if(__res)
    {
	  __bVerdict = __eVerdictFail;
      break;
    }
    {
      __res = DiagInterpretAs(__resp, "RDBI_PR");
      if(__res != 0)
      {
        __bVerdict = __eVerdictFail;
        DiagErrCodeTestStep(__res, "Can't interpret response as diagnostic primitive 'RDBI_PR'.");
        break;
      }
      else
      {
        TestStepPass( "Received primitive can be interpreted as diagnostic primitive 'RDBI_PR'.");
      }
    }
  }
  while(0);


  // Response, check & read aspect
  {
    __res = 1;
    __tableHandle = ReportTableHead5Columns(__cCheckCaption, __cTSym, __cTOp, __cRefVal, __cActual, __cRes);
    {
      __bDiagValueArrayCtr = DiagGetParameterErrorHandled(__resp, "Error_Flags", __bDiagValueArray, elcount(__bDiagValueArray), __cDiagValueArray, elcount(__cDiagValueArray));
      {
        byte __bArray2[2] = { 0x00, 0x00 };
        __bArrayCtr = __CopyBytes(__bDiagValueArray, __bDiagValueArrayCtr, __bArray);
        __bArrayCtr2 = elCount(__bArray2);
        __csr = CompareBytes(__bArray, __bArrayCtr, __bArray2, __bArrayCtr2) == 0;
        snprintf(__cArray, 8192, "%s", "Diagnostic parameter \'Error_Flags\'");
        snprintf(__cArray2, 8192, "%s", __cArray);
        snprintf(__cArray3, 8192, "%s", "");
        ReportTableRow(__tableHandle, 0, __cArray2, "Bytes", __bArray2, __bArrayCtr2, __cArray3, __oneOfFlag, __bSetInCheckAlignment);
        ReportCell(__tableHandle, __bArray, __bArrayCtr);
        ReportCellResult(__tableHandle, __csr, __ePassFail);
      }
    
      __res = __res && __csr;
    
    }
    ReportTableEndVerdict(__tableHandle, __cEvaluateResponse, __res);
	__bVerdict = __bVerdict && __res;
  }
  if (__bVerdict == __eVerdictFail)
    TestReportWriteDiagObjectList();
}
  
void __diagServiceo7tsimc_51(DiagRequest * __req, DiagResponse * __resp )
{
  stack long __tableHandle;
  long __res, __paramLen, __bytePos;

   __bVerdict = __eVerdictPass;

  do {
    TestReportResetDiagObjectList();
    DiagSetReportDetailLevel("CVADAS_0001_00000000_000", EnumServiceDetails_always);
    // Request aspect
    {

      if (0 >= DiagSendReqAndWaitForResp("CVADAS_0001_00000000_000", __req, __resp, __res, -1, -1, -1, -1, -1, EnumResult_pos, EnumServiceDetails_always, EnumSendingMode_functional, EnumSuppressPosResBit_asconfigured, EnumVerdictOnInvalidValues_fail))
        break;
    }

    __res = DiagErrCodeTestStep(__res, "Can't retrieve last response for request! No check possible.") < 0;
    if(__res)
    {
	  __bVerdict = __eVerdictFail;
      break;
    }
    {
      __res = DiagInterpretAs(__resp, "RDBI_PR");
      if(__res != 0)
      {
        __bVerdict = __eVerdictFail;
        DiagErrCodeTestStep(__res, "Can't interpret response as diagnostic primitive 'RDBI_PR'.");
        break;
      }
      else
      {
        TestStepPass( "Received primitive can be interpreted as diagnostic primitive 'RDBI_PR'.");
      }
    }
  }
  while(0);


  if (__bVerdict == __eVerdictFail)
    TestReportWriteDiagObjectList();
}
  
void __diagServiceo7tsimc_52(DiagRequest * __req, DiagResponse * __resp )
{
  stack long __tableHandle;
  long __res, __paramLen, __bytePos;

   __bVerdict = __eVerdictPass;

  do {
    TestReportResetDiagObjectList();
    DiagSetReportDetailLevel("CVADAS_0001_00000000_000", EnumServiceDetails_always);
    // Request aspect
    {

      if (0 >= DiagSendReqAndWaitForResp("CVADAS_0001_00000000_000", __req, __resp, __res, -1, -1, -1, -1, -1, EnumResult_pos, EnumServiceDetails_always, EnumSendingMode_functional, EnumSuppressPosResBit_asconfigured, EnumVerdictOnInvalidValues_fail))
        break;
    }

    __res = DiagErrCodeTestStep(__res, "Can't retrieve last response for request! No check possible.") < 0;
    if(__res)
    {
	  __bVerdict = __eVerdictFail;
      break;
    }
    {
      __res = DiagInterpretAs(__resp, "RDBI_PR");
      if(__res != 0)
      {
        __bVerdict = __eVerdictFail;
        DiagErrCodeTestStep(__res, "Can't interpret response as diagnostic primitive 'RDBI_PR'.");
        break;
      }
      else
      {
        TestStepPass( "Received primitive can be interpreted as diagnostic primitive 'RDBI_PR'.");
      }
    }
  }
  while(0);


  if (__bVerdict == __eVerdictFail)
    TestReportWriteDiagObjectList();
}

testcase Tto7tsimc_ImageCaptureCompare()
{
  stack long __tableHandle;
  SetBreakOnFail(1);

  TestCommandBegin(__eCAPLInline, __cCAPLInline, "Start Image Capture Compare Script", "0");
  {
    __cio7tsimcCaplInline2();
  }
  TestCommandEnd();

}

void __cio7tsimcCaplInline2()
{
  stack long __tableHandle;
  {
    testWaitForSyscall("python cli_camera_tester.pyw",0,5000);
testStepPass();

  }
}

testcase Tto7tsimc_HMI_Views_Steering_Angle_Test()
{
  stack long __tableHandle;
double __tt8LoopVar0;

  SetBreakOnFail(1);

  {
    __type_of(-500) __tcLocVar0;
    __type_of(0) __tcLocVar1;
    __type_of(100) __tcLocVar2;
  
    __tcLocVar0 = -500;
    __tcLocVar1 = 0;
    __tcLocVar2 = 100;
  
    snprintf(__cArray, 8192, "%s", "-500");
    snprintf(__cArray2, 8192, "%s", "0");
    snprintf(__cArray3, 8192, "%s", "100");
  
    snprintf(__cArray4, 8192, "For (For i=%s..%s, increment=%s)", __cArray, __cArray2, __cArray3);
    TestControlStructBegin(__cFor, __cArray4, "0");  
    for(__tt8LoopVar0 = __tcLocVar0; (__tcLocVar2 < 0) ? (CheckSignalMatch(__tt8LoopVar0, __tcLocVar1, ">=" ) == 1) : (CheckSignalMatch(__tt8LoopVar0, __tcLocVar1, "<=") == 1); __tt8LoopVar0 += __tcLocVar2)
    {
      if(__LoopIsBlocking())  
        break;
  
      snprintf(__cArray, 8192, "%s", "-500");
      snprintf(__cArray2, 8192, "%s", "0");
      snprintf(__cArray3, 8192, "%s", "100");
      snprintf(__cArray4, 8192, "For (For i=%s..%s, increment=%s; current i = %.15g)", __cArray, __cArray2, __cArray3, __tt8LoopVar0);
      TestControlStructBegin(__cForIteration, __cArray4, "0");
      TestCommandBegin(__eSet, __cSet, "", "1");
      {
        __tableHandle = ReportTableHead3Columns(__cSetCaption , __cTSym, __cTOp, __cAssigned); 
        {
          $`FDCAN2::dbNode::`BCM::`IPC_VEHICLE_SETUP::`SVC_Guidelines.phys = 1;
          snprintf(__cArray, 8192, "%s", "SVC_Guidelines");
          snprintf(__cArray2, 8192, "%s '%s'", __cCANSignal, __cArray);
          snprintf(__cArray3, 8192, "%s", "");
          
          ReportSetLValueOrSignalNotOnline(getSignalTime(`FDCAN2::dbNode::`BCM::`IPC_VEHICLE_SETUP::`SVC_Guidelines), __cArray2, __cArray4, 8192);
          ReportTableRow(__tableHandle, 0, __cArray4, __cAOp, 1, __cArray3, __oneOfFlag, __bSetInCheckAlignment);
          
      
        }
        ReportTableEndTestStep(__tableHandle, "1");
      }
      TestCommandEnd();


      TestCommandBegin(__eSet, __cSet, "", "2");
      {
        __tableHandle = ReportTableHead3Columns(__cSetCaption , __cTSym, __cTOp, __cAssigned); 
        {
          $`FDCAN2::dbNode::`BCM::`IPC_VEHICLE_SETUP::`Fwrd_Cam_Guidelines.phys = 1;
          snprintf(__cArray, 8192, "%s", "Fwrd_Cam_Guidelines");
          snprintf(__cArray2, 8192, "%s '%s'", __cCANSignal, __cArray);
          snprintf(__cArray3, 8192, "%s", "");
          
          ReportSetLValueOrSignalNotOnline(getSignalTime(`FDCAN2::dbNode::`BCM::`IPC_VEHICLE_SETUP::`Fwrd_Cam_Guidelines), __cArray2, __cArray4, 8192);
          ReportTableRow(__tableHandle, 0, __cArray4, __cAOp, 1, __cArray3, __oneOfFlag, __bSetInCheckAlignment);
          
      
        }
        ReportTableEndTestStep(__tableHandle, "1");
      }
      TestCommandEnd();


      TestCommandBegin(__eSet, __cSet, "", "3");
      {
        __tableHandle = ReportTableHead3Columns(__cSetCaption , __cTSym, __cTOp, __cAssigned); 
        {
          $`FDCAN14::dbNode::`EPS::`EPS_FD_1::`LwsAngle.phys = __tt8LoopVar0;
          snprintf(__cArray, 8192, "%s", "FDCAN14::EPS::EPS_FD_1::LwsAngle");
          snprintf(__cArray2, 8192, "%s '%s'", __cCANSignal, __cArray);
          snprintf(__cArray3, 8192, "%s", "i");
          
          ReportSetLValueOrSignalNotOnline(getSignalTime(`FDCAN14::dbNode::`EPS::`EPS_FD_1::`LwsAngle), __cArray2, __cArray4, 8192);
          ReportTableRow(__tableHandle, 0, __cArray4, __cAOp, __tt8LoopVar0, __cArray3, __oneOfFlag, __bSetInCheckAlignment);
          
      
        }
        ReportTableEndTestStep(__tableHandle, "1");
      }
      TestCommandEnd();


      TestControlStructEnd(__eUndefined);
    }
    TestControlStructEnd(__eUndefined);
  }

}

testcase Tto7tsimc_TRSC_Calibrating_CurState_5()
{
  stack long __tableHandle;
  SetBreakOnFail(1);

  CreateTTEIFFunction("Tto7tsimc_TsTc0_Completion", __eFct, __eLocal);
  
  AddIFAsCleanUpFunction();

  TestPreparationBegin();
  {
    {
      CreateTTEIFFunction("Tto7tsimc_General_Precondition", __eFct, __eLocal);
      CallInterfaceFunction(__cEmpty, __cEmpty, "e7b0609c-a6e0-42d6-9d60-147a1cf5844f");
    }


  }
  TestPreparationEnd();

  TestCommandBegin(__eDiagService, __cDiagService, "", "1");
  {
    if (DiagIsFunctionalGroup("CVADAS_0001_00000000_000"))
    {
      DiagResponse * __resp;
      DiagRequest CVADAS_0001_00000000_000.Extended_Diagnostic_Session_Start __req;
      __diagServiceo7tsimc_53(__req, __resp);
    }
    else
    {
      DiagResponse CVADAS_0001_00000000_000.* __resp;
      DiagRequest CVADAS_0001_00000000_000.Extended_Diagnostic_Session_Start __req;
      __diagServiceo7tsimc_53(__req, __resp);
    }
  }
  TestCommandEnd();


  TestCommandBegin(__eWait, __cWait, "", "2");
  {
    Wait("1", (150 * 1000000LL), 1000000, "");
  }
  TestCommandEnd();

  TestCommandBegin(__eDiagService, __cDiagService, "", "3");
  {
    if (DiagIsFunctionalGroup("CVADAS_0001_00000000_000"))
    {
      DiagResponse * __resp;
      DiagRequest CVADAS_0001_00000000_000._31011000_USS_Debug_Signals_Enable_Disable_Start __req;
      __diagServiceo7tsimc_54(__req, __resp);
    }
    else
    {
      DiagResponse CVADAS_0001_00000000_000.* __resp;
      DiagRequest CVADAS_0001_00000000_000._31011000_USS_Debug_Signals_Enable_Disable_Start __req;
      __diagServiceo7tsimc_54(__req, __resp);
    }
  }
  TestCommandEnd();


  TestCommandBegin(__eWait, __cWait, "", "4");
  {
    Wait("1", (500 * 1000000LL), 1000000, "");
  }
  TestCommandEnd();

  TestCommandBegin(__eSet, __cSet, "", "5");
  {
    __tableHandle = ReportTableHead3Columns(__cSetCaption , __cTSym, __cTOp, __cAssigned); 
    {
      $`FDCAN2::dbNode::`BCM::`TRANSM_FD_4::`ShiftLeverPosition.phys = 4;
      snprintf(__cArray, 8192, "%s", "ShiftLeverPosition");
      snprintf(__cArray2, 8192, "%s '%s'", __cCANSignal, __cArray);
      snprintf(__cArray3, 8192, "%s", "");
      
      ReportSetLValueOrSignalNotOnline(getSignalTime(`FDCAN2::dbNode::`BCM::`TRANSM_FD_4::`ShiftLeverPosition), __cArray2, __cArray4, 8192);
      ReportTableRow(__tableHandle, 0, __cArray4, __cAOp, 4, __cArray3, __oneOfFlag, __bSetInCheckAlignment);
      
  
    }
    ReportTableEndTestStep(__tableHandle, "1");
  }
  TestCommandEnd();


  TestCommandBegin(__eWait, __cWait, "", "6");
  {
    Wait("1", (50 * 1000000LL), 1000000, "");
  }
  TestCommandEnd();

  TestCommandBegin(__eSet, __cSet, "", "7");
  {
    __tableHandle = ReportTableHead3Columns(__cSetCaption , __cTSym, __cTOp, __cAssigned); 
    {
      $`FDCAN2::dbNode::`BCM::`TRANSM_FD_2::`GearEngagedForDisplay.phys = 15;
      snprintf(__cArray, 8192, "%s", "GearEngagedForDisplay");
      snprintf(__cArray2, 8192, "%s '%s'", __cCANSignal, __cArray);
      snprintf(__cArray3, 8192, "%s", "D");
      
      ReportSetLValueOrSignalNotOnline(getSignalTime(`FDCAN2::dbNode::`BCM::`TRANSM_FD_2::`GearEngagedForDisplay), __cArray2, __cArray4, 8192);
      ReportTableRow(__tableHandle, 0, __cArray4, __cAOp, 15, __cArray3, __oneOfFlag, __bSetInCheckAlignment);
      
  
    }
    ReportTableEndTestStep(__tableHandle, "1");
  }
  TestCommandEnd();


  TestCommandBegin(__eWait, __cWait, "", "8");
  {
    Wait("1", (1500 * 1000000LL), 1000000, "");
  }
  TestCommandEnd();

  TestCommandBegin(__eSet, __cSet, "", "9");
  {
    __tableHandle = ReportTableHead3Columns(__cSetCaption , __cTSym, __cTOp, __cAssigned); 
    {
      $`FDCAN2::dbNode::`BCM::`BCM_FD_27::`TrailerConnectionSts.phys = 1;
      snprintf(__cArray, 8192, "%s", "TrailerConnectionSts");
      snprintf(__cArray2, 8192, "%s '%s'", __cCANSignal, __cArray);
      snprintf(__cArray3, 8192, "%s", "Connected");
      
      ReportSetLValueOrSignalNotOnline(getSignalTime(`FDCAN2::dbNode::`BCM::`BCM_FD_27::`TrailerConnectionSts), __cArray2, __cArray4, 8192);
      ReportTableRow(__tableHandle, 0, __cArray4, __cAOp, 1, __cArray3, __oneOfFlag, __bSetInCheckAlignment);
      
  
    }
    ReportTableEndTestStep(__tableHandle, "1");
  }
  TestCommandEnd();


  TestCommandBegin(__eWait, __cWait, "", "10");
  {
    Wait("1", (300 * 1000000LL), 1000000, "");
  }
  TestCommandEnd();

  TestCommandBegin(__eSet, __cSet, "", "11");
  {
    __tableHandle = ReportTableHead3Columns(__cSetCaption , __cTSym, __cTOp, __cAssigned); 
    {
      $`FDCAN2::dbNode::`BCM::`BCM_FD_29::`ITBM_TrlrStat.phys = 1;
      snprintf(__cArray, 8192, "%s", "ITBM_TrlrStat");
      snprintf(__cArray2, 8192, "%s '%s'", __cCANSignal, __cArray);
      snprintf(__cArray3, 8192, "%s", "TRLR_PRSNT");
      
      ReportSetLValueOrSignalNotOnline(getSignalTime(`FDCAN2::dbNode::`BCM::`BCM_FD_29::`ITBM_TrlrStat), __cArray2, __cArray4, 8192);
      ReportTableRow(__tableHandle, 0, __cArray4, __cAOp, 1, __cArray3, __oneOfFlag, __bSetInCheckAlignment);
      
  
    }
    ReportTableEndTestStep(__tableHandle, "1");
  }
  TestCommandEnd();


  TestCommandBegin(__eWait, __cWait, "", "12");
  {
    Wait("1", (300 * 1000000LL), 1000000, "");
  }
  TestCommandEnd();

  TestCommandBegin(__eSet, __cSet, "", "13");
  {
    __tableHandle = ReportTableHead3Columns(__cSetCaption , __cTSym, __cTOp, __cAssigned); 
    {
      $`FDCAN2::dbNode::`BCM::`BRAKE_FD_2::`VehicleSpeedVSOSig.phys = 10;
      snprintf(__cArray, 8192, "%s", "BCM::BRAKE_FD_2::VehicleSpeedVSOSig");
      snprintf(__cArray2, 8192, "%s '%s'", __cCANSignal, __cArray);
      snprintf(__cArray3, 8192, "%s", "");
      
      ReportSetLValueOrSignalNotOnline(getSignalTime(`FDCAN2::dbNode::`BCM::`BRAKE_FD_2::`VehicleSpeedVSOSig), __cArray2, __cArray4, 8192);
      ReportTableRow(__tableHandle, 0, __cArray4, __cAOp, 10, __cArray3, __oneOfFlag, __bSetInCheckAlignment);
      
  
    }
    ReportTableEndTestStep(__tableHandle, "1");
  }
  TestCommandEnd();


  TestCommandBegin(__eWait, __cWait, "", "14");
  {
    Wait("1", (2000 * 1000000LL), 1000000, "");
  }
  TestCommandEnd();

  TestCommandBegin(__eSet, __cSet, "", "15");
  {
    __tableHandle = ReportTableHead3Columns(__cSetCaption , __cTSym, __cTOp, __cAssigned); 
    {
      $`FDCAN2::dbNode::`TRSKM::`TRSKM_FD_1::`TRSC_EnableBtn_Sts.phys = 1;
      snprintf(__cArray, 8192, "%s", "TRSC_EnableBtn_Sts");
      snprintf(__cArray2, 8192, "%s '%s'", __cCANSignal, __cArray);
      snprintf(__cArray3, 8192, "%s", "Pressed");
      
      ReportSetLValueOrSignalNotOnline(getSignalTime(`FDCAN2::dbNode::`TRSKM::`TRSKM_FD_1::`TRSC_EnableBtn_Sts), __cArray2, __cArray4, 8192);
      ReportTableRow(__tableHandle, 0, __cArray4, __cAOp, 1, __cArray3, __oneOfFlag, __bSetInCheckAlignment);
      
  
    }
    ReportTableEndTestStep(__tableHandle, "1");
  }
  TestCommandEnd();


  TestCommandBegin(__eWait, __cWait, "", "16");
  {
    Wait("1", (1500 * 1000000LL), 1000000, "");
  }
  TestCommandEnd();

  TestCommandBegin(__eSet, __cSet, "", "17");
  {
    __tableHandle = ReportTableHead3Columns(__cSetCaption , __cTSym, __cTOp, __cAssigned); 
    {
      $`FDCAN2::dbNode::`TRSKM::`TRSKM_FD_1::`TRSC_EnableBtn_Sts.phys = 0;
      snprintf(__cArray, 8192, "%s", "TRSC_EnableBtn_Sts");
      snprintf(__cArray2, 8192, "%s '%s'", __cCANSignal, __cArray);
      snprintf(__cArray3, 8192, "%s", "NOT_Pressed");
      
      ReportSetLValueOrSignalNotOnline(getSignalTime(`FDCAN2::dbNode::`TRSKM::`TRSKM_FD_1::`TRSC_EnableBtn_Sts), __cArray2, __cArray4, 8192);
      ReportTableRow(__tableHandle, 0, __cArray4, __cAOp, 0, __cArray3, __oneOfFlag, __bSetInCheckAlignment);
      
  
    }
    ReportTableEndTestStep(__tableHandle, "1");
  }
  TestCommandEnd();


  TestCommandBegin(__eWait, __cWait, "", "18");
  {
    Wait("1", (15000 * 1000000LL), 1000000, "");
  }
  TestCommandEnd();

  TestCommandBegin(__eSet, __cSet, "", "19");
  {
    __tableHandle = ReportTableHead3Columns(__cSetCaption , __cTSym, __cTOp, __cAssigned); 
    {
      $`FDCAN14::dbNode::`EPS::`EPS_FD_1::`LwsAngle.phys = 500;
      snprintf(__cArray, 8192, "%s", "FDCAN14::EPS::EPS_FD_1::LwsAngle");
      snprintf(__cArray2, 8192, "%s '%s'", __cCANSignal, __cArray);
      snprintf(__cArray3, 8192, "%s", "");
      
      ReportSetLValueOrSignalNotOnline(getSignalTime(`FDCAN14::dbNode::`EPS::`EPS_FD_1::`LwsAngle), __cArray2, __cArray4, 8192);
      ReportTableRow(__tableHandle, 0, __cArray4, __cAOp, 500, __cArray3, __oneOfFlag, __bSetInCheckAlignment);
      
  
    }
    ReportTableEndTestStep(__tableHandle, "1");
  }
  TestCommandEnd();


  TestCommandBegin(__eWait, __cWait, "", "20");
  {
    Wait("1", (2500 * 1000000LL), 1000000, "");
  }
  TestCommandEnd();

  TestCommandBegin(__eSet, __cSet, "", "21");
  {
    __tableHandle = ReportTableHead3Columns(__cSetCaption , __cTSym, __cTOp, __cAssigned); 
    {
      $`FDCAN14::dbNode::`EPS::`EPS_FD_1::`LwsAngle.phys = 0;
      snprintf(__cArray, 8192, "%s", "FDCAN14::EPS::EPS_FD_1::LwsAngle");
      snprintf(__cArray2, 8192, "%s '%s'", __cCANSignal, __cArray);
      snprintf(__cArray3, 8192, "%s", "");
      
      ReportSetLValueOrSignalNotOnline(getSignalTime(`FDCAN14::dbNode::`EPS::`EPS_FD_1::`LwsAngle), __cArray2, __cArray4, 8192);
      ReportTableRow(__tableHandle, 0, __cArray4, __cAOp, 0, __cArray3, __oneOfFlag, __bSetInCheckAlignment);
      
  
    }
    ReportTableEndTestStep(__tableHandle, "1");
  }
  TestCommandEnd();


  TestCommandBegin(__eWait, __cWait, "", "22");
  {
    Wait("1", (500 * 1000000LL), 1000000, "");
  }
  TestCommandEnd();

  TestCommandBegin(__eCheck, __cCheck, "", "23");
  {
    __bVerdict = __eVerdictPass;
    __tableHandle = ReportTableHead5Columns(__cCheckCaption, __cTSym, __cTOp, __cRefVal, __cActual, __cRes);
    {
      __csr = CheckSignalMatch(`FDCAN14::dbNode::`EPS::`EPS_FD_1::`LwsAngle, 0, "==") == 1;
      snprintf(__cArray, 8192, "%s", "FDCAN14::EPS::EPS_FD_1::LwsAngle");
      snprintf(__cArray2, 8192, "%s '%s'", __cCANSignal, __cArray);
      snprintf(__cArray3, 8192, "%s", "");
      ReportTableRow(__tableHandle, 0, __cArray2, "==", 0, __cArray3, __oneOfFlag, __bSetInCheckAlignment);
      ReportLValueOrSignalNotOnline(`FDCAN14::dbNode::`EPS::`EPS_FD_1::`LwsAngle, __cArray5, 8192);
      ReportCell(__tableHandle, __cArray5);
      ReportCellResult(__tableHandle, __csr, __ePassFail);
  
      __bVerdict = __bVerdict && __csr;
    }
    ReportTableEndVerdict(__tableHandle, "1", __bVerdict);
  }
  TestCommandEnd();


  TestCommandBegin(__eWait, __cWait, "", "24");
  {
    Wait("1", (10000 * 1000000LL), 1000000, "");
  }
  TestCommandEnd();


}

  
void __diagServiceo7tsimc_53(DiagRequest * __req, DiagResponse * __resp )
{
  stack long __tableHandle;
  long __res, __paramLen, __bytePos;

   __bVerdict = __eVerdictPass;

  do {
    TestReportResetDiagObjectList();
    DiagSetReportDetailLevel("CVADAS_0001_00000000_000", EnumServiceDetails_onfail);
    // Request aspect
    {

      if (0 >= DiagSendReqAndWaitForResp("CVADAS_0001_00000000_000", __req, __resp, __res, -1, -1, -1, -1, -1, EnumResult_pos, EnumServiceDetails_onfail, EnumSendingMode_physical, EnumSuppressPosResBit_asconfigured, EnumVerdictOnInvalidValues_fail))
        break;
    }

    __res = DiagErrCodeTestStep(__res, "Can't retrieve last response for request! No check possible.") < 0;
    if(__res)
    {
	  __bVerdict = __eVerdictFail;
      break;
    }
    {
      __res = DiagInterpretAs(__resp, "DSC_PR");
      if(__res != 0)
      {
        __bVerdict = __eVerdictFail;
        DiagErrCodeTestStep(__res, "Can't interpret response as diagnostic primitive 'DSC_PR'.");
        break;
      }
      else
      {
        TestStepPass( "Received primitive can be interpreted as diagnostic primitive 'DSC_PR'.");
      }
    }
  }
  while(0);


  // Response, check & read aspect
  {
    __res = 1;
    __tableHandle = ReportTableHead5Columns(__cCheckCaption, __cTSym, __cTOp, __cRefVal, __cActual, __cRes);
    {
      __bDiagValueArrayCtr = DiagGetParameterErrorHandled(__resp, "DiagSessionType", __bDiagValueArray, elcount(__bDiagValueArray), __cDiagValueArray, elcount(__cDiagValueArray));
      {
        byte __bArray2[1] = { 0x03 };
        __bArrayCtr = __CopyBytes(__bDiagValueArray, __bDiagValueArrayCtr, __bArray);
        __bArrayCtr2 = elCount(__bArray2);
        __csr = CompareBytes(__bArray, __bArrayCtr, __bArray2, __bArrayCtr2) == 0;
        snprintf(__cArray, 8192, "%s", "Diagnostic parameter \'DiagSessionType\'");
        snprintf(__cArray2, 8192, "%s", __cArray);
        snprintf(__cArray3, 8192, "%s", "");
        ReportTableRow(__tableHandle, 0, __cArray2, "Bytes", __bArray2, __bArrayCtr2, __cArray3, __oneOfFlag, __bSetInCheckAlignment);
        ReportCell(__tableHandle, __bArray, __bArrayCtr);
        ReportCellResult(__tableHandle, __csr, __ePassFail);
      }
    
      __res = __res && __csr;
    
    }
    ReportTableEndVerdict(__tableHandle, __cEvaluateResponse, __res);
	__bVerdict = __bVerdict && __res;
  }
  if (__bVerdict == __eVerdictFail)
    TestReportWriteDiagObjectList();
}
  
void __diagServiceo7tsimc_54(DiagRequest * __req, DiagResponse * __resp )
{
  stack long __tableHandle;
  long __res, __paramLen, __bytePos;

   __bVerdict = __eVerdictPass;

  do {
    TestReportResetDiagObjectList();
    DiagSetReportDetailLevel("CVADAS_0001_00000000_000", EnumServiceDetails_onfail);
    // Request aspect
    {
      {
        {
          byte __bArray[1] = { 0x01 };
          __bArrayCtr = elCount(__bArray);
          __bDiagValueArrayCtr = __CopyBytes(__bArray, __bArrayCtr, __bDiagValueArray);
        }
      
        __res = DiagSetParameterErrorHandled(__req, "RoutineControlType", __bDiagValueArray, __bDiagValueArrayCtr);
        if(__res < 0)
        {
          __bVerdict = __eVerdictFail;
          DiagErrCodeTestStep(__res, "Cannot set diagnostic parameter 'RoutineControlType'");
          break;
        }
      }
      {
        __res = DiagSetParameterErrorHandled(__req, "RoutineIdentifier", 0x1000);
        if(__res < 0)
        {
          __bVerdict = __eVerdictFail;
          DiagErrCodeTestStep(__res, "Cannot set diagnostic parameter 'RoutineIdentifier'");
          break;
        }
      }
      {
        __res = DiagSetParameterErrorHandled(__req, "Mode", "Debug");
        if(__res < 0)
        {
          __bVerdict = __eVerdictFail;
          DiagErrCodeTestStep(__res, "Cannot set diagnostic parameter 'Mode'");
          break;
        }
      }

      if (0 >= DiagSendReqAndWaitForResp("CVADAS_0001_00000000_000", __req, __resp, __res, -1, -1, -1, -1, -1, EnumResult_pos, EnumServiceDetails_onfail, EnumSendingMode_physical, EnumSuppressPosResBit_asconfigured, EnumVerdictOnInvalidValues_fail))
        break;
    }

    __res = DiagErrCodeTestStep(__res, "Can't retrieve last response for request! No check possible.") < 0;
    if(__res)
    {
	  __bVerdict = __eVerdictFail;
      break;
    }
    {
      __res = DiagInterpretAs(__resp, "RC_STR_PR");
      if(__res != 0)
      {
        __bVerdict = __eVerdictFail;
        DiagErrCodeTestStep(__res, "Can't interpret response as diagnostic primitive 'RC_STR_PR'.");
        break;
      }
      else
      {
        TestStepPass( "Received primitive can be interpreted as diagnostic primitive 'RC_STR_PR'.");
      }
    }
  }
  while(0);


  // Response, check & read aspect
  {
    __res = 1;
    __tableHandle = ReportTableHead5Columns(__cCheckCaption, __cTSym, __cTOp, __cRefVal, __cActual, __cRes);
    {
      double __nDiagValue;
      DiagGetParameterErrorHandled(__resp, "RoutineIdentifier", __nDiagValue);
      __csr = CheckSignalMatch(__nDiagValue, 0x1000, "==") == 1;
      snprintf(__cArray, 8192, "%s", "Diagnostic parameter \'RoutineIdentifier\'");
      snprintf(__cArray2, 8192, "%s", __cArray);
      snprintf(__cArray3, 8192, "%s", "");
      ReportTableRow(__tableHandle, 0, __cArray2, "==", 0x1000, __cArray3, __oneOfFlag, __bSetInCheckAlignment);
      ReportCell(__tableHandle, __nDiagValue);
      ReportCellResult(__tableHandle, __csr, __ePassFail);
    
      __res = __res && __csr;
    
    }
    {
      DiagGetParameterErrorHandled(__resp, "Mode", __bDiagValueArray, elcount(__bDiagValueArray), __cDiagValueArray, elcount(__cDiagValueArray));
      CheckCaplGenVarStringBufferConsistency(__cDiagValueArray, 8192);
      snprintf(__cArray, 8192, "%s", __cDiagValueArray);
      CheckLiteralGetStringBufferConsistency("Debug", 8192);
      snprintf(__cArray2, 8192, "%s", "Debug");
      __csr = strncmp(__cArray, __cArray2, 8192) == 0;
      snprintf(__cArray3, 8192, "%s", "Diagnostic parameter \'Mode\'");
      snprintf(__cArray4, 8192, "%s", __cArray3);
      snprintf(__cArray5, 8192, "%s", "");
      ReportTableRow(__tableHandle, 0, __cArray4, "==", __cArray2, __cArray5, __oneOfFlag, __bSetInCheckAlignment);
      ReportCell(__tableHandle, __cArray);
      ReportCellResult(__tableHandle, __csr, __ePassFail);
    
      __res = __res && __csr;
    
    }
    ReportTableEndVerdict(__tableHandle, __cEvaluateResponse, __res);
	__bVerdict = __bVerdict && __res;
  }
  if (__bVerdict == __eVerdictFail)
    TestReportWriteDiagObjectList();
}
void Tto7tsimc_TsTc0_Completion()
{
  stack long __tableHandle;
  TestCompletionBegin();
  {
    {
      CreateTTEIFFunction("Tto7tsimc_General_Postconditions", __eFct, __eLocal);
      CallInterfaceFunction(__cEmpty, __cEmpty, "1e332074-c202-4b57-ba23-fc1484b5400b");
    }


  }
  TestCompletionEnd();
}

testcase Tto7tsimc_TRSC_Turn_Off()
{
  stack long __tableHandle;
  SetBreakOnFail(1);

  TestPreparationBegin();
  {
    {
      CreateTTEIFFunction("Tto7tsimc_General_Precondition", __eFct, __eLocal);
      CallInterfaceFunction(__cEmpty, __cEmpty, "e7b0609c-a6e0-42d6-9d60-147a1cf5844f");
    }


  }
  TestPreparationEnd();

  TestCommandBegin(__eDiagService, __cDiagService, "", "1");
  {
    if (DiagIsFunctionalGroup("CVADAS_0001_00000000_000"))
    {
      DiagResponse * __resp;
      DiagRequest CVADAS_0001_00000000_000.Extended_Diagnostic_Session_Start __req;
      __diagServiceo7tsimc_55(__req, __resp);
    }
    else
    {
      DiagResponse CVADAS_0001_00000000_000.* __resp;
      DiagRequest CVADAS_0001_00000000_000.Extended_Diagnostic_Session_Start __req;
      __diagServiceo7tsimc_55(__req, __resp);
    }
  }
  TestCommandEnd();


  TestCommandBegin(__eWait, __cWait, "", "2");
  {
    Wait("1", (500 * 1000000LL), 1000000, "");
  }
  TestCommandEnd();

  TestCommandBegin(__eSet, __cSet, "", "3");
  {
    __tableHandle = ReportTableHead3Columns(__cSetCaption , __cTSym, __cTOp, __cAssigned); 
    {
      $`FDCAN2::dbNode::`BCM::`TRANSM_FD_4::`ShiftLeverPosition.phys = 4;
      snprintf(__cArray, 8192, "%s", "ShiftLeverPosition");
      snprintf(__cArray2, 8192, "%s '%s'", __cCANSignal, __cArray);
      snprintf(__cArray3, 8192, "%s", "");
      
      ReportSetLValueOrSignalNotOnline(getSignalTime(`FDCAN2::dbNode::`BCM::`TRANSM_FD_4::`ShiftLeverPosition), __cArray2, __cArray4, 8192);
      ReportTableRow(__tableHandle, 0, __cArray4, __cAOp, 4, __cArray3, __oneOfFlag, __bSetInCheckAlignment);
      
  
    }
    ReportTableEndTestStep(__tableHandle, "1");
  }
  TestCommandEnd();


  TestCommandBegin(__eWait, __cWait, "", "4");
  {
    Wait("1", (50 * 1000000LL), 1000000, "");
  }
  TestCommandEnd();

  TestCommandBegin(__eSet, __cSet, "", "5");
  {
    __tableHandle = ReportTableHead3Columns(__cSetCaption , __cTSym, __cTOp, __cAssigned); 
    {
      $`FDCAN2::dbNode::`BCM::`TRANSM_FD_2::`GearEngagedForDisplay.phys = 15;
      snprintf(__cArray, 8192, "%s", "GearEngagedForDisplay");
      snprintf(__cArray2, 8192, "%s '%s'", __cCANSignal, __cArray);
      snprintf(__cArray3, 8192, "%s", "D");
      
      ReportSetLValueOrSignalNotOnline(getSignalTime(`FDCAN2::dbNode::`BCM::`TRANSM_FD_2::`GearEngagedForDisplay), __cArray2, __cArray4, 8192);
      ReportTableRow(__tableHandle, 0, __cArray4, __cAOp, 15, __cArray3, __oneOfFlag, __bSetInCheckAlignment);
      
  
    }
    ReportTableEndTestStep(__tableHandle, "1");
  }
  TestCommandEnd();


  TestCommandBegin(__eWait, __cWait, "", "6");
  {
    Wait("1", (1500 * 1000000LL), 1000000, "");
  }
  TestCommandEnd();

  TestCommandBegin(__eSet, __cSet, "", "7");
  {
    __tableHandle = ReportTableHead3Columns(__cSetCaption , __cTSym, __cTOp, __cAssigned); 
    {
      $`FDCAN2::dbNode::`BCM::`BCM_FD_27::`TrailerConnectionSts.phys = 1;
      snprintf(__cArray, 8192, "%s", "TrailerConnectionSts");
      snprintf(__cArray2, 8192, "%s '%s'", __cCANSignal, __cArray);
      snprintf(__cArray3, 8192, "%s", "Connected");
      
      ReportSetLValueOrSignalNotOnline(getSignalTime(`FDCAN2::dbNode::`BCM::`BCM_FD_27::`TrailerConnectionSts), __cArray2, __cArray4, 8192);
      ReportTableRow(__tableHandle, 0, __cArray4, __cAOp, 1, __cArray3, __oneOfFlag, __bSetInCheckAlignment);
      
  
    }
    ReportTableEndTestStep(__tableHandle, "1");
  }
  TestCommandEnd();


  TestCommandBegin(__eWait, __cWait, "", "8");
  {
    Wait("1", (300 * 1000000LL), 1000000, "");
  }
  TestCommandEnd();

  TestCommandBegin(__eSet, __cSet, "", "9");
  {
    __tableHandle = ReportTableHead3Columns(__cSetCaption , __cTSym, __cTOp, __cAssigned); 
    {
      $`FDCAN2::dbNode::`BCM::`BCM_FD_29::`ITBM_TrlrStat.phys = 1;
      snprintf(__cArray, 8192, "%s", "ITBM_TrlrStat");
      snprintf(__cArray2, 8192, "%s '%s'", __cCANSignal, __cArray);
      snprintf(__cArray3, 8192, "%s", "TRLR_PRSNT");
      
      ReportSetLValueOrSignalNotOnline(getSignalTime(`FDCAN2::dbNode::`BCM::`BCM_FD_29::`ITBM_TrlrStat), __cArray2, __cArray4, 8192);
      ReportTableRow(__tableHandle, 0, __cArray4, __cAOp, 1, __cArray3, __oneOfFlag, __bSetInCheckAlignment);
      
  
    }
    ReportTableEndTestStep(__tableHandle, "1");
  }
  TestCommandEnd();


  TestCommandBegin(__eWait, __cWait, "", "10");
  {
    Wait("1", (300 * 1000000LL), 1000000, "");
  }
  TestCommandEnd();

  TestCommandBegin(__eSet, __cSet, "", "11");
  {
    __tableHandle = ReportTableHead3Columns(__cSetCaption , __cTSym, __cTOp, __cAssigned); 
    {
      $`FDCAN2::dbNode::`BCM::`BRAKE_FD_2::`VehicleSpeedVSOSig.phys = 10;
      snprintf(__cArray, 8192, "%s", "BCM::BRAKE_FD_2::VehicleSpeedVSOSig");
      snprintf(__cArray2, 8192, "%s '%s'", __cCANSignal, __cArray);
      snprintf(__cArray3, 8192, "%s", "");
      
      ReportSetLValueOrSignalNotOnline(getSignalTime(`FDCAN2::dbNode::`BCM::`BRAKE_FD_2::`VehicleSpeedVSOSig), __cArray2, __cArray4, 8192);
      ReportTableRow(__tableHandle, 0, __cArray4, __cAOp, 10, __cArray3, __oneOfFlag, __bSetInCheckAlignment);
      
  
    }
    ReportTableEndTestStep(__tableHandle, "1");
  }
  TestCommandEnd();


  TestCommandBegin(__eWait, __cWait, "", "12");
  {
    Wait("1", (2000 * 1000000LL), 1000000, "");
  }
  TestCommandEnd();

  TestCommandBegin(__eSet, __cSet, "", "13");
  {
    __tableHandle = ReportTableHead3Columns(__cSetCaption , __cTSym, __cTOp, __cAssigned); 
    {
      $`FDCAN2::dbNode::`TRSKM::`TRSKM_FD_1::`TRSC_EnableBtn_Sts.phys = 1;
      snprintf(__cArray, 8192, "%s", "TRSC_EnableBtn_Sts");
      snprintf(__cArray2, 8192, "%s '%s'", __cCANSignal, __cArray);
      snprintf(__cArray3, 8192, "%s", "Pressed");
      
      ReportSetLValueOrSignalNotOnline(getSignalTime(`FDCAN2::dbNode::`TRSKM::`TRSKM_FD_1::`TRSC_EnableBtn_Sts), __cArray2, __cArray4, 8192);
      ReportTableRow(__tableHandle, 0, __cArray4, __cAOp, 1, __cArray3, __oneOfFlag, __bSetInCheckAlignment);
      
  
    }
    ReportTableEndTestStep(__tableHandle, "1");
  }
  TestCommandEnd();


  TestCommandBegin(__eWait, __cWait, "", "14");
  {
    Wait("1", (1500 * 1000000LL), 1000000, "");
  }
  TestCommandEnd();

  TestCommandBegin(__eSet, __cSet, "", "15");
  {
    __tableHandle = ReportTableHead3Columns(__cSetCaption , __cTSym, __cTOp, __cAssigned); 
    {
      $`FDCAN2::dbNode::`TRSKM::`TRSKM_FD_1::`TRSC_EnableBtn_Sts.phys = 0;
      snprintf(__cArray, 8192, "%s", "TRSC_EnableBtn_Sts");
      snprintf(__cArray2, 8192, "%s '%s'", __cCANSignal, __cArray);
      snprintf(__cArray3, 8192, "%s", "NOT_Pressed");
      
      ReportSetLValueOrSignalNotOnline(getSignalTime(`FDCAN2::dbNode::`TRSKM::`TRSKM_FD_1::`TRSC_EnableBtn_Sts), __cArray2, __cArray4, 8192);
      ReportTableRow(__tableHandle, 0, __cArray4, __cAOp, 0, __cArray3, __oneOfFlag, __bSetInCheckAlignment);
      
  
    }
    ReportTableEndTestStep(__tableHandle, "1");
  }
  TestCommandEnd();


  TestCommandBegin(__eWait, __cWait, "", "16");
  {
    Wait("1", (15000 * 1000000LL), 1000000, "");
  }
  TestCommandEnd();

  TestCommandBegin(__eSet, __cSet, "", "17");
  {
    __tableHandle = ReportTableHead3Columns(__cSetCaption , __cTSym, __cTOp, __cAssigned); 
    {
      $`FDCAN14::dbNode::`EPS::`EPS_FD_1::`LwsAngle.phys = 500;
      snprintf(__cArray, 8192, "%s", "FDCAN14::EPS::EPS_FD_1::LwsAngle");
      snprintf(__cArray2, 8192, "%s '%s'", __cCANSignal, __cArray);
      snprintf(__cArray3, 8192, "%s", "");
      
      ReportSetLValueOrSignalNotOnline(getSignalTime(`FDCAN14::dbNode::`EPS::`EPS_FD_1::`LwsAngle), __cArray2, __cArray4, 8192);
      ReportTableRow(__tableHandle, 0, __cArray4, __cAOp, 500, __cArray3, __oneOfFlag, __bSetInCheckAlignment);
      
  
    }
    ReportTableEndTestStep(__tableHandle, "1");
  }
  TestCommandEnd();


  TestCommandBegin(__eWait, __cWait, "", "18");
  {
    Wait("1", (500 * 1000000LL), 1000000, "");
  }
  TestCommandEnd();

  TestCommandBegin(__eCheck, __cCheck, "", "19");
  {
    __bVerdict = __eVerdictPass;
    __tableHandle = ReportTableHead5Columns(__cCheckCaption, __cTSym, __cTOp, __cRefVal, __cActual, __cRes);
    {
      __csr = CheckSignalMatch(`FDCAN14::dbNode::`EPS::`EPS_FD_1::`LwsAngle, 500, "==") == 1;
      snprintf(__cArray, 8192, "%s", "FDCAN14::EPS::EPS_FD_1::LwsAngle");
      snprintf(__cArray2, 8192, "%s '%s'", __cCANSignal, __cArray);
      snprintf(__cArray3, 8192, "%s", "");
      ReportTableRow(__tableHandle, 0, __cArray2, "==", 500, __cArray3, __oneOfFlag, __bSetInCheckAlignment);
      ReportLValueOrSignalNotOnline(`FDCAN14::dbNode::`EPS::`EPS_FD_1::`LwsAngle, __cArray5, 8192);
      ReportCell(__tableHandle, __cArray5);
      ReportCellResult(__tableHandle, __csr, __ePassFail);
  
      __bVerdict = __bVerdict && __csr;
    }
    ReportTableEndVerdict(__tableHandle, "1", __bVerdict);
  }
  TestCommandEnd();


  TestCommandBegin(__eWait, __cWait, "", "20");
  {
    Wait("1", (2500 * 1000000LL), 1000000, "");
  }
  TestCommandEnd();

  TestCommandBegin(__eSet, __cSet, "", "21");
  {
    __tableHandle = ReportTableHead3Columns(__cSetCaption , __cTSym, __cTOp, __cAssigned); 
    {
      $`FDCAN14::dbNode::`EPS::`EPS_FD_1::`LwsAngle.phys = 0;
      snprintf(__cArray, 8192, "%s", "FDCAN14::EPS::EPS_FD_1::LwsAngle");
      snprintf(__cArray2, 8192, "%s '%s'", __cCANSignal, __cArray);
      snprintf(__cArray3, 8192, "%s", "");
      
      ReportSetLValueOrSignalNotOnline(getSignalTime(`FDCAN14::dbNode::`EPS::`EPS_FD_1::`LwsAngle), __cArray2, __cArray4, 8192);
      ReportTableRow(__tableHandle, 0, __cArray4, __cAOp, 0, __cArray3, __oneOfFlag, __bSetInCheckAlignment);
      
  
    }
    ReportTableEndTestStep(__tableHandle, "1");
  }
  TestCommandEnd();


  TestCommandBegin(__eWait, __cWait, "", "22");
  {
    Wait("1", (500 * 1000000LL), 1000000, "");
  }
  TestCommandEnd();

  TestCommandBegin(__eCheck, __cCheck, "", "23");
  {
    __bVerdict = __eVerdictPass;
    __tableHandle = ReportTableHead5Columns(__cCheckCaption, __cTSym, __cTOp, __cRefVal, __cActual, __cRes);
    {
      __csr = CheckSignalMatch(`FDCAN14::dbNode::`EPS::`EPS_FD_1::`LwsAngle, 0, "==") == 1;
      snprintf(__cArray, 8192, "%s", "FDCAN14::EPS::EPS_FD_1::LwsAngle");
      snprintf(__cArray2, 8192, "%s '%s'", __cCANSignal, __cArray);
      snprintf(__cArray3, 8192, "%s", "");
      ReportTableRow(__tableHandle, 0, __cArray2, "==", 0, __cArray3, __oneOfFlag, __bSetInCheckAlignment);
      ReportLValueOrSignalNotOnline(`FDCAN14::dbNode::`EPS::`EPS_FD_1::`LwsAngle, __cArray5, 8192);
      ReportCell(__tableHandle, __cArray5);
      ReportCellResult(__tableHandle, __csr, __ePassFail);
  
      __bVerdict = __bVerdict && __csr;
    }
    ReportTableEndVerdict(__tableHandle, "1", __bVerdict);
  }
  TestCommandEnd();


  {
    CreateCaplIFFunction("Disable_CAN_Communcation_NoSleep", __eFct);
    CallInterfaceFunction(__cEmpty, __cEmpty, "24");
  }


  {
    CreateCaplIFFunction("Enable_CAN_Communication", __eFct);
    CallInterfaceFunction(__cEmpty, __cEmpty, "25");
  }


}

  
void __diagServiceo7tsimc_55(DiagRequest * __req, DiagResponse * __resp )
{
  stack long __tableHandle;
  long __res, __paramLen, __bytePos;

   __bVerdict = __eVerdictPass;

  do {
    TestReportResetDiagObjectList();
    DiagSetReportDetailLevel("CVADAS_0001_00000000_000", EnumServiceDetails_onfail);
    // Request aspect
    {

      if (0 >= DiagSendReqAndWaitForResp("CVADAS_0001_00000000_000", __req, __resp, __res, -1, -1, -1, -1, -1, EnumResult_pos, EnumServiceDetails_onfail, EnumSendingMode_physical, EnumSuppressPosResBit_asconfigured, EnumVerdictOnInvalidValues_fail))
        break;
    }

    __res = DiagErrCodeTestStep(__res, "Can't retrieve last response for request! No check possible.") < 0;
    if(__res)
    {
	  __bVerdict = __eVerdictFail;
      break;
    }
    {
      __res = DiagInterpretAs(__resp, "DSC_PR");
      if(__res != 0)
      {
        __bVerdict = __eVerdictFail;
        DiagErrCodeTestStep(__res, "Can't interpret response as diagnostic primitive 'DSC_PR'.");
        break;
      }
      else
      {
        TestStepPass( "Received primitive can be interpreted as diagnostic primitive 'DSC_PR'.");
      }
    }
  }
  while(0);


  // Response, check & read aspect
  {
    __res = 1;
    __tableHandle = ReportTableHead5Columns(__cCheckCaption, __cTSym, __cTOp, __cRefVal, __cActual, __cRes);
    {
      __bDiagValueArrayCtr = DiagGetParameterErrorHandled(__resp, "DiagSessionType", __bDiagValueArray, elcount(__bDiagValueArray), __cDiagValueArray, elcount(__cDiagValueArray));
      {
        byte __bArray2[1] = { 0x03 };
        __bArrayCtr = __CopyBytes(__bDiagValueArray, __bDiagValueArrayCtr, __bArray);
        __bArrayCtr2 = elCount(__bArray2);
        __csr = CompareBytes(__bArray, __bArrayCtr, __bArray2, __bArrayCtr2) == 0;
        snprintf(__cArray, 8192, "%s", "Diagnostic parameter \'DiagSessionType\'");
        snprintf(__cArray2, 8192, "%s", __cArray);
        snprintf(__cArray3, 8192, "%s", "");
        ReportTableRow(__tableHandle, 0, __cArray2, "Bytes", __bArray2, __bArrayCtr2, __cArray3, __oneOfFlag, __bSetInCheckAlignment);
        ReportCell(__tableHandle, __bArray, __bArrayCtr);
        ReportCellResult(__tableHandle, __csr, __ePassFail);
      }
    
      __res = __res && __csr;
    
    }
    ReportTableEndVerdict(__tableHandle, __cEvaluateResponse, __res);
	__bVerdict = __bVerdict && __res;
  }
  if (__bVerdict == __eVerdictFail)
    TestReportWriteDiagObjectList();
}

testsequence Tto7tsimc_EOL_Calibration()
{
  stack long __tableHandle;
  SetBreakOnFail(1);

  CreateTTEIFFunction("Tto7tsimc_TsTc1", __eTcDef, __eLocal);
  AddIFParameterTestCaseAttribute("TC_ID", "");
  AddIFParameterTestCaseAttribute("Test Case ID", "");
  CallInterfaceFunction("21189419_Calibrate_All_Cameras", __cEmpty , "2cdcbdc5-eba5-4da3-a7ee-8743babe8040");

}

testcase Tto7tsimc_TsTc1()
{
  stack long __tableHandle;
  SetBreakOnFail(1);

  TestPreparationBegin();
  {
  }
  TestPreparationEnd();

  TestCommandBegin(__eDiagService, __cDiagService, "", "0");
  {
    if (DiagIsFunctionalGroup("CVADAS_0001_00000000_000"))
    {
      DiagResponse * __resp;
      DiagRequest CVADAS_0001_00000000_000.Extended_Diagnostic_Session_Start __req;
      __diagServiceo7tsimc_56(__req, __resp);
    }
    else
    {
      DiagResponse CVADAS_0001_00000000_000.* __resp;
      DiagRequest CVADAS_0001_00000000_000.Extended_Diagnostic_Session_Start __req;
      __diagServiceo7tsimc_56(__req, __resp);
    }
  }
  TestCommandEnd();


  TestCommandBegin(__eDiagService, __cDiagService, "", "1");
  {
    if (DiagIsFunctionalGroup("CVADAS_0001_00000000_000"))
    {
      DiagResponse * __resp;
      DiagRequest CVADAS_0001_00000000_000._22FD00_Plant_Camera_Calibration_Data_Write __req;
      __diagServiceo7tsimc_57(__req, __resp);
    }
    else
    {
      DiagResponse CVADAS_0001_00000000_000.* __resp;
      DiagRequest CVADAS_0001_00000000_000._22FD00_Plant_Camera_Calibration_Data_Write __req;
      __diagServiceo7tsimc_57(__req, __resp);
    }
  }
  TestCommandEnd();


  TestCommandBegin(__eWait, __cWait, "", "2");
  {
    Wait("1", (1000 * 1000000LL), 1000000, "");
  }
  TestCommandEnd();

  {
    CreateCaplIFFunction("Hard_Reset", __eFct);
    CallInterfaceFunction(__cEmpty, __cEmpty, "3");
  }


}

  
void __diagServiceo7tsimc_56(DiagRequest * __req, DiagResponse * __resp )
{
  stack long __tableHandle;
  long __res, __paramLen, __bytePos;

   __bVerdict = __eVerdictPass;

  do {
    TestReportResetDiagObjectList();
    DiagSetReportDetailLevel("CVADAS_0001_00000000_000", EnumServiceDetails_onfail);
    // Request aspect
    {
      {
        __res = DiagSetParameterErrorHandled(__req, "DiagSessionType", 03);
        if(__res < 0)
        {
          __bVerdict = __eVerdictFail;
          DiagErrCodeTestStep(__res, "Cannot set diagnostic parameter 'DiagSessionType'");
          break;
        }
      }

      if (0 >= DiagSendReqAndWaitForResp("CVADAS_0001_00000000_000", __req, __resp, __res, -1, -1, -1, -1, -1, EnumResult_pos, EnumServiceDetails_onfail, EnumSendingMode_physical, EnumSuppressPosResBit_asconfigured, EnumVerdictOnInvalidValues_fail))
        break;
    }

    __res = DiagErrCodeTestStep(__res, "Can't retrieve last response for request! No check possible.") < 0;
    if(__res)
    {
	  __bVerdict = __eVerdictFail;
      break;
    }
    {
      __res = DiagInterpretAs(__resp, "DSC_PR");
      if(__res != 0)
      {
        __bVerdict = __eVerdictFail;
        DiagErrCodeTestStep(__res, "Can't interpret response as diagnostic primitive 'DSC_PR'.");
        break;
      }
      else
      {
        TestStepPass( "Received primitive can be interpreted as diagnostic primitive 'DSC_PR'.");
      }
    }
  }
  while(0);


  // Response, check & read aspect
  {
    __res = 1;
    __tableHandle = ReportTableHead5Columns(__cCheckCaption, __cTSym, __cTOp, __cRefVal, __cActual, __cRes);
    {
      double __nDiagValue;
      DiagGetParameterErrorHandled(__resp, "DiagSessionType", __nDiagValue);
      __csr = CheckSignalMatch(__nDiagValue, 03, "==") == 1;
      snprintf(__cArray, 8192, "%s", "Diagnostic parameter \'DiagSessionType\'");
      snprintf(__cArray2, 8192, "%s", __cArray);
      snprintf(__cArray3, 8192, "%s", "");
      ReportTableRow(__tableHandle, 0, __cArray2, "==", 03, __cArray3, __oneOfFlag, __bSetInCheckAlignment);
      ReportCell(__tableHandle, __nDiagValue);
      ReportCellResult(__tableHandle, __csr, __ePassFail);
    
      __res = __res && __csr;
    
    }
    ReportTableEndVerdict(__tableHandle, __cEvaluateResponse, __res);
	__bVerdict = __bVerdict && __res;
  }
  if (__bVerdict == __eVerdictFail)
    TestReportWriteDiagObjectList();
}
  
void __diagServiceo7tsimc_57(DiagRequest * __req, DiagResponse * __resp )
{
  stack long __tableHandle;
  long __res, __paramLen, __bytePos;

   __bVerdict = __eVerdictPass;

  do {
    TestReportResetDiagObjectList();
    DiagSetReportDetailLevel("CVADAS_0001_00000000_000", EnumServiceDetails_onfail);
    // Request aspect
    {
      {
        {
          byte __bArray[1] = { 0x03 };
          __bArrayCtr = elCount(__bArray);
          __bDiagValueArrayCtr = __CopyBytes(__bArray, __bArrayCtr, __bDiagValueArray);
        }
      
        __res = DiagSetParameterErrorHandled(__req, "CalibrationStatus_Front", __bDiagValueArray, __bDiagValueArrayCtr);
        if(__res < 0)
        {
          __bVerdict = __eVerdictFail;
          DiagErrCodeTestStep(__res, "Cannot set diagnostic parameter 'CalibrationStatus_Front'");
          break;
        }
      }
      {
        {
          byte __bArray[1] = { 0x03 };
          __bArrayCtr = elCount(__bArray);
          __bDiagValueArrayCtr = __CopyBytes(__bArray, __bArrayCtr, __bDiagValueArray);
        }
      
        __res = DiagSetParameterErrorHandled(__req, "CalibrationStatus_Left", __bDiagValueArray, __bDiagValueArrayCtr);
        if(__res < 0)
        {
          __bVerdict = __eVerdictFail;
          DiagErrCodeTestStep(__res, "Cannot set diagnostic parameter 'CalibrationStatus_Left'");
          break;
        }
      }
      {
        {
          byte __bArray[1] = { 0x03 };
          __bArrayCtr = elCount(__bArray);
          __bDiagValueArrayCtr = __CopyBytes(__bArray, __bArrayCtr, __bDiagValueArray);
        }
      
        __res = DiagSetParameterErrorHandled(__req, "CalibrationStatus_Rear", __bDiagValueArray, __bDiagValueArrayCtr);
        if(__res < 0)
        {
          __bVerdict = __eVerdictFail;
          DiagErrCodeTestStep(__res, "Cannot set diagnostic parameter 'CalibrationStatus_Rear'");
          break;
        }
      }
      {
        {
          byte __bArray[1] = { 0x03 };
          __bArrayCtr = elCount(__bArray);
          __bDiagValueArrayCtr = __CopyBytes(__bArray, __bArrayCtr, __bDiagValueArray);
        }
      
        __res = DiagSetParameterErrorHandled(__req, "CalibrationStatus_Right", __bDiagValueArray, __bDiagValueArrayCtr);
        if(__res < 0)
        {
          __bVerdict = __eVerdictFail;
          DiagErrCodeTestStep(__res, "Cannot set diagnostic parameter 'CalibrationStatus_Right'");
          break;
        }
      }

      if (0 >= DiagSendReqAndWaitForResp("CVADAS_0001_00000000_000", __req, __resp, __res, -1, -1, -1, -1, -1, EnumResult_pos, EnumServiceDetails_onfail, EnumSendingMode_physical, EnumSuppressPosResBit_asconfigured, EnumVerdictOnInvalidValues_fail))
        break;
    }

    __res = DiagErrCodeTestStep(__res, "Can't retrieve last response for request! No check possible.") < 0;
    if(__res)
    {
	  __bVerdict = __eVerdictFail;
      break;
    }
    {
      __res = DiagInterpretAs(__resp, "WDBI_PR");
      if(__res != 0)
      {
        __bVerdict = __eVerdictFail;
        DiagErrCodeTestStep(__res, "Can't interpret response as diagnostic primitive 'WDBI_PR'.");
        break;
      }
      else
      {
        TestStepPass( "Received primitive can be interpreted as diagnostic primitive 'WDBI_PR'.");
      }
    }
  }
  while(0);


  if (__bVerdict == __eVerdictFail)
    TestReportWriteDiagObjectList();
}

testsequence Tto7tsimc_Reset_NVM()
{
  stack long __tableHandle;
  SetBreakOnFail(1);

  CreateTTEIFFunction("Tto7tsimc_TsTc2", __eTcDef, __eLocal);
  AddIFParameterTestCaseAttribute("TC_ID", "");
  AddIFParameterTestCaseAttribute("Test Case ID", "");
  CallInterfaceFunction("20657328_Reset_NVM", __cEmpty , "a090a573-a846-4c9d-b890-d2c83d12d20c");

}

testcase Tto7tsimc_TsTc2()
{
  stack long __tableHandle;
  SetBreakOnFail(1);

  TestPreparationBegin();
  {
  }
  TestPreparationEnd();

  TestCaseDescription("");

  TestCommandBegin(__eWait, __cWait, "Wait for boot up initally after flash", "0");
  {
    Wait("1", (45000 * 1000000LL), 1000000, "");
  }
  TestCommandEnd();

  TestCommandBegin(__eDiagService, __cDiagService, "", "1");
  {
    if (DiagIsFunctionalGroup("CVADAS_0001_00000000_000"))
    {
      DiagResponse * __resp;
      DiagRequest CVADAS_0001_00000000_000.Extended_Diagnostic_Session_Start __req;
      __diagServiceo7tsimc_58(__req, __resp);
    }
    else
    {
      DiagResponse CVADAS_0001_00000000_000.* __resp;
      DiagRequest CVADAS_0001_00000000_000.Extended_Diagnostic_Session_Start __req;
      __diagServiceo7tsimc_58(__req, __resp);
    }
  }
  TestCommandEnd();


  TestCommandBegin(__eDiagService, __cDiagService, "", "2");
  {
    if (DiagIsFunctionalGroup("CVADAS_0001_00000000_000"))
    {
      DiagResponse * __resp;
      DiagRequest CVADAS_0001_00000000_000._2EFD4E_Reset_NVM_Write __req;
      __diagServiceo7tsimc_59(__req, __resp);
    }
    else
    {
      DiagResponse CVADAS_0001_00000000_000.* __resp;
      DiagRequest CVADAS_0001_00000000_000._2EFD4E_Reset_NVM_Write __req;
      __diagServiceo7tsimc_59(__req, __resp);
    }
  }
  TestCommandEnd();


  TestCommandBegin(__eWait, __cWait, "", "3");
  {
    Wait("1", (10000 * 1000000LL), 1000000, "");
  }
  TestCommandEnd();

  {
    CreateCaplIFFunction("Hard_Reset", __eFct);
    CallInterfaceFunction(__cEmpty, __cEmpty, "4");
  }


  TestCommandBegin(__eWait, __cWait, "", "5");
  {
    Wait("1", (45000 * 1000000LL), 1000000, "");
  }
  TestCommandEnd();

}

  
void __diagServiceo7tsimc_58(DiagRequest * __req, DiagResponse * __resp )
{
  stack long __tableHandle;
  long __res, __paramLen, __bytePos;

   __bVerdict = __eVerdictPass;

  do {
    TestReportResetDiagObjectList();
    DiagSetReportDetailLevel("CVADAS_0001_00000000_000", EnumServiceDetails_onfail);
    // Request aspect
    {
      {
        __res = DiagSetParameterErrorHandled(__req, "DiagSessionType", 03);
        if(__res < 0)
        {
          __bVerdict = __eVerdictFail;
          DiagErrCodeTestStep(__res, "Cannot set diagnostic parameter 'DiagSessionType'");
          break;
        }
      }

      if (0 >= DiagSendReqAndWaitForResp("CVADAS_0001_00000000_000", __req, __resp, __res, -1, -1, -1, -1, -1, EnumResult_pos, EnumServiceDetails_onfail, EnumSendingMode_physical, EnumSuppressPosResBit_asconfigured, EnumVerdictOnInvalidValues_fail))
        break;
    }

    __res = DiagErrCodeTestStep(__res, "Can't retrieve last response for request! No check possible.") < 0;
    if(__res)
    {
	  __bVerdict = __eVerdictFail;
      break;
    }
    {
      __res = DiagInterpretAs(__resp, "DSC_PR");
      if(__res != 0)
      {
        __bVerdict = __eVerdictFail;
        DiagErrCodeTestStep(__res, "Can't interpret response as diagnostic primitive 'DSC_PR'.");
        break;
      }
      else
      {
        TestStepPass( "Received primitive can be interpreted as diagnostic primitive 'DSC_PR'.");
      }
    }
  }
  while(0);


  // Response, check & read aspect
  {
    __res = 1;
    __tableHandle = ReportTableHead5Columns(__cCheckCaption, __cTSym, __cTOp, __cRefVal, __cActual, __cRes);
    {
      double __nDiagValue;
      DiagGetParameterErrorHandled(__resp, "DiagSessionType", __nDiagValue);
      __csr = CheckSignalMatch(__nDiagValue, 03, "==") == 1;
      snprintf(__cArray, 8192, "%s", "Diagnostic parameter \'DiagSessionType\'");
      snprintf(__cArray2, 8192, "%s", __cArray);
      snprintf(__cArray3, 8192, "%s", "");
      ReportTableRow(__tableHandle, 0, __cArray2, "==", 03, __cArray3, __oneOfFlag, __bSetInCheckAlignment);
      ReportCell(__tableHandle, __nDiagValue);
      ReportCellResult(__tableHandle, __csr, __ePassFail);
    
      __res = __res && __csr;
    
    }
    ReportTableEndVerdict(__tableHandle, __cEvaluateResponse, __res);
	__bVerdict = __bVerdict && __res;
  }
  if (__bVerdict == __eVerdictFail)
    TestReportWriteDiagObjectList();
}
  
void __diagServiceo7tsimc_59(DiagRequest * __req, DiagResponse * __resp )
{
  stack long __tableHandle;
  long __res, __paramLen, __bytePos;

   __bVerdict = __eVerdictPass;

  do {
    TestReportResetDiagObjectList();
    DiagSetReportDetailLevel("CVADAS_0001_00000000_000", EnumServiceDetails_onfail);
    // Request aspect
    {
      {
        {
          byte __bArray[1] = { 0x00 };
          __bArrayCtr = elCount(__bArray);
          __bDiagValueArrayCtr = __CopyBytes(__bArray, __bArrayCtr, __bDiagValueArray);
        }
      
        __res = DiagSetParameterErrorHandled(__req, "HighLevel_NVM_Block_ID", __bDiagValueArray, __bDiagValueArrayCtr);
        if(__res < 0)
        {
          __bVerdict = __eVerdictFail;
          DiagErrCodeTestStep(__res, "Cannot set diagnostic parameter 'HighLevel_NVM_Block_ID'");
          break;
        }
      }

      if (0 >= DiagSendReqAndWaitForResp("CVADAS_0001_00000000_000", __req, __resp, __res, -1, -1, -1, -1, -1, EnumResult_pos, EnumServiceDetails_onfail, EnumSendingMode_physical, EnumSuppressPosResBit_asconfigured, EnumVerdictOnInvalidValues_fail))
        break;
    }

    __res = DiagErrCodeTestStep(__res, "Can't retrieve last response for request! No check possible.") < 0;
    if(__res)
    {
	  __bVerdict = __eVerdictFail;
      break;
    }
    {
      __res = DiagInterpretAs(__resp, "WDBI_PR");
      if(__res != 0)
      {
        __bVerdict = __eVerdictFail;
        DiagErrCodeTestStep(__res, "Can't interpret response as diagnostic primitive 'WDBI_PR'.");
        break;
      }
      else
      {
        TestStepPass( "Received primitive can be interpreted as diagnostic primitive 'WDBI_PR'.");
      }
    }
  }
  while(0);


  if (__bVerdict == __eVerdictFail)
    TestReportWriteDiagObjectList();
}

testsequence Tto7tsimc_HMI_View_Switch()
{
  stack long __tableHandle;
  SetBreakOnFail(1);

  CreateTTEIFFunction("Tto7tsimc_TsTc3", __eTcDef, __eLocal);
  AddIFParameterTestCaseAttribute("TC_ID", "");
  AddIFParameterTestCaseAttribute("Test Case ID", "");
  CallInterfaceFunction("Set to Surround View Camera", __cEmpty , "a9a3b385-9634-4970-bf27-8de3cb897245");

  CreateTTEIFFunction("Tto7tsimc_TsTc4", __eTcDef, __eLocal);
  AddIFParameterTestCaseAttribute("TC_ID", "");
  AddIFParameterTestCaseAttribute("Test Case ID", "");
  CallInterfaceFunction("Default View", __cEmpty , "a3d132d6-f472-4d78-8612-fbada2351cd9");

  CreateTTEIFFunction("Tto7tsimc_TsTc5", __eTcDef, __eLocal);
  AddIFParameterTestCaseAttribute("TC_ID", "");
  AddIFParameterTestCaseAttribute("Test Case ID", "");
  CallInterfaceFunction("View 1: FVTV_RVTV", __cEmpty , "2c5a958c-aba7-4498-b8b6-f4c78ac2ae62");

  CreateTTEIFFunction("Tto7tsimc_TsTc6", __eTcDef, __eLocal);
  AddIFParameterTestCaseAttribute("TC_ID", "");
  AddIFParameterTestCaseAttribute("Test Case ID", "");
  CallInterfaceFunction("View 2: BackupRearView", __cEmpty , "dc5b4866-c282-4786-bf1b-f4822ba6918b");

  CreateTTEIFFunction("Tto7tsimc_TsTc7", __eTcDef, __eLocal);
  AddIFParameterTestCaseAttribute("TC_ID", "");
  AddIFParameterTestCaseAttribute("Test Case ID", "");
  CallInterfaceFunction("View 3: Forward Facing Camera", __cEmpty , "e66e48ae-5a76-4497-a44a-0f0221afe7cd");

  CreateTTEIFFunction("Tto7tsimc_TsTc8", __eTcDef, __eLocal);
  AddIFParameterTestCaseAttribute("TC_ID", "");
  AddIFParameterTestCaseAttribute("Test Case ID", "");
  CallInterfaceFunction("View 5: Trailer Reverse Guidance", __cEmpty , "69a5633e-0713-462a-ac13-d87a979b1e87");

  CreateTTEIFFunction("Tto7tsimc_TsTc9", __eTcDef, __eLocal);
  AddIFParameterTestCaseAttribute("TC_ID", "");
  AddIFParameterTestCaseAttribute("Test Case ID", "");
  CallInterfaceFunction("View 6: Trailer Left View", __cEmpty , "a1c78552-8c7b-471b-a116-222053d65463");

  CreateTTEIFFunction("Tto7tsimc_TsTc10", __eTcDef, __eLocal);
  AddIFParameterTestCaseAttribute("TC_ID", "");
  AddIFParameterTestCaseAttribute("Test Case ID", "");
  CallInterfaceFunction("View 7: Trailer Right View", __cEmpty , "a9b3fc96-ef15-40ea-b810-8e6d59c886c4");

  CreateTTEIFFunction("Tto7tsimc_TsTc11", __eTcDef, __eLocal);
  AddIFParameterTestCaseAttribute("TC_ID", "");
  AddIFParameterTestCaseAttribute("Test Case ID", "");
  CallInterfaceFunction("View 8: Blind Spot Left View", __cEmpty , "268b44f9-9320-4a47-a7ef-3414d972df1d");

  CreateTTEIFFunction("Tto7tsimc_TsTc12", __eTcDef, __eLocal);
  AddIFParameterTestCaseAttribute("TC_ID", "");
  AddIFParameterTestCaseAttribute("Test Case ID", "");
  CallInterfaceFunction("View 9: Blind Spot Right View", __cEmpty , "a84a6c88-83a2-4747-b96f-1238794d9146");

  CreateTTEIFFunction("Tto7tsimc_TsTc13", __eTcDef, __eLocal);
  AddIFParameterTestCaseAttribute("TC_ID", "");
  AddIFParameterTestCaseAttribute("Test Case ID", "");
  CallInterfaceFunction("View 11: FVTV", __cEmpty , "094baf17-580b-47c5-b803-f2a7aa6ea309");

  CreateTTEIFFunction("Tto7tsimc_TsTc14", __eTcDef, __eLocal);
  AddIFParameterTestCaseAttribute("TC_ID", "");
  AddIFParameterTestCaseAttribute("Test Case ID", "");
  CallInterfaceFunction("View 12: RVTV", __cEmpty , "1ed14f4a-cb4c-4008-a325-beecb1e328b2");

  CreateTTEIFFunction("Tto7tsimc_TsTc15", __eTcDef, __eLocal);
  AddIFParameterTestCaseAttribute("TC_ID", "");
  AddIFParameterTestCaseAttribute("Test Case ID", "");
  CallInterfaceFunction("View 13: FrontCrossPathView", __cEmpty , "345baa51-a71b-4392-9628-32266ac96f1e");

  CreateTTEIFFunction("Tto7tsimc_TsTc16", __eTcDef, __eLocal);
  AddIFParameterTestCaseAttribute("TC_ID", "");
  AddIFParameterTestCaseAttribute("Test Case ID", "");
  CallInterfaceFunction("View 14: RearCrossPathView", __cEmpty , "05893c4e-fe68-44dc-892a-dc9afad3d0ec");

}

testcase Tto7tsimc_TsTc3()
{
  stack long __tableHandle;
  SetBreakOnFail(1);

  TestPreparationBegin();
  {
  }
  TestPreparationEnd();

  TestCommandBegin(__eSet, __cSet, "", "0");
  {
    __tableHandle = ReportTableHead3Columns(__cSetCaption , __cTSym, __cTOp, __cAssigned); 
    {
      $`FDCAN2::dbNode::`SGW::`TELEMATIC_FD_14::`TGW_CAMERA_DISP_STAT.phys = 4;
      snprintf(__cArray, 8192, "%s", "TGW_CAMERA_DISP_STAT");
      snprintf(__cArray2, 8192, "%s '%s'", __cCANSignal, __cArray);
      snprintf(__cArray3, 8192, "%s", "");
      
      ReportSetLValueOrSignalNotOnline(getSignalTime(`FDCAN2::dbNode::`SGW::`TELEMATIC_FD_14::`TGW_CAMERA_DISP_STAT), __cArray2, __cArray4, 8192);
      ReportTableRow(__tableHandle, 0, __cArray4, __cAOp, 4, __cArray3, __oneOfFlag, __bSetInCheckAlignment);
      
  
    }
    {
      $`FDCAN2::dbNode::`SGW::`TELEMATIC_FD_5::`CameraDisplaySts2.phys = 0;
      snprintf(__cArray, 8192, "%s", "CameraDisplaySts2");
      snprintf(__cArray2, 8192, "%s '%s'", __cCANSignal, __cArray);
      snprintf(__cArray3, 8192, "%s", "Default");
      
      ReportSetLValueOrSignalNotOnline(getSignalTime(`FDCAN2::dbNode::`SGW::`TELEMATIC_FD_5::`CameraDisplaySts2), __cArray2, __cArray4, 8192);
      ReportTableRow(__tableHandle, 0, __cArray4, __cAOp, 0, __cArray3, __oneOfFlag, __bSetInCheckAlignment);
      
  
    }
    ReportTableEndTestStep(__tableHandle, "1");
  }
  TestCommandEnd();


  TestCommandBegin(__eWait, __cWait, "", "1");
  {
    Wait("1", (1 * 1000000000LL), 1000000000, "");
  }
  TestCommandEnd();

  TestCommandBegin(__eCheck, __cCheck, "", "2");
  {
    __bVerdict = __eVerdictPass;
    __tableHandle = ReportTableHead5Columns(__cCheckCaption, __cTSym, __cTOp, __cRefVal, __cActual, __cRes);
    {
      {
        int __res1,__res2;
        __res1 = CheckSignalMatch(`FDCAN2::dbNode::`SGW::`TELEMATIC_FD_14::`TGW_CAMERA_DISP_STAT, 0, __cGreaterEqualThan) == 1;
        __res2 = CheckSignalMatch(`FDCAN2::dbNode::`SGW::`TELEMATIC_FD_14::`TGW_CAMERA_DISP_STAT, 4, __cLessEqualThan) == 1;
        __csr = __res1 && __res2;
        snprintf(__cArray, 8192, "%s", "TGW_CAMERA_DISP_STAT");
        snprintf(__cArray2, 8192, "%s '%s'", __cCANSignal, __cArray);
        snprintf(__cArray3, 8192, "%s", "");
        snprintf(__cArray4, 8192, "%s", "");
        snprintf(__cArray5, 8192, "%s", __cArray3);
        snprintf(__cArray6, 8192, "%s", __cArray4);
        ReportRange(0, 4, __cArray5, __cArray6, __cArray7, 8192);
        ReportTableRow(__tableHandle, 0, __cArray2, __cRange, __cArray7, __cEmpty, __oneOfFlag, __bSetInCheckAlignment);
        ReportLValueOrSignalNotOnline(`FDCAN2::dbNode::`SGW::`TELEMATIC_FD_14::`TGW_CAMERA_DISP_STAT, __cArray8, 8192);
        ReportCell(__tableHandle, __cArray8);
        ReportCellResult(__tableHandle, __csr, __ePassFail);
      }
  
      __bVerdict = __bVerdict && __csr;
    }
    ReportTableEndVerdict(__tableHandle, "1", __bVerdict);
  }
  TestCommandEnd();


  TestCommandBegin(__eWait, __cWait, "", "3");
  {
    Wait("1", (1 * 1000000000LL), 1000000000, "");
  }
  TestCommandEnd();

}

testcase Tto7tsimc_TsTc4()
{
  stack long __tableHandle;
  SetBreakOnFail(1);

  TestCommandBegin(__eSet, __cSet, "", "0");
  {
    __tableHandle = ReportTableHead3Columns(__cSetCaption , __cTSym, __cTOp, __cAssigned); 
    {
      $`FDCAN2::dbNode::`SGW::`TELEMATIC_FD_5::`CameraDisplaySts2.phys = 2;
      snprintf(__cArray, 8192, "%s", "CameraDisplaySts2");
      snprintf(__cArray2, 8192, "%s '%s'", __cCANSignal, __cArray);
      snprintf(__cArray3, 8192, "%s", "");
      
      ReportSetLValueOrSignalNotOnline(getSignalTime(`FDCAN2::dbNode::`SGW::`TELEMATIC_FD_5::`CameraDisplaySts2), __cArray2, __cArray4, 8192);
      ReportTableRow(__tableHandle, 0, __cArray4, __cAOp, 2, __cArray3, __oneOfFlag, __bSetInCheckAlignment);
      
  
    }
    ReportTableEndTestStep(__tableHandle, "1");
  }
  TestCommandEnd();


  TestCommandBegin(__eWait, __cWait, "", "1");
  {
    Wait("1", (1000 * 1000000LL), 1000000, "");
  }
  TestCommandEnd();

  TestCommandBegin(__eSet, __cSet, "", "2");
  {
    __tableHandle = ReportTableHead3Columns(__cSetCaption , __cTSym, __cTOp, __cAssigned); 
    {
      $`FDCAN2::dbNode::`SGW::`TELEMATIC_FD_5::`CameraDisplaySts2.phys = 0;
      snprintf(__cArray, 8192, "%s", "CameraDisplaySts2");
      snprintf(__cArray2, 8192, "%s '%s'", __cCANSignal, __cArray);
      snprintf(__cArray3, 8192, "%s", "");
      
      ReportSetLValueOrSignalNotOnline(getSignalTime(`FDCAN2::dbNode::`SGW::`TELEMATIC_FD_5::`CameraDisplaySts2), __cArray2, __cArray4, 8192);
      ReportTableRow(__tableHandle, 0, __cArray4, __cAOp, 0, __cArray3, __oneOfFlag, __bSetInCheckAlignment);
      
  
    }
    ReportTableEndTestStep(__tableHandle, "1");
  }
  TestCommandEnd();


  TestCommandBegin(__eWait, __cWait, "", "3");
  {
    Wait("1", (1000 * 1000000LL), 1000000, "");
  }
  TestCommandEnd();

  TestCommandBegin(__eCheck, __cCheck, "", "4");
  {
    __bVerdict = __eVerdictPass;
    __tableHandle = ReportTableHead5Columns(__cCheckCaption, __cTSym, __cTOp, __cRefVal, __cActual, __cRes);
    {
      {
        int __res1,__res2;
        __res1 = CheckSignalMatch(`FDCAN2::dbNode::`CVADAS::`CVPAM_FD_Info::`DisplayView2, 1, __cGreaterEqualThan) == 1;
        __res2 = CheckSignalMatch(`FDCAN2::dbNode::`CVADAS::`CVPAM_FD_Info::`DisplayView2, 15, __cLessEqualThan) == 1;
        __csr = __res1 && __res2;
        snprintf(__cArray, 8192, "%s", "DisplayView2");
        snprintf(__cArray2, 8192, "%s '%s'", __cCANSignal, __cArray);
        snprintf(__cArray3, 8192, "%s", "");
        snprintf(__cArray4, 8192, "%s", "");
        snprintf(__cArray5, 8192, "%s", __cArray3);
        snprintf(__cArray6, 8192, "%s", __cArray4);
        ReportRange(1, 15, __cArray5, __cArray6, __cArray7, 8192);
        ReportTableRow(__tableHandle, 0, __cArray2, __cRange, __cArray7, __cEmpty, __oneOfFlag, __bSetInCheckAlignment);
        ReportLValueOrSignalNotOnline(`FDCAN2::dbNode::`CVADAS::`CVPAM_FD_Info::`DisplayView2, __cArray8, 8192);
        ReportCell(__tableHandle, __cArray8);
        ReportCellResult(__tableHandle, __csr, __ePassFail);
      }
  
      __bVerdict = __bVerdict && __csr;
    }
    ReportTableEndVerdict(__tableHandle, "1", __bVerdict);
  }
  TestCommandEnd();


}

testcase Tto7tsimc_TsTc5()
{
  stack long __tableHandle;
  SetBreakOnFail(1);

  {
    CreateTTEIFFunction("Tto7tsimc_CaptureMasterImage", __eFct, __eLocal);
    CallInterfaceFunction(__cEmpty, __cEmpty, "8553246b-cbf4-4dd1-a2ec-aee75c0ec25c");
  }


  TestCommandBegin(__eSet, __cSet, "", "1");
  {
    __tableHandle = ReportTableHead3Columns(__cSetCaption , __cTSym, __cTOp, __cAssigned); 
    {
      $`FDCAN2::dbNode::`SGW::`TELEMATIC_FD_5::`CameraDisplaySts2.phys = 3;
      snprintf(__cArray, 8192, "%s", "CameraDisplaySts2");
      snprintf(__cArray2, 8192, "%s '%s'", __cCANSignal, __cArray);
      snprintf(__cArray3, 8192, "%s", "");
      
      ReportSetLValueOrSignalNotOnline(getSignalTime(`FDCAN2::dbNode::`SGW::`TELEMATIC_FD_5::`CameraDisplaySts2), __cArray2, __cArray4, 8192);
      ReportTableRow(__tableHandle, 0, __cArray4, __cAOp, 3, __cArray3, __oneOfFlag, __bSetInCheckAlignment);
      
  
    }
    ReportTableEndTestStep(__tableHandle, "1");
  }
  TestCommandEnd();


  TestCommandBegin(__eWait, __cWait, "", "2");
  {
    Wait("1", (1000 * 1000000LL), 1000000, "");
  }
  TestCommandEnd();

  TestCommandBegin(__eSet, __cSet, "", "3");
  {
    __tableHandle = ReportTableHead3Columns(__cSetCaption , __cTSym, __cTOp, __cAssigned); 
    {
      $`FDCAN2::dbNode::`SGW::`TELEMATIC_FD_5::`CameraDisplaySts2.phys = 1;
      snprintf(__cArray, 8192, "%s", "CameraDisplaySts2");
      snprintf(__cArray2, 8192, "%s '%s'", __cCANSignal, __cArray);
      snprintf(__cArray3, 8192, "%s", "");
      
      ReportSetLValueOrSignalNotOnline(getSignalTime(`FDCAN2::dbNode::`SGW::`TELEMATIC_FD_5::`CameraDisplaySts2), __cArray2, __cArray4, 8192);
      ReportTableRow(__tableHandle, 0, __cArray4, __cAOp, 1, __cArray3, __oneOfFlag, __bSetInCheckAlignment);
      
  
    }
    ReportTableEndTestStep(__tableHandle, "1");
  }
  TestCommandEnd();


  TestCommandBegin(__eCheck, __cCheck, "", "4");
  {
    __bVerdict = __eVerdictPass;
    __tableHandle = ReportTableHead5Columns(__cCheckCaption, __cTSym, __cTOp, __cRefVal, __cActual, __cRes);
    {
      {
        int __res1,__res2;
        __res1 = CheckSignalMatch(`FDCAN2::dbNode::`CVADAS::`CVPAM_FD_Info::`DisplayView2, 1, __cGreaterEqualThan) == 1;
        __res2 = CheckSignalMatch(`FDCAN2::dbNode::`CVADAS::`CVPAM_FD_Info::`DisplayView2, 15, __cLessEqualThan) == 1;
        __csr = __res1 && __res2;
        snprintf(__cArray, 8192, "%s", "DisplayView2");
        snprintf(__cArray2, 8192, "%s '%s'", __cCANSignal, __cArray);
        snprintf(__cArray3, 8192, "%s", "");
        snprintf(__cArray4, 8192, "%s", "");
        snprintf(__cArray5, 8192, "%s", __cArray3);
        snprintf(__cArray6, 8192, "%s", __cArray4);
        ReportRange(1, 15, __cArray5, __cArray6, __cArray7, 8192);
        ReportTableRow(__tableHandle, 0, __cArray2, __cRange, __cArray7, __cEmpty, __oneOfFlag, __bSetInCheckAlignment);
        ReportLValueOrSignalNotOnline(`FDCAN2::dbNode::`CVADAS::`CVPAM_FD_Info::`DisplayView2, __cArray8, 8192);
        ReportCell(__tableHandle, __cArray8);
        ReportCellResult(__tableHandle, __csr, __ePassFail);
      }
  
      __bVerdict = __bVerdict && __csr;
    }
    ReportTableEndVerdict(__tableHandle, "1", __bVerdict);
  }
  TestCommandEnd();


}

testcase Tto7tsimc_TsTc6()
{
  stack long __tableHandle;
  SetBreakOnFail(1);

  {
    CreateTTEIFFunction("Tto7tsimc_CaptureImage", __eFct, __eLocal);
    CallInterfaceFunction(__cEmpty, __cEmpty, "089248de-5a83-431b-a302-b3696a072dd4");
  }


  TestCommandBegin(__eSet, __cSet, "", "1");
  {
    __tableHandle = ReportTableHead3Columns(__cSetCaption , __cTSym, __cTOp, __cAssigned); 
    {
      $`FDCAN2::dbNode::`SGW::`TELEMATIC_FD_5::`CameraDisplaySts2.phys = 2;
      snprintf(__cArray, 8192, "%s", "CameraDisplaySts2");
      snprintf(__cArray2, 8192, "%s '%s'", __cCANSignal, __cArray);
      snprintf(__cArray3, 8192, "%s", "");
      
      ReportSetLValueOrSignalNotOnline(getSignalTime(`FDCAN2::dbNode::`SGW::`TELEMATIC_FD_5::`CameraDisplaySts2), __cArray2, __cArray4, 8192);
      ReportTableRow(__tableHandle, 0, __cArray4, __cAOp, 2, __cArray3, __oneOfFlag, __bSetInCheckAlignment);
      
  
    }
    ReportTableEndTestStep(__tableHandle, "1");
  }
  TestCommandEnd();


  TestCommandBegin(__eWait, __cWait, "", "2");
  {
    Wait("1", (1000 * 1000000LL), 1000000, "");
  }
  TestCommandEnd();

  TestCommandBegin(__eCheck, __cCheck, "", "3");
  {
    __bVerdict = __eVerdictPass;
    __tableHandle = ReportTableHead5Columns(__cCheckCaption, __cTSym, __cTOp, __cRefVal, __cActual, __cRes);
    {
      {
        int __res1,__res2;
        __res1 = CheckSignalMatch(`FDCAN2::dbNode::`CVADAS::`CVPAM_FD_Info::`DisplayView2, 1, __cGreaterEqualThan) == 1;
        __res2 = CheckSignalMatch(`FDCAN2::dbNode::`CVADAS::`CVPAM_FD_Info::`DisplayView2, 15, __cLessEqualThan) == 1;
        __csr = __res1 && __res2;
        snprintf(__cArray, 8192, "%s", "DisplayView2");
        snprintf(__cArray2, 8192, "%s '%s'", __cCANSignal, __cArray);
        snprintf(__cArray3, 8192, "%s", "");
        snprintf(__cArray4, 8192, "%s", "");
        snprintf(__cArray5, 8192, "%s", __cArray3);
        snprintf(__cArray6, 8192, "%s", __cArray4);
        ReportRange(1, 15, __cArray5, __cArray6, __cArray7, 8192);
        ReportTableRow(__tableHandle, 0, __cArray2, __cRange, __cArray7, __cEmpty, __oneOfFlag, __bSetInCheckAlignment);
        ReportLValueOrSignalNotOnline(`FDCAN2::dbNode::`CVADAS::`CVPAM_FD_Info::`DisplayView2, __cArray8, 8192);
        ReportCell(__tableHandle, __cArray8);
        ReportCellResult(__tableHandle, __csr, __ePassFail);
      }
  
      __bVerdict = __bVerdict && __csr;
    }
    ReportTableEndVerdict(__tableHandle, "1", __bVerdict);
  }
  TestCommandEnd();


}

testcase Tto7tsimc_TsTc7()
{
  stack long __tableHandle;
  SetBreakOnFail(1);

  {
    CreateTTEIFFunction("Tto7tsimc_CaptureImage", __eFct, __eLocal);
    CallInterfaceFunction(__cEmpty, __cEmpty, "089248de-5a83-431b-a302-b3696a072dd4");
  }


  TestCommandBegin(__eSet, __cSet, "", "1");
  {
    __tableHandle = ReportTableHead3Columns(__cSetCaption , __cTSym, __cTOp, __cAssigned); 
    {
      $`FDCAN2::dbNode::`SGW::`TELEMATIC_FD_5::`CameraDisplaySts2.phys = 3;
      snprintf(__cArray, 8192, "%s", "CameraDisplaySts2");
      snprintf(__cArray2, 8192, "%s '%s'", __cCANSignal, __cArray);
      snprintf(__cArray3, 8192, "%s", "");
      
      ReportSetLValueOrSignalNotOnline(getSignalTime(`FDCAN2::dbNode::`SGW::`TELEMATIC_FD_5::`CameraDisplaySts2), __cArray2, __cArray4, 8192);
      ReportTableRow(__tableHandle, 0, __cArray4, __cAOp, 3, __cArray3, __oneOfFlag, __bSetInCheckAlignment);
      
  
    }
    ReportTableEndTestStep(__tableHandle, "1");
  }
  TestCommandEnd();


  TestCommandBegin(__eWait, __cWait, "", "2");
  {
    Wait("1", (1000 * 1000000LL), 1000000, "");
  }
  TestCommandEnd();

  TestCommandBegin(__eCheck, __cCheck, "", "3");
  {
    __bVerdict = __eVerdictPass;
    __tableHandle = ReportTableHead5Columns(__cCheckCaption, __cTSym, __cTOp, __cRefVal, __cActual, __cRes);
    {
      {
        int __res1,__res2;
        __res1 = CheckSignalMatch(`FDCAN2::dbNode::`CVADAS::`CVPAM_FD_Info::`DisplayView2, 1, __cGreaterEqualThan) == 1;
        __res2 = CheckSignalMatch(`FDCAN2::dbNode::`CVADAS::`CVPAM_FD_Info::`DisplayView2, 15, __cLessEqualThan) == 1;
        __csr = __res1 && __res2;
        snprintf(__cArray, 8192, "%s", "DisplayView2");
        snprintf(__cArray2, 8192, "%s '%s'", __cCANSignal, __cArray);
        snprintf(__cArray3, 8192, "%s", "");
        snprintf(__cArray4, 8192, "%s", "");
        snprintf(__cArray5, 8192, "%s", __cArray3);
        snprintf(__cArray6, 8192, "%s", __cArray4);
        ReportRange(1, 15, __cArray5, __cArray6, __cArray7, 8192);
        ReportTableRow(__tableHandle, 0, __cArray2, __cRange, __cArray7, __cEmpty, __oneOfFlag, __bSetInCheckAlignment);
        ReportLValueOrSignalNotOnline(`FDCAN2::dbNode::`CVADAS::`CVPAM_FD_Info::`DisplayView2, __cArray8, 8192);
        ReportCell(__tableHandle, __cArray8);
        ReportCellResult(__tableHandle, __csr, __ePassFail);
      }
  
      __bVerdict = __bVerdict && __csr;
    }
    ReportTableEndVerdict(__tableHandle, "1", __bVerdict);
  }
  TestCommandEnd();


}

testcase Tto7tsimc_TsTc8()
{
  stack long __tableHandle;
  SetBreakOnFail(1);

  {
    CreateTTEIFFunction("Tto7tsimc_CaptureImage", __eFct, __eLocal);
    CallInterfaceFunction(__cEmpty, __cEmpty, "089248de-5a83-431b-a302-b3696a072dd4");
  }


  TestCommandBegin(__eSet, __cSet, "", "1");
  {
    __tableHandle = ReportTableHead3Columns(__cSetCaption , __cTSym, __cTOp, __cAssigned); 
    {
      $`FDCAN2::dbNode::`SGW::`TELEMATIC_FD_5::`CameraDisplaySts2.phys = 5;
      snprintf(__cArray, 8192, "%s", "CameraDisplaySts2");
      snprintf(__cArray2, 8192, "%s '%s'", __cCANSignal, __cArray);
      snprintf(__cArray3, 8192, "%s", "");
      
      ReportSetLValueOrSignalNotOnline(getSignalTime(`FDCAN2::dbNode::`SGW::`TELEMATIC_FD_5::`CameraDisplaySts2), __cArray2, __cArray4, 8192);
      ReportTableRow(__tableHandle, 0, __cArray4, __cAOp, 5, __cArray3, __oneOfFlag, __bSetInCheckAlignment);
      
  
    }
    ReportTableEndTestStep(__tableHandle, "1");
  }
  TestCommandEnd();


  TestCommandBegin(__eWait, __cWait, "", "2");
  {
    Wait("1", (1000 * 1000000LL), 1000000, "");
  }
  TestCommandEnd();

  TestCommandBegin(__eCheck, __cCheck, "", "3");
  {
    __bVerdict = __eVerdictPass;
    __tableHandle = ReportTableHead5Columns(__cCheckCaption, __cTSym, __cTOp, __cRefVal, __cActual, __cRes);
    {
      {
        int __res1,__res2;
        __res1 = CheckSignalMatch(`FDCAN2::dbNode::`CVADAS::`CVPAM_FD_Info::`DisplayView2, 1, __cGreaterEqualThan) == 1;
        __res2 = CheckSignalMatch(`FDCAN2::dbNode::`CVADAS::`CVPAM_FD_Info::`DisplayView2, 15, __cLessEqualThan) == 1;
        __csr = __res1 && __res2;
        snprintf(__cArray, 8192, "%s", "DisplayView2");
        snprintf(__cArray2, 8192, "%s '%s'", __cCANSignal, __cArray);
        snprintf(__cArray3, 8192, "%s", "");
        snprintf(__cArray4, 8192, "%s", "");
        snprintf(__cArray5, 8192, "%s", __cArray3);
        snprintf(__cArray6, 8192, "%s", __cArray4);
        ReportRange(1, 15, __cArray5, __cArray6, __cArray7, 8192);
        ReportTableRow(__tableHandle, 0, __cArray2, __cRange, __cArray7, __cEmpty, __oneOfFlag, __bSetInCheckAlignment);
        ReportLValueOrSignalNotOnline(`FDCAN2::dbNode::`CVADAS::`CVPAM_FD_Info::`DisplayView2, __cArray8, 8192);
        ReportCell(__tableHandle, __cArray8);
        ReportCellResult(__tableHandle, __csr, __ePassFail);
      }
  
      __bVerdict = __bVerdict && __csr;
    }
    ReportTableEndVerdict(__tableHandle, "1", __bVerdict);
  }
  TestCommandEnd();


}

testcase Tto7tsimc_TsTc9()
{
  stack long __tableHandle;
  SetBreakOnFail(1);

  {
    CreateTTEIFFunction("Tto7tsimc_CaptureImage", __eFct, __eLocal);
    CallInterfaceFunction(__cEmpty, __cEmpty, "089248de-5a83-431b-a302-b3696a072dd4");
  }


  TestCommandBegin(__eSet, __cSet, "", "1");
  {
    __tableHandle = ReportTableHead3Columns(__cSetCaption , __cTSym, __cTOp, __cAssigned); 
    {
      $`FDCAN2::dbNode::`SGW::`TELEMATIC_FD_5::`CameraDisplaySts2.phys = 6;
      snprintf(__cArray, 8192, "%s", "CameraDisplaySts2");
      snprintf(__cArray2, 8192, "%s '%s'", __cCANSignal, __cArray);
      snprintf(__cArray3, 8192, "%s", "");
      
      ReportSetLValueOrSignalNotOnline(getSignalTime(`FDCAN2::dbNode::`SGW::`TELEMATIC_FD_5::`CameraDisplaySts2), __cArray2, __cArray4, 8192);
      ReportTableRow(__tableHandle, 0, __cArray4, __cAOp, 6, __cArray3, __oneOfFlag, __bSetInCheckAlignment);
      
  
    }
    ReportTableEndTestStep(__tableHandle, "1");
  }
  TestCommandEnd();


  TestCommandBegin(__eWait, __cWait, "", "2");
  {
    Wait("1", (1000 * 1000000LL), 1000000, "");
  }
  TestCommandEnd();

  TestCommandBegin(__eCheck, __cCheck, "", "3");
  {
    __bVerdict = __eVerdictPass;
    __tableHandle = ReportTableHead5Columns(__cCheckCaption, __cTSym, __cTOp, __cRefVal, __cActual, __cRes);
    {
      {
        int __res1,__res2;
        __res1 = CheckSignalMatch(`FDCAN2::dbNode::`CVADAS::`CVPAM_FD_Info::`DisplayView2, 1, __cGreaterEqualThan) == 1;
        __res2 = CheckSignalMatch(`FDCAN2::dbNode::`CVADAS::`CVPAM_FD_Info::`DisplayView2, 15, __cLessEqualThan) == 1;
        __csr = __res1 && __res2;
        snprintf(__cArray, 8192, "%s", "DisplayView2");
        snprintf(__cArray2, 8192, "%s '%s'", __cCANSignal, __cArray);
        snprintf(__cArray3, 8192, "%s", "");
        snprintf(__cArray4, 8192, "%s", "");
        snprintf(__cArray5, 8192, "%s", __cArray3);
        snprintf(__cArray6, 8192, "%s", __cArray4);
        ReportRange(1, 15, __cArray5, __cArray6, __cArray7, 8192);
        ReportTableRow(__tableHandle, 0, __cArray2, __cRange, __cArray7, __cEmpty, __oneOfFlag, __bSetInCheckAlignment);
        ReportLValueOrSignalNotOnline(`FDCAN2::dbNode::`CVADAS::`CVPAM_FD_Info::`DisplayView2, __cArray8, 8192);
        ReportCell(__tableHandle, __cArray8);
        ReportCellResult(__tableHandle, __csr, __ePassFail);
      }
  
      __bVerdict = __bVerdict && __csr;
    }
    ReportTableEndVerdict(__tableHandle, "1", __bVerdict);
  }
  TestCommandEnd();


}

testcase Tto7tsimc_TsTc10()
{
  stack long __tableHandle;
  SetBreakOnFail(1);

  {
    CreateTTEIFFunction("Tto7tsimc_CaptureImage", __eFct, __eLocal);
    CallInterfaceFunction(__cEmpty, __cEmpty, "089248de-5a83-431b-a302-b3696a072dd4");
  }


  TestCommandBegin(__eSet, __cSet, "", "1");
  {
    __tableHandle = ReportTableHead3Columns(__cSetCaption , __cTSym, __cTOp, __cAssigned); 
    {
      $`FDCAN2::dbNode::`SGW::`TELEMATIC_FD_5::`CameraDisplaySts2.phys = 7;
      snprintf(__cArray, 8192, "%s", "CameraDisplaySts2");
      snprintf(__cArray2, 8192, "%s '%s'", __cCANSignal, __cArray);
      snprintf(__cArray3, 8192, "%s", "");
      
      ReportSetLValueOrSignalNotOnline(getSignalTime(`FDCAN2::dbNode::`SGW::`TELEMATIC_FD_5::`CameraDisplaySts2), __cArray2, __cArray4, 8192);
      ReportTableRow(__tableHandle, 0, __cArray4, __cAOp, 7, __cArray3, __oneOfFlag, __bSetInCheckAlignment);
      
  
    }
    ReportTableEndTestStep(__tableHandle, "1");
  }
  TestCommandEnd();


  TestCommandBegin(__eWait, __cWait, "", "2");
  {
    Wait("1", (1000 * 1000000LL), 1000000, "");
  }
  TestCommandEnd();

  TestCommandBegin(__eCheck, __cCheck, "", "3");
  {
    __bVerdict = __eVerdictPass;
    __tableHandle = ReportTableHead5Columns(__cCheckCaption, __cTSym, __cTOp, __cRefVal, __cActual, __cRes);
    {
      {
        int __res1,__res2;
        __res1 = CheckSignalMatch(`FDCAN2::dbNode::`CVADAS::`CVPAM_FD_Info::`DisplayView2, 1, __cGreaterEqualThan) == 1;
        __res2 = CheckSignalMatch(`FDCAN2::dbNode::`CVADAS::`CVPAM_FD_Info::`DisplayView2, 15, __cLessEqualThan) == 1;
        __csr = __res1 && __res2;
        snprintf(__cArray, 8192, "%s", "DisplayView2");
        snprintf(__cArray2, 8192, "%s '%s'", __cCANSignal, __cArray);
        snprintf(__cArray3, 8192, "%s", "");
        snprintf(__cArray4, 8192, "%s", "");
        snprintf(__cArray5, 8192, "%s", __cArray3);
        snprintf(__cArray6, 8192, "%s", __cArray4);
        ReportRange(1, 15, __cArray5, __cArray6, __cArray7, 8192);
        ReportTableRow(__tableHandle, 0, __cArray2, __cRange, __cArray7, __cEmpty, __oneOfFlag, __bSetInCheckAlignment);
        ReportLValueOrSignalNotOnline(`FDCAN2::dbNode::`CVADAS::`CVPAM_FD_Info::`DisplayView2, __cArray8, 8192);
        ReportCell(__tableHandle, __cArray8);
        ReportCellResult(__tableHandle, __csr, __ePassFail);
      }
  
      __bVerdict = __bVerdict && __csr;
    }
    ReportTableEndVerdict(__tableHandle, "1", __bVerdict);
  }
  TestCommandEnd();


}

testcase Tto7tsimc_TsTc11()
{
  stack long __tableHandle;
  SetBreakOnFail(1);

  {
    CreateTTEIFFunction("Tto7tsimc_CaptureImage", __eFct, __eLocal);
    CallInterfaceFunction(__cEmpty, __cEmpty, "089248de-5a83-431b-a302-b3696a072dd4");
  }


  TestCommandBegin(__eSet, __cSet, "", "1");
  {
    __tableHandle = ReportTableHead3Columns(__cSetCaption , __cTSym, __cTOp, __cAssigned); 
    {
      $`FDCAN2::dbNode::`SGW::`TELEMATIC_FD_5::`CameraDisplaySts2.phys = 8;
      snprintf(__cArray, 8192, "%s", "CameraDisplaySts2");
      snprintf(__cArray2, 8192, "%s '%s'", __cCANSignal, __cArray);
      snprintf(__cArray3, 8192, "%s", "");
      
      ReportSetLValueOrSignalNotOnline(getSignalTime(`FDCAN2::dbNode::`SGW::`TELEMATIC_FD_5::`CameraDisplaySts2), __cArray2, __cArray4, 8192);
      ReportTableRow(__tableHandle, 0, __cArray4, __cAOp, 8, __cArray3, __oneOfFlag, __bSetInCheckAlignment);
      
  
    }
    ReportTableEndTestStep(__tableHandle, "1");
  }
  TestCommandEnd();


  TestCommandBegin(__eWait, __cWait, "", "2");
  {
    Wait("1", (1000 * 1000000LL), 1000000, "");
  }
  TestCommandEnd();

  TestCommandBegin(__eCheck, __cCheck, "", "3");
  {
    __bVerdict = __eVerdictPass;
    __tableHandle = ReportTableHead5Columns(__cCheckCaption, __cTSym, __cTOp, __cRefVal, __cActual, __cRes);
    {
      {
        int __res1,__res2;
        __res1 = CheckSignalMatch(`FDCAN2::dbNode::`CVADAS::`CVPAM_FD_Info::`DisplayView2, 1, __cGreaterEqualThan) == 1;
        __res2 = CheckSignalMatch(`FDCAN2::dbNode::`CVADAS::`CVPAM_FD_Info::`DisplayView2, 15, __cLessEqualThan) == 1;
        __csr = __res1 && __res2;
        snprintf(__cArray, 8192, "%s", "DisplayView2");
        snprintf(__cArray2, 8192, "%s '%s'", __cCANSignal, __cArray);
        snprintf(__cArray3, 8192, "%s", "");
        snprintf(__cArray4, 8192, "%s", "");
        snprintf(__cArray5, 8192, "%s", __cArray3);
        snprintf(__cArray6, 8192, "%s", __cArray4);
        ReportRange(1, 15, __cArray5, __cArray6, __cArray7, 8192);
        ReportTableRow(__tableHandle, 0, __cArray2, __cRange, __cArray7, __cEmpty, __oneOfFlag, __bSetInCheckAlignment);
        ReportLValueOrSignalNotOnline(`FDCAN2::dbNode::`CVADAS::`CVPAM_FD_Info::`DisplayView2, __cArray8, 8192);
        ReportCell(__tableHandle, __cArray8);
        ReportCellResult(__tableHandle, __csr, __ePassFail);
      }
  
      __bVerdict = __bVerdict && __csr;
    }
    ReportTableEndVerdict(__tableHandle, "1", __bVerdict);
  }
  TestCommandEnd();


}

testcase Tto7tsimc_TsTc12()
{
  stack long __tableHandle;
  SetBreakOnFail(1);

  {
    CreateTTEIFFunction("Tto7tsimc_CaptureImage", __eFct, __eLocal);
    CallInterfaceFunction(__cEmpty, __cEmpty, "089248de-5a83-431b-a302-b3696a072dd4");
  }


  TestCommandBegin(__eSet, __cSet, "", "1");
  {
    __tableHandle = ReportTableHead3Columns(__cSetCaption , __cTSym, __cTOp, __cAssigned); 
    {
      $`FDCAN2::dbNode::`SGW::`TELEMATIC_FD_5::`CameraDisplaySts2.phys = 9;
      snprintf(__cArray, 8192, "%s", "CameraDisplaySts2");
      snprintf(__cArray2, 8192, "%s '%s'", __cCANSignal, __cArray);
      snprintf(__cArray3, 8192, "%s", "");
      
      ReportSetLValueOrSignalNotOnline(getSignalTime(`FDCAN2::dbNode::`SGW::`TELEMATIC_FD_5::`CameraDisplaySts2), __cArray2, __cArray4, 8192);
      ReportTableRow(__tableHandle, 0, __cArray4, __cAOp, 9, __cArray3, __oneOfFlag, __bSetInCheckAlignment);
      
  
    }
    ReportTableEndTestStep(__tableHandle, "1");
  }
  TestCommandEnd();


  TestCommandBegin(__eWait, __cWait, "", "2");
  {
    Wait("1", (1000 * 1000000LL), 1000000, "");
  }
  TestCommandEnd();

  TestCommandBegin(__eCheck, __cCheck, "", "3");
  {
    __bVerdict = __eVerdictPass;
    __tableHandle = ReportTableHead5Columns(__cCheckCaption, __cTSym, __cTOp, __cRefVal, __cActual, __cRes);
    {
      {
        int __res1,__res2;
        __res1 = CheckSignalMatch(`FDCAN2::dbNode::`CVADAS::`CVPAM_FD_Info::`DisplayView2, 1, __cGreaterEqualThan) == 1;
        __res2 = CheckSignalMatch(`FDCAN2::dbNode::`CVADAS::`CVPAM_FD_Info::`DisplayView2, 15, __cLessEqualThan) == 1;
        __csr = __res1 && __res2;
        snprintf(__cArray, 8192, "%s", "DisplayView2");
        snprintf(__cArray2, 8192, "%s '%s'", __cCANSignal, __cArray);
        snprintf(__cArray3, 8192, "%s", "");
        snprintf(__cArray4, 8192, "%s", "");
        snprintf(__cArray5, 8192, "%s", __cArray3);
        snprintf(__cArray6, 8192, "%s", __cArray4);
        ReportRange(1, 15, __cArray5, __cArray6, __cArray7, 8192);
        ReportTableRow(__tableHandle, 0, __cArray2, __cRange, __cArray7, __cEmpty, __oneOfFlag, __bSetInCheckAlignment);
        ReportLValueOrSignalNotOnline(`FDCAN2::dbNode::`CVADAS::`CVPAM_FD_Info::`DisplayView2, __cArray8, 8192);
        ReportCell(__tableHandle, __cArray8);
        ReportCellResult(__tableHandle, __csr, __ePassFail);
      }
  
      __bVerdict = __bVerdict && __csr;
    }
    ReportTableEndVerdict(__tableHandle, "1", __bVerdict);
  }
  TestCommandEnd();


}

testcase Tto7tsimc_TsTc13()
{
  stack long __tableHandle;
  SetBreakOnFail(1);

  {
    CreateTTEIFFunction("Tto7tsimc_CaptureImage", __eFct, __eLocal);
    CallInterfaceFunction(__cEmpty, __cEmpty, "089248de-5a83-431b-a302-b3696a072dd4");
  }


  TestCommandBegin(__eSet, __cSet, "", "1");
  {
    __tableHandle = ReportTableHead3Columns(__cSetCaption , __cTSym, __cTOp, __cAssigned); 
    {
      $`FDCAN2::dbNode::`SGW::`TELEMATIC_FD_5::`CameraDisplaySts2.phys = 11;
      snprintf(__cArray, 8192, "%s", "CameraDisplaySts2");
      snprintf(__cArray2, 8192, "%s '%s'", __cCANSignal, __cArray);
      snprintf(__cArray3, 8192, "%s", "");
      
      ReportSetLValueOrSignalNotOnline(getSignalTime(`FDCAN2::dbNode::`SGW::`TELEMATIC_FD_5::`CameraDisplaySts2), __cArray2, __cArray4, 8192);
      ReportTableRow(__tableHandle, 0, __cArray4, __cAOp, 11, __cArray3, __oneOfFlag, __bSetInCheckAlignment);
      
  
    }
    ReportTableEndTestStep(__tableHandle, "1");
  }
  TestCommandEnd();


  TestCommandBegin(__eWait, __cWait, "", "2");
  {
    Wait("1", (1000 * 1000000LL), 1000000, "");
  }
  TestCommandEnd();

  TestCommandBegin(__eCheck, __cCheck, "", "3");
  {
    __bVerdict = __eVerdictPass;
    __tableHandle = ReportTableHead5Columns(__cCheckCaption, __cTSym, __cTOp, __cRefVal, __cActual, __cRes);
    {
      {
        int __res1,__res2;
        __res1 = CheckSignalMatch(`FDCAN2::dbNode::`CVADAS::`CVPAM_FD_Info::`DisplayView2, 1, __cGreaterEqualThan) == 1;
        __res2 = CheckSignalMatch(`FDCAN2::dbNode::`CVADAS::`CVPAM_FD_Info::`DisplayView2, 15, __cLessEqualThan) == 1;
        __csr = __res1 && __res2;
        snprintf(__cArray, 8192, "%s", "DisplayView2");
        snprintf(__cArray2, 8192, "%s '%s'", __cCANSignal, __cArray);
        snprintf(__cArray3, 8192, "%s", "");
        snprintf(__cArray4, 8192, "%s", "");
        snprintf(__cArray5, 8192, "%s", __cArray3);
        snprintf(__cArray6, 8192, "%s", __cArray4);
        ReportRange(1, 15, __cArray5, __cArray6, __cArray7, 8192);
        ReportTableRow(__tableHandle, 0, __cArray2, __cRange, __cArray7, __cEmpty, __oneOfFlag, __bSetInCheckAlignment);
        ReportLValueOrSignalNotOnline(`FDCAN2::dbNode::`CVADAS::`CVPAM_FD_Info::`DisplayView2, __cArray8, 8192);
        ReportCell(__tableHandle, __cArray8);
        ReportCellResult(__tableHandle, __csr, __ePassFail);
      }
  
      __bVerdict = __bVerdict && __csr;
    }
    ReportTableEndVerdict(__tableHandle, "1", __bVerdict);
  }
  TestCommandEnd();


}

testcase Tto7tsimc_TsTc14()
{
  stack long __tableHandle;
  SetBreakOnFail(1);

  {
    CreateTTEIFFunction("Tto7tsimc_CaptureImage", __eFct, __eLocal);
    CallInterfaceFunction(__cEmpty, __cEmpty, "089248de-5a83-431b-a302-b3696a072dd4");
  }


  TestCommandBegin(__eSet, __cSet, "", "1");
  {
    __tableHandle = ReportTableHead3Columns(__cSetCaption , __cTSym, __cTOp, __cAssigned); 
    {
      $`FDCAN2::dbNode::`SGW::`TELEMATIC_FD_5::`CameraDisplaySts2.phys = 12;
      snprintf(__cArray, 8192, "%s", "CameraDisplaySts2");
      snprintf(__cArray2, 8192, "%s '%s'", __cCANSignal, __cArray);
      snprintf(__cArray3, 8192, "%s", "");
      
      ReportSetLValueOrSignalNotOnline(getSignalTime(`FDCAN2::dbNode::`SGW::`TELEMATIC_FD_5::`CameraDisplaySts2), __cArray2, __cArray4, 8192);
      ReportTableRow(__tableHandle, 0, __cArray4, __cAOp, 12, __cArray3, __oneOfFlag, __bSetInCheckAlignment);
      
  
    }
    ReportTableEndTestStep(__tableHandle, "1");
  }
  TestCommandEnd();


  TestCommandBegin(__eWait, __cWait, "", "2");
  {
    Wait("1", (1000 * 1000000LL), 1000000, "");
  }
  TestCommandEnd();

  TestCommandBegin(__eCheck, __cCheck, "", "3");
  {
    __bVerdict = __eVerdictPass;
    __tableHandle = ReportTableHead5Columns(__cCheckCaption, __cTSym, __cTOp, __cRefVal, __cActual, __cRes);
    {
      {
        int __res1,__res2;
        __res1 = CheckSignalMatch(`FDCAN2::dbNode::`CVADAS::`CVPAM_FD_Info::`DisplayView2, 1, __cGreaterEqualThan) == 1;
        __res2 = CheckSignalMatch(`FDCAN2::dbNode::`CVADAS::`CVPAM_FD_Info::`DisplayView2, 15, __cLessEqualThan) == 1;
        __csr = __res1 && __res2;
        snprintf(__cArray, 8192, "%s", "DisplayView2");
        snprintf(__cArray2, 8192, "%s '%s'", __cCANSignal, __cArray);
        snprintf(__cArray3, 8192, "%s", "");
        snprintf(__cArray4, 8192, "%s", "");
        snprintf(__cArray5, 8192, "%s", __cArray3);
        snprintf(__cArray6, 8192, "%s", __cArray4);
        ReportRange(1, 15, __cArray5, __cArray6, __cArray7, 8192);
        ReportTableRow(__tableHandle, 0, __cArray2, __cRange, __cArray7, __cEmpty, __oneOfFlag, __bSetInCheckAlignment);
        ReportLValueOrSignalNotOnline(`FDCAN2::dbNode::`CVADAS::`CVPAM_FD_Info::`DisplayView2, __cArray8, 8192);
        ReportCell(__tableHandle, __cArray8);
        ReportCellResult(__tableHandle, __csr, __ePassFail);
      }
  
      __bVerdict = __bVerdict && __csr;
    }
    ReportTableEndVerdict(__tableHandle, "1", __bVerdict);
  }
  TestCommandEnd();


}

testcase Tto7tsimc_TsTc15()
{
  stack long __tableHandle;
  SetBreakOnFail(1);

  {
    CreateTTEIFFunction("Tto7tsimc_CaptureImage", __eFct, __eLocal);
    CallInterfaceFunction(__cEmpty, __cEmpty, "089248de-5a83-431b-a302-b3696a072dd4");
  }


  TestCommandBegin(__eSet, __cSet, "", "1");
  {
    __tableHandle = ReportTableHead3Columns(__cSetCaption , __cTSym, __cTOp, __cAssigned); 
    {
      $`FDCAN2::dbNode::`SGW::`TELEMATIC_FD_5::`CameraDisplaySts2.phys = 13;
      snprintf(__cArray, 8192, "%s", "CameraDisplaySts2");
      snprintf(__cArray2, 8192, "%s '%s'", __cCANSignal, __cArray);
      snprintf(__cArray3, 8192, "%s", "");
      
      ReportSetLValueOrSignalNotOnline(getSignalTime(`FDCAN2::dbNode::`SGW::`TELEMATIC_FD_5::`CameraDisplaySts2), __cArray2, __cArray4, 8192);
      ReportTableRow(__tableHandle, 0, __cArray4, __cAOp, 13, __cArray3, __oneOfFlag, __bSetInCheckAlignment);
      
  
    }
    ReportTableEndTestStep(__tableHandle, "1");
  }
  TestCommandEnd();


  TestCommandBegin(__eWait, __cWait, "", "2");
  {
    Wait("1", (1000 * 1000000LL), 1000000, "");
  }
  TestCommandEnd();

  TestCommandBegin(__eCheck, __cCheck, "", "3");
  {
    __bVerdict = __eVerdictPass;
    __tableHandle = ReportTableHead5Columns(__cCheckCaption, __cTSym, __cTOp, __cRefVal, __cActual, __cRes);
    {
      {
        int __res1,__res2;
        __res1 = CheckSignalMatch(`FDCAN2::dbNode::`CVADAS::`CVPAM_FD_Info::`DisplayView2, 1, __cGreaterEqualThan) == 1;
        __res2 = CheckSignalMatch(`FDCAN2::dbNode::`CVADAS::`CVPAM_FD_Info::`DisplayView2, 15, __cLessEqualThan) == 1;
        __csr = __res1 && __res2;
        snprintf(__cArray, 8192, "%s", "DisplayView2");
        snprintf(__cArray2, 8192, "%s '%s'", __cCANSignal, __cArray);
        snprintf(__cArray3, 8192, "%s", "");
        snprintf(__cArray4, 8192, "%s", "");
        snprintf(__cArray5, 8192, "%s", __cArray3);
        snprintf(__cArray6, 8192, "%s", __cArray4);
        ReportRange(1, 15, __cArray5, __cArray6, __cArray7, 8192);
        ReportTableRow(__tableHandle, 0, __cArray2, __cRange, __cArray7, __cEmpty, __oneOfFlag, __bSetInCheckAlignment);
        ReportLValueOrSignalNotOnline(`FDCAN2::dbNode::`CVADAS::`CVPAM_FD_Info::`DisplayView2, __cArray8, 8192);
        ReportCell(__tableHandle, __cArray8);
        ReportCellResult(__tableHandle, __csr, __ePassFail);
      }
  
      __bVerdict = __bVerdict && __csr;
    }
    ReportTableEndVerdict(__tableHandle, "1", __bVerdict);
  }
  TestCommandEnd();


}

testcase Tto7tsimc_TsTc16()
{
  stack long __tableHandle;
  SetBreakOnFail(1);

  {
    CreateTTEIFFunction("Tto7tsimc_CaptureImage", __eFct, __eLocal);
    CallInterfaceFunction(__cEmpty, __cEmpty, "089248de-5a83-431b-a302-b3696a072dd4");
  }


  TestCommandBegin(__eSet, __cSet, "", "1");
  {
    __tableHandle = ReportTableHead3Columns(__cSetCaption , __cTSym, __cTOp, __cAssigned); 
    {
      $`FDCAN2::dbNode::`SGW::`TELEMATIC_FD_5::`CameraDisplaySts2.phys = 14;
      snprintf(__cArray, 8192, "%s", "CameraDisplaySts2");
      snprintf(__cArray2, 8192, "%s '%s'", __cCANSignal, __cArray);
      snprintf(__cArray3, 8192, "%s", "");
      
      ReportSetLValueOrSignalNotOnline(getSignalTime(`FDCAN2::dbNode::`SGW::`TELEMATIC_FD_5::`CameraDisplaySts2), __cArray2, __cArray4, 8192);
      ReportTableRow(__tableHandle, 0, __cArray4, __cAOp, 14, __cArray3, __oneOfFlag, __bSetInCheckAlignment);
      
  
    }
    ReportTableEndTestStep(__tableHandle, "1");
  }
  TestCommandEnd();


  TestCommandBegin(__eWait, __cWait, "", "2");
  {
    Wait("1", (1000 * 1000000LL), 1000000, "");
  }
  TestCommandEnd();

  TestCommandBegin(__eCheck, __cCheck, "", "3");
  {
    __bVerdict = __eVerdictPass;
    __tableHandle = ReportTableHead5Columns(__cCheckCaption, __cTSym, __cTOp, __cRefVal, __cActual, __cRes);
    {
      {
        int __res1,__res2;
        __res1 = CheckSignalMatch(`FDCAN2::dbNode::`CVADAS::`CVPAM_FD_Info::`DisplayView2, 1, __cGreaterEqualThan) == 1;
        __res2 = CheckSignalMatch(`FDCAN2::dbNode::`CVADAS::`CVPAM_FD_Info::`DisplayView2, 15, __cLessEqualThan) == 1;
        __csr = __res1 && __res2;
        snprintf(__cArray, 8192, "%s", "DisplayView2");
        snprintf(__cArray2, 8192, "%s '%s'", __cCANSignal, __cArray);
        snprintf(__cArray3, 8192, "%s", "");
        snprintf(__cArray4, 8192, "%s", "");
        snprintf(__cArray5, 8192, "%s", __cArray3);
        snprintf(__cArray6, 8192, "%s", __cArray4);
        ReportRange(1, 15, __cArray5, __cArray6, __cArray7, 8192);
        ReportTableRow(__tableHandle, 0, __cArray2, __cRange, __cArray7, __cEmpty, __oneOfFlag, __bSetInCheckAlignment);
        ReportLValueOrSignalNotOnline(`FDCAN2::dbNode::`CVADAS::`CVPAM_FD_Info::`DisplayView2, __cArray8, 8192);
        ReportCell(__tableHandle, __cArray8);
        ReportCellResult(__tableHandle, __csr, __ePassFail);
      }
  
      __bVerdict = __bVerdict && __csr;
    }
    ReportTableEndVerdict(__tableHandle, "1", __bVerdict);
  }
  TestCommandEnd();


}

testsequence Tto7tsimc_SteeringAngleTest_HMI_View_Switch()
{
  stack long __tableHandle;
  SetBreakOnFail(1);

  {
    CreateTTEIFFunction("Tto7tsimc_CaptureMasterImage", __eFct, __eLocal);
    CallInterfaceFunction(__cEmpty, __cEmpty, "8553246b-cbf4-4dd1-a2ec-aee75c0ec25c");
  }


  {
    __type_of(0) __tcLocVar0;
    __type_of(500) __tcLocVar1;
    __type_of(100) __tcLocVar2;
  
    __tcLocVar0 = 0;
    __tcLocVar1 = 500;
    __tcLocVar2 = 100;
  
    snprintf(__cArray, 8192, "%s", "0");
    snprintf(__cArray2, 8192, "%s", "500");
    snprintf(__cArray3, 8192, "%s", "100");
  
    snprintf(__cArray4, 8192, "For (For i=%s..%s, increment=%s)", __cArray, __cArray2, __cArray3);
    TestControlStructBegin(__cFor, __cArray4, "0");  
    for(__tt8LoopVar1 = __tcLocVar0; (__tcLocVar2 < 0) ? (CheckSignalMatch(__tt8LoopVar1, __tcLocVar1, ">=" ) == 1) : (CheckSignalMatch(__tt8LoopVar1, __tcLocVar1, "<=") == 1); __tt8LoopVar1 += __tcLocVar2)
    {
      if(__LoopIsBlocking())  
        break;
  
      snprintf(__cArray, 8192, "%s", "0");
      snprintf(__cArray2, 8192, "%s", "500");
      snprintf(__cArray3, 8192, "%s", "100");
      snprintf(__cArray4, 8192, "For (For i=%s..%s, increment=%s; current i = %lld)", __cArray, __cArray2, __cArray3, __tt8LoopVar1);
      TestControlStructBegin(__cForIteration, __cArray4, "1");
      TestCommandBegin(__eSet, __cSet, "", "2");
      {
        __tableHandle = ReportTableHead3Columns(__cSetCaption , __cTSym, __cTOp, __cAssigned); 
        {
          $`FDCAN2::dbNode::`BCM::`IPC_VEHICLE_SETUP::`SVC_Guidelines.phys = 1;
          snprintf(__cArray, 8192, "%s", "SVC_Guidelines");
          snprintf(__cArray2, 8192, "%s '%s'", __cCANSignal, __cArray);
          snprintf(__cArray3, 8192, "%s", "");
          
          ReportSetLValueOrSignalNotOnline(getSignalTime(`FDCAN2::dbNode::`BCM::`IPC_VEHICLE_SETUP::`SVC_Guidelines), __cArray2, __cArray4, 8192);
          ReportTableRow(__tableHandle, 0, __cArray4, __cAOp, 1, __cArray3, __oneOfFlag, __bSetInCheckAlignment);
          
      
        }
        ReportTableEndTestStep(__tableHandle, "1");
      }
      TestCommandEnd();


      TestCommandBegin(__eSet, __cSet, "", "3");
      {
        __tableHandle = ReportTableHead3Columns(__cSetCaption , __cTSym, __cTOp, __cAssigned); 
        {
          $`FDCAN2::dbNode::`BCM::`IPC_VEHICLE_SETUP::`Fwrd_Cam_Guidelines.phys = 1;
          snprintf(__cArray, 8192, "%s", "Fwrd_Cam_Guidelines");
          snprintf(__cArray2, 8192, "%s '%s'", __cCANSignal, __cArray);
          snprintf(__cArray3, 8192, "%s", "");
          
          ReportSetLValueOrSignalNotOnline(getSignalTime(`FDCAN2::dbNode::`BCM::`IPC_VEHICLE_SETUP::`Fwrd_Cam_Guidelines), __cArray2, __cArray4, 8192);
          ReportTableRow(__tableHandle, 0, __cArray4, __cAOp, 1, __cArray3, __oneOfFlag, __bSetInCheckAlignment);
          
      
        }
        ReportTableEndTestStep(__tableHandle, "1");
      }
      TestCommandEnd();


      TestCommandBegin(__eSet, __cSet, "", "4");
      {
        __tableHandle = ReportTableHead3Columns(__cSetCaption , __cTSym, __cTOp, __cAssigned); 
        {
          $`FDCAN14::dbNode::`EPS::`EPS_FD_1::`LwsAngle.phys = __tt8LoopVar1;
          snprintf(__cArray, 8192, "%s", "FDCAN14::EPS::EPS_FD_1::LwsAngle");
          snprintf(__cArray2, 8192, "%s '%s'", __cCANSignal, __cArray);
          snprintf(__cArray3, 8192, "%s", "i");
          
          ReportSetLValueOrSignalNotOnline(getSignalTime(`FDCAN14::dbNode::`EPS::`EPS_FD_1::`LwsAngle), __cArray2, __cArray4, 8192);
          ReportTableRow(__tableHandle, 0, __cArray4, __cAOp, __tt8LoopVar1, __cArray3, __oneOfFlag, __bSetInCheckAlignment);
          
      
        }
        ReportTableEndTestStep(__tableHandle, "1");
      }
      TestCommandEnd();


      CreateTTEIFFunction("Tto7tsimc_TsTc17", __eTcDef, __eLocal);
      AddIFParameterTestCaseAttribute("TC_ID", "");
      AddIFParameterTestCaseAttribute("Test Case ID", "");
      CallInterfaceFunction("Set to Surround View Camera", __cEmpty , "0434ff3f-233b-4f4a-aaf7-fb004f21ba00");

      CreateTTEIFFunction("Tto7tsimc_TsTc18", __eTcDef, __eLocal);
      AddIFParameterTestCaseAttribute("TC_ID", "");
      AddIFParameterTestCaseAttribute("Test Case ID", "");
      CallInterfaceFunction("View 3: Forward Facing Camera", __cEmpty , "fea2a249-0c4d-4f4f-9ecc-6c26b32301b6");

      CreateTTEIFFunction("Tto7tsimc_TsTc19", __eTcDef, __eLocal);
      AddIFParameterTestCaseAttribute("TC_ID", "");
      AddIFParameterTestCaseAttribute("Test Case ID", "");
      CallInterfaceFunction("View 11: FVTV", __cEmpty , "6fc1cf1b-b2fd-4555-8f46-e9e4d6d2a4ac");

      CreateTTEIFFunction("Tto7tsimc_TsTc20", __eTcDef, __eLocal);
      AddIFParameterTestCaseAttribute("TC_ID", "");
      AddIFParameterTestCaseAttribute("Test Case ID", "");
      CallInterfaceFunction("View 12: RVTV", __cEmpty , "168b1650-e364-4995-96e0-4974602cb9d5");

      TestControlStructEnd(__eUndefined);
    }
    TestControlStructEnd(__eUndefined);
  }

  {
    __type_of(-500) __tcLocVar0;
    __type_of(0) __tcLocVar1;
    __type_of(100) __tcLocVar2;
  
    __tcLocVar0 = -500;
    __tcLocVar1 = 0;
    __tcLocVar2 = 100;
  
    snprintf(__cArray, 8192, "%s", "-500");
    snprintf(__cArray2, 8192, "%s", "0");
    snprintf(__cArray3, 8192, "%s", "100");
  
    snprintf(__cArray4, 8192, "For (For i=%s..%s, increment=%s)", __cArray, __cArray2, __cArray3);
    TestControlStructBegin(__cFor, __cArray4, "0");  
    for(__tt8LoopVar2 = __tcLocVar0; (__tcLocVar2 < 0) ? (CheckSignalMatch(__tt8LoopVar2, __tcLocVar1, ">=" ) == 1) : (CheckSignalMatch(__tt8LoopVar2, __tcLocVar1, "<=") == 1); __tt8LoopVar2 += __tcLocVar2)
    {
      if(__LoopIsBlocking())  
        break;
  
      snprintf(__cArray, 8192, "%s", "-500");
      snprintf(__cArray2, 8192, "%s", "0");
      snprintf(__cArray3, 8192, "%s", "100");
      snprintf(__cArray4, 8192, "For (For i=%s..%s, increment=%s; current i = %.15g)", __cArray, __cArray2, __cArray3, __tt8LoopVar2);
      TestControlStructBegin(__cForIteration, __cArray4, "5");
      TestCommandBegin(__eSet, __cSet, "", "6");
      {
        __tableHandle = ReportTableHead3Columns(__cSetCaption , __cTSym, __cTOp, __cAssigned); 
        {
          $`FDCAN2::dbNode::`BCM::`IPC_VEHICLE_SETUP::`SVC_Guidelines.phys = 1;
          snprintf(__cArray, 8192, "%s", "SVC_Guidelines");
          snprintf(__cArray2, 8192, "%s '%s'", __cCANSignal, __cArray);
          snprintf(__cArray3, 8192, "%s", "");
          
          ReportSetLValueOrSignalNotOnline(getSignalTime(`FDCAN2::dbNode::`BCM::`IPC_VEHICLE_SETUP::`SVC_Guidelines), __cArray2, __cArray4, 8192);
          ReportTableRow(__tableHandle, 0, __cArray4, __cAOp, 1, __cArray3, __oneOfFlag, __bSetInCheckAlignment);
          
      
        }
        ReportTableEndTestStep(__tableHandle, "1");
      }
      TestCommandEnd();


      TestCommandBegin(__eSet, __cSet, "", "7");
      {
        __tableHandle = ReportTableHead3Columns(__cSetCaption , __cTSym, __cTOp, __cAssigned); 
        {
          $`FDCAN2::dbNode::`BCM::`IPC_VEHICLE_SETUP::`Fwrd_Cam_Guidelines.phys = 1;
          snprintf(__cArray, 8192, "%s", "Fwrd_Cam_Guidelines");
          snprintf(__cArray2, 8192, "%s '%s'", __cCANSignal, __cArray);
          snprintf(__cArray3, 8192, "%s", "");
          
          ReportSetLValueOrSignalNotOnline(getSignalTime(`FDCAN2::dbNode::`BCM::`IPC_VEHICLE_SETUP::`Fwrd_Cam_Guidelines), __cArray2, __cArray4, 8192);
          ReportTableRow(__tableHandle, 0, __cArray4, __cAOp, 1, __cArray3, __oneOfFlag, __bSetInCheckAlignment);
          
      
        }
        ReportTableEndTestStep(__tableHandle, "1");
      }
      TestCommandEnd();


      TestCommandBegin(__eSet, __cSet, "", "8");
      {
        __tableHandle = ReportTableHead3Columns(__cSetCaption , __cTSym, __cTOp, __cAssigned); 
        {
          $`FDCAN14::dbNode::`EPS::`EPS_FD_1::`LwsAngle.phys = __tt8LoopVar2;
          snprintf(__cArray, 8192, "%s", "FDCAN14::EPS::EPS_FD_1::LwsAngle");
          snprintf(__cArray2, 8192, "%s '%s'", __cCANSignal, __cArray);
          snprintf(__cArray3, 8192, "%s", "i");
          
          ReportSetLValueOrSignalNotOnline(getSignalTime(`FDCAN14::dbNode::`EPS::`EPS_FD_1::`LwsAngle), __cArray2, __cArray4, 8192);
          ReportTableRow(__tableHandle, 0, __cArray4, __cAOp, __tt8LoopVar2, __cArray3, __oneOfFlag, __bSetInCheckAlignment);
          
      
        }
        ReportTableEndTestStep(__tableHandle, "1");
      }
      TestCommandEnd();


      CreateTTEIFFunction("Tto7tsimc_TsTc21", __eTcDef, __eLocal);
      AddIFParameterTestCaseAttribute("TC_ID", "");
      AddIFParameterTestCaseAttribute("Test Case ID", "");
      CallInterfaceFunction("Set to Surround View Camera", __cEmpty , "2d036126-26d1-439c-ab1a-3aae9b0a817d");

      CreateTTEIFFunction("Tto7tsimc_TsTc22", __eTcDef, __eLocal);
      AddIFParameterTestCaseAttribute("TC_ID", "");
      AddIFParameterTestCaseAttribute("Test Case ID", "");
      CallInterfaceFunction("View 3: Forward Facing Camera", __cEmpty , "dc9be348-1aa7-4edc-be62-30b5d6276d7f");

      CreateTTEIFFunction("Tto7tsimc_TsTc23", __eTcDef, __eLocal);
      AddIFParameterTestCaseAttribute("TC_ID", "");
      AddIFParameterTestCaseAttribute("Test Case ID", "");
      CallInterfaceFunction("View 11: FVTV", __cEmpty , "b599d233-db46-4e37-a7da-d5e332a56abd");

      CreateTTEIFFunction("Tto7tsimc_TsTc24", __eTcDef, __eLocal);
      AddIFParameterTestCaseAttribute("TC_ID", "");
      AddIFParameterTestCaseAttribute("Test Case ID", "");
      CallInterfaceFunction("View 12: RVTV", __cEmpty , "ccbf0167-4dc5-4333-a492-bce5462f8336");

      TestControlStructEnd(__eUndefined);
    }
    TestControlStructEnd(__eUndefined);
  }

}

testcase Tto7tsimc_TsTc17()
{
  stack long __tableHandle;
  SetBreakOnFail(1);

  TestPreparationBegin();
  {
  }
  TestPreparationEnd();

  TestCommandBegin(__eSet, __cSet, "", "0");
  {
    __tableHandle = ReportTableHead3Columns(__cSetCaption , __cTSym, __cTOp, __cAssigned); 
    {
      $`FDCAN2::dbNode::`SGW::`TELEMATIC_FD_14::`TGW_CAMERA_DISP_STAT.phys = 4;
      snprintf(__cArray, 8192, "%s", "TGW_CAMERA_DISP_STAT");
      snprintf(__cArray2, 8192, "%s '%s'", __cCANSignal, __cArray);
      snprintf(__cArray3, 8192, "%s", "");
      
      ReportSetLValueOrSignalNotOnline(getSignalTime(`FDCAN2::dbNode::`SGW::`TELEMATIC_FD_14::`TGW_CAMERA_DISP_STAT), __cArray2, __cArray4, 8192);
      ReportTableRow(__tableHandle, 0, __cArray4, __cAOp, 4, __cArray3, __oneOfFlag, __bSetInCheckAlignment);
      
  
    }
    {
      $`FDCAN2::dbNode::`SGW::`TELEMATIC_FD_5::`CameraDisplaySts2.phys = 0;
      snprintf(__cArray, 8192, "%s", "CameraDisplaySts2");
      snprintf(__cArray2, 8192, "%s '%s'", __cCANSignal, __cArray);
      snprintf(__cArray3, 8192, "%s", "Default");
      
      ReportSetLValueOrSignalNotOnline(getSignalTime(`FDCAN2::dbNode::`SGW::`TELEMATIC_FD_5::`CameraDisplaySts2), __cArray2, __cArray4, 8192);
      ReportTableRow(__tableHandle, 0, __cArray4, __cAOp, 0, __cArray3, __oneOfFlag, __bSetInCheckAlignment);
      
  
    }
    ReportTableEndTestStep(__tableHandle, "1");
  }
  TestCommandEnd();


  TestCommandBegin(__eWait, __cWait, "", "1");
  {
    Wait("1", (1000 * 1000000LL), 1000000, "");
  }
  TestCommandEnd();

  TestCommandBegin(__eCheck, __cCheck, "", "2");
  {
    __bVerdict = __eVerdictPass;
    __tableHandle = ReportTableHead5Columns(__cCheckCaption, __cTSym, __cTOp, __cRefVal, __cActual, __cRes);
    {
      {
        int __res1,__res2;
        __res1 = CheckSignalMatch(`FDCAN2::dbNode::`SGW::`TELEMATIC_FD_14::`TGW_CAMERA_DISP_STAT, 0, __cGreaterEqualThan) == 1;
        __res2 = CheckSignalMatch(`FDCAN2::dbNode::`SGW::`TELEMATIC_FD_14::`TGW_CAMERA_DISP_STAT, 4, __cLessEqualThan) == 1;
        __csr = __res1 && __res2;
        snprintf(__cArray, 8192, "%s", "TGW_CAMERA_DISP_STAT");
        snprintf(__cArray2, 8192, "%s '%s'", __cCANSignal, __cArray);
        snprintf(__cArray3, 8192, "%s", "");
        snprintf(__cArray4, 8192, "%s", "");
        snprintf(__cArray5, 8192, "%s", __cArray3);
        snprintf(__cArray6, 8192, "%s", __cArray4);
        ReportRange(0, 4, __cArray5, __cArray6, __cArray7, 8192);
        ReportTableRow(__tableHandle, 0, __cArray2, __cRange, __cArray7, __cEmpty, __oneOfFlag, __bSetInCheckAlignment);
        ReportLValueOrSignalNotOnline(`FDCAN2::dbNode::`SGW::`TELEMATIC_FD_14::`TGW_CAMERA_DISP_STAT, __cArray8, 8192);
        ReportCell(__tableHandle, __cArray8);
        ReportCellResult(__tableHandle, __csr, __ePassFail);
      }
  
      __bVerdict = __bVerdict && __csr;
    }
    ReportTableEndVerdict(__tableHandle, "1", __bVerdict);
  }
  TestCommandEnd();


  TestCommandBegin(__eWait, __cWait, "", "3");
  {
    Wait("1", (3000 * 1000000LL), 1000000, "");
  }
  TestCommandEnd();

}

testcase Tto7tsimc_TsTc18()
{
  stack long __tableHandle;
  SetBreakOnFail(1);

  {
    CreateTTEIFFunction("Tto7tsimc_CaptureImage", __eFct, __eLocal);
    CallInterfaceFunction(__cEmpty, __cEmpty, "089248de-5a83-431b-a302-b3696a072dd4");
  }


  TestCommandBegin(__eSet, __cSet, "", "1");
  {
    __tableHandle = ReportTableHead3Columns(__cSetCaption , __cTSym, __cTOp, __cAssigned); 
    {
      $`FDCAN2::dbNode::`SGW::`TELEMATIC_FD_5::`CameraDisplaySts2.phys = 3;
      snprintf(__cArray, 8192, "%s", "CameraDisplaySts2");
      snprintf(__cArray2, 8192, "%s '%s'", __cCANSignal, __cArray);
      snprintf(__cArray3, 8192, "%s", "");
      
      ReportSetLValueOrSignalNotOnline(getSignalTime(`FDCAN2::dbNode::`SGW::`TELEMATIC_FD_5::`CameraDisplaySts2), __cArray2, __cArray4, 8192);
      ReportTableRow(__tableHandle, 0, __cArray4, __cAOp, 3, __cArray3, __oneOfFlag, __bSetInCheckAlignment);
      
  
    }
    ReportTableEndTestStep(__tableHandle, "1");
  }
  TestCommandEnd();


  TestCommandBegin(__eWait, __cWait, "", "2");
  {
    Wait("1", (1000 * 1000000LL), 1000000, "");
  }
  TestCommandEnd();

  TestCommandBegin(__eCheck, __cCheck, "", "3");
  {
    __bVerdict = __eVerdictPass;
    __tableHandle = ReportTableHead5Columns(__cCheckCaption, __cTSym, __cTOp, __cRefVal, __cActual, __cRes);
    {
      {
        int __res1,__res2;
        __res1 = CheckSignalMatch(`FDCAN2::dbNode::`CVADAS::`CVPAM_FD_Info::`DisplayView2, 1, __cGreaterEqualThan) == 1;
        __res2 = CheckSignalMatch(`FDCAN2::dbNode::`CVADAS::`CVPAM_FD_Info::`DisplayView2, 15, __cLessEqualThan) == 1;
        __csr = __res1 && __res2;
        snprintf(__cArray, 8192, "%s", "DisplayView2");
        snprintf(__cArray2, 8192, "%s '%s'", __cCANSignal, __cArray);
        snprintf(__cArray3, 8192, "%s", "");
        snprintf(__cArray4, 8192, "%s", "");
        snprintf(__cArray5, 8192, "%s", __cArray3);
        snprintf(__cArray6, 8192, "%s", __cArray4);
        ReportRange(1, 15, __cArray5, __cArray6, __cArray7, 8192);
        ReportTableRow(__tableHandle, 0, __cArray2, __cRange, __cArray7, __cEmpty, __oneOfFlag, __bSetInCheckAlignment);
        ReportLValueOrSignalNotOnline(`FDCAN2::dbNode::`CVADAS::`CVPAM_FD_Info::`DisplayView2, __cArray8, 8192);
        ReportCell(__tableHandle, __cArray8);
        ReportCellResult(__tableHandle, __csr, __ePassFail);
      }
  
      __bVerdict = __bVerdict && __csr;
    }
    ReportTableEndVerdict(__tableHandle, "1", __bVerdict);
  }
  TestCommandEnd();


}

testcase Tto7tsimc_TsTc19()
{
  stack long __tableHandle;
  SetBreakOnFail(1);

  {
    CreateTTEIFFunction("Tto7tsimc_CaptureImage", __eFct, __eLocal);
    CallInterfaceFunction(__cEmpty, __cEmpty, "089248de-5a83-431b-a302-b3696a072dd4");
  }


  TestCommandBegin(__eSet, __cSet, "", "1");
  {
    __tableHandle = ReportTableHead3Columns(__cSetCaption , __cTSym, __cTOp, __cAssigned); 
    {
      $`FDCAN2::dbNode::`SGW::`TELEMATIC_FD_5::`CameraDisplaySts2.phys = 11;
      snprintf(__cArray, 8192, "%s", "CameraDisplaySts2");
      snprintf(__cArray2, 8192, "%s '%s'", __cCANSignal, __cArray);
      snprintf(__cArray3, 8192, "%s", "");
      
      ReportSetLValueOrSignalNotOnline(getSignalTime(`FDCAN2::dbNode::`SGW::`TELEMATIC_FD_5::`CameraDisplaySts2), __cArray2, __cArray4, 8192);
      ReportTableRow(__tableHandle, 0, __cArray4, __cAOp, 11, __cArray3, __oneOfFlag, __bSetInCheckAlignment);
      
  
    }
    ReportTableEndTestStep(__tableHandle, "1");
  }
  TestCommandEnd();


  TestCommandBegin(__eWait, __cWait, "", "2");
  {
    Wait("1", (1000 * 1000000LL), 1000000, "");
  }
  TestCommandEnd();

  TestCommandBegin(__eCheck, __cCheck, "", "3");
  {
    __bVerdict = __eVerdictPass;
    __tableHandle = ReportTableHead5Columns(__cCheckCaption, __cTSym, __cTOp, __cRefVal, __cActual, __cRes);
    {
      {
        int __res1,__res2;
        __res1 = CheckSignalMatch(`FDCAN2::dbNode::`CVADAS::`CVPAM_FD_Info::`DisplayView2, 1, __cGreaterEqualThan) == 1;
        __res2 = CheckSignalMatch(`FDCAN2::dbNode::`CVADAS::`CVPAM_FD_Info::`DisplayView2, 15, __cLessEqualThan) == 1;
        __csr = __res1 && __res2;
        snprintf(__cArray, 8192, "%s", "DisplayView2");
        snprintf(__cArray2, 8192, "%s '%s'", __cCANSignal, __cArray);
        snprintf(__cArray3, 8192, "%s", "");
        snprintf(__cArray4, 8192, "%s", "");
        snprintf(__cArray5, 8192, "%s", __cArray3);
        snprintf(__cArray6, 8192, "%s", __cArray4);
        ReportRange(1, 15, __cArray5, __cArray6, __cArray7, 8192);
        ReportTableRow(__tableHandle, 0, __cArray2, __cRange, __cArray7, __cEmpty, __oneOfFlag, __bSetInCheckAlignment);
        ReportLValueOrSignalNotOnline(`FDCAN2::dbNode::`CVADAS::`CVPAM_FD_Info::`DisplayView2, __cArray8, 8192);
        ReportCell(__tableHandle, __cArray8);
        ReportCellResult(__tableHandle, __csr, __ePassFail);
      }
  
      __bVerdict = __bVerdict && __csr;
    }
    ReportTableEndVerdict(__tableHandle, "1", __bVerdict);
  }
  TestCommandEnd();


}

testcase Tto7tsimc_TsTc20()
{
  stack long __tableHandle;
  SetBreakOnFail(1);

  {
    CreateTTEIFFunction("Tto7tsimc_CaptureImage", __eFct, __eLocal);
    CallInterfaceFunction(__cEmpty, __cEmpty, "089248de-5a83-431b-a302-b3696a072dd4");
  }


  TestCommandBegin(__eSet, __cSet, "", "1");
  {
    __tableHandle = ReportTableHead3Columns(__cSetCaption , __cTSym, __cTOp, __cAssigned); 
    {
      $`FDCAN2::dbNode::`SGW::`TELEMATIC_FD_5::`CameraDisplaySts2.phys = 12;
      snprintf(__cArray, 8192, "%s", "CameraDisplaySts2");
      snprintf(__cArray2, 8192, "%s '%s'", __cCANSignal, __cArray);
      snprintf(__cArray3, 8192, "%s", "");
      
      ReportSetLValueOrSignalNotOnline(getSignalTime(`FDCAN2::dbNode::`SGW::`TELEMATIC_FD_5::`CameraDisplaySts2), __cArray2, __cArray4, 8192);
      ReportTableRow(__tableHandle, 0, __cArray4, __cAOp, 12, __cArray3, __oneOfFlag, __bSetInCheckAlignment);
      
  
    }
    ReportTableEndTestStep(__tableHandle, "1");
  }
  TestCommandEnd();


  TestCommandBegin(__eWait, __cWait, "", "2");
  {
    Wait("1", (1000 * 1000000LL), 1000000, "");
  }
  TestCommandEnd();

  TestCommandBegin(__eCheck, __cCheck, "", "3");
  {
    __bVerdict = __eVerdictPass;
    __tableHandle = ReportTableHead5Columns(__cCheckCaption, __cTSym, __cTOp, __cRefVal, __cActual, __cRes);
    {
      {
        int __res1,__res2;
        __res1 = CheckSignalMatch(`FDCAN2::dbNode::`CVADAS::`CVPAM_FD_Info::`DisplayView2, 1, __cGreaterEqualThan) == 1;
        __res2 = CheckSignalMatch(`FDCAN2::dbNode::`CVADAS::`CVPAM_FD_Info::`DisplayView2, 15, __cLessEqualThan) == 1;
        __csr = __res1 && __res2;
        snprintf(__cArray, 8192, "%s", "DisplayView2");
        snprintf(__cArray2, 8192, "%s '%s'", __cCANSignal, __cArray);
        snprintf(__cArray3, 8192, "%s", "");
        snprintf(__cArray4, 8192, "%s", "");
        snprintf(__cArray5, 8192, "%s", __cArray3);
        snprintf(__cArray6, 8192, "%s", __cArray4);
        ReportRange(1, 15, __cArray5, __cArray6, __cArray7, 8192);
        ReportTableRow(__tableHandle, 0, __cArray2, __cRange, __cArray7, __cEmpty, __oneOfFlag, __bSetInCheckAlignment);
        ReportLValueOrSignalNotOnline(`FDCAN2::dbNode::`CVADAS::`CVPAM_FD_Info::`DisplayView2, __cArray8, 8192);
        ReportCell(__tableHandle, __cArray8);
        ReportCellResult(__tableHandle, __csr, __ePassFail);
      }
  
      __bVerdict = __bVerdict && __csr;
    }
    ReportTableEndVerdict(__tableHandle, "1", __bVerdict);
  }
  TestCommandEnd();


}

testcase Tto7tsimc_TsTc21()
{
  stack long __tableHandle;
  SetBreakOnFail(1);

  TestPreparationBegin();
  {
  }
  TestPreparationEnd();

  TestCommandBegin(__eSet, __cSet, "", "0");
  {
    __tableHandle = ReportTableHead3Columns(__cSetCaption , __cTSym, __cTOp, __cAssigned); 
    {
      $`FDCAN2::dbNode::`SGW::`TELEMATIC_FD_14::`TGW_CAMERA_DISP_STAT.phys = 4;
      snprintf(__cArray, 8192, "%s", "TGW_CAMERA_DISP_STAT");
      snprintf(__cArray2, 8192, "%s '%s'", __cCANSignal, __cArray);
      snprintf(__cArray3, 8192, "%s", "");
      
      ReportSetLValueOrSignalNotOnline(getSignalTime(`FDCAN2::dbNode::`SGW::`TELEMATIC_FD_14::`TGW_CAMERA_DISP_STAT), __cArray2, __cArray4, 8192);
      ReportTableRow(__tableHandle, 0, __cArray4, __cAOp, 4, __cArray3, __oneOfFlag, __bSetInCheckAlignment);
      
  
    }
    {
      $`FDCAN2::dbNode::`SGW::`TELEMATIC_FD_5::`CameraDisplaySts2.phys = 0;
      snprintf(__cArray, 8192, "%s", "CameraDisplaySts2");
      snprintf(__cArray2, 8192, "%s '%s'", __cCANSignal, __cArray);
      snprintf(__cArray3, 8192, "%s", "Default");
      
      ReportSetLValueOrSignalNotOnline(getSignalTime(`FDCAN2::dbNode::`SGW::`TELEMATIC_FD_5::`CameraDisplaySts2), __cArray2, __cArray4, 8192);
      ReportTableRow(__tableHandle, 0, __cArray4, __cAOp, 0, __cArray3, __oneOfFlag, __bSetInCheckAlignment);
      
  
    }
    ReportTableEndTestStep(__tableHandle, "1");
  }
  TestCommandEnd();


  TestCommandBegin(__eWait, __cWait, "", "1");
  {
    Wait("1", (1000 * 1000000LL), 1000000, "");
  }
  TestCommandEnd();

  TestCommandBegin(__eCheck, __cCheck, "", "2");
  {
    __bVerdict = __eVerdictPass;
    __tableHandle = ReportTableHead5Columns(__cCheckCaption, __cTSym, __cTOp, __cRefVal, __cActual, __cRes);
    {
      {
        int __res1,__res2;
        __res1 = CheckSignalMatch(`FDCAN2::dbNode::`SGW::`TELEMATIC_FD_14::`TGW_CAMERA_DISP_STAT, 0, __cGreaterEqualThan) == 1;
        __res2 = CheckSignalMatch(`FDCAN2::dbNode::`SGW::`TELEMATIC_FD_14::`TGW_CAMERA_DISP_STAT, 4, __cLessEqualThan) == 1;
        __csr = __res1 && __res2;
        snprintf(__cArray, 8192, "%s", "TGW_CAMERA_DISP_STAT");
        snprintf(__cArray2, 8192, "%s '%s'", __cCANSignal, __cArray);
        snprintf(__cArray3, 8192, "%s", "");
        snprintf(__cArray4, 8192, "%s", "");
        snprintf(__cArray5, 8192, "%s", __cArray3);
        snprintf(__cArray6, 8192, "%s", __cArray4);
        ReportRange(0, 4, __cArray5, __cArray6, __cArray7, 8192);
        ReportTableRow(__tableHandle, 0, __cArray2, __cRange, __cArray7, __cEmpty, __oneOfFlag, __bSetInCheckAlignment);
        ReportLValueOrSignalNotOnline(`FDCAN2::dbNode::`SGW::`TELEMATIC_FD_14::`TGW_CAMERA_DISP_STAT, __cArray8, 8192);
        ReportCell(__tableHandle, __cArray8);
        ReportCellResult(__tableHandle, __csr, __ePassFail);
      }
  
      __bVerdict = __bVerdict && __csr;
    }
    ReportTableEndVerdict(__tableHandle, "1", __bVerdict);
  }
  TestCommandEnd();


  TestCommandBegin(__eWait, __cWait, "", "3");
  {
    Wait("1", (3000 * 1000000LL), 1000000, "");
  }
  TestCommandEnd();

}

testcase Tto7tsimc_TsTc22()
{
  stack long __tableHandle;
  SetBreakOnFail(1);

  {
    CreateTTEIFFunction("Tto7tsimc_CaptureImage", __eFct, __eLocal);
    CallInterfaceFunction(__cEmpty, __cEmpty, "089248de-5a83-431b-a302-b3696a072dd4");
  }


  TestCommandBegin(__eSet, __cSet, "", "1");
  {
    __tableHandle = ReportTableHead3Columns(__cSetCaption , __cTSym, __cTOp, __cAssigned); 
    {
      $`FDCAN2::dbNode::`SGW::`TELEMATIC_FD_5::`CameraDisplaySts2.phys = 3;
      snprintf(__cArray, 8192, "%s", "CameraDisplaySts2");
      snprintf(__cArray2, 8192, "%s '%s'", __cCANSignal, __cArray);
      snprintf(__cArray3, 8192, "%s", "");
      
      ReportSetLValueOrSignalNotOnline(getSignalTime(`FDCAN2::dbNode::`SGW::`TELEMATIC_FD_5::`CameraDisplaySts2), __cArray2, __cArray4, 8192);
      ReportTableRow(__tableHandle, 0, __cArray4, __cAOp, 3, __cArray3, __oneOfFlag, __bSetInCheckAlignment);
      
  
    }
    ReportTableEndTestStep(__tableHandle, "1");
  }
  TestCommandEnd();


  TestCommandBegin(__eWait, __cWait, "", "2");
  {
    Wait("1", (1000 * 1000000LL), 1000000, "");
  }
  TestCommandEnd();

  TestCommandBegin(__eCheck, __cCheck, "", "3");
  {
    __bVerdict = __eVerdictPass;
    __tableHandle = ReportTableHead5Columns(__cCheckCaption, __cTSym, __cTOp, __cRefVal, __cActual, __cRes);
    {
      {
        int __res1,__res2;
        __res1 = CheckSignalMatch(`FDCAN2::dbNode::`CVADAS::`CVPAM_FD_Info::`DisplayView2, 1, __cGreaterEqualThan) == 1;
        __res2 = CheckSignalMatch(`FDCAN2::dbNode::`CVADAS::`CVPAM_FD_Info::`DisplayView2, 15, __cLessEqualThan) == 1;
        __csr = __res1 && __res2;
        snprintf(__cArray, 8192, "%s", "DisplayView2");
        snprintf(__cArray2, 8192, "%s '%s'", __cCANSignal, __cArray);
        snprintf(__cArray3, 8192, "%s", "");
        snprintf(__cArray4, 8192, "%s", "");
        snprintf(__cArray5, 8192, "%s", __cArray3);
        snprintf(__cArray6, 8192, "%s", __cArray4);
        ReportRange(1, 15, __cArray5, __cArray6, __cArray7, 8192);
        ReportTableRow(__tableHandle, 0, __cArray2, __cRange, __cArray7, __cEmpty, __oneOfFlag, __bSetInCheckAlignment);
        ReportLValueOrSignalNotOnline(`FDCAN2::dbNode::`CVADAS::`CVPAM_FD_Info::`DisplayView2, __cArray8, 8192);
        ReportCell(__tableHandle, __cArray8);
        ReportCellResult(__tableHandle, __csr, __ePassFail);
      }
  
      __bVerdict = __bVerdict && __csr;
    }
    ReportTableEndVerdict(__tableHandle, "1", __bVerdict);
  }
  TestCommandEnd();


}

testcase Tto7tsimc_TsTc23()
{
  stack long __tableHandle;
  SetBreakOnFail(1);

  {
    CreateTTEIFFunction("Tto7tsimc_CaptureImage", __eFct, __eLocal);
    CallInterfaceFunction(__cEmpty, __cEmpty, "089248de-5a83-431b-a302-b3696a072dd4");
  }


  TestCommandBegin(__eSet, __cSet, "", "1");
  {
    __tableHandle = ReportTableHead3Columns(__cSetCaption , __cTSym, __cTOp, __cAssigned); 
    {
      $`FDCAN2::dbNode::`SGW::`TELEMATIC_FD_5::`CameraDisplaySts2.phys = 11;
      snprintf(__cArray, 8192, "%s", "CameraDisplaySts2");
      snprintf(__cArray2, 8192, "%s '%s'", __cCANSignal, __cArray);
      snprintf(__cArray3, 8192, "%s", "");
      
      ReportSetLValueOrSignalNotOnline(getSignalTime(`FDCAN2::dbNode::`SGW::`TELEMATIC_FD_5::`CameraDisplaySts2), __cArray2, __cArray4, 8192);
      ReportTableRow(__tableHandle, 0, __cArray4, __cAOp, 11, __cArray3, __oneOfFlag, __bSetInCheckAlignment);
      
  
    }
    ReportTableEndTestStep(__tableHandle, "1");
  }
  TestCommandEnd();


  TestCommandBegin(__eWait, __cWait, "", "2");
  {
    Wait("1", (1000 * 1000000LL), 1000000, "");
  }
  TestCommandEnd();

  TestCommandBegin(__eCheck, __cCheck, "", "3");
  {
    __bVerdict = __eVerdictPass;
    __tableHandle = ReportTableHead5Columns(__cCheckCaption, __cTSym, __cTOp, __cRefVal, __cActual, __cRes);
    {
      {
        int __res1,__res2;
        __res1 = CheckSignalMatch(`FDCAN2::dbNode::`CVADAS::`CVPAM_FD_Info::`DisplayView2, 1, __cGreaterEqualThan) == 1;
        __res2 = CheckSignalMatch(`FDCAN2::dbNode::`CVADAS::`CVPAM_FD_Info::`DisplayView2, 15, __cLessEqualThan) == 1;
        __csr = __res1 && __res2;
        snprintf(__cArray, 8192, "%s", "DisplayView2");
        snprintf(__cArray2, 8192, "%s '%s'", __cCANSignal, __cArray);
        snprintf(__cArray3, 8192, "%s", "");
        snprintf(__cArray4, 8192, "%s", "");
        snprintf(__cArray5, 8192, "%s", __cArray3);
        snprintf(__cArray6, 8192, "%s", __cArray4);
        ReportRange(1, 15, __cArray5, __cArray6, __cArray7, 8192);
        ReportTableRow(__tableHandle, 0, __cArray2, __cRange, __cArray7, __cEmpty, __oneOfFlag, __bSetInCheckAlignment);
        ReportLValueOrSignalNotOnline(`FDCAN2::dbNode::`CVADAS::`CVPAM_FD_Info::`DisplayView2, __cArray8, 8192);
        ReportCell(__tableHandle, __cArray8);
        ReportCellResult(__tableHandle, __csr, __ePassFail);
      }
  
      __bVerdict = __bVerdict && __csr;
    }
    ReportTableEndVerdict(__tableHandle, "1", __bVerdict);
  }
  TestCommandEnd();


}

testcase Tto7tsimc_TsTc24()
{
  stack long __tableHandle;
  SetBreakOnFail(1);

  {
    CreateTTEIFFunction("Tto7tsimc_CaptureImage", __eFct, __eLocal);
    CallInterfaceFunction(__cEmpty, __cEmpty, "089248de-5a83-431b-a302-b3696a072dd4");
  }


  TestCommandBegin(__eSet, __cSet, "", "1");
  {
    __tableHandle = ReportTableHead3Columns(__cSetCaption , __cTSym, __cTOp, __cAssigned); 
    {
      $`FDCAN2::dbNode::`SGW::`TELEMATIC_FD_5::`CameraDisplaySts2.phys = 12;
      snprintf(__cArray, 8192, "%s", "CameraDisplaySts2");
      snprintf(__cArray2, 8192, "%s '%s'", __cCANSignal, __cArray);
      snprintf(__cArray3, 8192, "%s", "");
      
      ReportSetLValueOrSignalNotOnline(getSignalTime(`FDCAN2::dbNode::`SGW::`TELEMATIC_FD_5::`CameraDisplaySts2), __cArray2, __cArray4, 8192);
      ReportTableRow(__tableHandle, 0, __cArray4, __cAOp, 12, __cArray3, __oneOfFlag, __bSetInCheckAlignment);
      
  
    }
    ReportTableEndTestStep(__tableHandle, "1");
  }
  TestCommandEnd();


  TestCommandBegin(__eWait, __cWait, "", "2");
  {
    Wait("1", (1000 * 1000000LL), 1000000, "");
  }
  TestCommandEnd();

  TestCommandBegin(__eCheck, __cCheck, "", "3");
  {
    __bVerdict = __eVerdictPass;
    __tableHandle = ReportTableHead5Columns(__cCheckCaption, __cTSym, __cTOp, __cRefVal, __cActual, __cRes);
    {
      {
        int __res1,__res2;
        __res1 = CheckSignalMatch(`FDCAN2::dbNode::`CVADAS::`CVPAM_FD_Info::`DisplayView2, 1, __cGreaterEqualThan) == 1;
        __res2 = CheckSignalMatch(`FDCAN2::dbNode::`CVADAS::`CVPAM_FD_Info::`DisplayView2, 15, __cLessEqualThan) == 1;
        __csr = __res1 && __res2;
        snprintf(__cArray, 8192, "%s", "DisplayView2");
        snprintf(__cArray2, 8192, "%s '%s'", __cCANSignal, __cArray);
        snprintf(__cArray3, 8192, "%s", "");
        snprintf(__cArray4, 8192, "%s", "");
        snprintf(__cArray5, 8192, "%s", __cArray3);
        snprintf(__cArray6, 8192, "%s", __cArray4);
        ReportRange(1, 15, __cArray5, __cArray6, __cArray7, 8192);
        ReportTableRow(__tableHandle, 0, __cArray2, __cRange, __cArray7, __cEmpty, __oneOfFlag, __bSetInCheckAlignment);
        ReportLValueOrSignalNotOnline(`FDCAN2::dbNode::`CVADAS::`CVPAM_FD_Info::`DisplayView2, __cArray8, 8192);
        ReportCell(__tableHandle, __cArray8);
        ReportCellResult(__tableHandle, __csr, __ePassFail);
      }
  
      __bVerdict = __bVerdict && __csr;
    }
    ReportTableEndVerdict(__tableHandle, "1", __bVerdict);
  }
  TestCommandEnd();


}

void Tto7tsimc_Tet_TtInit()
{
  stack long __tableHandle;
}

void Tto7tsimc_Tet_CaplTcCall0()
{
  stack long __tableHandle;
  CreateCaplIFFunction("Send_Proxi", __eTcDef);
  AddIFParameterTestCaseAttribute("TC_ID", "");
  AddIFParameterTestCaseAttribute("Test Case ID", "");
  AddIFParameterChar(syspar::`VehicleProxy1_Single);
  CallInterfaceFunction(__cEmpty , "", __cEmpty );
}

void Tto7tsimc_Tet_TsCall0()
{
  stack long __tableHandle;
  CreateTTEIFFunction("Tto7tsimc_HMI_View_Switch", __eTsDef, __eLocal);
  CallInterfaceFunction(__cEmpty , __cEmpty, __cEmpty );
}

void Tto7tsimc_Tet_CaplTcCall1()
{
  stack long __tableHandle;
  CreateCaplIFFunction("Send_Proxi", __eTcDef);
  AddIFParameterTestCaseAttribute("TC_ID", "");
  AddIFParameterTestCaseAttribute("Test Case ID", "");
  AddIFParameterChar(syspar::`VehicleProxy1);
  CallInterfaceFunction(__cEmpty , "", __cEmpty );
}

void Tto7tsimc_Tet_TsCall1()
{
  stack long __tableHandle;
  CreateTTEIFFunction("Tto7tsimc_SteeringAngleTest_HMI_View_Switch", __eTsDef, __eLocal);
  CallInterfaceFunction(__cEmpty , __cEmpty, __cEmpty );
}

void Tto7tsimc_Tet_TsCall2()
{
  stack long __tableHandle;
  CreateTTEIFFunction("Tto7tsimc_HMI_View_Switch", __eTsDef, __eLocal);
  CallInterfaceFunction(__cEmpty , __cEmpty, __cEmpty );
}

void Tto7tsimc_Tet_CaplTcCall2()
{
  stack long __tableHandle;
  CreateCaplIFFunction("Send_Proxi", __eTcDef);
  AddIFParameterTestCaseAttribute("TC_ID", "");
  AddIFParameterTestCaseAttribute("Test Case ID", "");
  AddIFParameterChar(syspar::`VehicleProxy2_Single);
  CallInterfaceFunction(__cEmpty , "", __cEmpty );
}

void Tto7tsimc_Tet_TsCall3()
{
  stack long __tableHandle;
  CreateTTEIFFunction("Tto7tsimc_HMI_View_Switch", __eTsDef, __eLocal);
  CallInterfaceFunction(__cEmpty , __cEmpty, __cEmpty );
}

void Tto7tsimc_Tet_CaplTcCall3()
{
  stack long __tableHandle;
  CreateCaplIFFunction("Send_Proxi", __eTcDef);
  AddIFParameterTestCaseAttribute("TC_ID", "");
  AddIFParameterTestCaseAttribute("Test Case ID", "");
  AddIFParameterChar(syspar::`VehicleProxy2);
  CallInterfaceFunction(__cEmpty , "", __cEmpty );
}

void Tto7tsimc_Tet_TsCall4()
{
  stack long __tableHandle;
  CreateTTEIFFunction("Tto7tsimc_HMI_View_Switch", __eTsDef, __eLocal);
  CallInterfaceFunction(__cEmpty , __cEmpty, __cEmpty );
}

void Tto7tsimc_Tet_CaplTcCall4()
{
  stack long __tableHandle;
  CreateCaplIFFunction("Send_Proxi", __eTcDef);
  AddIFParameterTestCaseAttribute("TC_ID", "");
  AddIFParameterTestCaseAttribute("Test Case ID", "");
  AddIFParameterChar(syspar::`VehicleProxy3);
  CallInterfaceFunction(__cEmpty , "", __cEmpty );
}

void Tto7tsimc_Tet_TsCall5()
{
  stack long __tableHandle;
  CreateTTEIFFunction("Tto7tsimc_HMI_View_Switch", __eTsDef, __eLocal);
  CallInterfaceFunction(__cEmpty , __cEmpty, __cEmpty );
}

void Tto7tsimc_Tet_CaplTcCall5()
{
  stack long __tableHandle;
  CreateCaplIFFunction("Send_Proxi", __eTcDef);
  AddIFParameterTestCaseAttribute("TC_ID", "");
  AddIFParameterTestCaseAttribute("Test Case ID", "");
  AddIFParameterChar(syspar::`VehicleProxy4);
  CallInterfaceFunction(__cEmpty , "", __cEmpty );
}

void Tto7tsimc_Tet_TsCall6()
{
  stack long __tableHandle;
  CreateTTEIFFunction("Tto7tsimc_HMI_View_Switch", __eTsDef, __eLocal);
  CallInterfaceFunction(__cEmpty , __cEmpty, __cEmpty );
}

void Tto7tsimc_Tet_CaplTcCall6()
{
  stack long __tableHandle;
  CreateCaplIFFunction("Send_Proxi", __eTcDef);
  AddIFParameterTestCaseAttribute("TC_ID", "");
  AddIFParameterTestCaseAttribute("Test Case ID", "");
  AddIFParameterChar(syspar::`VehicleProxy5_Single);
  CallInterfaceFunction(__cEmpty , "", __cEmpty );
}

void Tto7tsimc_Tet_TsCall7()
{
  stack long __tableHandle;
  CreateTTEIFFunction("Tto7tsimc_HMI_View_Switch", __eTsDef, __eLocal);
  CallInterfaceFunction(__cEmpty , __cEmpty, __cEmpty );
}

void Tto7tsimc_Tet_CaplTcCall7()
{
  stack long __tableHandle;
  CreateCaplIFFunction("Send_Proxi", __eTcDef);
  AddIFParameterTestCaseAttribute("TC_ID", "");
  AddIFParameterTestCaseAttribute("Test Case ID", "");
  AddIFParameterChar(syspar::`VehicleProxy5);
  CallInterfaceFunction(__cEmpty , "", __cEmpty );
}

void Tto7tsimc_Tet_TsCall8()
{
  stack long __tableHandle;
  CreateTTEIFFunction("Tto7tsimc_HMI_View_Switch", __eTsDef, __eLocal);
  CallInterfaceFunction(__cEmpty , __cEmpty, __cEmpty );
}

void Tto7tsimc_Tet_CaplTcCall8()
{
  stack long __tableHandle;
  CreateCaplIFFunction("Send_Proxi", __eTcDef);
  AddIFParameterTestCaseAttribute("TC_ID", "");
  AddIFParameterTestCaseAttribute("Test Case ID", "");
  AddIFParameterChar(syspar::`VehicleProxy6);
  CallInterfaceFunction(__cEmpty , "", __cEmpty );
}

void Tto7tsimc_Tet_TsCall9()
{
  stack long __tableHandle;
  CreateTTEIFFunction("Tto7tsimc_HMI_View_Switch", __eTsDef, __eLocal);
  CallInterfaceFunction(__cEmpty , __cEmpty, __cEmpty );
}

void Tto7tsimc_Tet_CaplTcCall9()
{
  stack long __tableHandle;
  CreateCaplIFFunction("Send_Proxi", __eTcDef);
  AddIFParameterTestCaseAttribute("TC_ID", "");
  AddIFParameterTestCaseAttribute("Test Case ID", "");
  AddIFParameterChar(syspar::`VehicleProxy7);
  CallInterfaceFunction(__cEmpty , "", __cEmpty );
}

void Tto7tsimc_Tet_TsCall10()
{
  stack long __tableHandle;
  CreateTTEIFFunction("Tto7tsimc_HMI_View_Switch", __eTsDef, __eLocal);
  CallInterfaceFunction(__cEmpty , __cEmpty, __cEmpty );
}

void Tto7tsimc_Tet_CaplTcCall10()
{
  stack long __tableHandle;
  CreateCaplIFFunction("Send_Proxi", __eTcDef);
  AddIFParameterTestCaseAttribute("TC_ID", "");
  AddIFParameterTestCaseAttribute("Test Case ID", "");
  AddIFParameterChar(syspar::`VehicleProxy8);
  CallInterfaceFunction(__cEmpty , "", __cEmpty );
}

void Tto7tsimc_Tet_TsCall11()
{
  stack long __tableHandle;
  CreateTTEIFFunction("Tto7tsimc_HMI_View_Switch", __eTsDef, __eLocal);
  CallInterfaceFunction(__cEmpty , __cEmpty, __cEmpty );
}

void Tto7tsimc_Tet_CaplTcCall11()
{
  stack long __tableHandle;
  CreateCaplIFFunction("Send_Proxi", __eTcDef);
  AddIFParameterTestCaseAttribute("TC_ID", "");
  AddIFParameterTestCaseAttribute("Test Case ID", "");
  AddIFParameterChar(syspar::`VehicleProxy9);
  CallInterfaceFunction(__cEmpty , "", __cEmpty );
}

void Tto7tsimc_Tet_TsCall12()
{
  stack long __tableHandle;
  CreateTTEIFFunction("Tto7tsimc_HMI_View_Switch", __eTsDef, __eLocal);
  CallInterfaceFunction(__cEmpty , __cEmpty, __cEmpty );
}

