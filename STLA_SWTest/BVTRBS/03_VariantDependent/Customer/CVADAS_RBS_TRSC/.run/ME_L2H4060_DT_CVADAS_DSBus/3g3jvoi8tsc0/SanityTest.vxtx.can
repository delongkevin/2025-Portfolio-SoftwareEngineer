/* !Encoding: 65001  */
includes
{
  #include "__DiagLibrary.cin"
  #include "__VariablesLib.cin"
  #include "__CaplGeneratorLib.cin"
  #include "__CANoeReportFuntionsLib.cin"
}

variables
{
  // Global variables defined within this CAPL file
  int64 __tt2cnt_1;
  int64 __tt2cnt_3;
  int64 __tt2cnt_5;
  int64 __tt2cnt_7;
  int64 __tt2cnt_9;
  int64 __tt2cnt_11;
  int64 __tt2cnt_13;
  int64 __tt2cnt_15;
  int64 __tt2cnt_17;
  int64 __tt2cnt_19;
  int64 __tt2cnt_21;
  int64 __tt2cnt_23;
  int64 __tt2cnt_25;
  int64 __tt2cnt_27;
  int64 __tt2cnt_29;
  int64 __tt2cnt_31;
  int64 __tt2cnt_33;
  int64 __tt2cnt_35;
  int64 __tt2cnt_37;
  int64 __tt2cnt_39;
  int64 __tt2cnt_41;
  int64 __tt2cnt_43;
  int64 __tt2cnt_45;
  int64 __tt2cnt_47;
  int64 __tt2cnt_49;
  int64 __tt2cnt_51;
}

void Tt4h42sqi_General_Precondition()
{
  stack long __tableHandle;
  TestCommandBegin(__eWait, __cWait, "", "0");
  {
    Wait("1", (1000 * 1000000LL), 1000000, "");
  }
  TestCommandEnd();

  TestCommandBegin(__eWait, __cWait, "", "2");
  {
    Wait("1", (2000 * 1000000LL), 1000000, "");
  }
  TestCommandEnd();

  TestCommandBegin(__eWait, __cWait, "", "4");
  {
    Wait("1", (2500 * 1000000LL), 1000000, "");
  }
  TestCommandEnd();

  TestCommandBegin(__eSet, __cSet, "", "20");
  {
    __tableHandle = ReportTableHead3Columns(__cSetCaption , __cTSym, __cTOp, __cAssigned); 
    {
      @`MEnv_Default_SET_BOL_1 = 0;
      snprintf(__cArray, 8192, "%s", "MEnv_Default_SET_BOL_1");
      snprintf(__cArray2, 8192, "%s '%s'", __cEnvVar, __cArray);
      snprintf(__cArray3, 8192, "%s", "");
      
      ReportTableRow(__tableHandle, 0, __cArray2, __cAOp, 0, __cArray3, __oneOfFlag, __bSetInCheckAlignment);
      
  
    }
    ReportTableEndTestStep(__tableHandle, "1");
  }
  TestCommandEnd();


  TestCommandBegin(__eWait, __cWait, "", "21");
  {
    Wait("1", (1000 * 1000000LL), 1000000, "");
  }
  TestCommandEnd();

  TestCommandBegin(__eSet, __cSet, "", "22");
  {
    __tableHandle = ReportTableHead3Columns(__cSetCaption , __cTSym, __cTOp, __cAssigned); 
    {
      @`MEnv_Default_SET_BOL_1 = 1;
      snprintf(__cArray, 8192, "%s", "MEnv_Default_SET_BOL_1");
      snprintf(__cArray2, 8192, "%s '%s'", __cEnvVar, __cArray);
      snprintf(__cArray3, 8192, "%s", "");
      
      ReportTableRow(__tableHandle, 0, __cArray2, __cAOp, 1, __cArray3, __oneOfFlag, __bSetInCheckAlignment);
      
  
    }
    ReportTableEndTestStep(__tableHandle, "1");
  }
  TestCommandEnd();


  TestCommandBegin(__eWait, __cWait, "", "23");
  {
    Wait("1", (1000 * 1000000LL), 1000000, "");
  }
  TestCommandEnd();

  TestCommandBegin(__eWait, __cWait, "", "25");
  {
    Wait("1", (1000 * 1000000LL), 1000000, "");
  }
  TestCommandEnd();

  TestCommandBegin(__eSet, __cSet, "", "37");
  {
    __tableHandle = ReportTableHead3Columns(__cSetCaption , __cTSym, __cTOp, __cAssigned); 
    {
      $`FDCAN2::dbNode::`BCM::`BRAKE_FD_2::`VehicleSpeedVSOSig.phys = 0;
      snprintf(__cArray, 8192, "%s", "BCM::BRAKE_FD_2::VehicleSpeedVSOSig");
      snprintf(__cArray2, 8192, "%s '%s'", __cCANSignal, __cArray);
      snprintf(__cArray3, 8192, "%s", "");
      
      ReportSetLValueOrSignalNotOnline(getSignalTime(`FDCAN2::dbNode::`BCM::`BRAKE_FD_2::`VehicleSpeedVSOSig), __cArray2, __cArray4, 8192);
      ReportTableRow(__tableHandle, 0, __cArray4, __cAOp, 0, __cArray3, __oneOfFlag, __bSetInCheckAlignment);
      
  
    }
    ReportTableEndTestStep(__tableHandle, "1");
  }
  TestCommandEnd();


  TestCommandBegin(__eWait, __cWait, "", "38");
  {
    Wait("1", (1000 * 1000000LL), 1000000, "");
  }
  TestCommandEnd();

  {
    CreateCaplIFFunction("stopTesterPresent", __eTestFct);
    CallInterfaceFunction("stopTesterPresent ()", __cEmpty, "39");
  }


  TestCommandBegin(__eWait, __cWait, "", "40");
  {
    Wait("1", (1000 * 1000000LL), 1000000, "");
  }
  TestCommandEnd();

  TestCommandBegin(__eDiagService, __cDiagService, "", "41");
  {
    if (DiagIsFunctionalGroup("CVADAS_0001_00000000_000"))
    {
      DiagResponse * __resp;
      DiagRequest CVADAS_0001_00000000_000.Default_Session_Start __req;
      __diagService4h42sqi_0(__req, __resp);
    }
    else
    {
      DiagResponse CVADAS_0001_00000000_000.* __resp;
      DiagRequest CVADAS_0001_00000000_000.Default_Session_Start __req;
      __diagService4h42sqi_0(__req, __resp);
    }
  }
  TestCommandEnd();


  TestCommandBegin(__eWait, __cWait, "", "42");
  {
    Wait("1", (1000 * 1000000LL), 1000000, "");
  }
  TestCommandEnd();

  TestCommandBegin(__eDiagService, __cDiagService, "", "43");
  {
    if (DiagIsFunctionalGroup("CVADAS_0001_00000000_000"))
    {
      DiagResponse * __resp;
      DiagRequest CVADAS_0001_00000000_000.FaultMemory_Clear __req;
      __diagService4h42sqi_1(__req, __resp);
    }
    else
    {
      DiagResponse CVADAS_0001_00000000_000.* __resp;
      DiagRequest CVADAS_0001_00000000_000.FaultMemory_Clear __req;
      __diagService4h42sqi_1(__req, __resp);
    }
  }
  TestCommandEnd();


  TestCommandBegin(__eWait, __cWait, "", "44");
  {
    Wait("1", (1000 * 1000000LL), 1000000, "");
  }
  TestCommandEnd();

  TestCommandBegin(__eDiagService, __cDiagService, "", "45");
  {
    if (DiagIsFunctionalGroup("CVADAS_0001_00000000_000"))
    {
      DiagResponse * __resp;
      DiagRequest CVADAS_0001_00000000_000.FaultMemory_ReadAllIdentified __req;
      __diagService4h42sqi_2(__req, __resp);
    }
    else
    {
      DiagResponse CVADAS_0001_00000000_000.* __resp;
      DiagRequest CVADAS_0001_00000000_000.FaultMemory_ReadAllIdentified __req;
      __diagService4h42sqi_2(__req, __resp);
    }
  }
  TestCommandEnd();


}

  
void __diagService4h42sqi_0(DiagRequest * __req, DiagResponse * __resp )
{
  stack long __tableHandle;
  long __res, __paramLen, __bytePos;

   __bVerdict = __eVerdictPass;

  do {
    TestReportResetDiagObjectList();
    DiagSetReportDetailLevel("CVADAS_0001_00000000_000", EnumServiceDetails_onfail);
    // Request aspect
    {
      {
        {
          byte __bArray[1] = { 0x01 };
          __bArrayCtr = elCount(__bArray);
          __bDiagValueArrayCtr = __CopyBytes(__bArray, __bArrayCtr, __bDiagValueArray);
        }
      
        __res = DiagSetParameterErrorHandled(__req, "DiagSessionType", __bDiagValueArray, __bDiagValueArrayCtr);
        if(__res < 0)
        {
          __bVerdict = __eVerdictFail;
          DiagErrCodeTestStep(__res, "Cannot set diagnostic parameter 'DiagSessionType'");
          break;
        }
      }

      if (0 >= DiagSendReqAndWaitForResp("CVADAS_0001_00000000_000", __req, __resp, __res, -1, -1, -1, -1, -1, EnumResult_pos, EnumServiceDetails_onfail, EnumSendingMode_physical, EnumSuppressPosResBit_asconfigured, EnumVerdictOnInvalidValues_fail))
        break;
    }

    __res = DiagErrCodeTestStep(__res, "Can't retrieve last response for request! No check possible.") < 0;
    if(__res)
    {
	  __bVerdict = __eVerdictFail;
      break;
    }
    {
      __res = DiagInterpretAs(__resp, "DSC_PR");
      if(__res != 0)
      {
        __bVerdict = __eVerdictFail;
        DiagErrCodeTestStep(__res, "Can't interpret response as diagnostic primitive 'DSC_PR'.");
        break;
      }
      else
      {
        TestStepPass( "Received primitive can be interpreted as diagnostic primitive 'DSC_PR'.");
      }
    }
  }
  while(0);


  // Response, check & read aspect
  {
    __res = 1;
    __tableHandle = ReportTableHead5Columns(__cCheckCaption, __cTSym, __cTOp, __cRefVal, __cActual, __cRes);
    {
      __bDiagValueArrayCtr = DiagGetParameterErrorHandled(__resp, "DiagSessionType", __bDiagValueArray, elcount(__bDiagValueArray), __cDiagValueArray, elcount(__cDiagValueArray));
      {
        byte __bArray2[1] = { 0x01 };
        __bArrayCtr = __CopyBytes(__bDiagValueArray, __bDiagValueArrayCtr, __bArray);
        __bArrayCtr2 = elCount(__bArray2);
        __csr = CompareBytes(__bArray, __bArrayCtr, __bArray2, __bArrayCtr2) == 0;
        snprintf(__cArray, 8192, "%s", "Diagnostic parameter \'DiagSessionType\'");
        snprintf(__cArray2, 8192, "%s", __cArray);
        snprintf(__cArray3, 8192, "%s", "");
        ReportTableRow(__tableHandle, 0, __cArray2, "Bytes", __bArray2, __bArrayCtr2, __cArray3, __oneOfFlag, __bSetInCheckAlignment);
        ReportCell(__tableHandle, __bArray, __bArrayCtr);
        ReportCellResult(__tableHandle, __csr, __ePassFail);
      }
    
      __res = __res && __csr;
    
    }
    ReportTableEndVerdict(__tableHandle, __cEvaluateResponse, __res);
	__bVerdict = __bVerdict && __res;
  }
  if (__bVerdict == __eVerdictFail)
    TestReportWriteDiagObjectList();
}
  
void __diagService4h42sqi_1(DiagRequest * __req, DiagResponse * __resp )
{
  stack long __tableHandle;
  long __res, __paramLen, __bytePos;

   __bVerdict = __eVerdictPass;

  do {
    TestReportResetDiagObjectList();
    DiagSetReportDetailLevel("CVADAS_0001_00000000_000", EnumServiceDetails_onfail);
    // Request aspect
    {
      {
        CheckLiteralGetStringBufferConsistency("FFFFFF", 8192);
      snprintf(__cDiagValueArray, 8192, "%s", "FFFFFF");
        __bDiagValueArrayCtr = __MapChar2ByteAtDiagSet(__cDiagValueArray, __bDiagValueArray);
        if (__bDiagValueArrayCtr >= 0)
        {
          __res = DiagSetParameterErrorHandled(__req, "GroupOfDtc", __bDiagValueArray, __bDiagValueArrayCtr);
          if(__res < 0)
          {
            __bVerdict = __eVerdictFail;
            DiagErrCodeTestStep(__res, "Cannot set diagnostic parameter 'GroupOfDtc'");
            break;
          }
        }
        else
        {
      	__bVerdict = __eVerdictFail;
          snprintf(__cArray2, 8192, "SetParameter: illegal byte sequence: '%s' (parameter %s). Use hex tuples like '01 AF ...'", __cDiagValueArray, "GroupOfDtc");
          DiagErrCodeTestStep(__bDiagValueArrayCtr, __cArray2);
          DiagErrCodeTestStep(-1, "Cannot set diagnostic parameter 'GroupOfDtc'");
      	break;
        }
      }

      if (0 >= DiagSendReqAndWaitForResp("CVADAS_0001_00000000_000", __req, __resp, __res, -1, -1, -1, -1, -1, EnumResult_pos, EnumServiceDetails_onfail, EnumSendingMode_physical, EnumSuppressPosResBit_asconfigured, EnumVerdictOnInvalidValues_fail))
        break;
    }

    __res = DiagErrCodeTestStep(__res, "Can't retrieve last response for request! No check possible.") < 0;
    if(__res)
    {
	  __bVerdict = __eVerdictFail;
      break;
    }
    {
      __res = DiagInterpretAs(__resp, "CDI_PR");
      if(__res != 0)
      {
        __bVerdict = __eVerdictFail;
        DiagErrCodeTestStep(__res, "Can't interpret response as diagnostic primitive 'CDI_PR'.");
        break;
      }
      else
      {
        TestStepPass( "Received primitive can be interpreted as diagnostic primitive 'CDI_PR'.");
      }
    }
  }
  while(0);


  if (__bVerdict == __eVerdictFail)
    TestReportWriteDiagObjectList();
}
  
void __diagService4h42sqi_2(DiagRequest * __req, DiagResponse * __resp )
{
  stack long __tableHandle;
  long __res, __paramLen, __bytePos;

   __bVerdict = __eVerdictPass;

  do {
    TestReportResetDiagObjectList();
    DiagSetReportDetailLevel("CVADAS_0001_00000000_000", EnumServiceDetails_onfail);
    // Request aspect
    {
      {
        {
          byte __bArray[1] = { 0x02 };
          __bArrayCtr = elCount(__bArray);
          __bDiagValueArrayCtr = __CopyBytes(__bArray, __bArrayCtr, __bDiagValueArray);
        }
      
        __res = DiagSetParameterErrorHandled(__req, "ReportDtcByStatusMask", __bDiagValueArray, __bDiagValueArrayCtr);
        if(__res < 0)
        {
          __bVerdict = __eVerdictFail;
          DiagErrCodeTestStep(__res, "Cannot set diagnostic parameter 'ReportDtcByStatusMask'");
          break;
        }
      }
      {
        {
          byte __bArray[1] = { 0x09 };
          __bArrayCtr = elCount(__bArray);
          __bDiagValueArrayCtr = __CopyBytes(__bArray, __bArrayCtr, __bDiagValueArray);
        }
      
        __res = DiagSetParameterErrorHandled(__req, "DTCStatusMask", __bDiagValueArray, __bDiagValueArrayCtr);
        if(__res < 0)
        {
          __bVerdict = __eVerdictFail;
          DiagErrCodeTestStep(__res, "Cannot set diagnostic parameter 'DTCStatusMask'");
          break;
        }
      }

      if (0 >= DiagSendReqAndWaitForResp("CVADAS_0001_00000000_000", __req, __resp, __res, -1, -1, -1, -1, -1, EnumResult_pos, EnumServiceDetails_onfail, EnumSendingMode_physical, EnumSuppressPosResBit_asconfigured, EnumVerdictOnInvalidValues_fail))
        break;
    }

    __res = DiagErrCodeTestStep(__res, "Can't retrieve last response for request! No check possible.") < 0;
    if(__res)
    {
	  __bVerdict = __eVerdictFail;
      break;
    }
    {
      __res = DiagInterpretAs(__resp, "RDI_RDTCBSM_PR");
      if(__res != 0)
      {
        __bVerdict = __eVerdictFail;
        DiagErrCodeTestStep(__res, "Can't interpret response as diagnostic primitive 'RDI_RDTCBSM_PR'.");
        break;
      }
      else
      {
        TestStepPass( "Received primitive can be interpreted as diagnostic primitive 'RDI_RDTCBSM_PR'.");
      }
    }
  }
  while(0);


  // Response, check & read aspect
  {
    __res = 1;
    __tableHandle = ReportTableHead5Columns(__cCheckCaption, __cTSym, __cTOp, __cRefVal, __cActual, __cRes);
    {
      __bDiagValueArrayCtr = DiagGetParameterErrorHandled(__resp, "ReportDtcByStatusMask", __bDiagValueArray, elcount(__bDiagValueArray), __cDiagValueArray, elcount(__cDiagValueArray));
      {
        byte __bArray2[1] = { 0x02 };
        __bArrayCtr = __CopyBytes(__bDiagValueArray, __bDiagValueArrayCtr, __bArray);
        __bArrayCtr2 = elCount(__bArray2);
        __csr = CompareBytes(__bArray, __bArrayCtr, __bArray2, __bArrayCtr2) == 0;
        snprintf(__cArray, 8192, "%s", "Diagnostic parameter \'ReportDtcByStatusMask\'");
        snprintf(__cArray2, 8192, "%s", __cArray);
        snprintf(__cArray3, 8192, "%s", "");
        ReportTableRow(__tableHandle, 0, __cArray2, "Bytes", __bArray2, __bArrayCtr2, __cArray3, __oneOfFlag, __bSetInCheckAlignment);
        ReportCell(__tableHandle, __bArray, __bArrayCtr);
        ReportCellResult(__tableHandle, __csr, __ePassFail);
      }
    
      __res = __res && __csr;
    
    }
    {
      __bDiagValueArrayCtr = DiagGetParameterErrorHandled(__resp, "DtcAvailabilityMask", __bDiagValueArray, elcount(__bDiagValueArray), __cDiagValueArray, elcount(__cDiagValueArray));
      {
        byte __bArray2[1] = { 0x7F };
        __bArrayCtr = __CopyBytes(__bDiagValueArray, __bDiagValueArrayCtr, __bArray);
        __bArrayCtr2 = elCount(__bArray2);
        __csr = CompareBytes(__bArray, __bArrayCtr, __bArray2, __bArrayCtr2) == 0;
        snprintf(__cArray, 8192, "%s", "Diagnostic parameter \'DtcAvailabilityMask\'");
        snprintf(__cArray2, 8192, "%s", __cArray);
        snprintf(__cArray3, 8192, "%s", "");
        ReportTableRow(__tableHandle, 0, __cArray2, "Bytes", __bArray2, __bArrayCtr2, __cArray3, __oneOfFlag, __bSetInCheckAlignment);
        ReportCell(__tableHandle, __bArray, __bArrayCtr);
        ReportCellResult(__tableHandle, __csr, __ePassFail);
      }
    
      __res = __res && __csr;
    
    }
    ReportTableEndVerdict(__tableHandle, __cEvaluateResponse, __res);
	__bVerdict = __bVerdict && __res;
  }
  if (__bVerdict == __eVerdictFail)
    TestReportWriteDiagObjectList();
}

void Tt4h42sqi_HMI_General_Precondition()
{
  stack long __tableHandle;
  TestCommandBegin(__eWait, __cWait, "", "0");
  {
    Wait("1", (50 * 1000000LL), 1000000, "");
  }
  TestCommandEnd();

  TestCommandBegin(__eWait, __cWait, "", "2");
  {
    Wait("1", (1000 * 1000000LL), 1000000, "");
  }
  TestCommandEnd();

  TestCommandBegin(__eWait, __cWait, "", "4");
  {
    Wait("1", (2500 * 1000000LL), 1000000, "");
  }
  TestCommandEnd();

  TestCommandBegin(__eSet, __cSet, "", "5");
  {
    __tableHandle = ReportTableHead3Columns(__cSetCaption , __cTSym, __cTOp, __cAssigned); 
    {
      $`FDCAN2::dbNode::`BCM::`TRANSM_FD_4::`ShiftLeverPosition.phys = 1;
      snprintf(__cArray, 8192, "%s", "ShiftLeverPosition");
      snprintf(__cArray2, 8192, "%s '%s'", __cCANSignal, __cArray);
      snprintf(__cArray3, 8192, "%s", "");
      
      ReportSetLValueOrSignalNotOnline(getSignalTime(`FDCAN2::dbNode::`BCM::`TRANSM_FD_4::`ShiftLeverPosition), __cArray2, __cArray4, 8192);
      ReportTableRow(__tableHandle, 0, __cArray4, __cAOp, 1, __cArray3, __oneOfFlag, __bSetInCheckAlignment);
      
  
    }
    ReportTableEndTestStep(__tableHandle, "1");
  }
  TestCommandEnd();


  TestCommandBegin(__eSet, __cSet, "", "6");
  {
    __tableHandle = ReportTableHead3Columns(__cSetCaption , __cTSym, __cTOp, __cAssigned); 
    {
      $`FDCAN2::dbNode::`SGW::`TELEMATIC_FD_5::`CameraDisplaySts2.phys = 0;
      snprintf(__cArray, 8192, "%s", "CameraDisplaySts2");
      snprintf(__cArray2, 8192, "%s '%s'", __cCANSignal, __cArray);
      snprintf(__cArray3, 8192, "%s", "");
      
      ReportSetLValueOrSignalNotOnline(getSignalTime(`FDCAN2::dbNode::`SGW::`TELEMATIC_FD_5::`CameraDisplaySts2), __cArray2, __cArray4, 8192);
      ReportTableRow(__tableHandle, 0, __cArray4, __cAOp, 0, __cArray3, __oneOfFlag, __bSetInCheckAlignment);
      
  
    }
    ReportTableEndTestStep(__tableHandle, "1");
  }
  TestCommandEnd();


  TestCommandBegin(__eWait, __cWait, "", "7");
  {
    Wait("1", (3 * 1000000000LL), 1000000000, "");
  }
  TestCommandEnd();

  TestCommandBegin(__eWait, __cWait, "", "9");
  {
    Wait("1", (2500 * 1000000LL), 1000000, "");
  }
  TestCommandEnd();

  TestCommandBegin(__eSet, __cSet, "", "10");
  {
    __tableHandle = ReportTableHead3Columns(__cSetCaption , __cTSym, __cTOp, __cAssigned); 
    {
      $`FDCAN2::dbNode::`BCM::`TRANSM_FD_4::`ShiftLeverPosition.phys = 2;
      snprintf(__cArray, 8192, "%s", "ShiftLeverPosition");
      snprintf(__cArray2, 8192, "%s '%s'", __cCANSignal, __cArray);
      snprintf(__cArray3, 8192, "%s", "");
      
      ReportSetLValueOrSignalNotOnline(getSignalTime(`FDCAN2::dbNode::`BCM::`TRANSM_FD_4::`ShiftLeverPosition), __cArray2, __cArray4, 8192);
      ReportTableRow(__tableHandle, 0, __cArray4, __cAOp, 2, __cArray3, __oneOfFlag, __bSetInCheckAlignment);
      
  
    }
    ReportTableEndTestStep(__tableHandle, "1");
  }
  TestCommandEnd();


  TestCommandBegin(__eWait, __cWait, "", "11");
  {
    Wait("1", (500 * 1000000LL), 1000000, "");
  }
  TestCommandEnd();

  TestCommandBegin(__eSet, __cSet, "", "12");
  {
    __tableHandle = ReportTableHead3Columns(__cSetCaption , __cTSym, __cTOp, __cAssigned); 
    {
      $`FDCAN2::dbNode::`SGW::`TELEMATIC_FD_14::`TGW_CAMERA_DISP_STAT.phys = 0;
      snprintf(__cArray, 8192, "%s", "TGW_CAMERA_DISP_STAT");
      snprintf(__cArray2, 8192, "%s '%s'", __cCANSignal, __cArray);
      snprintf(__cArray3, 8192, "%s", "");
      
      ReportSetLValueOrSignalNotOnline(getSignalTime(`FDCAN2::dbNode::`SGW::`TELEMATIC_FD_14::`TGW_CAMERA_DISP_STAT), __cArray2, __cArray4, 8192);
      ReportTableRow(__tableHandle, 0, __cArray4, __cAOp, 0, __cArray3, __oneOfFlag, __bSetInCheckAlignment);
      
  
    }
    ReportTableEndTestStep(__tableHandle, "1");
  }
  TestCommandEnd();


  TestCommandBegin(__eWait, __cWait, "", "13");
  {
    Wait("1", (500 * 1000000LL), 1000000, "");
  }
  TestCommandEnd();

  TestCommandBegin(__eSet, __cSet, "", "14");
  {
    __tableHandle = ReportTableHead3Columns(__cSetCaption , __cTSym, __cTOp, __cAssigned); 
    {
      $`FDCAN2::dbNode::`SGW::`TELEMATIC_FD_5::`CameraDisplaySts2.phys = 0;
      snprintf(__cArray, 8192, "%s", "CameraDisplaySts2");
      snprintf(__cArray2, 8192, "%s '%s'", __cCANSignal, __cArray);
      snprintf(__cArray3, 8192, "%s", "");
      
      ReportSetLValueOrSignalNotOnline(getSignalTime(`FDCAN2::dbNode::`SGW::`TELEMATIC_FD_5::`CameraDisplaySts2), __cArray2, __cArray4, 8192);
      ReportTableRow(__tableHandle, 0, __cArray4, __cAOp, 0, __cArray3, __oneOfFlag, __bSetInCheckAlignment);
      
  
    }
    ReportTableEndTestStep(__tableHandle, "1");
  }
  TestCommandEnd();


  TestCommandBegin(__eWait, __cWait, "", "15");
  {
    Wait("1", (500 * 1000000LL), 1000000, "");
  }
  TestCommandEnd();

  TestCommandBegin(__eSet, __cSet, "", "16");
  {
    __tableHandle = ReportTableHead3Columns(__cSetCaption , __cTSym, __cTOp, __cAssigned); 
    {
      $`FDCAN2::dbNode::`BCM::`BRAKE_FD_2::`VehicleSpeedVSOSig.phys = 0;
      snprintf(__cArray, 8192, "%s", "BCM::BRAKE_FD_2::VehicleSpeedVSOSig");
      snprintf(__cArray2, 8192, "%s '%s'", __cCANSignal, __cArray);
      snprintf(__cArray3, 8192, "%s", "");
      
      ReportSetLValueOrSignalNotOnline(getSignalTime(`FDCAN2::dbNode::`BCM::`BRAKE_FD_2::`VehicleSpeedVSOSig), __cArray2, __cArray4, 8192);
      ReportTableRow(__tableHandle, 0, __cArray4, __cAOp, 0, __cArray3, __oneOfFlag, __bSetInCheckAlignment);
      
  
    }
    ReportTableEndTestStep(__tableHandle, "1");
  }
  TestCommandEnd();


  TestCommandBegin(__eWait, __cWait, "", "17");
  {
    Wait("1", (500 * 1000000LL), 1000000, "");
  }
  TestCommandEnd();

  TestCommandBegin(__eWait, __cWait, "", "18");
  {
    Wait("1", (500 * 1000000LL), 1000000, "");
  }
  TestCommandEnd();

  TestCommandBegin(__eSet, __cSet, "", "19");
  {
    __tableHandle = ReportTableHead3Columns(__cSetCaption , __cTSym, __cTOp, __cAssigned); 
    {
      $`FDCAN2::dbNode::`BCM::`TRANSM_FD_4::`ShiftLeverPosition.phys = 2;
      snprintf(__cArray, 8192, "%s", "ShiftLeverPosition");
      snprintf(__cArray2, 8192, "%s '%s'", __cCANSignal, __cArray);
      snprintf(__cArray3, 8192, "%s", "");
      
      ReportSetLValueOrSignalNotOnline(getSignalTime(`FDCAN2::dbNode::`BCM::`TRANSM_FD_4::`ShiftLeverPosition), __cArray2, __cArray4, 8192);
      ReportTableRow(__tableHandle, 0, __cArray4, __cAOp, 2, __cArray3, __oneOfFlag, __bSetInCheckAlignment);
      
  
    }
    ReportTableEndTestStep(__tableHandle, "1");
  }
  TestCommandEnd();


  TestCommandBegin(__eWait, __cWait, "", "20");
  {
    Wait("1", (6000 * 1000000LL), 1000000, "");
  }
  TestCommandEnd();

}

void Tt4h42sqi_General_Precondition_For_BootLoader()
{
  stack long __tableHandle;
  TestCommandBegin(__eWait, __cWait, "", "0");
  {
    Wait("1", (1000 * 1000000LL), 1000000, "");
  }
  TestCommandEnd();

  TestCommandBegin(__eWait, __cWait, "", "2");
  {
    Wait("1", (1000 * 1000000LL), 1000000, "");
  }
  TestCommandEnd();

  TestCommandBegin(__eWait, __cWait, "", "4");
  {
    Wait("1", (2500 * 1000000LL), 1000000, "");
  }
  TestCommandEnd();

  {
    CreateCaplIFFunction("startTesterPresent", __eTestFct);
    CallInterfaceFunction("startTesterPresent ()", __cEmpty, "5");
  }


  TestCommandBegin(__eWait, __cWait, "", "9");
  {
    Wait("1", (2500 * 1000000LL), 1000000, "");
  }
  TestCommandEnd();

  TestCommandBegin(__eDiagService, __cDiagService, "", "10");
  {
    if (DiagIsFunctionalGroup("CVADAS_0001_00000000_000"))
    {
      DiagResponse * __resp;
      DiagRequest CVADAS_0001_00000000_000.Default_Session_Start __req;
      __diagService4h42sqi_3(__req, __resp);
    }
    else
    {
      DiagResponse CVADAS_0001_00000000_000.* __resp;
      DiagRequest CVADAS_0001_00000000_000.Default_Session_Start __req;
      __diagService4h42sqi_3(__req, __resp);
    }
  }
  TestCommandEnd();


  TestCommandBegin(__eWait, __cWait, "", "11");
  {
    Wait("1", (2000 * 1000000LL), 1000000, "");
  }
  TestCommandEnd();

  {
    CreateCaplIFFunction("stopTesterPresent", __eTestFct);
    CallInterfaceFunction("stopTesterPresent ()", __cEmpty, "12");
  }


  TestCommandBegin(__eWait, __cWait, "", "13");
  {
    Wait("1", (1000 * 1000000LL), 1000000, "");
  }
  TestCommandEnd();

}

  
void __diagService4h42sqi_3(DiagRequest * __req, DiagResponse * __resp )
{
  stack long __tableHandle;
  long __res, __paramLen, __bytePos;

   __bVerdict = __eVerdictPass;

  do {
    TestReportResetDiagObjectList();
    DiagSetReportDetailLevel("CVADAS_0001_00000000_000", EnumServiceDetails_onfail);
    // Request aspect
    {
      {
        {
          byte __bArray[1] = { 0x01 };
          __bArrayCtr = elCount(__bArray);
          __bDiagValueArrayCtr = __CopyBytes(__bArray, __bArrayCtr, __bDiagValueArray);
        }
      
        __res = DiagSetParameterErrorHandled(__req, "DiagSessionType", __bDiagValueArray, __bDiagValueArrayCtr);
        if(__res < 0)
        {
          __bVerdict = __eVerdictFail;
          DiagErrCodeTestStep(__res, "Cannot set diagnostic parameter 'DiagSessionType'");
          break;
        }
      }

      if (0 >= DiagSendReqAndWaitForResp("CVADAS_0001_00000000_000", __req, __resp, __res, -1, -1, -1, -1, -1, EnumResult_pos, EnumServiceDetails_onfail, EnumSendingMode_physical, EnumSuppressPosResBit_asconfigured, EnumVerdictOnInvalidValues_fail))
        break;
    }

    __res = DiagErrCodeTestStep(__res, "Can't retrieve last response for request! No check possible.") < 0;
    if(__res)
    {
	  __bVerdict = __eVerdictFail;
      break;
    }
    {
      __res = DiagInterpretAs(__resp, "DSC_PR");
      if(__res != 0)
      {
        __bVerdict = __eVerdictFail;
        DiagErrCodeTestStep(__res, "Can't interpret response as diagnostic primitive 'DSC_PR'.");
        break;
      }
      else
      {
        TestStepPass( "Received primitive can be interpreted as diagnostic primitive 'DSC_PR'.");
      }
    }
  }
  while(0);


  // Response, check & read aspect
  {
    __res = 1;
    __tableHandle = ReportTableHead5Columns(__cCheckCaption, __cTSym, __cTOp, __cRefVal, __cActual, __cRes);
    {
      __bDiagValueArrayCtr = DiagGetParameterErrorHandled(__resp, "DiagSessionType", __bDiagValueArray, elcount(__bDiagValueArray), __cDiagValueArray, elcount(__cDiagValueArray));
      {
        byte __bArray2[1] = { 0x01 };
        __bArrayCtr = __CopyBytes(__bDiagValueArray, __bDiagValueArrayCtr, __bArray);
        __bArrayCtr2 = elCount(__bArray2);
        __csr = CompareBytes(__bArray, __bArrayCtr, __bArray2, __bArrayCtr2) == 0;
        snprintf(__cArray, 8192, "%s", "Diagnostic parameter \'DiagSessionType\'");
        snprintf(__cArray2, 8192, "%s", __cArray);
        snprintf(__cArray3, 8192, "%s", "");
        ReportTableRow(__tableHandle, 0, __cArray2, "Bytes", __bArray2, __bArrayCtr2, __cArray3, __oneOfFlag, __bSetInCheckAlignment);
        ReportCell(__tableHandle, __bArray, __bArrayCtr);
        ReportCellResult(__tableHandle, __csr, __ePassFail);
      }
    
      __res = __res && __csr;
    
    }
    ReportTableEndVerdict(__tableHandle, __cEvaluateResponse, __res);
	__bVerdict = __bVerdict && __res;
  }
  if (__bVerdict == __eVerdictFail)
    TestReportWriteDiagObjectList();
}

void Tt4h42sqi_General_Postconditions()
{
  stack long __tableHandle;
  TestCommandBegin(__eSet, __cSet, "", "0");
  {
    __tableHandle = ReportTableHead3Columns(__cSetCaption , __cTSym, __cTOp, __cAssigned); 
    {
      @`MEnv_Default_SET_BOL_1 = 0;
      snprintf(__cArray, 8192, "%s", "MEnv_Default_SET_BOL_1");
      snprintf(__cArray2, 8192, "%s '%s'", __cEnvVar, __cArray);
      snprintf(__cArray3, 8192, "%s", "");
      
      ReportTableRow(__tableHandle, 0, __cArray2, __cAOp, 0, __cArray3, __oneOfFlag, __bSetInCheckAlignment);
      
  
    }
    ReportTableEndTestStep(__tableHandle, "1");
  }
  TestCommandEnd();


  TestCommandBegin(__eWait, __cWait, "", "1");
  {
    Wait("1", (200 * 1000000LL), 1000000, "");
  }
  TestCommandEnd();

  TestCommandBegin(__eWait, __cWait, "", "3");
  {
    Wait("1", (1000 * 1000000LL), 1000000, "");
  }
  TestCommandEnd();

}

void Tt4h42sqi_Default_Session_Standard_Physical_Address()
{
  stack long __tableHandle;
  TestCommandBegin(__eRequestResponse, __cRequestResponse, "", "0");
  {
    message `FDCAN2::`DIAGNOSTIC_RESPONSE_PAM __tt2msg_0;
  
    long __res;
    int64 __timeout;
    __res = 0;
    __nInt64 = 1;
    __timeout = syspar::`P2_Server * 1000000LL;
    {
    
      long __testStepInitOk;
      message `FDCAN2::`DIAGNOSTIC_REQUEST_PAM __output;
      message `FDCAN2::`DIAGNOSTIC_REQUEST_PAM __msgOrig;
      __output = __msgOrig;
      __testStepInitOk = 1;
      {
        int64 __dlc;
        __dlc = 3;
        if (__dlc >= 0 && __dlc <= (__output.EDL ? 15 : 8))
          __output.DLC = __dlc;
        else
        {
          testStepErrorInTestSystem(0, __cEmpty, "Unable to set DLC=%lld in message. Please check input parameter.", __dlc);
          __testStepInitOk = 0;
        }
      }
      if (__testStepInitOk)
      {
        snprintf(__cArray, elCount(__cArray), "CAN message '%s' ID = 416981233x (0x18DAA0F1x) on bus FDCAN2", "DIAGNOSTIC_REQUEST_PAM");
        snprintf(__cArray2, elCount(__cArray2), "Send %s", __cArray);
        __tableHandle = ReportTableHead3Columns(__cArray2, "Byte", __cTOp, __cAssigned);
        ReportByteIndex("", 0, __cArray, elCount(__cArray));
        snprintf(__cArray2, 8192, "%s", __cArray);
        snprintf(__cArray3, 8192, "%s", "");
        
        ReportTableRow(__tableHandle, 0, __cArray2, __cAOp, 0x2, __cArray3, __oneOfFlag, __bSetInCheckAlignment);
        
        if (0 >= 0 && 0 < 64)
        {
          __output.byte((word)0) = 0x2;
        }
        else
        {
          testStepErrorInTestSystem(0, __cEmpty, "Index out of range. Unable to set byte %lld in message. Please check input parameter.", (int64)0);
          __testStepInitOk = 0;
        }
        ReportByteIndex("", 1, __cArray, elCount(__cArray));
        snprintf(__cArray2, 8192, "%s", __cArray);
        snprintf(__cArray3, 8192, "%s", "");
        
        ReportTableRow(__tableHandle, 0, __cArray2, __cAOp, 0x10, __cArray3, __oneOfFlag, __bSetInCheckAlignment);
        
        if (1 >= 0 && 1 < 64)
        {
          __output.byte((word)1) = 0x10;
        }
        else
        {
          testStepErrorInTestSystem(0, __cEmpty, "Index out of range. Unable to set byte %lld in message. Please check input parameter.", (int64)1);
          __testStepInitOk = 0;
        }
        ReportByteIndex("", 2, __cArray, elCount(__cArray));
        snprintf(__cArray2, 8192, "%s", __cArray);
        snprintf(__cArray3, 8192, "%s", "");
        
        ReportTableRow(__tableHandle, 0, __cArray2, __cAOp, 0x1, __cArray3, __oneOfFlag, __bSetInCheckAlignment);
        
        if (2 >= 0 && 2 < 64)
        {
          __output.byte((word)2) = 0x1;
        }
        else
        {
          testStepErrorInTestSystem(0, __cEmpty, "Index out of range. Unable to set byte %lld in message. Please check input parameter.", (int64)2);
          __testStepInitOk = 0;
        }
      
        ReportTableEndTestStep(__tableHandle, "Req1");
      }
      if (__testStepInitOk)
      {
        output(__output);
      }
    }
    if (__timeout <= 0)
    {
      testStepErrorInTestSystem(0, "1", "Unable to wait for %.3f %s. Please check input parameter.", __timeout / ((float)1000000), "ms");
    }
    else
    {
      if (0 < 0 || 64 <= 0)
      {
        testStepErrorInTestSystem(0, __cEmpty, "Index out of range. Unable to get byte %lld in message.", (int64) 0);
        __nInt64 = 0;
      }
      if (1 < 0 || 64 <= 1)
      {
        testStepErrorInTestSystem(0, __cEmpty, "Index out of range. Unable to get byte %lld in message.", (int64) 1);
        __nInt64 = 0;
      }
      if (2 < 0 || 64 <= 2)
      {
        testStepErrorInTestSystem(0, __cEmpty, "Index out of range. Unable to get byte %lld in message.", (int64) 2);
        __nInt64 = 0;
      }
      if (3 < 0 || 64 <= 3)
      {
        testStepErrorInTestSystem(0, __cEmpty, "Index out of range. Unable to get byte %lld in message.", (int64) 3);
        __nInt64 = 0;
      }
      if (4 < 0 || 64 <= 4)
      {
        testStepErrorInTestSystem(0, __cEmpty, "Index out of range. Unable to get byte %lld in message.", (int64) 4);
        __nInt64 = 0;
      }
      if (5 < 0 || 64 <= 5)
      {
        testStepErrorInTestSystem(0, __cEmpty, "Index out of range. Unable to get byte %lld in message.", (int64) 5);
        __nInt64 = 0;
      }
      if (6 < 0 || 64 <= 6)
      {
        testStepErrorInTestSystem(0, __cEmpty, "Index out of range. Unable to get byte %lld in message.", (int64) 6);
        __nInt64 = 0;
      }
      __tt2cnt_1 = 0;
      snprintf(__cArray, elCount(__cArray), "CAN message '%s' ID = 417001888x (0x18DAF1A0x) on bus FDCAN2", "DIAGNOSTIC_RESPONSE_PAM");
      if(SetBusContextByName("FDCAN2", __eSaveCurrent, __nBusContextNew, __nBusContextOld))
        testJoinMessageEvent(`FDCAN2::`DIAGNOSTIC_RESPONSE_PAM,  __cArray,
             delegate dword(message * __m)
             {
               dword __msg_callback_ret;
               byte __b0;
               byte __b1;
               byte __b2;
               byte __b3;
               byte __b4;
               byte __b5;
               byte __b6;
               if (__tt2cnt_1 == -1)
               {
                 return 1;
               }
               __tt2msg_0 = __m;
               __msg_callback_ret = 1;
               __tt2cnt_1++;
               if (0 < 0 || 64 <= 0) return 0;
               __csr = CheckSignalMatch(__tt2msg_0.byte((word)0), 0x6, "==") == 1;
               __msg_callback_ret &= __csr;
               if (1 < 0 || 64 <= 1) return 0;
               __csr = CheckSignalMatch(__tt2msg_0.byte((word)1), 0x50, "==") == 1;
               __msg_callback_ret &= __csr;
               if (2 < 0 || 64 <= 2) return 0;
               __csr = CheckSignalMatch(__tt2msg_0.byte((word)2), 0x1, "==") == 1;
               __msg_callback_ret &= __csr;
               if (3 < 0 || 64 <= 3) return 0;
               __csr = CheckSignalMatch(__tt2msg_0.byte((word)3), 0x0, "==") == 1;
               __msg_callback_ret &= __csr;
               if (4 < 0 || 64 <= 4) return 0;
               __csr = CheckSignalMatch(__tt2msg_0.byte((word)4), 0x32, "==") == 1;
               __msg_callback_ret &= __csr;
               if (5 < 0 || 64 <= 5) return 0;
               __csr = CheckSignalMatch(__tt2msg_0.byte((word)5), 0x1, "==") == 1;
               __msg_callback_ret &= __csr;
               if (6 < 0 || 64 <= 6) return 0;
               __csr = CheckSignalMatch(__tt2msg_0.byte((word)6), 0xF4, "==") == 1;
               __msg_callback_ret &= __csr;
               if (__msg_callback_ret)
               {
                 __tt2cnt_1 = -1;
                 return 1;
               }
               return 0;
             });
      __res = testWaitForAllJoinedEventsNS(__timeout);
      if (__nInt64 != 0)
      {
        snprintf(__cArray, elCount(__cArray), "CAN message '%s' ID = 417001888x (0x18DAF1A0x) on bus FDCAN2", "DIAGNOSTIC_RESPONSE_PAM");
        if(__tt2cnt_1 == -1)
        {
          snprintf(__cArray2, 8192, "Response of %s", __cArray);
        snprintf(__cArray, 8192, "%s", __cActual);
        }
        else
        {
          snprintf(__cArray2, 8192, "Response of %s (received %d times)", __cArray, __tt2cnt_1);
          snprintf(__cArray, 8192, "Last Received");
        }
        if (__tt2cnt_1 == 0)
        {
          testStepFail(0, "Resp1", __cArray2);
        }
        else
        {
          byte __b0;
          byte __b1;
          byte __b2;
          byte __b3;
          byte __b4;
          byte __b5;
          byte __b6;
          __bVerdict = __eVerdictPass;
          __tableHandle = ReportTableHead5Columns(__cArray2, "Signal/Byte", __cTOp, __cRefVal, __cArray, __cRes);
        __csr = CheckSignalMatch(__tt2msg_0.byte((word)0), 0x6, "==") == 1;
        ReportByteIndex("", 0, __cArray, elCount(__cArray));
        snprintf(__cArray2, 8192, "%s", __cArray);
        snprintf(__cArray3, 8192, "%s", "");
        ReportTableRow(__tableHandle, 0, __cArray2, "==", 0x6, __cArray3, __oneOfFlag, __bSetInCheckAlignment);
        ReportCell(__tableHandle, __tt2msg_0.byte((word)0));
        ReportCellResult(__tableHandle, __csr, __ePassFail);
          __bVerdict &= __csr;
        __csr = CheckSignalMatch(__tt2msg_0.byte((word)1), 0x50, "==") == 1;
        ReportByteIndex("", 1, __cArray, elCount(__cArray));
        snprintf(__cArray2, 8192, "%s", __cArray);
        snprintf(__cArray3, 8192, "%s", "");
        ReportTableRow(__tableHandle, 0, __cArray2, "==", 0x50, __cArray3, __oneOfFlag, __bSetInCheckAlignment);
        ReportCell(__tableHandle, __tt2msg_0.byte((word)1));
        ReportCellResult(__tableHandle, __csr, __ePassFail);
          __bVerdict &= __csr;
        __csr = CheckSignalMatch(__tt2msg_0.byte((word)2), 0x1, "==") == 1;
        ReportByteIndex("", 2, __cArray, elCount(__cArray));
        snprintf(__cArray2, 8192, "%s", __cArray);
        snprintf(__cArray3, 8192, "%s", "");
        ReportTableRow(__tableHandle, 0, __cArray2, "==", 0x1, __cArray3, __oneOfFlag, __bSetInCheckAlignment);
        ReportCell(__tableHandle, __tt2msg_0.byte((word)2));
        ReportCellResult(__tableHandle, __csr, __ePassFail);
          __bVerdict &= __csr;
        __csr = CheckSignalMatch(__tt2msg_0.byte((word)3), 0x0, "==") == 1;
        ReportByteIndex("", 3, __cArray, elCount(__cArray));
        snprintf(__cArray2, 8192, "%s", __cArray);
        snprintf(__cArray3, 8192, "%s", "");
        ReportTableRow(__tableHandle, 0, __cArray2, "==", 0x0, __cArray3, __oneOfFlag, __bSetInCheckAlignment);
        ReportCell(__tableHandle, __tt2msg_0.byte((word)3));
        ReportCellResult(__tableHandle, __csr, __ePassFail);
          __bVerdict &= __csr;
        __csr = CheckSignalMatch(__tt2msg_0.byte((word)4), 0x32, "==") == 1;
        ReportByteIndex("", 4, __cArray, elCount(__cArray));
        snprintf(__cArray2, 8192, "%s", __cArray);
        snprintf(__cArray3, 8192, "%s", "");
        ReportTableRow(__tableHandle, 0, __cArray2, "==", 0x32, __cArray3, __oneOfFlag, __bSetInCheckAlignment);
        ReportCell(__tableHandle, __tt2msg_0.byte((word)4));
        ReportCellResult(__tableHandle, __csr, __ePassFail);
          __bVerdict &= __csr;
        __csr = CheckSignalMatch(__tt2msg_0.byte((word)5), 0x1, "==") == 1;
        ReportByteIndex("", 5, __cArray, elCount(__cArray));
        snprintf(__cArray2, 8192, "%s", __cArray);
        snprintf(__cArray3, 8192, "%s", "");
        ReportTableRow(__tableHandle, 0, __cArray2, "==", 0x1, __cArray3, __oneOfFlag, __bSetInCheckAlignment);
        ReportCell(__tableHandle, __tt2msg_0.byte((word)5));
        ReportCellResult(__tableHandle, __csr, __ePassFail);
          __bVerdict &= __csr;
        __csr = CheckSignalMatch(__tt2msg_0.byte((word)6), 0xF4, "==") == 1;
        ReportByteIndex("", 6, __cArray, elCount(__cArray));
        snprintf(__cArray2, 8192, "%s", __cArray);
        snprintf(__cArray3, 8192, "%s", "");
        ReportTableRow(__tableHandle, 0, __cArray2, "==", 0xF4, __cArray3, __oneOfFlag, __bSetInCheckAlignment);
        ReportCell(__tableHandle, __tt2msg_0.byte((word)6));
        ReportCellResult(__tableHandle, __csr, __ePassFail);
          __bVerdict &= __csr;
          ReportTableEndVerdict(__tableHandle, "Resp1", __bVerdict);
        }
        __ReportRequestResponseResult(__res, 0);
      }
      ResetBusContext(__nBusContextNew, __nBusContextOld);
    }
  }
  TestCommandEnd();

}

void Tt4h42sqi_Extended_Session_Standard_Physical_Address()
{
  stack long __tableHandle;
  TestCommandBegin(__eRequestResponse, __cRequestResponse, "", "0");
  {
    message `FDCAN2::`DIAGNOSTIC_RESPONSE_PAM __tt2msg_2;
  
    long __res;
    int64 __timeout;
    __res = 0;
    __nInt64 = 1;
    __timeout = syspar::`P2_Server * 1000000LL;
    {
    
      long __testStepInitOk;
      message `FDCAN2::`DIAGNOSTIC_REQUEST_PAM __output;
      message `FDCAN2::`DIAGNOSTIC_REQUEST_PAM __msgOrig;
      __output = __msgOrig;
      __testStepInitOk = 1;
      {
        int64 __dlc;
        __dlc = 3;
        if (__dlc >= 0 && __dlc <= (__output.EDL ? 15 : 8))
          __output.DLC = __dlc;
        else
        {
          testStepErrorInTestSystem(0, __cEmpty, "Unable to set DLC=%lld in message. Please check input parameter.", __dlc);
          __testStepInitOk = 0;
        }
      }
      if (__testStepInitOk)
      {
        snprintf(__cArray, elCount(__cArray), "CAN message '%s' ID = 416981233x (0x18DAA0F1x) on bus FDCAN2", "DIAGNOSTIC_REQUEST_PAM");
        snprintf(__cArray2, elCount(__cArray2), "Send %s", __cArray);
        __tableHandle = ReportTableHead3Columns(__cArray2, "Byte", __cTOp, __cAssigned);
        ReportByteIndex("", 0, __cArray, elCount(__cArray));
        snprintf(__cArray2, 8192, "%s", __cArray);
        snprintf(__cArray3, 8192, "%s", "");
        
        ReportTableRow(__tableHandle, 0, __cArray2, __cAOp, 0x2, __cArray3, __oneOfFlag, __bSetInCheckAlignment);
        
        if (0 >= 0 && 0 < 64)
        {
          __output.byte((word)0) = 0x2;
        }
        else
        {
          testStepErrorInTestSystem(0, __cEmpty, "Index out of range. Unable to set byte %lld in message. Please check input parameter.", (int64)0);
          __testStepInitOk = 0;
        }
        ReportByteIndex("", 1, __cArray, elCount(__cArray));
        snprintf(__cArray2, 8192, "%s", __cArray);
        snprintf(__cArray3, 8192, "%s", "");
        
        ReportTableRow(__tableHandle, 0, __cArray2, __cAOp, 0x10, __cArray3, __oneOfFlag, __bSetInCheckAlignment);
        
        if (1 >= 0 && 1 < 64)
        {
          __output.byte((word)1) = 0x10;
        }
        else
        {
          testStepErrorInTestSystem(0, __cEmpty, "Index out of range. Unable to set byte %lld in message. Please check input parameter.", (int64)1);
          __testStepInitOk = 0;
        }
        ReportByteIndex("", 2, __cArray, elCount(__cArray));
        snprintf(__cArray2, 8192, "%s", __cArray);
        snprintf(__cArray3, 8192, "%s", "");
        
        ReportTableRow(__tableHandle, 0, __cArray2, __cAOp, 0x3, __cArray3, __oneOfFlag, __bSetInCheckAlignment);
        
        if (2 >= 0 && 2 < 64)
        {
          __output.byte((word)2) = 0x3;
        }
        else
        {
          testStepErrorInTestSystem(0, __cEmpty, "Index out of range. Unable to set byte %lld in message. Please check input parameter.", (int64)2);
          __testStepInitOk = 0;
        }
      
        ReportTableEndTestStep(__tableHandle, "Req1");
      }
      if (__testStepInitOk)
      {
        output(__output);
      }
    }
    if (__timeout <= 0)
    {
      testStepErrorInTestSystem(0, "1", "Unable to wait for %.3f %s. Please check input parameter.", __timeout / ((float)1000000), "ms");
    }
    else
    {
      if (0 < 0 || 64 <= 0)
      {
        testStepErrorInTestSystem(0, __cEmpty, "Index out of range. Unable to get byte %lld in message.", (int64) 0);
        __nInt64 = 0;
      }
      if (1 < 0 || 64 <= 1)
      {
        testStepErrorInTestSystem(0, __cEmpty, "Index out of range. Unable to get byte %lld in message.", (int64) 1);
        __nInt64 = 0;
      }
      if (2 < 0 || 64 <= 2)
      {
        testStepErrorInTestSystem(0, __cEmpty, "Index out of range. Unable to get byte %lld in message.", (int64) 2);
        __nInt64 = 0;
      }
      if (3 < 0 || 64 <= 3)
      {
        testStepErrorInTestSystem(0, __cEmpty, "Index out of range. Unable to get byte %lld in message.", (int64) 3);
        __nInt64 = 0;
      }
      if (4 < 0 || 64 <= 4)
      {
        testStepErrorInTestSystem(0, __cEmpty, "Index out of range. Unable to get byte %lld in message.", (int64) 4);
        __nInt64 = 0;
      }
      if (5 < 0 || 64 <= 5)
      {
        testStepErrorInTestSystem(0, __cEmpty, "Index out of range. Unable to get byte %lld in message.", (int64) 5);
        __nInt64 = 0;
      }
      if (6 < 0 || 64 <= 6)
      {
        testStepErrorInTestSystem(0, __cEmpty, "Index out of range. Unable to get byte %lld in message.", (int64) 6);
        __nInt64 = 0;
      }
      __tt2cnt_3 = 0;
      snprintf(__cArray, elCount(__cArray), "CAN message '%s' ID = 417001888x (0x18DAF1A0x) on bus FDCAN2", "DIAGNOSTIC_RESPONSE_PAM");
      if(SetBusContextByName("FDCAN2", __eSaveCurrent, __nBusContextNew, __nBusContextOld))
        testJoinMessageEvent(`FDCAN2::`DIAGNOSTIC_RESPONSE_PAM,  __cArray,
             delegate dword(message * __m)
             {
               dword __msg_callback_ret;
               byte __b0;
               byte __b1;
               byte __b2;
               byte __b3;
               byte __b4;
               byte __b5;
               byte __b6;
               if (__tt2cnt_3 == -1)
               {
                 return 1;
               }
               __tt2msg_2 = __m;
               __msg_callback_ret = 1;
               __tt2cnt_3++;
               if (0 < 0 || 64 <= 0) return 0;
               __csr = CheckSignalMatch(__tt2msg_2.byte((word)0), 0x6, "==") == 1;
               __msg_callback_ret &= __csr;
               if (1 < 0 || 64 <= 1) return 0;
               __csr = CheckSignalMatch(__tt2msg_2.byte((word)1), 0x50, "==") == 1;
               __msg_callback_ret &= __csr;
               if (2 < 0 || 64 <= 2) return 0;
               __csr = CheckSignalMatch(__tt2msg_2.byte((word)2), 0x3, "==") == 1;
               __msg_callback_ret &= __csr;
               if (3 < 0 || 64 <= 3) return 0;
               __csr = CheckSignalMatch(__tt2msg_2.byte((word)3), 0x0, "==") == 1;
               __msg_callback_ret &= __csr;
               if (4 < 0 || 64 <= 4) return 0;
               __csr = CheckSignalMatch(__tt2msg_2.byte((word)4), 0x32, "==") == 1;
               __msg_callback_ret &= __csr;
               if (5 < 0 || 64 <= 5) return 0;
               __csr = CheckSignalMatch(__tt2msg_2.byte((word)5), 0x1, "==") == 1;
               __msg_callback_ret &= __csr;
               if (6 < 0 || 64 <= 6) return 0;
               __csr = CheckSignalMatch(__tt2msg_2.byte((word)6), 0xF4, "==") == 1;
               __msg_callback_ret &= __csr;
               if (__msg_callback_ret)
               {
                 __tt2cnt_3 = -1;
                 return 1;
               }
               return 0;
             });
      __res = testWaitForAllJoinedEventsNS(__timeout);
      if (__nInt64 != 0)
      {
        snprintf(__cArray, elCount(__cArray), "CAN message '%s' ID = 417001888x (0x18DAF1A0x) on bus FDCAN2", "DIAGNOSTIC_RESPONSE_PAM");
        if(__tt2cnt_3 == -1)
        {
          snprintf(__cArray2, 8192, "Response of %s", __cArray);
        snprintf(__cArray, 8192, "%s", __cActual);
        }
        else
        {
          snprintf(__cArray2, 8192, "Response of %s (received %d times)", __cArray, __tt2cnt_3);
          snprintf(__cArray, 8192, "Last Received");
        }
        if (__tt2cnt_3 == 0)
        {
          testStepFail(0, "Resp1", __cArray2);
        }
        else
        {
          byte __b0;
          byte __b1;
          byte __b2;
          byte __b3;
          byte __b4;
          byte __b5;
          byte __b6;
          __bVerdict = __eVerdictPass;
          __tableHandle = ReportTableHead5Columns(__cArray2, "Signal/Byte", __cTOp, __cRefVal, __cArray, __cRes);
        __csr = CheckSignalMatch(__tt2msg_2.byte((word)0), 0x6, "==") == 1;
        ReportByteIndex("", 0, __cArray, elCount(__cArray));
        snprintf(__cArray2, 8192, "%s", __cArray);
        snprintf(__cArray3, 8192, "%s", "");
        ReportTableRow(__tableHandle, 0, __cArray2, "==", 0x6, __cArray3, __oneOfFlag, __bSetInCheckAlignment);
        ReportCell(__tableHandle, __tt2msg_2.byte((word)0));
        ReportCellResult(__tableHandle, __csr, __ePassFail);
          __bVerdict &= __csr;
        __csr = CheckSignalMatch(__tt2msg_2.byte((word)1), 0x50, "==") == 1;
        ReportByteIndex("", 1, __cArray, elCount(__cArray));
        snprintf(__cArray2, 8192, "%s", __cArray);
        snprintf(__cArray3, 8192, "%s", "");
        ReportTableRow(__tableHandle, 0, __cArray2, "==", 0x50, __cArray3, __oneOfFlag, __bSetInCheckAlignment);
        ReportCell(__tableHandle, __tt2msg_2.byte((word)1));
        ReportCellResult(__tableHandle, __csr, __ePassFail);
          __bVerdict &= __csr;
        __csr = CheckSignalMatch(__tt2msg_2.byte((word)2), 0x3, "==") == 1;
        ReportByteIndex("", 2, __cArray, elCount(__cArray));
        snprintf(__cArray2, 8192, "%s", __cArray);
        snprintf(__cArray3, 8192, "%s", "");
        ReportTableRow(__tableHandle, 0, __cArray2, "==", 0x3, __cArray3, __oneOfFlag, __bSetInCheckAlignment);
        ReportCell(__tableHandle, __tt2msg_2.byte((word)2));
        ReportCellResult(__tableHandle, __csr, __ePassFail);
          __bVerdict &= __csr;
        __csr = CheckSignalMatch(__tt2msg_2.byte((word)3), 0x0, "==") == 1;
        ReportByteIndex("", 3, __cArray, elCount(__cArray));
        snprintf(__cArray2, 8192, "%s", __cArray);
        snprintf(__cArray3, 8192, "%s", "");
        ReportTableRow(__tableHandle, 0, __cArray2, "==", 0x0, __cArray3, __oneOfFlag, __bSetInCheckAlignment);
        ReportCell(__tableHandle, __tt2msg_2.byte((word)3));
        ReportCellResult(__tableHandle, __csr, __ePassFail);
          __bVerdict &= __csr;
        __csr = CheckSignalMatch(__tt2msg_2.byte((word)4), 0x32, "==") == 1;
        ReportByteIndex("", 4, __cArray, elCount(__cArray));
        snprintf(__cArray2, 8192, "%s", __cArray);
        snprintf(__cArray3, 8192, "%s", "");
        ReportTableRow(__tableHandle, 0, __cArray2, "==", 0x32, __cArray3, __oneOfFlag, __bSetInCheckAlignment);
        ReportCell(__tableHandle, __tt2msg_2.byte((word)4));
        ReportCellResult(__tableHandle, __csr, __ePassFail);
          __bVerdict &= __csr;
        __csr = CheckSignalMatch(__tt2msg_2.byte((word)5), 0x1, "==") == 1;
        ReportByteIndex("", 5, __cArray, elCount(__cArray));
        snprintf(__cArray2, 8192, "%s", __cArray);
        snprintf(__cArray3, 8192, "%s", "");
        ReportTableRow(__tableHandle, 0, __cArray2, "==", 0x1, __cArray3, __oneOfFlag, __bSetInCheckAlignment);
        ReportCell(__tableHandle, __tt2msg_2.byte((word)5));
        ReportCellResult(__tableHandle, __csr, __ePassFail);
          __bVerdict &= __csr;
        __csr = CheckSignalMatch(__tt2msg_2.byte((word)6), 0xF4, "==") == 1;
        ReportByteIndex("", 6, __cArray, elCount(__cArray));
        snprintf(__cArray2, 8192, "%s", __cArray);
        snprintf(__cArray3, 8192, "%s", "");
        ReportTableRow(__tableHandle, 0, __cArray2, "==", 0xF4, __cArray3, __oneOfFlag, __bSetInCheckAlignment);
        ReportCell(__tableHandle, __tt2msg_2.byte((word)6));
        ReportCellResult(__tableHandle, __csr, __ePassFail);
          __bVerdict &= __csr;
          ReportTableEndVerdict(__tableHandle, "Resp1", __bVerdict);
        }
        __ReportRequestResponseResult(__res, 0);
      }
      ResetBusContext(__nBusContextNew, __nBusContextOld);
    }
  }
  TestCommandEnd();

}

void Tt4h42sqi_Programming_Session_Standard_Physical_Address()
{
  stack long __tableHandle;
  TestCommandBegin(__eRequestResponse, __cRequestResponse, "", "0");
  {
  
    long __res;
    int64 __timeout;
    __res = 0;
    __nInt64 = 1;
    __timeout = syspar::`P2_Server * 1000000LL;
    {
    
      long __testStepInitOk;
      message `FDCAN2::`DIAGNOSTIC_REQUEST_PAM __output;
      message `FDCAN2::`DIAGNOSTIC_REQUEST_PAM __msgOrig;
      __output = __msgOrig;
      __testStepInitOk = 1;
      {
        int64 __dlc;
        __dlc = 3;
        if (__dlc >= 0 && __dlc <= (__output.EDL ? 15 : 8))
          __output.DLC = __dlc;
        else
        {
          testStepErrorInTestSystem(0, __cEmpty, "Unable to set DLC=%lld in message. Please check input parameter.", __dlc);
          __testStepInitOk = 0;
        }
      }
      if (__testStepInitOk)
      {
        snprintf(__cArray, elCount(__cArray), "CAN message '%s' ID = 416981233x (0x18DAA0F1x) on bus FDCAN2", "DIAGNOSTIC_REQUEST_PAM");
        snprintf(__cArray2, elCount(__cArray2), "Send %s", __cArray);
        __tableHandle = ReportTableHead3Columns(__cArray2, "Byte", __cTOp, __cAssigned);
        ReportByteIndex("", 0, __cArray, elCount(__cArray));
        snprintf(__cArray2, 8192, "%s", __cArray);
        snprintf(__cArray3, 8192, "%s", "");
        
        ReportTableRow(__tableHandle, 0, __cArray2, __cAOp, 0x2, __cArray3, __oneOfFlag, __bSetInCheckAlignment);
        
        if (0 >= 0 && 0 < 64)
        {
          __output.byte((word)0) = 0x2;
        }
        else
        {
          testStepErrorInTestSystem(0, __cEmpty, "Index out of range. Unable to set byte %lld in message. Please check input parameter.", (int64)0);
          __testStepInitOk = 0;
        }
        ReportByteIndex("", 1, __cArray, elCount(__cArray));
        snprintf(__cArray2, 8192, "%s", __cArray);
        snprintf(__cArray3, 8192, "%s", "");
        
        ReportTableRow(__tableHandle, 0, __cArray2, __cAOp, 0x10, __cArray3, __oneOfFlag, __bSetInCheckAlignment);
        
        if (1 >= 0 && 1 < 64)
        {
          __output.byte((word)1) = 0x10;
        }
        else
        {
          testStepErrorInTestSystem(0, __cEmpty, "Index out of range. Unable to set byte %lld in message. Please check input parameter.", (int64)1);
          __testStepInitOk = 0;
        }
        ReportByteIndex("", 2, __cArray, elCount(__cArray));
        snprintf(__cArray2, 8192, "%s", __cArray);
        snprintf(__cArray3, 8192, "%s", "");
        
        ReportTableRow(__tableHandle, 0, __cArray2, __cAOp, 0x2, __cArray3, __oneOfFlag, __bSetInCheckAlignment);
        
        if (2 >= 0 && 2 < 64)
        {
          __output.byte((word)2) = 0x2;
        }
        else
        {
          testStepErrorInTestSystem(0, __cEmpty, "Index out of range. Unable to set byte %lld in message. Please check input parameter.", (int64)2);
          __testStepInitOk = 0;
        }
      
        ReportTableEndTestStep(__tableHandle, "Req1");
      }
      if (__testStepInitOk)
      {
        output(__output);
      }
    }
    if (__timeout <= 0)
    {
      testStepErrorInTestSystem(0, "1", "Unable to wait for %.3f %s. Please check input parameter.", __timeout / ((float)1000000), "ms");
    }
    else
    {
      __tt2cnt_5 = 0;
      snprintf(__cArray, elCount(__cArray), "CAN message '%s' ID = 417001888x (0x18DAF1A0x) on bus FDCAN2", "DIAGNOSTIC_RESPONSE_PAM");
      if(SetBusContextByName("FDCAN2", __eSaveCurrent, __nBusContextNew, __nBusContextOld))
        testJoinMessageEvent(`FDCAN2::`DIAGNOSTIC_RESPONSE_PAM,  __cArray,
             delegate dword(message * __m)
             {
               dword __msg_callback_ret;
               if (__tt2cnt_5 == -1)
               {
                 return 1;
               }
               __msg_callback_ret = 1;
               __tt2cnt_5++;
               if (__msg_callback_ret)
               {
                 __tt2cnt_5 = -1;
                 return 1;
               }
               return 0;
             });
      __res = testWaitForAllJoinedEventsNS(__timeout);
      if (__nInt64 != 0)
      {
        snprintf(__cArray, elCount(__cArray), "CAN message '%s' ID = 417001888x (0x18DAF1A0x) on bus FDCAN2", "DIAGNOSTIC_RESPONSE_PAM");
        if(__tt2cnt_5 == -1)
        {
          snprintf(__cArray2, 8192, "Response of %s", __cArray);
        }
        else
        {
          snprintf(__cArray2, 8192, "Response of %s (received %d times)", __cArray, __tt2cnt_5);
        }
        if (__tt2cnt_5 == 0)
        {
          testStepFail(0, "Resp1", __cArray2);
        }
        else
        {
          testStepPass(2, "Resp1", __cArray2);
        }
        __ReportRequestResponseResult(__res, 0);
      }
      ResetBusContext(__nBusContextNew, __nBusContextOld);
    }
  }
  TestCommandEnd();

}

void Tt4h42sqi_F181_DID_with_Physical_Address()
{
  stack long __tableHandle;
  TestCommandBegin(__eDiagService, __cDiagService, "", "0");
  {
    if (DiagIsFunctionalGroup("CVADAS_0001_00000000_000"))
    {
      DiagResponse * __resp;
      DiagRequest CVADAS_0001_00000000_000._22F181_Application_Software_Identification __req;
      __diagService4h42sqi_4(__req, __resp);
    }
    else
    {
      DiagResponse CVADAS_0001_00000000_000.* __resp;
      DiagRequest CVADAS_0001_00000000_000._22F181_Application_Software_Identification __req;
      __diagService4h42sqi_4(__req, __resp);
    }
  }
  TestCommandEnd();


}

  
void __diagService4h42sqi_4(DiagRequest * __req, DiagResponse * __resp )
{
  stack long __tableHandle;
  long __res, __paramLen, __bytePos;

   __bVerdict = __eVerdictPass;

  do {
    TestReportResetDiagObjectList();
    DiagSetReportDetailLevel("CVADAS_0001_00000000_000", EnumServiceDetails_onfail);
    // Request aspect
    {

      if (0 >= DiagSendReqAndWaitForResp("CVADAS_0001_00000000_000", __req, __resp, __res, -1, -1, -1, -1, -1, EnumResult_pos, EnumServiceDetails_onfail, EnumSendingMode_physical, EnumSuppressPosResBit_asconfigured, EnumVerdictOnInvalidValues_fail))
        break;
    }

    __res = DiagErrCodeTestStep(__res, "Can't retrieve last response for request! No check possible.") < 0;
    if(__res)
    {
	  __bVerdict = __eVerdictFail;
      break;
    }
    {
      __res = DiagInterpretAs(__resp, "RDBI_PR");
      if(__res != 0)
      {
        __bVerdict = __eVerdictFail;
        DiagErrCodeTestStep(__res, "Can't interpret response as diagnostic primitive 'RDBI_PR'.");
        break;
      }
      else
      {
        TestStepPass( "Received primitive can be interpreted as diagnostic primitive 'RDBI_PR'.");
      }
    }
  }
  while(0);


  // Response, check & read aspect
  {
    __res = 1;
    __tableHandle = ReportTableHead5Columns(__cCheckCaption, __cTSym, __cTOp, __cRefVal, __cActual, __cRes);
    {
      double __nDiagValue;
      DiagGetParameterErrorHandled(__resp, "_Number_of_Application_SW_Logical_Blocks_24", __nDiagValue);
      __csr = CheckSignalMatch(__nDiagValue, syspar::`F181_App_SW_Identification::`Num_Application_SW_Logical_Blocks, "==") == 1;
      snprintf(__cArray, 8192, "%s", "Diagnostic parameter \'_Number_of_Application_SW_Logical_Blocks_24\'");
      snprintf(__cArray2, 8192, "%s", __cArray);
      snprintf(__cArray3, 8192, "%s", "Num_Application_SW_Logical_Blocks");
      ReportTableRow(__tableHandle, 0, __cArray2, "==", syspar::`F181_App_SW_Identification::`Num_Application_SW_Logical_Blocks, __cArray3, __oneOfFlag, __bSetInCheckAlignment);
      ReportCell(__tableHandle, __nDiagValue);
      ReportCellResult(__tableHandle, __csr, __ePassFail);
    
      __res = __res && __csr;
    
    }
    {
      double __nDiagValue;
      DiagGetParameterErrorHandled(__resp, "_Application_Software_Logical_Block_1_Version_Information__Year", __nDiagValue);
      __csr = CheckSignalMatch(__nDiagValue, syspar::`F181_App_SW_Identification::`APP_SW_Year, ">=") == 1;
      snprintf(__cArray, 8192, "%s", "Diagnostic parameter \'_Application_Software_Logical_Block_1_Version_Information__Year\'");
      snprintf(__cArray2, 8192, "%s", __cArray);
      snprintf(__cArray3, 8192, "%s", "APP_SW_Year");
      ReportTableRow(__tableHandle, 0, __cArray2, ">=", syspar::`F181_App_SW_Identification::`APP_SW_Year, __cArray3, __oneOfFlag, __bSetInCheckAlignment);
      ReportCell(__tableHandle, __nDiagValue);
      ReportCellResult(__tableHandle, __csr, __ePassFail);
    
      __res = __res && __csr;
    
    }
    {
      double __nDiagValue;
      DiagGetParameterErrorHandled(__resp, "_Application_Software_Logical_Block_1_Version_Information__Week", __nDiagValue);
      __csr = CheckSignalMatch(__nDiagValue, syspar::`F181_App_SW_Identification::`App_SW_Week, ">=") == 1;
      snprintf(__cArray, 8192, "%s", "Diagnostic parameter \'_Application_Software_Logical_Block_1_Version_Information__Week\'");
      snprintf(__cArray2, 8192, "%s", __cArray);
      snprintf(__cArray3, 8192, "%s", "App_SW_Week");
      ReportTableRow(__tableHandle, 0, __cArray2, ">=", syspar::`F181_App_SW_Identification::`App_SW_Week, __cArray3, __oneOfFlag, __bSetInCheckAlignment);
      ReportCell(__tableHandle, __nDiagValue);
      ReportCellResult(__tableHandle, __csr, __ePassFail);
    
      __res = __res && __csr;
    
    }
    {
      double __nDiagValue;
      DiagGetParameterErrorHandled(__resp, "_Application_Software_Logical_Block_1_Version_Information__Patc", __nDiagValue);
      __csr = CheckSignalMatch(__nDiagValue, syspar::`F181_App_SW_Identification::`App_SW_Patch, ">=") == 1;
      snprintf(__cArray, 8192, "%s", "Diagnostic parameter \'_Application_Software_Logical_Block_1_Version_Information__Patc\'");
      snprintf(__cArray2, 8192, "%s", __cArray);
      snprintf(__cArray3, 8192, "%s", "App_SW_Patch");
      ReportTableRow(__tableHandle, 0, __cArray2, ">=", syspar::`F181_App_SW_Identification::`App_SW_Patch, __cArray3, __oneOfFlag, __bSetInCheckAlignment);
      ReportCell(__tableHandle, __nDiagValue);
      ReportCellResult(__tableHandle, __csr, __ePassFail);
    
      __res = __res && __csr;
    
    }
    {
      __bDiagValueArrayCtr = DiagGetParameterErrorHandled(__resp, "_Application_Software_Logical_Block_1_Version_Information__Iden", __bDiagValueArray, elcount(__bDiagValueArray), __cDiagValueArray, elcount(__cDiagValueArray));
      CheckPlainParameterGetStringBufferConsistency(syspar::`F181_App_SW_Identification::`App_SW_Identification,"syspar::`F181_App_SW_Identification::`App_SW_Identification", 8192);
    snprintf(__cArray, 8192, "%s", syspar::`F181_App_SW_Identification::`App_SW_Identification);  
      __bDiagValueArrayCtr2 = __MapChar2ByteAtDiagCheck(__cArray, __bDiagValueArray2);
      snprintf(__cArray10, 8192, "%s", "App_SW_Identification");
      {
        __bArrayCtr = __CopyBytes(__bDiagValueArray, __bDiagValueArrayCtr, __bArray);
        __bArrayCtr2 = __CopyBytes(__bDiagValueArray2, __bDiagValueArrayCtr2, __bArray2);
        __csr = CompareBytes(__bArray, __bArrayCtr, __bArray2, __bArrayCtr2) == 0;
        snprintf(__cArray, 8192, "%s", "Diagnostic parameter \'_Application_Software_Logical_Block_1_Version_Information__Iden\'");
        snprintf(__cArray2, 8192, "%s", __cArray);
        snprintf(__cArray3, 8192, "%s", __cArray10);
        ReportTableRow(__tableHandle, 0, __cArray2, "Bytes", __bArray2, __bArrayCtr2, __cArray3, __oneOfFlag, __bSetInCheckAlignment);
        ReportCell(__tableHandle, __bArray, __bArrayCtr);
        ReportCellResult(__tableHandle, __csr, __ePassFail);
      }
    
      __res = __res && __csr;
    
    }
    ReportTableEndVerdict(__tableHandle, __cEvaluateResponse, __res);
	__bVerdict = __bVerdict && __res;
  }
  if (__bVerdict == __eVerdictFail)
    TestReportWriteDiagObjectList();
}

void Tt4h42sqi_F181_DID_with_Standard_Physical_Address()
{
  stack long __tableHandle;
  TestCommandBegin(__eRequestResponse, __cRequestResponse, "", "0");
  {
  
    long __res;
    int64 __timeout;
    __res = 0;
    __nInt64 = 1;
    __timeout = syspar::`P2_Server * 1000000LL;
    {
    
      long __testStepInitOk;
      message `FDCAN2::`DIAGNOSTIC_REQUEST_PAM __output;
      message `FDCAN2::`DIAGNOSTIC_REQUEST_PAM __msgOrig;
      __output = __msgOrig;
      __testStepInitOk = 1;
      {
        int64 __dlc;
        __dlc = 4;
        if (__dlc >= 0 && __dlc <= (__output.EDL ? 15 : 8))
          __output.DLC = __dlc;
        else
        {
          testStepErrorInTestSystem(0, __cEmpty, "Unable to set DLC=%lld in message. Please check input parameter.", __dlc);
          __testStepInitOk = 0;
        }
      }
      if (__testStepInitOk)
      {
        snprintf(__cArray, elCount(__cArray), "CAN message '%s' ID = 416981233x (0x18DAA0F1x) on bus FDCAN2", "DIAGNOSTIC_REQUEST_PAM");
        snprintf(__cArray2, elCount(__cArray2), "Send %s", __cArray);
        __tableHandle = ReportTableHead3Columns(__cArray2, "Byte", __cTOp, __cAssigned);
        ReportByteIndex("", 0, __cArray, elCount(__cArray));
        snprintf(__cArray2, 8192, "%s", __cArray);
        snprintf(__cArray3, 8192, "%s", "");
        
        ReportTableRow(__tableHandle, 0, __cArray2, __cAOp, 0x3, __cArray3, __oneOfFlag, __bSetInCheckAlignment);
        
        if (0 >= 0 && 0 < 64)
        {
          __output.byte((word)0) = 0x3;
        }
        else
        {
          testStepErrorInTestSystem(0, __cEmpty, "Index out of range. Unable to set byte %lld in message. Please check input parameter.", (int64)0);
          __testStepInitOk = 0;
        }
        ReportByteIndex("", 1, __cArray, elCount(__cArray));
        snprintf(__cArray2, 8192, "%s", __cArray);
        snprintf(__cArray3, 8192, "%s", "");
        
        ReportTableRow(__tableHandle, 0, __cArray2, __cAOp, 0x22, __cArray3, __oneOfFlag, __bSetInCheckAlignment);
        
        if (1 >= 0 && 1 < 64)
        {
          __output.byte((word)1) = 0x22;
        }
        else
        {
          testStepErrorInTestSystem(0, __cEmpty, "Index out of range. Unable to set byte %lld in message. Please check input parameter.", (int64)1);
          __testStepInitOk = 0;
        }
        ReportByteIndex("", 2, __cArray, elCount(__cArray));
        snprintf(__cArray2, 8192, "%s", __cArray);
        snprintf(__cArray3, 8192, "%s", "");
        
        ReportTableRow(__tableHandle, 0, __cArray2, __cAOp, 0xF1, __cArray3, __oneOfFlag, __bSetInCheckAlignment);
        
        if (2 >= 0 && 2 < 64)
        {
          __output.byte((word)2) = 0xF1;
        }
        else
        {
          testStepErrorInTestSystem(0, __cEmpty, "Index out of range. Unable to set byte %lld in message. Please check input parameter.", (int64)2);
          __testStepInitOk = 0;
        }
        ReportByteIndex("", 3, __cArray, elCount(__cArray));
        snprintf(__cArray2, 8192, "%s", __cArray);
        snprintf(__cArray3, 8192, "%s", "");
        
        ReportTableRow(__tableHandle, 0, __cArray2, __cAOp, 0x81, __cArray3, __oneOfFlag, __bSetInCheckAlignment);
        
        if (3 >= 0 && 3 < 64)
        {
          __output.byte((word)3) = 0x81;
        }
        else
        {
          testStepErrorInTestSystem(0, __cEmpty, "Index out of range. Unable to set byte %lld in message. Please check input parameter.", (int64)3);
          __testStepInitOk = 0;
        }
      
        ReportTableEndTestStep(__tableHandle, "Req1");
      }
      if (__testStepInitOk)
      {
        output(__output);
      }
    }
    if (__timeout <= 0)
    {
      testStepErrorInTestSystem(0, "1", "Unable to wait for %.3f %s. Please check input parameter.", __timeout / ((float)1000000), "ms");
    }
    else
    {
      __tt2cnt_7 = 0;
      snprintf(__cArray, elCount(__cArray), "CAN message '%s' ID = 417001888x (0x18DAF1A0x) on bus FDCAN2", "DIAGNOSTIC_RESPONSE_PAM");
      if(SetBusContextByName("FDCAN2", __eSaveCurrent, __nBusContextNew, __nBusContextOld))
        testJoinMessageEvent(`FDCAN2::`DIAGNOSTIC_RESPONSE_PAM,  __cArray,
             delegate dword(message * __m)
             {
               dword __msg_callback_ret;
               if (__tt2cnt_7 == -1)
               {
                 return 1;
               }
               __msg_callback_ret = 1;
               __tt2cnt_7++;
               if (__msg_callback_ret)
               {
                 __tt2cnt_7 = -1;
                 return 1;
               }
               return 0;
             });
      __res = testWaitForAllJoinedEventsNS(__timeout);
      if (__nInt64 != 0)
      {
        snprintf(__cArray, elCount(__cArray), "CAN message '%s' ID = 417001888x (0x18DAF1A0x) on bus FDCAN2", "DIAGNOSTIC_RESPONSE_PAM");
        if(__tt2cnt_7 == -1)
        {
          snprintf(__cArray2, 8192, "Response of %s", __cArray);
        }
        else
        {
          snprintf(__cArray2, 8192, "Response of %s (received %d times)", __cArray, __tt2cnt_7);
        }
        if (__tt2cnt_7 == 0)
        {
          testStepFail(0, "Resp1", __cArray2);
        }
        else
        {
          testStepPass(2, "Resp1", __cArray2);
        }
        __ReportRequestResponseResult(__res, 0);
      }
      ResetBusContext(__nBusContextNew, __nBusContextOld);
    }
  }
  TestCommandEnd();

}

void Tt4h42sqi_F181_DID_with_Functional_Address()
{
  stack long __tableHandle;
  TestCommandBegin(__eDiagService, __cDiagService, "", "0");
  {
    if (DiagIsFunctionalGroup("CVADAS_0001_00000000_000"))
    {
      DiagResponse * __resp;
      DiagRequest CVADAS_0001_00000000_000._22F181_Application_Software_Identification __req;
      __diagService4h42sqi_5(__req, __resp);
    }
    else
    {
      DiagResponse CVADAS_0001_00000000_000.* __resp;
      DiagRequest CVADAS_0001_00000000_000._22F181_Application_Software_Identification __req;
      __diagService4h42sqi_5(__req, __resp);
    }
  }
  TestCommandEnd();


}

  
void __diagService4h42sqi_5(DiagRequest * __req, DiagResponse * __resp )
{
  stack long __tableHandle;
  long __res, __paramLen, __bytePos;

   __bVerdict = __eVerdictPass;

  do {
    TestReportResetDiagObjectList();
    DiagSetReportDetailLevel("CVADAS_0001_00000000_000", EnumServiceDetails_onfail);
    // Request aspect
    {

      if (0 >= DiagSendReqAndWaitForResp("CVADAS_0001_00000000_000", __req, __resp, __res, -1, -1, -1, -1, -1, EnumResult_pos, EnumServiceDetails_onfail, EnumSendingMode_functional, EnumSuppressPosResBit_asconfigured, EnumVerdictOnInvalidValues_fail))
        break;
    }

    __res = DiagErrCodeTestStep(__res, "Can't retrieve last response for request! No check possible.") < 0;
    if(__res)
    {
	  __bVerdict = __eVerdictFail;
      break;
    }
    {
      __res = DiagInterpretAs(__resp, "RDBI_PR");
      if(__res != 0)
      {
        __bVerdict = __eVerdictFail;
        DiagErrCodeTestStep(__res, "Can't interpret response as diagnostic primitive 'RDBI_PR'.");
        break;
      }
      else
      {
        TestStepPass( "Received primitive can be interpreted as diagnostic primitive 'RDBI_PR'.");
      }
    }
  }
  while(0);


  // Response, check & read aspect
  {
    __res = 1;
    __tableHandle = ReportTableHead5Columns(__cCheckCaption, __cTSym, __cTOp, __cRefVal, __cActual, __cRes);
    {
      double __nDiagValue;
      DiagGetParameterErrorHandled(__resp, "_Number_of_Application_SW_Logical_Blocks_24", __nDiagValue);
      __csr = CheckSignalMatch(__nDiagValue, syspar::`F181_App_SW_Identification::`Num_Application_SW_Logical_Blocks, "==") == 1;
      snprintf(__cArray, 8192, "%s", "Diagnostic parameter \'_Number_of_Application_SW_Logical_Blocks_24\'");
      snprintf(__cArray2, 8192, "%s", __cArray);
      snprintf(__cArray3, 8192, "%s", "Num_Application_SW_Logical_Blocks");
      ReportTableRow(__tableHandle, 0, __cArray2, "==", syspar::`F181_App_SW_Identification::`Num_Application_SW_Logical_Blocks, __cArray3, __oneOfFlag, __bSetInCheckAlignment);
      ReportCell(__tableHandle, __nDiagValue);
      ReportCellResult(__tableHandle, __csr, __ePassFail);
    
      __res = __res && __csr;
    
    }
    {
      double __nDiagValue;
      DiagGetParameterErrorHandled(__resp, "_Application_Software_Logical_Block_1_Version_Information__Year", __nDiagValue);
      __csr = CheckSignalMatch(__nDiagValue, syspar::`F181_App_SW_Identification::`APP_SW_Year, ">=") == 1;
      snprintf(__cArray, 8192, "%s", "Diagnostic parameter \'_Application_Software_Logical_Block_1_Version_Information__Year\'");
      snprintf(__cArray2, 8192, "%s", __cArray);
      snprintf(__cArray3, 8192, "%s", "APP_SW_Year");
      ReportTableRow(__tableHandle, 0, __cArray2, ">=", syspar::`F181_App_SW_Identification::`APP_SW_Year, __cArray3, __oneOfFlag, __bSetInCheckAlignment);
      ReportCell(__tableHandle, __nDiagValue);
      ReportCellResult(__tableHandle, __csr, __ePassFail);
    
      __res = __res && __csr;
    
    }
    {
      double __nDiagValue;
      DiagGetParameterErrorHandled(__resp, "_Application_Software_Logical_Block_1_Version_Information__Week", __nDiagValue);
      __csr = CheckSignalMatch(__nDiagValue, syspar::`F181_App_SW_Identification::`App_SW_Week, ">=") == 1;
      snprintf(__cArray, 8192, "%s", "Diagnostic parameter \'_Application_Software_Logical_Block_1_Version_Information__Week\'");
      snprintf(__cArray2, 8192, "%s", __cArray);
      snprintf(__cArray3, 8192, "%s", "App_SW_Week");
      ReportTableRow(__tableHandle, 0, __cArray2, ">=", syspar::`F181_App_SW_Identification::`App_SW_Week, __cArray3, __oneOfFlag, __bSetInCheckAlignment);
      ReportCell(__tableHandle, __nDiagValue);
      ReportCellResult(__tableHandle, __csr, __ePassFail);
    
      __res = __res && __csr;
    
    }
    {
      double __nDiagValue;
      DiagGetParameterErrorHandled(__resp, "_Application_Software_Logical_Block_1_Version_Information__Patc", __nDiagValue);
      __csr = CheckSignalMatch(__nDiagValue, syspar::`F181_App_SW_Identification::`App_SW_Patch, ">=") == 1;
      snprintf(__cArray, 8192, "%s", "Diagnostic parameter \'_Application_Software_Logical_Block_1_Version_Information__Patc\'");
      snprintf(__cArray2, 8192, "%s", __cArray);
      snprintf(__cArray3, 8192, "%s", "App_SW_Patch");
      ReportTableRow(__tableHandle, 0, __cArray2, ">=", syspar::`F181_App_SW_Identification::`App_SW_Patch, __cArray3, __oneOfFlag, __bSetInCheckAlignment);
      ReportCell(__tableHandle, __nDiagValue);
      ReportCellResult(__tableHandle, __csr, __ePassFail);
    
      __res = __res && __csr;
    
    }
    {
      __bDiagValueArrayCtr = DiagGetParameterErrorHandled(__resp, "_Application_Software_Logical_Block_1_Version_Information__Iden", __bDiagValueArray, elcount(__bDiagValueArray), __cDiagValueArray, elcount(__cDiagValueArray));
      CheckPlainParameterGetStringBufferConsistency(syspar::`F181_App_SW_Identification::`App_SW_Identification,"syspar::`F181_App_SW_Identification::`App_SW_Identification", 8192);
    snprintf(__cArray, 8192, "%s", syspar::`F181_App_SW_Identification::`App_SW_Identification);  
      __bDiagValueArrayCtr2 = __MapChar2ByteAtDiagCheck(__cArray, __bDiagValueArray2);
      snprintf(__cArray10, 8192, "%s", "App_SW_Identification");
      {
        __bArrayCtr = __CopyBytes(__bDiagValueArray, __bDiagValueArrayCtr, __bArray);
        __bArrayCtr2 = __CopyBytes(__bDiagValueArray2, __bDiagValueArrayCtr2, __bArray2);
        __csr = CompareBytes(__bArray, __bArrayCtr, __bArray2, __bArrayCtr2) == 0;
        snprintf(__cArray, 8192, "%s", "Diagnostic parameter \'_Application_Software_Logical_Block_1_Version_Information__Iden\'");
        snprintf(__cArray2, 8192, "%s", __cArray);
        snprintf(__cArray3, 8192, "%s", __cArray10);
        ReportTableRow(__tableHandle, 0, __cArray2, "Bytes", __bArray2, __bArrayCtr2, __cArray3, __oneOfFlag, __bSetInCheckAlignment);
        ReportCell(__tableHandle, __bArray, __bArrayCtr);
        ReportCellResult(__tableHandle, __csr, __ePassFail);
      }
    
      __res = __res && __csr;
    
    }
    ReportTableEndVerdict(__tableHandle, __cEvaluateResponse, __res);
	__bVerdict = __bVerdict && __res;
  }
  if (__bVerdict == __eVerdictFail)
    TestReportWriteDiagObjectList();
}

void Tt4h42sqi_F182_DID_with_Physical_Address()
{
  stack long __tableHandle;
  TestCommandBegin(__eDiagService, __cDiagService, "", "0");
  {
    if (DiagIsFunctionalGroup("CVADAS_0001_00000000_000"))
    {
      DiagResponse * __resp;
      DiagRequest CVADAS_0001_00000000_000._22F182_Application_Data_Identification __req;
      __diagService4h42sqi_6(__req, __resp);
    }
    else
    {
      DiagResponse CVADAS_0001_00000000_000.* __resp;
      DiagRequest CVADAS_0001_00000000_000._22F182_Application_Data_Identification __req;
      __diagService4h42sqi_6(__req, __resp);
    }
  }
  TestCommandEnd();


}

  
void __diagService4h42sqi_6(DiagRequest * __req, DiagResponse * __resp )
{
  stack long __tableHandle;
  long __res, __paramLen, __bytePos;

   __bVerdict = __eVerdictPass;

  do {
    TestReportResetDiagObjectList();
    DiagSetReportDetailLevel("CVADAS_0001_00000000_000", EnumServiceDetails_onfail);
    // Request aspect
    {

      if (0 >= DiagSendReqAndWaitForResp("CVADAS_0001_00000000_000", __req, __resp, __res, -1, -1, -1, -1, -1, EnumResult_pos, EnumServiceDetails_onfail, EnumSendingMode_physical, EnumSuppressPosResBit_asconfigured, EnumVerdictOnInvalidValues_no_impact))
        break;
    }

    __res = DiagErrCodeTestStep(__res, "Can't retrieve last response for request! No check possible.") < 0;
    if(__res)
    {
	  __bVerdict = __eVerdictFail;
      break;
    }
    {
      __res = DiagInterpretAs(__resp, "RDBI_PR");
      if(__res != 0)
      {
        __bVerdict = __eVerdictFail;
        DiagErrCodeTestStep(__res, "Can't interpret response as diagnostic primitive 'RDBI_PR'.");
        break;
      }
      else
      {
        TestStepPass( "Received primitive can be interpreted as diagnostic primitive 'RDBI_PR'.");
      }
    }
  }
  while(0);


  // Response, check & read aspect
  {
    __res = 1;
    __tableHandle = ReportTableHead5Columns(__cCheckCaption, __cTSym, __cTOp, __cRefVal, __cActual, __cRes);
    {
      double __nDiagValue;
      DiagGetParameterErrorHandled(__resp, "_Number_of_Application_Data_Logical_Blocks_24", __nDiagValue);
      __csr = CheckSignalMatch(__nDiagValue, syspar::`F182_App_Data_Identification::`Num_App_Data_SW_Logical_Blocks, "==") == 1;
      snprintf(__cArray, 8192, "%s", "Diagnostic parameter \'_Number_of_Application_Data_Logical_Blocks_24\'");
      snprintf(__cArray2, 8192, "%s", __cArray);
      snprintf(__cArray3, 8192, "%s", "Num_App_Data_SW_Logical_Blocks");
      ReportTableRow(__tableHandle, 0, __cArray2, "==", syspar::`F182_App_Data_Identification::`Num_App_Data_SW_Logical_Blocks, __cArray3, __oneOfFlag, __bSetInCheckAlignment);
      ReportCell(__tableHandle, __nDiagValue);
      ReportCellResult(__tableHandle, __csr, __ePassFail);
    
      __res = __res && __csr;
    
    }
    {
      double __nDiagValue;
      DiagGetParameterErrorHandled(__resp, "_SW_Year_32", __nDiagValue);
      __csr = CheckSignalMatch(__nDiagValue, syspar::`F182_App_Data_Identification::`App_Data_SW_Year, "==") == 1;
      snprintf(__cArray, 8192, "%s", "Diagnostic parameter \'_SW_Year_32\'");
      snprintf(__cArray2, 8192, "%s", __cArray);
      snprintf(__cArray3, 8192, "%s", "App_Data_SW_Year");
      ReportTableRow(__tableHandle, 0, __cArray2, "==", syspar::`F182_App_Data_Identification::`App_Data_SW_Year, __cArray3, __oneOfFlag, __bSetInCheckAlignment);
      ReportCell(__tableHandle, __nDiagValue);
      ReportCellResult(__tableHandle, __csr, __ePassFail);
    
      __res = __res && __csr;
    
    }
    {
      double __nDiagValue;
      DiagGetParameterErrorHandled(__resp, "_SW__Week_40", __nDiagValue);
      __csr = CheckSignalMatch(__nDiagValue, syspar::`F182_App_Data_Identification::`App_Data_SW_Week, ">=") == 1;
      snprintf(__cArray, 8192, "%s", "Diagnostic parameter \'_SW__Week_40\'");
      snprintf(__cArray2, 8192, "%s", __cArray);
      snprintf(__cArray3, 8192, "%s", "App_Data_SW_Week");
      ReportTableRow(__tableHandle, 0, __cArray2, ">=", syspar::`F182_App_Data_Identification::`App_Data_SW_Week, __cArray3, __oneOfFlag, __bSetInCheckAlignment);
      ReportCell(__tableHandle, __nDiagValue);
      ReportCellResult(__tableHandle, __csr, __ePassFail);
    
      __res = __res && __csr;
    
    }
    {
      double __nDiagValue;
      DiagGetParameterErrorHandled(__resp, "_SW__Patch_Level_48", __nDiagValue);
      __csr = CheckSignalMatch(__nDiagValue, syspar::`F182_App_Data_Identification::`App_Data_SW_Patch_Level, ">=") == 1;
      snprintf(__cArray, 8192, "%s", "Diagnostic parameter \'_SW__Patch_Level_48\'");
      snprintf(__cArray2, 8192, "%s", __cArray);
      snprintf(__cArray3, 8192, "%s", "App_Data_SW_Patch_Level");
      ReportTableRow(__tableHandle, 0, __cArray2, ">=", syspar::`F182_App_Data_Identification::`App_Data_SW_Patch_Level, __cArray3, __oneOfFlag, __bSetInCheckAlignment);
      ReportCell(__tableHandle, __nDiagValue);
      ReportCellResult(__tableHandle, __csr, __ePassFail);
    
      __res = __res && __csr;
    
    }
    {
      __bDiagValueArrayCtr = DiagGetParameterErrorHandled(__resp, "_SW__Identification_56", __bDiagValueArray, elcount(__bDiagValueArray), __cDiagValueArray, elcount(__cDiagValueArray));
      CheckPlainParameterGetStringBufferConsistency(syspar::`F182_App_Data_Identification::`App_Data_SW_Identification,"syspar::`F182_App_Data_Identification::`App_Data_SW_Identification", 8192);
    snprintf(__cArray, 8192, "%s", syspar::`F182_App_Data_Identification::`App_Data_SW_Identification);  
      __bDiagValueArrayCtr2 = __MapChar2ByteAtDiagCheck(__cArray, __bDiagValueArray2);
      snprintf(__cArray10, 8192, "%s", "App_Data_SW_Identification");
      {
        __bArrayCtr = __CopyBytes(__bDiagValueArray, __bDiagValueArrayCtr, __bArray);
        __bArrayCtr2 = __CopyBytes(__bDiagValueArray2, __bDiagValueArrayCtr2, __bArray2);
        __csr = CompareBytes(__bArray, __bArrayCtr, __bArray2, __bArrayCtr2) == 0;
        snprintf(__cArray, 8192, "%s", "Diagnostic parameter \'_SW__Identification_56\'");
        snprintf(__cArray2, 8192, "%s", __cArray);
        snprintf(__cArray3, 8192, "%s", __cArray10);
        ReportTableRow(__tableHandle, 0, __cArray2, "Bytes", __bArray2, __bArrayCtr2, __cArray3, __oneOfFlag, __bSetInCheckAlignment);
        ReportCell(__tableHandle, __bArray, __bArrayCtr);
        ReportCellResult(__tableHandle, __csr, __ePassFail);
      }
    
      __res = __res && __csr;
    
    }
    ReportTableEndVerdict(__tableHandle, __cEvaluateResponse, __res);
	__bVerdict = __bVerdict && __res;
  }
  if (__bVerdict == __eVerdictFail)
    TestReportWriteDiagObjectList();
}

void Tt4h42sqi_F182_DID_with_Functional_Address()
{
  stack long __tableHandle;
  TestCommandBegin(__eDiagService, __cDiagService, "", "0");
  {
    if (DiagIsFunctionalGroup("CVADAS_0001_00000000_000"))
    {
      DiagResponse * __resp;
      DiagRequest CVADAS_0001_00000000_000._22F182_Application_Data_Identification __req;
      __diagService4h42sqi_7(__req, __resp);
    }
    else
    {
      DiagResponse CVADAS_0001_00000000_000.* __resp;
      DiagRequest CVADAS_0001_00000000_000._22F182_Application_Data_Identification __req;
      __diagService4h42sqi_7(__req, __resp);
    }
  }
  TestCommandEnd();


}

  
void __diagService4h42sqi_7(DiagRequest * __req, DiagResponse * __resp )
{
  stack long __tableHandle;
  long __res, __paramLen, __bytePos;

   __bVerdict = __eVerdictPass;

  do {
    TestReportResetDiagObjectList();
    DiagSetReportDetailLevel("CVADAS_0001_00000000_000", EnumServiceDetails_onfail);
    // Request aspect
    {

      if (0 >= DiagSendReqAndWaitForResp("CVADAS_0001_00000000_000", __req, __resp, __res, -1, -1, -1, -1, -1, EnumResult_pos, EnumServiceDetails_onfail, EnumSendingMode_functional, EnumSuppressPosResBit_asconfigured, EnumVerdictOnInvalidValues_no_impact))
        break;
    }

    __res = DiagErrCodeTestStep(__res, "Can't retrieve last response for request! No check possible.") < 0;
    if(__res)
    {
	  __bVerdict = __eVerdictFail;
      break;
    }
    {
      __res = DiagInterpretAs(__resp, "RDBI_PR");
      if(__res != 0)
      {
        __bVerdict = __eVerdictFail;
        DiagErrCodeTestStep(__res, "Can't interpret response as diagnostic primitive 'RDBI_PR'.");
        break;
      }
      else
      {
        TestStepPass( "Received primitive can be interpreted as diagnostic primitive 'RDBI_PR'.");
      }
    }
  }
  while(0);


  // Response, check & read aspect
  {
    __res = 1;
    __tableHandle = ReportTableHead5Columns(__cCheckCaption, __cTSym, __cTOp, __cRefVal, __cActual, __cRes);
    {
      double __nDiagValue;
      DiagGetParameterErrorHandled(__resp, "_Number_of_Application_Data_Logical_Blocks_24", __nDiagValue);
      __csr = CheckSignalMatch(__nDiagValue, syspar::`F182_App_Data_Identification::`Num_App_Data_SW_Logical_Blocks, "==") == 1;
      snprintf(__cArray, 8192, "%s", "Diagnostic parameter \'_Number_of_Application_Data_Logical_Blocks_24\'");
      snprintf(__cArray2, 8192, "%s", __cArray);
      snprintf(__cArray3, 8192, "%s", "Num_App_Data_SW_Logical_Blocks");
      ReportTableRow(__tableHandle, 0, __cArray2, "==", syspar::`F182_App_Data_Identification::`Num_App_Data_SW_Logical_Blocks, __cArray3, __oneOfFlag, __bSetInCheckAlignment);
      ReportCell(__tableHandle, __nDiagValue);
      ReportCellResult(__tableHandle, __csr, __ePassFail);
    
      __res = __res && __csr;
    
    }
    {
      double __nDiagValue;
      DiagGetParameterErrorHandled(__resp, "_SW_Year_32", __nDiagValue);
      __csr = CheckSignalMatch(__nDiagValue, syspar::`F182_App_Data_Identification::`App_Data_SW_Year, "==") == 1;
      snprintf(__cArray, 8192, "%s", "Diagnostic parameter \'_SW_Year_32\'");
      snprintf(__cArray2, 8192, "%s", __cArray);
      snprintf(__cArray3, 8192, "%s", "App_Data_SW_Year");
      ReportTableRow(__tableHandle, 0, __cArray2, "==", syspar::`F182_App_Data_Identification::`App_Data_SW_Year, __cArray3, __oneOfFlag, __bSetInCheckAlignment);
      ReportCell(__tableHandle, __nDiagValue);
      ReportCellResult(__tableHandle, __csr, __ePassFail);
    
      __res = __res && __csr;
    
    }
    {
      double __nDiagValue;
      DiagGetParameterErrorHandled(__resp, "_SW__Week_40", __nDiagValue);
      __csr = CheckSignalMatch(__nDiagValue, syspar::`F182_App_Data_Identification::`App_Data_SW_Week, ">=") == 1;
      snprintf(__cArray, 8192, "%s", "Diagnostic parameter \'_SW__Week_40\'");
      snprintf(__cArray2, 8192, "%s", __cArray);
      snprintf(__cArray3, 8192, "%s", "App_Data_SW_Week");
      ReportTableRow(__tableHandle, 0, __cArray2, ">=", syspar::`F182_App_Data_Identification::`App_Data_SW_Week, __cArray3, __oneOfFlag, __bSetInCheckAlignment);
      ReportCell(__tableHandle, __nDiagValue);
      ReportCellResult(__tableHandle, __csr, __ePassFail);
    
      __res = __res && __csr;
    
    }
    {
      double __nDiagValue;
      DiagGetParameterErrorHandled(__resp, "_SW__Patch_Level_48", __nDiagValue);
      __csr = CheckSignalMatch(__nDiagValue, syspar::`F182_App_Data_Identification::`App_Data_SW_Patch_Level, ">=") == 1;
      snprintf(__cArray, 8192, "%s", "Diagnostic parameter \'_SW__Patch_Level_48\'");
      snprintf(__cArray2, 8192, "%s", __cArray);
      snprintf(__cArray3, 8192, "%s", "App_Data_SW_Patch_Level");
      ReportTableRow(__tableHandle, 0, __cArray2, ">=", syspar::`F182_App_Data_Identification::`App_Data_SW_Patch_Level, __cArray3, __oneOfFlag, __bSetInCheckAlignment);
      ReportCell(__tableHandle, __nDiagValue);
      ReportCellResult(__tableHandle, __csr, __ePassFail);
    
      __res = __res && __csr;
    
    }
    {
      __bDiagValueArrayCtr = DiagGetParameterErrorHandled(__resp, "_SW__Identification_56", __bDiagValueArray, elcount(__bDiagValueArray), __cDiagValueArray, elcount(__cDiagValueArray));
      CheckPlainParameterGetStringBufferConsistency(syspar::`F182_App_Data_Identification::`App_Data_SW_Identification,"syspar::`F182_App_Data_Identification::`App_Data_SW_Identification", 8192);
    snprintf(__cArray, 8192, "%s", syspar::`F182_App_Data_Identification::`App_Data_SW_Identification);  
      __bDiagValueArrayCtr2 = __MapChar2ByteAtDiagCheck(__cArray, __bDiagValueArray2);
      snprintf(__cArray10, 8192, "%s", "App_Data_SW_Identification");
      {
        __bArrayCtr = __CopyBytes(__bDiagValueArray, __bDiagValueArrayCtr, __bArray);
        __bArrayCtr2 = __CopyBytes(__bDiagValueArray2, __bDiagValueArrayCtr2, __bArray2);
        __csr = CompareBytes(__bArray, __bArrayCtr, __bArray2, __bArrayCtr2) == 0;
        snprintf(__cArray, 8192, "%s", "Diagnostic parameter \'_SW__Identification_56\'");
        snprintf(__cArray2, 8192, "%s", __cArray);
        snprintf(__cArray3, 8192, "%s", __cArray10);
        ReportTableRow(__tableHandle, 0, __cArray2, "Bytes", __bArray2, __bArrayCtr2, __cArray3, __oneOfFlag, __bSetInCheckAlignment);
        ReportCell(__tableHandle, __bArray, __bArrayCtr);
        ReportCellResult(__tableHandle, __csr, __ePassFail);
      }
    
      __res = __res && __csr;
    
    }
    ReportTableEndVerdict(__tableHandle, __cEvaluateResponse, __res);
	__bVerdict = __bVerdict && __res;
  }
  if (__bVerdict == __eVerdictFail)
    TestReportWriteDiagObjectList();
}

void Tt4h42sqi_F182_DID_with_Standard_Physical_Address()
{
  stack long __tableHandle;
  TestCommandBegin(__eRequestResponse, __cRequestResponse, "", "0");
  {
  
    long __res;
    int64 __timeout;
    __res = 0;
    __nInt64 = 1;
    __timeout = syspar::`P2_Server * 1000000LL;
    {
    
      long __testStepInitOk;
      message `FDCAN2::`DIAGNOSTIC_REQUEST_PAM __output;
      message `FDCAN2::`DIAGNOSTIC_REQUEST_PAM __msgOrig;
      __output = __msgOrig;
      __testStepInitOk = 1;
      {
        int64 __dlc;
        __dlc = 4;
        if (__dlc >= 0 && __dlc <= (__output.EDL ? 15 : 8))
          __output.DLC = __dlc;
        else
        {
          testStepErrorInTestSystem(0, __cEmpty, "Unable to set DLC=%lld in message. Please check input parameter.", __dlc);
          __testStepInitOk = 0;
        }
      }
      if (__testStepInitOk)
      {
        snprintf(__cArray, elCount(__cArray), "CAN message '%s' ID = 416981233x (0x18DAA0F1x) on bus FDCAN2", "DIAGNOSTIC_REQUEST_PAM");
        snprintf(__cArray2, elCount(__cArray2), "Send %s", __cArray);
        __tableHandle = ReportTableHead3Columns(__cArray2, "Byte", __cTOp, __cAssigned);
        ReportByteIndex("", 0, __cArray, elCount(__cArray));
        snprintf(__cArray2, 8192, "%s", __cArray);
        snprintf(__cArray3, 8192, "%s", "");
        
        ReportTableRow(__tableHandle, 0, __cArray2, __cAOp, 0x3, __cArray3, __oneOfFlag, __bSetInCheckAlignment);
        
        if (0 >= 0 && 0 < 64)
        {
          __output.byte((word)0) = 0x3;
        }
        else
        {
          testStepErrorInTestSystem(0, __cEmpty, "Index out of range. Unable to set byte %lld in message. Please check input parameter.", (int64)0);
          __testStepInitOk = 0;
        }
        ReportByteIndex("", 1, __cArray, elCount(__cArray));
        snprintf(__cArray2, 8192, "%s", __cArray);
        snprintf(__cArray3, 8192, "%s", "");
        
        ReportTableRow(__tableHandle, 0, __cArray2, __cAOp, 0x22, __cArray3, __oneOfFlag, __bSetInCheckAlignment);
        
        if (1 >= 0 && 1 < 64)
        {
          __output.byte((word)1) = 0x22;
        }
        else
        {
          testStepErrorInTestSystem(0, __cEmpty, "Index out of range. Unable to set byte %lld in message. Please check input parameter.", (int64)1);
          __testStepInitOk = 0;
        }
        ReportByteIndex("", 2, __cArray, elCount(__cArray));
        snprintf(__cArray2, 8192, "%s", __cArray);
        snprintf(__cArray3, 8192, "%s", "");
        
        ReportTableRow(__tableHandle, 0, __cArray2, __cAOp, 0xF1, __cArray3, __oneOfFlag, __bSetInCheckAlignment);
        
        if (2 >= 0 && 2 < 64)
        {
          __output.byte((word)2) = 0xF1;
        }
        else
        {
          testStepErrorInTestSystem(0, __cEmpty, "Index out of range. Unable to set byte %lld in message. Please check input parameter.", (int64)2);
          __testStepInitOk = 0;
        }
        ReportByteIndex("", 3, __cArray, elCount(__cArray));
        snprintf(__cArray2, 8192, "%s", __cArray);
        snprintf(__cArray3, 8192, "%s", "");
        
        ReportTableRow(__tableHandle, 0, __cArray2, __cAOp, 0x82, __cArray3, __oneOfFlag, __bSetInCheckAlignment);
        
        if (3 >= 0 && 3 < 64)
        {
          __output.byte((word)3) = 0x82;
        }
        else
        {
          testStepErrorInTestSystem(0, __cEmpty, "Index out of range. Unable to set byte %lld in message. Please check input parameter.", (int64)3);
          __testStepInitOk = 0;
        }
      
        ReportTableEndTestStep(__tableHandle, "Req1");
      }
      if (__testStepInitOk)
      {
        output(__output);
      }
    }
    if (__timeout <= 0)
    {
      testStepErrorInTestSystem(0, "1", "Unable to wait for %.3f %s. Please check input parameter.", __timeout / ((float)1000000), "ms");
    }
    else
    {
      __tt2cnt_9 = 0;
      snprintf(__cArray, elCount(__cArray), "CAN message '%s' ID = 417001888x (0x18DAF1A0x) on bus FDCAN2", "DIAGNOSTIC_RESPONSE_PAM");
      if(SetBusContextByName("FDCAN2", __eSaveCurrent, __nBusContextNew, __nBusContextOld))
        testJoinMessageEvent(`FDCAN2::`DIAGNOSTIC_RESPONSE_PAM,  __cArray,
             delegate dword(message * __m)
             {
               dword __msg_callback_ret;
               if (__tt2cnt_9 == -1)
               {
                 return 1;
               }
               __msg_callback_ret = 1;
               __tt2cnt_9++;
               if (__msg_callback_ret)
               {
                 __tt2cnt_9 = -1;
                 return 1;
               }
               return 0;
             });
      __res = testWaitForAllJoinedEventsNS(__timeout);
      if (__nInt64 != 0)
      {
        snprintf(__cArray, elCount(__cArray), "CAN message '%s' ID = 417001888x (0x18DAF1A0x) on bus FDCAN2", "DIAGNOSTIC_RESPONSE_PAM");
        if(__tt2cnt_9 == -1)
        {
          snprintf(__cArray2, 8192, "Response of %s", __cArray);
        }
        else
        {
          snprintf(__cArray2, 8192, "Response of %s (received %d times)", __cArray, __tt2cnt_9);
        }
        if (__tt2cnt_9 == 0)
        {
          testStepFail(0, "Resp1", __cArray2);
        }
        else
        {
          testStepPass(2, "Resp1", __cArray2);
        }
        __ReportRequestResponseResult(__res, 0);
      }
      ResetBusContext(__nBusContextNew, __nBusContextOld);
    }
  }
  TestCommandEnd();

}

void Tt4h42sqi_F122_DID_with_Physical_Address()
{
  stack long __tableHandle;
  TestCommandBegin(__eDiagService, __cDiagService, "", "0");
  {
    if (DiagIsFunctionalGroup("CVADAS_0001_00000000_000"))
    {
      DiagResponse * __resp;
      DiagRequest CVADAS_0001_00000000_000._22F122_Software_EBOM_Part_Number __req;
      __diagService4h42sqi_8(__req, __resp);
    }
    else
    {
      DiagResponse CVADAS_0001_00000000_000.* __resp;
      DiagRequest CVADAS_0001_00000000_000._22F122_Software_EBOM_Part_Number __req;
      __diagService4h42sqi_8(__req, __resp);
    }
  }
  TestCommandEnd();


}

  
void __diagService4h42sqi_8(DiagRequest * __req, DiagResponse * __resp )
{
  stack long __tableHandle;
  long __res, __paramLen, __bytePos;

   __bVerdict = __eVerdictPass;

  do {
    TestReportResetDiagObjectList();
    DiagSetReportDetailLevel("CVADAS_0001_00000000_000", EnumServiceDetails_onfail);
    // Request aspect
    {

      if (0 >= DiagSendReqAndWaitForResp("CVADAS_0001_00000000_000", __req, __resp, __res, -1, -1, -1, -1, -1, EnumResult_pos, EnumServiceDetails_onfail, EnumSendingMode_physical, EnumSuppressPosResBit_asconfigured, EnumVerdictOnInvalidValues_fail))
        break;
    }

    __res = DiagErrCodeTestStep(__res, "Can't retrieve last response for request! No check possible.") < 0;
    if(__res)
    {
	  __bVerdict = __eVerdictFail;
      break;
    }
    {
      __res = DiagInterpretAs(__resp, "RDBI_PR");
      if(__res != 0)
      {
        __bVerdict = __eVerdictFail;
        DiagErrCodeTestStep(__res, "Can't interpret response as diagnostic primitive 'RDBI_PR'.");
        break;
      }
      else
      {
        TestStepPass( "Received primitive can be interpreted as diagnostic primitive 'RDBI_PR'.");
      }
    }
  }
  while(0);


  // Response, check & read aspect
  {
    __res = 1;
    __tableHandle = ReportTableHead5Columns(__cCheckCaption, __cTSym, __cTOp, __cRefVal, __cActual, __cRes);
    {
      __bDiagValueArrayCtr = DiagGetParameterErrorHandled(__resp, "_Software_Logical_Block_1_Part_Number_24", __bDiagValueArray, elcount(__bDiagValueArray), __cDiagValueArray, elcount(__cDiagValueArray));
      {
        __bArrayCtr = __CopyBytes(__bDiagValueArray, __bDiagValueArrayCtr, __bArray);
        CheckPlainParameterGetDataBufferConsistency(sysParGetData(syspar::`F122_SW_EBOM_Part_Number::`SW_Loical_Block_1_Part_Number, __bArray2, __bArrayCtr2), __bArrayCtr2, "syspar::`F122_SW_EBOM_Part_Number::`SW_Loical_Block_1_Part_Number");
        __csr = CompareBytes(__bArray, __bArrayCtr, __bArray2, __bArrayCtr2) == 0;
        snprintf(__cArray, 8192, "%s", "Diagnostic parameter \'_Software_Logical_Block_1_Part_Number_24\'");
        snprintf(__cArray2, 8192, "%s", __cArray);
        snprintf(__cArray3, 8192, "%s", "SW_Loical_Block_1_Part_Number");
        ReportTableRow(__tableHandle, 0, __cArray2, "Bytes", __bArray2, __bArrayCtr2, __cArray3, __oneOfFlag, __bSetInCheckAlignment);
        ReportCell(__tableHandle, __bArray, __bArrayCtr);
        ReportCellResult(__tableHandle, __csr, __ePassFail);
      }
    
      __res = __res && __csr;
    
    }
    {
      __bDiagValueArrayCtr = DiagGetParameterErrorHandled(__resp, "Software_Logical_Block_2_Part_Number", __bDiagValueArray, elcount(__bDiagValueArray), __cDiagValueArray, elcount(__cDiagValueArray));
      {
        __bArrayCtr = __CopyBytes(__bDiagValueArray, __bDiagValueArrayCtr, __bArray);
        CheckPlainParameterGetDataBufferConsistency(sysParGetData(syspar::`F122_SW_EBOM_Part_Number::`SW_Loical_Block_2_Part_Number, __bArray2, __bArrayCtr2), __bArrayCtr2, "syspar::`F122_SW_EBOM_Part_Number::`SW_Loical_Block_2_Part_Number");
        __csr = CompareBytes(__bArray, __bArrayCtr, __bArray2, __bArrayCtr2) == 0;
        snprintf(__cArray, 8192, "%s", "Diagnostic parameter \'Software_Logical_Block_2_Part_Number\'");
        snprintf(__cArray2, 8192, "%s", __cArray);
        snprintf(__cArray3, 8192, "%s", "SW_Loical_Block_2_Part_Number");
        ReportTableRow(__tableHandle, 0, __cArray2, "Bytes", __bArray2, __bArrayCtr2, __cArray3, __oneOfFlag, __bSetInCheckAlignment);
        ReportCell(__tableHandle, __bArray, __bArrayCtr);
        ReportCellResult(__tableHandle, __csr, __ePassFail);
      }
    
      __res = __res && __csr;
    
    }
    {
      __bDiagValueArrayCtr = DiagGetParameterErrorHandled(__resp, "Software_Logical_Block_3_Part_Number", __bDiagValueArray, elcount(__bDiagValueArray), __cDiagValueArray, elcount(__cDiagValueArray));
      {
        __bArrayCtr = __CopyBytes(__bDiagValueArray, __bDiagValueArrayCtr, __bArray);
        CheckPlainParameterGetDataBufferConsistency(sysParGetData(syspar::`F122_SW_EBOM_Part_Number::`SW_Loical_Block_3_Part_Number, __bArray2, __bArrayCtr2), __bArrayCtr2, "syspar::`F122_SW_EBOM_Part_Number::`SW_Loical_Block_3_Part_Number");
        __csr = CompareBytes(__bArray, __bArrayCtr, __bArray2, __bArrayCtr2) == 0;
        snprintf(__cArray, 8192, "%s", "Diagnostic parameter \'Software_Logical_Block_3_Part_Number\'");
        snprintf(__cArray2, 8192, "%s", __cArray);
        snprintf(__cArray3, 8192, "%s", "SW_Loical_Block_3_Part_Number");
        ReportTableRow(__tableHandle, 0, __cArray2, "Bytes", __bArray2, __bArrayCtr2, __cArray3, __oneOfFlag, __bSetInCheckAlignment);
        ReportCell(__tableHandle, __bArray, __bArrayCtr);
        ReportCellResult(__tableHandle, __csr, __ePassFail);
      }
    
      __res = __res && __csr;
    
    }
    {
      __bDiagValueArrayCtr = DiagGetParameterErrorHandled(__resp, "Software_Logical_Block_4_Part_Number", __bDiagValueArray, elcount(__bDiagValueArray), __cDiagValueArray, elcount(__cDiagValueArray));
      {
        __bArrayCtr = __CopyBytes(__bDiagValueArray, __bDiagValueArrayCtr, __bArray);
        CheckPlainParameterGetDataBufferConsistency(sysParGetData(syspar::`F122_SW_EBOM_Part_Number::`SW_Loical_Block_4_Part_Number, __bArray2, __bArrayCtr2), __bArrayCtr2, "syspar::`F122_SW_EBOM_Part_Number::`SW_Loical_Block_4_Part_Number");
        __csr = CompareBytes(__bArray, __bArrayCtr, __bArray2, __bArrayCtr2) == 0;
        snprintf(__cArray, 8192, "%s", "Diagnostic parameter \'Software_Logical_Block_4_Part_Number\'");
        snprintf(__cArray2, 8192, "%s", __cArray);
        snprintf(__cArray3, 8192, "%s", "SW_Loical_Block_4_Part_Number");
        ReportTableRow(__tableHandle, 0, __cArray2, "Bytes", __bArray2, __bArrayCtr2, __cArray3, __oneOfFlag, __bSetInCheckAlignment);
        ReportCell(__tableHandle, __bArray, __bArrayCtr);
        ReportCellResult(__tableHandle, __csr, __ePassFail);
      }
    
      __res = __res && __csr;
    
    }
    {
      __bDiagValueArrayCtr = DiagGetParameterErrorHandled(__resp, "Software_Logical_Block_5_Part_Number", __bDiagValueArray, elcount(__bDiagValueArray), __cDiagValueArray, elcount(__cDiagValueArray));
      {
        __bArrayCtr = __CopyBytes(__bDiagValueArray, __bDiagValueArrayCtr, __bArray);
        CheckPlainParameterGetDataBufferConsistency(sysParGetData(syspar::`F122_SW_EBOM_Part_Number::`SW_Loical_Block_5_Part_Number, __bArray2, __bArrayCtr2), __bArrayCtr2, "syspar::`F122_SW_EBOM_Part_Number::`SW_Loical_Block_5_Part_Number");
        __csr = CompareBytes(__bArray, __bArrayCtr, __bArray2, __bArrayCtr2) == 0;
        snprintf(__cArray, 8192, "%s", "Diagnostic parameter \'Software_Logical_Block_5_Part_Number\'");
        snprintf(__cArray2, 8192, "%s", __cArray);
        snprintf(__cArray3, 8192, "%s", "SW_Loical_Block_5_Part_Number");
        ReportTableRow(__tableHandle, 0, __cArray2, "Bytes", __bArray2, __bArrayCtr2, __cArray3, __oneOfFlag, __bSetInCheckAlignment);
        ReportCell(__tableHandle, __bArray, __bArrayCtr);
        ReportCellResult(__tableHandle, __csr, __ePassFail);
      }
    
      __res = __res && __csr;
    
    }
    {
      __bDiagValueArrayCtr = DiagGetParameterErrorHandled(__resp, "Software_Logical_Block_7_Part_Number", __bDiagValueArray, elcount(__bDiagValueArray), __cDiagValueArray, elcount(__cDiagValueArray));
      {
        __bArrayCtr = __CopyBytes(__bDiagValueArray, __bDiagValueArrayCtr, __bArray);
        CheckPlainParameterGetDataBufferConsistency(sysParGetData(syspar::`F122_SW_EBOM_Part_Number::`SW_Loical_Block_7_Part_Number, __bArray2, __bArrayCtr2), __bArrayCtr2, "syspar::`F122_SW_EBOM_Part_Number::`SW_Loical_Block_7_Part_Number");
        __csr = CompareBytes(__bArray, __bArrayCtr, __bArray2, __bArrayCtr2) == 0;
        snprintf(__cArray, 8192, "%s", "Diagnostic parameter \'Software_Logical_Block_7_Part_Number\'");
        snprintf(__cArray2, 8192, "%s", __cArray);
        snprintf(__cArray3, 8192, "%s", "SW_Loical_Block_7_Part_Number");
        ReportTableRow(__tableHandle, 0, __cArray2, "Bytes", __bArray2, __bArrayCtr2, __cArray3, __oneOfFlag, __bSetInCheckAlignment);
        ReportCell(__tableHandle, __bArray, __bArrayCtr);
        ReportCellResult(__tableHandle, __csr, __ePassFail);
      }
    
      __res = __res && __csr;
    
    }
    {
      __bDiagValueArrayCtr = DiagGetParameterErrorHandled(__resp, "Software_Logical_Block_8_Part_Number", __bDiagValueArray, elcount(__bDiagValueArray), __cDiagValueArray, elcount(__cDiagValueArray));
      {
        __bArrayCtr = __CopyBytes(__bDiagValueArray, __bDiagValueArrayCtr, __bArray);
        CheckPlainParameterGetDataBufferConsistency(sysParGetData(syspar::`F122_SW_EBOM_Part_Number::`SW_Loical_Block_8_Part_Number, __bArray2, __bArrayCtr2), __bArrayCtr2, "syspar::`F122_SW_EBOM_Part_Number::`SW_Loical_Block_8_Part_Number");
        __csr = CompareBytes(__bArray, __bArrayCtr, __bArray2, __bArrayCtr2) == 0;
        snprintf(__cArray, 8192, "%s", "Diagnostic parameter \'Software_Logical_Block_8_Part_Number\'");
        snprintf(__cArray2, 8192, "%s", __cArray);
        snprintf(__cArray3, 8192, "%s", "SW_Loical_Block_8_Part_Number");
        ReportTableRow(__tableHandle, 0, __cArray2, "Bytes", __bArray2, __bArrayCtr2, __cArray3, __oneOfFlag, __bSetInCheckAlignment);
        ReportCell(__tableHandle, __bArray, __bArrayCtr);
        ReportCellResult(__tableHandle, __csr, __ePassFail);
      }
    
      __res = __res && __csr;
    
    }
    ReportTableEndVerdict(__tableHandle, __cEvaluateResponse, __res);
	__bVerdict = __bVerdict && __res;
  }
  if (__bVerdict == __eVerdictFail)
    TestReportWriteDiagObjectList();
}

void Tt4h42sqi_F122_DID_with_Functional_Address()
{
  stack long __tableHandle;
  TestCommandBegin(__eDiagService, __cDiagService, "", "0");
  {
    if (DiagIsFunctionalGroup("CVADAS_0001_00000000_000"))
    {
      DiagResponse * __resp;
      DiagRequest CVADAS_0001_00000000_000._22F122_Software_EBOM_Part_Number __req;
      __diagService4h42sqi_9(__req, __resp);
    }
    else
    {
      DiagResponse CVADAS_0001_00000000_000.* __resp;
      DiagRequest CVADAS_0001_00000000_000._22F122_Software_EBOM_Part_Number __req;
      __diagService4h42sqi_9(__req, __resp);
    }
  }
  TestCommandEnd();


}

  
void __diagService4h42sqi_9(DiagRequest * __req, DiagResponse * __resp )
{
  stack long __tableHandle;
  long __res, __paramLen, __bytePos;

   __bVerdict = __eVerdictPass;

  do {
    TestReportResetDiagObjectList();
    DiagSetReportDetailLevel("CVADAS_0001_00000000_000", EnumServiceDetails_onfail);
    // Request aspect
    {

      if (0 >= DiagSendReqAndWaitForResp("CVADAS_0001_00000000_000", __req, __resp, __res, -1, -1, -1, -1, -1, EnumResult_pos, EnumServiceDetails_onfail, EnumSendingMode_functional, EnumSuppressPosResBit_asconfigured, EnumVerdictOnInvalidValues_fail))
        break;
    }

    __res = DiagErrCodeTestStep(__res, "Can't retrieve last response for request! No check possible.") < 0;
    if(__res)
    {
	  __bVerdict = __eVerdictFail;
      break;
    }
    {
      __res = DiagInterpretAs(__resp, "RDBI_PR");
      if(__res != 0)
      {
        __bVerdict = __eVerdictFail;
        DiagErrCodeTestStep(__res, "Can't interpret response as diagnostic primitive 'RDBI_PR'.");
        break;
      }
      else
      {
        TestStepPass( "Received primitive can be interpreted as diagnostic primitive 'RDBI_PR'.");
      }
    }
  }
  while(0);


  // Response, check & read aspect
  {
    __res = 1;
    __tableHandle = ReportTableHead5Columns(__cCheckCaption, __cTSym, __cTOp, __cRefVal, __cActual, __cRes);
    {
      __bDiagValueArrayCtr = DiagGetParameterErrorHandled(__resp, "_Software_Logical_Block_1_Part_Number_24", __bDiagValueArray, elcount(__bDiagValueArray), __cDiagValueArray, elcount(__cDiagValueArray));
      {
        __bArrayCtr = __CopyBytes(__bDiagValueArray, __bDiagValueArrayCtr, __bArray);
        CheckPlainParameterGetDataBufferConsistency(sysParGetData(syspar::`F122_SW_EBOM_Part_Number::`SW_Loical_Block_1_Part_Number, __bArray2, __bArrayCtr2), __bArrayCtr2, "syspar::`F122_SW_EBOM_Part_Number::`SW_Loical_Block_1_Part_Number");
        __csr = CompareBytes(__bArray, __bArrayCtr, __bArray2, __bArrayCtr2) == 0;
        snprintf(__cArray, 8192, "%s", "Diagnostic parameter \'_Software_Logical_Block_1_Part_Number_24\'");
        snprintf(__cArray2, 8192, "%s", __cArray);
        snprintf(__cArray3, 8192, "%s", "SW_Loical_Block_1_Part_Number");
        ReportTableRow(__tableHandle, 0, __cArray2, "Bytes", __bArray2, __bArrayCtr2, __cArray3, __oneOfFlag, __bSetInCheckAlignment);
        ReportCell(__tableHandle, __bArray, __bArrayCtr);
        ReportCellResult(__tableHandle, __csr, __ePassFail);
      }
    
      __res = __res && __csr;
    
    }
    {
      __bDiagValueArrayCtr = DiagGetParameterErrorHandled(__resp, "Software_Logical_Block_2_Part_Number", __bDiagValueArray, elcount(__bDiagValueArray), __cDiagValueArray, elcount(__cDiagValueArray));
      {
        __bArrayCtr = __CopyBytes(__bDiagValueArray, __bDiagValueArrayCtr, __bArray);
        CheckPlainParameterGetDataBufferConsistency(sysParGetData(syspar::`F122_SW_EBOM_Part_Number::`SW_Loical_Block_2_Part_Number, __bArray2, __bArrayCtr2), __bArrayCtr2, "syspar::`F122_SW_EBOM_Part_Number::`SW_Loical_Block_2_Part_Number");
        __csr = CompareBytes(__bArray, __bArrayCtr, __bArray2, __bArrayCtr2) == 0;
        snprintf(__cArray, 8192, "%s", "Diagnostic parameter \'Software_Logical_Block_2_Part_Number\'");
        snprintf(__cArray2, 8192, "%s", __cArray);
        snprintf(__cArray3, 8192, "%s", "SW_Loical_Block_2_Part_Number");
        ReportTableRow(__tableHandle, 0, __cArray2, "Bytes", __bArray2, __bArrayCtr2, __cArray3, __oneOfFlag, __bSetInCheckAlignment);
        ReportCell(__tableHandle, __bArray, __bArrayCtr);
        ReportCellResult(__tableHandle, __csr, __ePassFail);
      }
    
      __res = __res && __csr;
    
    }
    {
      __bDiagValueArrayCtr = DiagGetParameterErrorHandled(__resp, "Software_Logical_Block_3_Part_Number", __bDiagValueArray, elcount(__bDiagValueArray), __cDiagValueArray, elcount(__cDiagValueArray));
      {
        __bArrayCtr = __CopyBytes(__bDiagValueArray, __bDiagValueArrayCtr, __bArray);
        CheckPlainParameterGetDataBufferConsistency(sysParGetData(syspar::`F122_SW_EBOM_Part_Number::`SW_Loical_Block_3_Part_Number, __bArray2, __bArrayCtr2), __bArrayCtr2, "syspar::`F122_SW_EBOM_Part_Number::`SW_Loical_Block_3_Part_Number");
        __csr = CompareBytes(__bArray, __bArrayCtr, __bArray2, __bArrayCtr2) == 0;
        snprintf(__cArray, 8192, "%s", "Diagnostic parameter \'Software_Logical_Block_3_Part_Number\'");
        snprintf(__cArray2, 8192, "%s", __cArray);
        snprintf(__cArray3, 8192, "%s", "SW_Loical_Block_3_Part_Number");
        ReportTableRow(__tableHandle, 0, __cArray2, "Bytes", __bArray2, __bArrayCtr2, __cArray3, __oneOfFlag, __bSetInCheckAlignment);
        ReportCell(__tableHandle, __bArray, __bArrayCtr);
        ReportCellResult(__tableHandle, __csr, __ePassFail);
      }
    
      __res = __res && __csr;
    
    }
    {
      __bDiagValueArrayCtr = DiagGetParameterErrorHandled(__resp, "Software_Logical_Block_4_Part_Number", __bDiagValueArray, elcount(__bDiagValueArray), __cDiagValueArray, elcount(__cDiagValueArray));
      {
        __bArrayCtr = __CopyBytes(__bDiagValueArray, __bDiagValueArrayCtr, __bArray);
        CheckPlainParameterGetDataBufferConsistency(sysParGetData(syspar::`F122_SW_EBOM_Part_Number::`SW_Loical_Block_4_Part_Number, __bArray2, __bArrayCtr2), __bArrayCtr2, "syspar::`F122_SW_EBOM_Part_Number::`SW_Loical_Block_4_Part_Number");
        __csr = CompareBytes(__bArray, __bArrayCtr, __bArray2, __bArrayCtr2) == 0;
        snprintf(__cArray, 8192, "%s", "Diagnostic parameter \'Software_Logical_Block_4_Part_Number\'");
        snprintf(__cArray2, 8192, "%s", __cArray);
        snprintf(__cArray3, 8192, "%s", "SW_Loical_Block_4_Part_Number");
        ReportTableRow(__tableHandle, 0, __cArray2, "Bytes", __bArray2, __bArrayCtr2, __cArray3, __oneOfFlag, __bSetInCheckAlignment);
        ReportCell(__tableHandle, __bArray, __bArrayCtr);
        ReportCellResult(__tableHandle, __csr, __ePassFail);
      }
    
      __res = __res && __csr;
    
    }
    {
      __bDiagValueArrayCtr = DiagGetParameterErrorHandled(__resp, "Software_Logical_Block_5_Part_Number", __bDiagValueArray, elcount(__bDiagValueArray), __cDiagValueArray, elcount(__cDiagValueArray));
      {
        __bArrayCtr = __CopyBytes(__bDiagValueArray, __bDiagValueArrayCtr, __bArray);
        CheckPlainParameterGetDataBufferConsistency(sysParGetData(syspar::`F122_SW_EBOM_Part_Number::`SW_Loical_Block_5_Part_Number, __bArray2, __bArrayCtr2), __bArrayCtr2, "syspar::`F122_SW_EBOM_Part_Number::`SW_Loical_Block_5_Part_Number");
        __csr = CompareBytes(__bArray, __bArrayCtr, __bArray2, __bArrayCtr2) == 0;
        snprintf(__cArray, 8192, "%s", "Diagnostic parameter \'Software_Logical_Block_5_Part_Number\'");
        snprintf(__cArray2, 8192, "%s", __cArray);
        snprintf(__cArray3, 8192, "%s", "SW_Loical_Block_5_Part_Number");
        ReportTableRow(__tableHandle, 0, __cArray2, "Bytes", __bArray2, __bArrayCtr2, __cArray3, __oneOfFlag, __bSetInCheckAlignment);
        ReportCell(__tableHandle, __bArray, __bArrayCtr);
        ReportCellResult(__tableHandle, __csr, __ePassFail);
      }
    
      __res = __res && __csr;
    
    }
    {
      __bDiagValueArrayCtr = DiagGetParameterErrorHandled(__resp, "Software_Logical_Block_7_Part_Number", __bDiagValueArray, elcount(__bDiagValueArray), __cDiagValueArray, elcount(__cDiagValueArray));
      {
        __bArrayCtr = __CopyBytes(__bDiagValueArray, __bDiagValueArrayCtr, __bArray);
        CheckPlainParameterGetDataBufferConsistency(sysParGetData(syspar::`F122_SW_EBOM_Part_Number::`SW_Loical_Block_7_Part_Number, __bArray2, __bArrayCtr2), __bArrayCtr2, "syspar::`F122_SW_EBOM_Part_Number::`SW_Loical_Block_7_Part_Number");
        __csr = CompareBytes(__bArray, __bArrayCtr, __bArray2, __bArrayCtr2) == 0;
        snprintf(__cArray, 8192, "%s", "Diagnostic parameter \'Software_Logical_Block_7_Part_Number\'");
        snprintf(__cArray2, 8192, "%s", __cArray);
        snprintf(__cArray3, 8192, "%s", "SW_Loical_Block_7_Part_Number");
        ReportTableRow(__tableHandle, 0, __cArray2, "Bytes", __bArray2, __bArrayCtr2, __cArray3, __oneOfFlag, __bSetInCheckAlignment);
        ReportCell(__tableHandle, __bArray, __bArrayCtr);
        ReportCellResult(__tableHandle, __csr, __ePassFail);
      }
    
      __res = __res && __csr;
    
    }
    {
      __bDiagValueArrayCtr = DiagGetParameterErrorHandled(__resp, "Software_Logical_Block_8_Part_Number", __bDiagValueArray, elcount(__bDiagValueArray), __cDiagValueArray, elcount(__cDiagValueArray));
      {
        __bArrayCtr = __CopyBytes(__bDiagValueArray, __bDiagValueArrayCtr, __bArray);
        CheckPlainParameterGetDataBufferConsistency(sysParGetData(syspar::`F122_SW_EBOM_Part_Number::`SW_Loical_Block_8_Part_Number, __bArray2, __bArrayCtr2), __bArrayCtr2, "syspar::`F122_SW_EBOM_Part_Number::`SW_Loical_Block_8_Part_Number");
        __csr = CompareBytes(__bArray, __bArrayCtr, __bArray2, __bArrayCtr2) == 0;
        snprintf(__cArray, 8192, "%s", "Diagnostic parameter \'Software_Logical_Block_8_Part_Number\'");
        snprintf(__cArray2, 8192, "%s", __cArray);
        snprintf(__cArray3, 8192, "%s", "SW_Loical_Block_8_Part_Number");
        ReportTableRow(__tableHandle, 0, __cArray2, "Bytes", __bArray2, __bArrayCtr2, __cArray3, __oneOfFlag, __bSetInCheckAlignment);
        ReportCell(__tableHandle, __bArray, __bArrayCtr);
        ReportCellResult(__tableHandle, __csr, __ePassFail);
      }
    
      __res = __res && __csr;
    
    }
    ReportTableEndVerdict(__tableHandle, __cEvaluateResponse, __res);
	__bVerdict = __bVerdict && __res;
  }
  if (__bVerdict == __eVerdictFail)
    TestReportWriteDiagObjectList();
}

void Tt4h42sqi_F122_DID_with_Standard_Physical_Address()
{
  stack long __tableHandle;
  TestCommandBegin(__eRequestResponse, __cRequestResponse, "", "0");
  {
  
    long __res;
    int64 __timeout;
    __res = 0;
    __nInt64 = 1;
    __timeout = syspar::`P2_Server * 1000000LL;
    {
    
      long __testStepInitOk;
      message `FDCAN2::`DIAGNOSTIC_REQUEST_PAM __output;
      message `FDCAN2::`DIAGNOSTIC_REQUEST_PAM __msgOrig;
      __output = __msgOrig;
      __testStepInitOk = 1;
      {
        int64 __dlc;
        __dlc = 4;
        if (__dlc >= 0 && __dlc <= (__output.EDL ? 15 : 8))
          __output.DLC = __dlc;
        else
        {
          testStepErrorInTestSystem(0, __cEmpty, "Unable to set DLC=%lld in message. Please check input parameter.", __dlc);
          __testStepInitOk = 0;
        }
      }
      if (__testStepInitOk)
      {
        snprintf(__cArray, elCount(__cArray), "CAN message '%s' ID = 416981233x (0x18DAA0F1x) on bus FDCAN2", "DIAGNOSTIC_REQUEST_PAM");
        snprintf(__cArray2, elCount(__cArray2), "Send %s", __cArray);
        __tableHandle = ReportTableHead3Columns(__cArray2, "Byte", __cTOp, __cAssigned);
        ReportByteIndex("", 0, __cArray, elCount(__cArray));
        snprintf(__cArray2, 8192, "%s", __cArray);
        snprintf(__cArray3, 8192, "%s", "");
        
        ReportTableRow(__tableHandle, 0, __cArray2, __cAOp, 0x3, __cArray3, __oneOfFlag, __bSetInCheckAlignment);
        
        if (0 >= 0 && 0 < 64)
        {
          __output.byte((word)0) = 0x3;
        }
        else
        {
          testStepErrorInTestSystem(0, __cEmpty, "Index out of range. Unable to set byte %lld in message. Please check input parameter.", (int64)0);
          __testStepInitOk = 0;
        }
        ReportByteIndex("", 1, __cArray, elCount(__cArray));
        snprintf(__cArray2, 8192, "%s", __cArray);
        snprintf(__cArray3, 8192, "%s", "");
        
        ReportTableRow(__tableHandle, 0, __cArray2, __cAOp, 0x22, __cArray3, __oneOfFlag, __bSetInCheckAlignment);
        
        if (1 >= 0 && 1 < 64)
        {
          __output.byte((word)1) = 0x22;
        }
        else
        {
          testStepErrorInTestSystem(0, __cEmpty, "Index out of range. Unable to set byte %lld in message. Please check input parameter.", (int64)1);
          __testStepInitOk = 0;
        }
        ReportByteIndex("", 2, __cArray, elCount(__cArray));
        snprintf(__cArray2, 8192, "%s", __cArray);
        snprintf(__cArray3, 8192, "%s", "");
        
        ReportTableRow(__tableHandle, 0, __cArray2, __cAOp, 0xF1, __cArray3, __oneOfFlag, __bSetInCheckAlignment);
        
        if (2 >= 0 && 2 < 64)
        {
          __output.byte((word)2) = 0xF1;
        }
        else
        {
          testStepErrorInTestSystem(0, __cEmpty, "Index out of range. Unable to set byte %lld in message. Please check input parameter.", (int64)2);
          __testStepInitOk = 0;
        }
        ReportByteIndex("", 3, __cArray, elCount(__cArray));
        snprintf(__cArray2, 8192, "%s", __cArray);
        snprintf(__cArray3, 8192, "%s", "");
        
        ReportTableRow(__tableHandle, 0, __cArray2, __cAOp, 0x22, __cArray3, __oneOfFlag, __bSetInCheckAlignment);
        
        if (3 >= 0 && 3 < 64)
        {
          __output.byte((word)3) = 0x22;
        }
        else
        {
          testStepErrorInTestSystem(0, __cEmpty, "Index out of range. Unable to set byte %lld in message. Please check input parameter.", (int64)3);
          __testStepInitOk = 0;
        }
      
        ReportTableEndTestStep(__tableHandle, "Req1");
      }
      if (__testStepInitOk)
      {
        output(__output);
      }
    }
    if (__timeout <= 0)
    {
      testStepErrorInTestSystem(0, "1", "Unable to wait for %.3f %s. Please check input parameter.", __timeout / ((float)1000000), "ms");
    }
    else
    {
      __tt2cnt_11 = 0;
      snprintf(__cArray, elCount(__cArray), "CAN message '%s' ID = 417001888x (0x18DAF1A0x) on bus FDCAN2", "DIAGNOSTIC_RESPONSE_PAM");
      if(SetBusContextByName("FDCAN2", __eSaveCurrent, __nBusContextNew, __nBusContextOld))
        testJoinMessageEvent(`FDCAN2::`DIAGNOSTIC_RESPONSE_PAM,  __cArray,
             delegate dword(message * __m)
             {
               dword __msg_callback_ret;
               if (__tt2cnt_11 == -1)
               {
                 return 1;
               }
               __msg_callback_ret = 1;
               __tt2cnt_11++;
               if (__msg_callback_ret)
               {
                 __tt2cnt_11 = -1;
                 return 1;
               }
               return 0;
             });
      __res = testWaitForAllJoinedEventsNS(__timeout);
      if (__nInt64 != 0)
      {
        snprintf(__cArray, elCount(__cArray), "CAN message '%s' ID = 417001888x (0x18DAF1A0x) on bus FDCAN2", "DIAGNOSTIC_RESPONSE_PAM");
        if(__tt2cnt_11 == -1)
        {
          snprintf(__cArray2, 8192, "Response of %s", __cArray);
        }
        else
        {
          snprintf(__cArray2, 8192, "Response of %s (received %d times)", __cArray, __tt2cnt_11);
        }
        if (__tt2cnt_11 == 0)
        {
          testStepFail(0, "Resp1", __cArray2);
        }
        else
        {
          testStepPass(2, "Resp1", __cArray2);
        }
        __ReportRequestResponseResult(__res, 0);
      }
      ResetBusContext(__nBusContextNew, __nBusContextOld);
    }
  }
  TestCommandEnd();

}

void Tt4h42sqi_F180_DID_with_Physical_Address()
{
  stack long __tableHandle;
  TestCommandBegin(__eDiagService, __cDiagService, "", "0");
  {
    if (DiagIsFunctionalGroup("CVADAS_0001_00000000_000"))
    {
      DiagResponse * __resp;
      DiagRequest CVADAS_0001_00000000_000._22F180_Boot_Software_Version_Information __req;
      __diagService4h42sqi_10(__req, __resp);
    }
    else
    {
      DiagResponse CVADAS_0001_00000000_000.* __resp;
      DiagRequest CVADAS_0001_00000000_000._22F180_Boot_Software_Version_Information __req;
      __diagService4h42sqi_10(__req, __resp);
    }
  }
  TestCommandEnd();


}

  
void __diagService4h42sqi_10(DiagRequest * __req, DiagResponse * __resp )
{
  stack long __tableHandle;
  long __res, __paramLen, __bytePos;

   __bVerdict = __eVerdictPass;

  do {
    TestReportResetDiagObjectList();
    DiagSetReportDetailLevel("CVADAS_0001_00000000_000", EnumServiceDetails_onfail);
    // Request aspect
    {

      if (0 >= DiagSendReqAndWaitForResp("CVADAS_0001_00000000_000", __req, __resp, __res, -1, -1, -1, -1, -1, EnumResult_pos, EnumServiceDetails_onfail, EnumSendingMode_physical, EnumSuppressPosResBit_asconfigured, EnumVerdictOnInvalidValues_fail))
        break;
    }

    __res = DiagErrCodeTestStep(__res, "Can't retrieve last response for request! No check possible.") < 0;
    if(__res)
    {
	  __bVerdict = __eVerdictFail;
      break;
    }
    {
      __res = DiagInterpretAs(__resp, "RDBI_PR");
      if(__res != 0)
      {
        __bVerdict = __eVerdictFail;
        DiagErrCodeTestStep(__res, "Can't interpret response as diagnostic primitive 'RDBI_PR'.");
        break;
      }
      else
      {
        TestStepPass( "Received primitive can be interpreted as diagnostic primitive 'RDBI_PR'.");
      }
    }
  }
  while(0);


  // Response, check & read aspect
  {
    __res = 1;
    __tableHandle = ReportTableHead5Columns(__cCheckCaption, __cTSym, __cTOp, __cRefVal, __cActual, __cRes);
    {
      double __nDiagValue;
      DiagGetParameterErrorHandled(__resp, "_Number_of_Boot_Software_Logical_Blocks_24", __nDiagValue);
      __csr = CheckSignalMatch(__nDiagValue, syspar::`F180_Boot_SW_Version_Information::`Num_Boot_SW_Logical_Blocks, "==") == 1;
      snprintf(__cArray, 8192, "%s", "Diagnostic parameter \'_Number_of_Boot_Software_Logical_Blocks_24\'");
      snprintf(__cArray2, 8192, "%s", __cArray);
      snprintf(__cArray3, 8192, "%s", "Num_Boot_SW_Logical_Blocks");
      ReportTableRow(__tableHandle, 0, __cArray2, "==", syspar::`F180_Boot_SW_Version_Information::`Num_Boot_SW_Logical_Blocks, __cArray3, __oneOfFlag, __bSetInCheckAlignment);
      ReportCell(__tableHandle, __nDiagValue);
      ReportCellResult(__tableHandle, __csr, __ePassFail);
    
      __res = __res && __csr;
    
    }
    {
      double __nDiagValue;
      DiagGetParameterErrorHandled(__resp, "_SW_Year_32", __nDiagValue);
      __csr = CheckSignalMatch(__nDiagValue, syspar::`F180_Boot_SW_Version_Information::`Software_Year, ">=") == 1;
      snprintf(__cArray, 8192, "%s", "Diagnostic parameter \'_SW_Year_32\'");
      snprintf(__cArray2, 8192, "%s", __cArray);
      snprintf(__cArray3, 8192, "%s", "Software_Year");
      ReportTableRow(__tableHandle, 0, __cArray2, ">=", syspar::`F180_Boot_SW_Version_Information::`Software_Year, __cArray3, __oneOfFlag, __bSetInCheckAlignment);
      ReportCell(__tableHandle, __nDiagValue);
      ReportCellResult(__tableHandle, __csr, __ePassFail);
    
      __res = __res && __csr;
    
    }
    {
      double __nDiagValue;
      DiagGetParameterErrorHandled(__resp, "_SW__Week_40", __nDiagValue);
      __csr = CheckSignalMatch(__nDiagValue, 1, ">=") == 1;
      snprintf(__cArray, 8192, "%s", "Diagnostic parameter \'_SW__Week_40\'");
      snprintf(__cArray2, 8192, "%s", __cArray);
      snprintf(__cArray3, 8192, "%s", "");
      ReportTableRow(__tableHandle, 0, __cArray2, ">=", 1, __cArray3, __oneOfFlag, __bSetInCheckAlignment);
      ReportCell(__tableHandle, __nDiagValue);
      ReportCellResult(__tableHandle, __csr, __ePassFail);
    
      __res = __res && __csr;
    
    }
    {
      double __nDiagValue;
      DiagGetParameterErrorHandled(__resp, "_SW__Patch_Level_48", __nDiagValue);
      __csr = CheckSignalMatch(__nDiagValue, syspar::`F180_Boot_SW_Version_Information::`Software_Patch_Level, ">=") == 1;
      snprintf(__cArray, 8192, "%s", "Diagnostic parameter \'_SW__Patch_Level_48\'");
      snprintf(__cArray2, 8192, "%s", __cArray);
      snprintf(__cArray3, 8192, "%s", "Software_Patch_Level");
      ReportTableRow(__tableHandle, 0, __cArray2, ">=", syspar::`F180_Boot_SW_Version_Information::`Software_Patch_Level, __cArray3, __oneOfFlag, __bSetInCheckAlignment);
      ReportCell(__tableHandle, __nDiagValue);
      ReportCellResult(__tableHandle, __csr, __ePassFail);
    
      __res = __res && __csr;
    
    }
    {
      __bDiagValueArrayCtr = DiagGetParameterErrorHandled(__resp, "_SW__Identification_56", __bDiagValueArray, elcount(__bDiagValueArray), __cDiagValueArray, elcount(__cDiagValueArray));
      CheckPlainParameterGetStringBufferConsistency(syspar::`F180_Boot_SW_Version_Information::`Software_Identification,"syspar::`F180_Boot_SW_Version_Information::`Software_Identification", 8192);
    snprintf(__cArray, 8192, "%s", syspar::`F180_Boot_SW_Version_Information::`Software_Identification);  
      __bDiagValueArrayCtr2 = __MapChar2ByteAtDiagCheck(__cArray, __bDiagValueArray2);
      snprintf(__cArray10, 8192, "%s", "Software_Identification");
      {
        __bArrayCtr = __CopyBytes(__bDiagValueArray, __bDiagValueArrayCtr, __bArray);
        __bArrayCtr2 = __CopyBytes(__bDiagValueArray2, __bDiagValueArrayCtr2, __bArray2);
        __csr = CompareBytes(__bArray, __bArrayCtr, __bArray2, __bArrayCtr2) == 0;
        snprintf(__cArray, 8192, "%s", "Diagnostic parameter \'_SW__Identification_56\'");
        snprintf(__cArray2, 8192, "%s", __cArray);
        snprintf(__cArray3, 8192, "%s", __cArray10);
        ReportTableRow(__tableHandle, 0, __cArray2, "Bytes", __bArray2, __bArrayCtr2, __cArray3, __oneOfFlag, __bSetInCheckAlignment);
        ReportCell(__tableHandle, __bArray, __bArrayCtr);
        ReportCellResult(__tableHandle, __csr, __ePassFail);
      }
    
      __res = __res && __csr;
    
    }
    ReportTableEndVerdict(__tableHandle, __cEvaluateResponse, __res);
	__bVerdict = __bVerdict && __res;
  }
  if (__bVerdict == __eVerdictFail)
    TestReportWriteDiagObjectList();
}

void Tt4h42sqi_F180_DID_with_Functional_Address()
{
  stack long __tableHandle;
  TestCommandBegin(__eDiagService, __cDiagService, "", "0");
  {
    if (DiagIsFunctionalGroup("CVADAS_0001_00000000_000"))
    {
      DiagResponse * __resp;
      DiagRequest CVADAS_0001_00000000_000._22F180_Boot_Software_Version_Information __req;
      __diagService4h42sqi_11(__req, __resp);
    }
    else
    {
      DiagResponse CVADAS_0001_00000000_000.* __resp;
      DiagRequest CVADAS_0001_00000000_000._22F180_Boot_Software_Version_Information __req;
      __diagService4h42sqi_11(__req, __resp);
    }
  }
  TestCommandEnd();


}

  
void __diagService4h42sqi_11(DiagRequest * __req, DiagResponse * __resp )
{
  stack long __tableHandle;
  long __res, __paramLen, __bytePos;

   __bVerdict = __eVerdictPass;

  do {
    TestReportResetDiagObjectList();
    DiagSetReportDetailLevel("CVADAS_0001_00000000_000", EnumServiceDetails_onfail);
    // Request aspect
    {

      if (0 >= DiagSendReqAndWaitForResp("CVADAS_0001_00000000_000", __req, __resp, __res, -1, -1, -1, -1, -1, EnumResult_pos, EnumServiceDetails_onfail, EnumSendingMode_functional, EnumSuppressPosResBit_asconfigured, EnumVerdictOnInvalidValues_fail))
        break;
    }

    __res = DiagErrCodeTestStep(__res, "Can't retrieve last response for request! No check possible.") < 0;
    if(__res)
    {
	  __bVerdict = __eVerdictFail;
      break;
    }
    {
      __res = DiagInterpretAs(__resp, "RDBI_PR");
      if(__res != 0)
      {
        __bVerdict = __eVerdictFail;
        DiagErrCodeTestStep(__res, "Can't interpret response as diagnostic primitive 'RDBI_PR'.");
        break;
      }
      else
      {
        TestStepPass( "Received primitive can be interpreted as diagnostic primitive 'RDBI_PR'.");
      }
    }
  }
  while(0);


  // Response, check & read aspect
  {
    __res = 1;
    __tableHandle = ReportTableHead5Columns(__cCheckCaption, __cTSym, __cTOp, __cRefVal, __cActual, __cRes);
    {
      double __nDiagValue;
      DiagGetParameterErrorHandled(__resp, "_Number_of_Boot_Software_Logical_Blocks_24", __nDiagValue);
      __csr = CheckSignalMatch(__nDiagValue, syspar::`F180_Boot_SW_Version_Information::`Num_Boot_SW_Logical_Blocks, "==") == 1;
      snprintf(__cArray, 8192, "%s", "Diagnostic parameter \'_Number_of_Boot_Software_Logical_Blocks_24\'");
      snprintf(__cArray2, 8192, "%s", __cArray);
      snprintf(__cArray3, 8192, "%s", "Num_Boot_SW_Logical_Blocks");
      ReportTableRow(__tableHandle, 0, __cArray2, "==", syspar::`F180_Boot_SW_Version_Information::`Num_Boot_SW_Logical_Blocks, __cArray3, __oneOfFlag, __bSetInCheckAlignment);
      ReportCell(__tableHandle, __nDiagValue);
      ReportCellResult(__tableHandle, __csr, __ePassFail);
    
      __res = __res && __csr;
    
    }
    {
      double __nDiagValue;
      DiagGetParameterErrorHandled(__resp, "_SW_Year_32", __nDiagValue);
      __csr = CheckSignalMatch(__nDiagValue, syspar::`F180_Boot_SW_Version_Information::`Software_Year, ">=") == 1;
      snprintf(__cArray, 8192, "%s", "Diagnostic parameter \'_SW_Year_32\'");
      snprintf(__cArray2, 8192, "%s", __cArray);
      snprintf(__cArray3, 8192, "%s", "Software_Year");
      ReportTableRow(__tableHandle, 0, __cArray2, ">=", syspar::`F180_Boot_SW_Version_Information::`Software_Year, __cArray3, __oneOfFlag, __bSetInCheckAlignment);
      ReportCell(__tableHandle, __nDiagValue);
      ReportCellResult(__tableHandle, __csr, __ePassFail);
    
      __res = __res && __csr;
    
    }
    {
      double __nDiagValue;
      DiagGetParameterErrorHandled(__resp, "_SW__Week_40", __nDiagValue);
      __csr = CheckSignalMatch(__nDiagValue, 1, ">=") == 1;
      snprintf(__cArray, 8192, "%s", "Diagnostic parameter \'_SW__Week_40\'");
      snprintf(__cArray2, 8192, "%s", __cArray);
      snprintf(__cArray3, 8192, "%s", "");
      ReportTableRow(__tableHandle, 0, __cArray2, ">=", 1, __cArray3, __oneOfFlag, __bSetInCheckAlignment);
      ReportCell(__tableHandle, __nDiagValue);
      ReportCellResult(__tableHandle, __csr, __ePassFail);
    
      __res = __res && __csr;
    
    }
    {
      double __nDiagValue;
      DiagGetParameterErrorHandled(__resp, "_SW__Patch_Level_48", __nDiagValue);
      __csr = CheckSignalMatch(__nDiagValue, syspar::`F180_Boot_SW_Version_Information::`Software_Patch_Level, ">=") == 1;
      snprintf(__cArray, 8192, "%s", "Diagnostic parameter \'_SW__Patch_Level_48\'");
      snprintf(__cArray2, 8192, "%s", __cArray);
      snprintf(__cArray3, 8192, "%s", "Software_Patch_Level");
      ReportTableRow(__tableHandle, 0, __cArray2, ">=", syspar::`F180_Boot_SW_Version_Information::`Software_Patch_Level, __cArray3, __oneOfFlag, __bSetInCheckAlignment);
      ReportCell(__tableHandle, __nDiagValue);
      ReportCellResult(__tableHandle, __csr, __ePassFail);
    
      __res = __res && __csr;
    
    }
    {
      __bDiagValueArrayCtr = DiagGetParameterErrorHandled(__resp, "_SW__Identification_56", __bDiagValueArray, elcount(__bDiagValueArray), __cDiagValueArray, elcount(__cDiagValueArray));
      CheckPlainParameterGetStringBufferConsistency(syspar::`F180_Boot_SW_Version_Information::`Software_Identification,"syspar::`F180_Boot_SW_Version_Information::`Software_Identification", 8192);
    snprintf(__cArray, 8192, "%s", syspar::`F180_Boot_SW_Version_Information::`Software_Identification);  
      __bDiagValueArrayCtr2 = __MapChar2ByteAtDiagCheck(__cArray, __bDiagValueArray2);
      snprintf(__cArray10, 8192, "%s", "Software_Identification");
      {
        __bArrayCtr = __CopyBytes(__bDiagValueArray, __bDiagValueArrayCtr, __bArray);
        __bArrayCtr2 = __CopyBytes(__bDiagValueArray2, __bDiagValueArrayCtr2, __bArray2);
        __csr = CompareBytes(__bArray, __bArrayCtr, __bArray2, __bArrayCtr2) == 0;
        snprintf(__cArray, 8192, "%s", "Diagnostic parameter \'_SW__Identification_56\'");
        snprintf(__cArray2, 8192, "%s", __cArray);
        snprintf(__cArray3, 8192, "%s", __cArray10);
        ReportTableRow(__tableHandle, 0, __cArray2, "Bytes", __bArray2, __bArrayCtr2, __cArray3, __oneOfFlag, __bSetInCheckAlignment);
        ReportCell(__tableHandle, __bArray, __bArrayCtr);
        ReportCellResult(__tableHandle, __csr, __ePassFail);
      }
    
      __res = __res && __csr;
    
    }
    ReportTableEndVerdict(__tableHandle, __cEvaluateResponse, __res);
	__bVerdict = __bVerdict && __res;
  }
  if (__bVerdict == __eVerdictFail)
    TestReportWriteDiagObjectList();
}

void Tt4h42sqi_F180_DID_with_Standard_Physical_Address()
{
  stack long __tableHandle;
  TestCommandBegin(__eRequestResponse, __cRequestResponse, "", "0");
  {
  
    long __res;
    int64 __timeout;
    __res = 0;
    __nInt64 = 1;
    __timeout = syspar::`P2_Server * 1000000LL;
    {
    
      long __testStepInitOk;
      message `FDCAN2::`DIAGNOSTIC_REQUEST_PAM __output;
      message `FDCAN2::`DIAGNOSTIC_REQUEST_PAM __msgOrig;
      __output = __msgOrig;
      __testStepInitOk = 1;
      {
        int64 __dlc;
        __dlc = 4;
        if (__dlc >= 0 && __dlc <= (__output.EDL ? 15 : 8))
          __output.DLC = __dlc;
        else
        {
          testStepErrorInTestSystem(0, __cEmpty, "Unable to set DLC=%lld in message. Please check input parameter.", __dlc);
          __testStepInitOk = 0;
        }
      }
      if (__testStepInitOk)
      {
        snprintf(__cArray, elCount(__cArray), "CAN message '%s' ID = 416981233x (0x18DAA0F1x) on bus FDCAN2", "DIAGNOSTIC_REQUEST_PAM");
        snprintf(__cArray2, elCount(__cArray2), "Send %s", __cArray);
        __tableHandle = ReportTableHead3Columns(__cArray2, "Byte", __cTOp, __cAssigned);
        ReportByteIndex("", 0, __cArray, elCount(__cArray));
        snprintf(__cArray2, 8192, "%s", __cArray);
        snprintf(__cArray3, 8192, "%s", "");
        
        ReportTableRow(__tableHandle, 0, __cArray2, __cAOp, 0x3, __cArray3, __oneOfFlag, __bSetInCheckAlignment);
        
        if (0 >= 0 && 0 < 64)
        {
          __output.byte((word)0) = 0x3;
        }
        else
        {
          testStepErrorInTestSystem(0, __cEmpty, "Index out of range. Unable to set byte %lld in message. Please check input parameter.", (int64)0);
          __testStepInitOk = 0;
        }
        ReportByteIndex("", 1, __cArray, elCount(__cArray));
        snprintf(__cArray2, 8192, "%s", __cArray);
        snprintf(__cArray3, 8192, "%s", "");
        
        ReportTableRow(__tableHandle, 0, __cArray2, __cAOp, 0x22, __cArray3, __oneOfFlag, __bSetInCheckAlignment);
        
        if (1 >= 0 && 1 < 64)
        {
          __output.byte((word)1) = 0x22;
        }
        else
        {
          testStepErrorInTestSystem(0, __cEmpty, "Index out of range. Unable to set byte %lld in message. Please check input parameter.", (int64)1);
          __testStepInitOk = 0;
        }
        ReportByteIndex("", 2, __cArray, elCount(__cArray));
        snprintf(__cArray2, 8192, "%s", __cArray);
        snprintf(__cArray3, 8192, "%s", "");
        
        ReportTableRow(__tableHandle, 0, __cArray2, __cAOp, 0xF1, __cArray3, __oneOfFlag, __bSetInCheckAlignment);
        
        if (2 >= 0 && 2 < 64)
        {
          __output.byte((word)2) = 0xF1;
        }
        else
        {
          testStepErrorInTestSystem(0, __cEmpty, "Index out of range. Unable to set byte %lld in message. Please check input parameter.", (int64)2);
          __testStepInitOk = 0;
        }
        ReportByteIndex("", 3, __cArray, elCount(__cArray));
        snprintf(__cArray2, 8192, "%s", __cArray);
        snprintf(__cArray3, 8192, "%s", "");
        
        ReportTableRow(__tableHandle, 0, __cArray2, __cAOp, 0x80, __cArray3, __oneOfFlag, __bSetInCheckAlignment);
        
        if (3 >= 0 && 3 < 64)
        {
          __output.byte((word)3) = 0x80;
        }
        else
        {
          testStepErrorInTestSystem(0, __cEmpty, "Index out of range. Unable to set byte %lld in message. Please check input parameter.", (int64)3);
          __testStepInitOk = 0;
        }
      
        ReportTableEndTestStep(__tableHandle, "Req1");
      }
      if (__testStepInitOk)
      {
        output(__output);
      }
    }
    if (__timeout <= 0)
    {
      testStepErrorInTestSystem(0, "1", "Unable to wait for %.3f %s. Please check input parameter.", __timeout / ((float)1000000), "ms");
    }
    else
    {
      __tt2cnt_13 = 0;
      snprintf(__cArray, elCount(__cArray), "CAN message '%s' ID = 417001888x (0x18DAF1A0x) on bus FDCAN2", "DIAGNOSTIC_RESPONSE_PAM");
      if(SetBusContextByName("FDCAN2", __eSaveCurrent, __nBusContextNew, __nBusContextOld))
        testJoinMessageEvent(`FDCAN2::`DIAGNOSTIC_RESPONSE_PAM,  __cArray,
             delegate dword(message * __m)
             {
               dword __msg_callback_ret;
               if (__tt2cnt_13 == -1)
               {
                 return 1;
               }
               __msg_callback_ret = 1;
               __tt2cnt_13++;
               if (__msg_callback_ret)
               {
                 __tt2cnt_13 = -1;
                 return 1;
               }
               return 0;
             });
      __res = testWaitForAllJoinedEventsNS(__timeout);
      if (__nInt64 != 0)
      {
        snprintf(__cArray, elCount(__cArray), "CAN message '%s' ID = 417001888x (0x18DAF1A0x) on bus FDCAN2", "DIAGNOSTIC_RESPONSE_PAM");
        if(__tt2cnt_13 == -1)
        {
          snprintf(__cArray2, 8192, "Response of %s", __cArray);
        }
        else
        {
          snprintf(__cArray2, 8192, "Response of %s (received %d times)", __cArray, __tt2cnt_13);
        }
        if (__tt2cnt_13 == 0)
        {
          testStepFail(0, "Resp1", __cArray2);
        }
        else
        {
          testStepPass(2, "Resp1", __cArray2);
        }
        __ReportRequestResponseResult(__res, 0);
      }
      ResetBusContext(__nBusContextNew, __nBusContextOld);
    }
  }
  TestCommandEnd();

}

void Tt4h42sqi_F132_DID_with_Physical_Address()
{
  stack long __tableHandle;
  TestCommandBegin(__eDiagService, __cDiagService, "", "0");
  {
    if (DiagIsFunctionalGroup("CVADAS_0001_00000000_000"))
    {
      DiagResponse * __resp;
      DiagRequest CVADAS_0001_00000000_000._22F132_EBOM_ECU_Part_Number __req;
      __diagService4h42sqi_12(__req, __resp);
    }
    else
    {
      DiagResponse CVADAS_0001_00000000_000.* __resp;
      DiagRequest CVADAS_0001_00000000_000._22F132_EBOM_ECU_Part_Number __req;
      __diagService4h42sqi_12(__req, __resp);
    }
  }
  TestCommandEnd();


}

  
void __diagService4h42sqi_12(DiagRequest * __req, DiagResponse * __resp )
{
  stack long __tableHandle;
  long __res, __paramLen, __bytePos;

   __bVerdict = __eVerdictPass;

  do {
    TestReportResetDiagObjectList();
    DiagSetReportDetailLevel("CVADAS_0001_00000000_000", EnumServiceDetails_onfail);
    // Request aspect
    {

      if (0 >= DiagSendReqAndWaitForResp("CVADAS_0001_00000000_000", __req, __resp, __res, -1, -1, -1, -1, -1, EnumResult_pos, EnumServiceDetails_onfail, EnumSendingMode_physical, EnumSuppressPosResBit_asconfigured, EnumVerdictOnInvalidValues_fail))
        break;
    }

    __res = DiagErrCodeTestStep(__res, "Can't retrieve last response for request! No check possible.") < 0;
    if(__res)
    {
	  __bVerdict = __eVerdictFail;
      break;
    }
    {
      __res = DiagInterpretAs(__resp, "RDBI_PR");
      if(__res != 0)
      {
        __bVerdict = __eVerdictFail;
        DiagErrCodeTestStep(__res, "Can't interpret response as diagnostic primitive 'RDBI_PR'.");
        break;
      }
      else
      {
        TestStepPass( "Received primitive can be interpreted as diagnostic primitive 'RDBI_PR'.");
      }
    }
  }
  while(0);


  // Response, check & read aspect
  {
    __res = 1;
    __tableHandle = ReportTableHead5Columns(__cCheckCaption, __cTSym, __cTOp, __cRefVal, __cActual, __cRes);
    {
      DiagGetParameterErrorHandled(__resp, "_EBOM_ECU_Part_Number_24", __bDiagValueArray, elcount(__bDiagValueArray), __cDiagValueArray, elcount(__cDiagValueArray));
      CheckCaplGenVarStringBufferConsistency(__cDiagValueArray, 8192);
      snprintf(__cArray, 8192, "%s", __cDiagValueArray);
      CheckLiteralGetStringBufferConsistency("1", 8192);
      snprintf(__cArray2, 8192, "%s", "1");
      __csr = strncmp(__cArray, __cArray2, 8192) >= 0;
      snprintf(__cArray3, 8192, "%s", "Diagnostic parameter \'_EBOM_ECU_Part_Number_24\'");
      snprintf(__cArray4, 8192, "%s", __cArray3);
      snprintf(__cArray5, 8192, "%s", "");
      ReportTableRow(__tableHandle, 0, __cArray4, ">=", __cArray2, __cArray5, __oneOfFlag, __bSetInCheckAlignment);
      ReportCell(__tableHandle, __cArray);
      ReportCellResult(__tableHandle, __csr, __ePassFail);
    
      __res = __res && __csr;
    
    }
    ReportTableEndVerdict(__tableHandle, __cEvaluateResponse, __res);
	__bVerdict = __bVerdict && __res;
  }
  if (__bVerdict == __eVerdictFail)
    TestReportWriteDiagObjectList();
}

void Tt4h42sqi_F132_DID_with_Functional_Address()
{
  stack long __tableHandle;
  TestCommandBegin(__eDiagService, __cDiagService, "", "0");
  {
    if (DiagIsFunctionalGroup("CVADAS_0001_00000000_000"))
    {
      DiagResponse * __resp;
      DiagRequest CVADAS_0001_00000000_000._22F132_EBOM_ECU_Part_Number __req;
      __diagService4h42sqi_13(__req, __resp);
    }
    else
    {
      DiagResponse CVADAS_0001_00000000_000.* __resp;
      DiagRequest CVADAS_0001_00000000_000._22F132_EBOM_ECU_Part_Number __req;
      __diagService4h42sqi_13(__req, __resp);
    }
  }
  TestCommandEnd();


}

  
void __diagService4h42sqi_13(DiagRequest * __req, DiagResponse * __resp )
{
  stack long __tableHandle;
  long __res, __paramLen, __bytePos;

   __bVerdict = __eVerdictPass;

  do {
    TestReportResetDiagObjectList();
    DiagSetReportDetailLevel("CVADAS_0001_00000000_000", EnumServiceDetails_onfail);
    // Request aspect
    {

      if (0 >= DiagSendReqAndWaitForResp("CVADAS_0001_00000000_000", __req, __resp, __res, -1, -1, -1, -1, -1, EnumResult_pos, EnumServiceDetails_onfail, EnumSendingMode_functional, EnumSuppressPosResBit_asconfigured, EnumVerdictOnInvalidValues_fail))
        break;
    }

    __res = DiagErrCodeTestStep(__res, "Can't retrieve last response for request! No check possible.") < 0;
    if(__res)
    {
	  __bVerdict = __eVerdictFail;
      break;
    }
    {
      __res = DiagInterpretAs(__resp, "RDBI_PR");
      if(__res != 0)
      {
        __bVerdict = __eVerdictFail;
        DiagErrCodeTestStep(__res, "Can't interpret response as diagnostic primitive 'RDBI_PR'.");
        break;
      }
      else
      {
        TestStepPass( "Received primitive can be interpreted as diagnostic primitive 'RDBI_PR'.");
      }
    }
  }
  while(0);


  // Response, check & read aspect
  {
    __res = 1;
    __tableHandle = ReportTableHead5Columns(__cCheckCaption, __cTSym, __cTOp, __cRefVal, __cActual, __cRes);
    {
      DiagGetParameterErrorHandled(__resp, "_EBOM_ECU_Part_Number_24", __bDiagValueArray, elcount(__bDiagValueArray), __cDiagValueArray, elcount(__cDiagValueArray));
      CheckCaplGenVarStringBufferConsistency(__cDiagValueArray, 8192);
      snprintf(__cArray, 8192, "%s", __cDiagValueArray);
      CheckLiteralGetStringBufferConsistency("1", 8192);
      snprintf(__cArray2, 8192, "%s", "1");
      __csr = strncmp(__cArray, __cArray2, 8192) >= 0;
      snprintf(__cArray3, 8192, "%s", "Diagnostic parameter \'_EBOM_ECU_Part_Number_24\'");
      snprintf(__cArray4, 8192, "%s", __cArray3);
      snprintf(__cArray5, 8192, "%s", "");
      ReportTableRow(__tableHandle, 0, __cArray4, ">=", __cArray2, __cArray5, __oneOfFlag, __bSetInCheckAlignment);
      ReportCell(__tableHandle, __cArray);
      ReportCellResult(__tableHandle, __csr, __ePassFail);
    
      __res = __res && __csr;
    
    }
    ReportTableEndVerdict(__tableHandle, __cEvaluateResponse, __res);
	__bVerdict = __bVerdict && __res;
  }
  if (__bVerdict == __eVerdictFail)
    TestReportWriteDiagObjectList();
}

void Tt4h42sqi_F132_DID_with_Standard_Physical_Address()
{
  stack long __tableHandle;
  TestCommandBegin(__eRequestResponse, __cRequestResponse, "", "0");
  {
  
    long __res;
    int64 __timeout;
    __res = 0;
    __nInt64 = 1;
    __timeout = syspar::`P2_Server * 1000000LL;
    {
    
      long __testStepInitOk;
      message `FDCAN2::`DIAGNOSTIC_REQUEST_PAM __output;
      message `FDCAN2::`DIAGNOSTIC_REQUEST_PAM __msgOrig;
      __output = __msgOrig;
      __testStepInitOk = 1;
      {
        int64 __dlc;
        __dlc = 4;
        if (__dlc >= 0 && __dlc <= (__output.EDL ? 15 : 8))
          __output.DLC = __dlc;
        else
        {
          testStepErrorInTestSystem(0, __cEmpty, "Unable to set DLC=%lld in message. Please check input parameter.", __dlc);
          __testStepInitOk = 0;
        }
      }
      if (__testStepInitOk)
      {
        snprintf(__cArray, elCount(__cArray), "CAN message '%s' ID = 416981233x (0x18DAA0F1x) on bus FDCAN2", "DIAGNOSTIC_REQUEST_PAM");
        snprintf(__cArray2, elCount(__cArray2), "Send %s", __cArray);
        __tableHandle = ReportTableHead3Columns(__cArray2, "Byte", __cTOp, __cAssigned);
        ReportByteIndex("", 0, __cArray, elCount(__cArray));
        snprintf(__cArray2, 8192, "%s", __cArray);
        snprintf(__cArray3, 8192, "%s", "");
        
        ReportTableRow(__tableHandle, 0, __cArray2, __cAOp, 0x3, __cArray3, __oneOfFlag, __bSetInCheckAlignment);
        
        if (0 >= 0 && 0 < 64)
        {
          __output.byte((word)0) = 0x3;
        }
        else
        {
          testStepErrorInTestSystem(0, __cEmpty, "Index out of range. Unable to set byte %lld in message. Please check input parameter.", (int64)0);
          __testStepInitOk = 0;
        }
        ReportByteIndex("", 1, __cArray, elCount(__cArray));
        snprintf(__cArray2, 8192, "%s", __cArray);
        snprintf(__cArray3, 8192, "%s", "");
        
        ReportTableRow(__tableHandle, 0, __cArray2, __cAOp, 0x22, __cArray3, __oneOfFlag, __bSetInCheckAlignment);
        
        if (1 >= 0 && 1 < 64)
        {
          __output.byte((word)1) = 0x22;
        }
        else
        {
          testStepErrorInTestSystem(0, __cEmpty, "Index out of range. Unable to set byte %lld in message. Please check input parameter.", (int64)1);
          __testStepInitOk = 0;
        }
        ReportByteIndex("", 2, __cArray, elCount(__cArray));
        snprintf(__cArray2, 8192, "%s", __cArray);
        snprintf(__cArray3, 8192, "%s", "");
        
        ReportTableRow(__tableHandle, 0, __cArray2, __cAOp, 0xF1, __cArray3, __oneOfFlag, __bSetInCheckAlignment);
        
        if (2 >= 0 && 2 < 64)
        {
          __output.byte((word)2) = 0xF1;
        }
        else
        {
          testStepErrorInTestSystem(0, __cEmpty, "Index out of range. Unable to set byte %lld in message. Please check input parameter.", (int64)2);
          __testStepInitOk = 0;
        }
        ReportByteIndex("", 3, __cArray, elCount(__cArray));
        snprintf(__cArray2, 8192, "%s", __cArray);
        snprintf(__cArray3, 8192, "%s", "");
        
        ReportTableRow(__tableHandle, 0, __cArray2, __cAOp, 0x32, __cArray3, __oneOfFlag, __bSetInCheckAlignment);
        
        if (3 >= 0 && 3 < 64)
        {
          __output.byte((word)3) = 0x32;
        }
        else
        {
          testStepErrorInTestSystem(0, __cEmpty, "Index out of range. Unable to set byte %lld in message. Please check input parameter.", (int64)3);
          __testStepInitOk = 0;
        }
      
        ReportTableEndTestStep(__tableHandle, "Req1");
      }
      if (__testStepInitOk)
      {
        output(__output);
      }
    }
    if (__timeout <= 0)
    {
      testStepErrorInTestSystem(0, "1", "Unable to wait for %.3f %s. Please check input parameter.", __timeout / ((float)1000000), "ms");
    }
    else
    {
      __tt2cnt_15 = 0;
      snprintf(__cArray, elCount(__cArray), "CAN message '%s' ID = 417001888x (0x18DAF1A0x) on bus FDCAN2", "DIAGNOSTIC_RESPONSE_PAM");
      if(SetBusContextByName("FDCAN2", __eSaveCurrent, __nBusContextNew, __nBusContextOld))
        testJoinMessageEvent(`FDCAN2::`DIAGNOSTIC_RESPONSE_PAM,  __cArray,
             delegate dword(message * __m)
             {
               dword __msg_callback_ret;
               if (__tt2cnt_15 == -1)
               {
                 return 1;
               }
               __msg_callback_ret = 1;
               __tt2cnt_15++;
               if (__msg_callback_ret)
               {
                 __tt2cnt_15 = -1;
                 return 1;
               }
               return 0;
             });
      __res = testWaitForAllJoinedEventsNS(__timeout);
      if (__nInt64 != 0)
      {
        snprintf(__cArray, elCount(__cArray), "CAN message '%s' ID = 417001888x (0x18DAF1A0x) on bus FDCAN2", "DIAGNOSTIC_RESPONSE_PAM");
        if(__tt2cnt_15 == -1)
        {
          snprintf(__cArray2, 8192, "Response of %s", __cArray);
        }
        else
        {
          snprintf(__cArray2, 8192, "Response of %s (received %d times)", __cArray, __tt2cnt_15);
        }
        if (__tt2cnt_15 == 0)
        {
          testStepFail(0, "Resp1", __cArray2);
        }
        else
        {
          testStepPass(2, "Resp1", __cArray2);
        }
        __ReportRequestResponseResult(__res, 0);
      }
      ResetBusContext(__nBusContextNew, __nBusContextOld);
    }
  }
  TestCommandEnd();

}

void Tt4h42sqi_F1A2_DID_with_Physical_Address()
{
  stack long __tableHandle;
  TestCommandBegin(__eDiagService, __cDiagService, "", "0");
  {
    if (DiagIsFunctionalGroup("CVADAS_0001_00000000_000"))
    {
      DiagResponse * __resp;
      DiagRequest CVADAS_0001_00000000_000._22F1A2_Vector_Delivery_ID __req;
      __diagService4h42sqi_14(__req, __resp);
    }
    else
    {
      DiagResponse CVADAS_0001_00000000_000.* __resp;
      DiagRequest CVADAS_0001_00000000_000._22F1A2_Vector_Delivery_ID __req;
      __diagService4h42sqi_14(__req, __resp);
    }
  }
  TestCommandEnd();


}

  
void __diagService4h42sqi_14(DiagRequest * __req, DiagResponse * __resp )
{
  stack long __tableHandle;
  long __res, __paramLen, __bytePos;

   __bVerdict = __eVerdictPass;

  do {
    TestReportResetDiagObjectList();
    DiagSetReportDetailLevel("CVADAS_0001_00000000_000", EnumServiceDetails_onfail);
    // Request aspect
    {

      if (0 >= DiagSendReqAndWaitForResp("CVADAS_0001_00000000_000", __req, __resp, __res, -1, -1, -1, -1, -1, EnumResult_pos, EnumServiceDetails_onfail, EnumSendingMode_physical, EnumSuppressPosResBit_asconfigured, EnumVerdictOnInvalidValues_fail))
        break;
    }

    __res = DiagErrCodeTestStep(__res, "Can't retrieve last response for request! No check possible.") < 0;
    if(__res)
    {
	  __bVerdict = __eVerdictFail;
      break;
    }
    {
      __res = DiagInterpretAs(__resp, "RDBI_PR");
      if(__res != 0)
      {
        __bVerdict = __eVerdictFail;
        DiagErrCodeTestStep(__res, "Can't interpret response as diagnostic primitive 'RDBI_PR'.");
        break;
      }
      else
      {
        TestStepPass( "Received primitive can be interpreted as diagnostic primitive 'RDBI_PR'.");
      }
    }
  }
  while(0);


  // Response, check & read aspect
  {
    __res = 1;
    __tableHandle = ReportTableHead5Columns(__cCheckCaption, __cTSym, __cTOp, __cRefVal, __cActual, __cRes);
    {
      __bDiagValueArrayCtr = DiagGetParameterErrorHandled(__resp, "_Vector_Release_Version_Basic_Software_BSW_24", __bDiagValueArray, elcount(__bDiagValueArray), __cDiagValueArray, elcount(__cDiagValueArray));
      {
        __bArrayCtr = __CopyBytes(__bDiagValueArray, __bDiagValueArrayCtr, __bArray);
        CheckPlainParameterGetDataBufferConsistency(sysParGetData(syspar::`F1A2_Vector_Delivery_ID::`Vector_Release_Version_BSW, __bArray2, __bArrayCtr2), __bArrayCtr2, "syspar::`F1A2_Vector_Delivery_ID::`Vector_Release_Version_BSW");
        __csr = CompareBytes(__bArray, __bArrayCtr, __bArray2, __bArrayCtr2) == 0;
        snprintf(__cArray, 8192, "%s", "Diagnostic parameter \'_Vector_Release_Version_Basic_Software_BSW_24\'");
        snprintf(__cArray2, 8192, "%s", __cArray);
        snprintf(__cArray3, 8192, "%s", "Vector_Release_Version_BSW");
        ReportTableRow(__tableHandle, 0, __cArray2, "Bytes", __bArray2, __bArrayCtr2, __cArray3, __oneOfFlag, __bSetInCheckAlignment);
        ReportCell(__tableHandle, __bArray, __bArrayCtr);
        ReportCellResult(__tableHandle, __csr, __ePassFail);
      }
    
      __res = __res && __csr;
    
    }
    {
      __bDiagValueArrayCtr = DiagGetParameterErrorHandled(__resp, "_Vector_License_Number_CBD_Number_48", __bDiagValueArray, elcount(__bDiagValueArray), __cDiagValueArray, elcount(__cDiagValueArray));
      {
        __bArrayCtr = __CopyBytes(__bDiagValueArray, __bDiagValueArrayCtr, __bArray);
        CheckPlainParameterGetDataBufferConsistency(sysParGetData(syspar::`F1A2_Vector_Delivery_ID::`Vector_License_Number_CBD_Num, __bArray2, __bArrayCtr2), __bArrayCtr2, "syspar::`F1A2_Vector_Delivery_ID::`Vector_License_Number_CBD_Num");
        __csr = CompareBytes(__bArray, __bArrayCtr, __bArray2, __bArrayCtr2) == 0;
        snprintf(__cArray, 8192, "%s", "Diagnostic parameter \'_Vector_License_Number_CBD_Number_48\'");
        snprintf(__cArray2, 8192, "%s", __cArray);
        snprintf(__cArray3, 8192, "%s", "Vector_License_Number_CBD_Num");
        ReportTableRow(__tableHandle, 0, __cArray2, "Bytes", __bArray2, __bArrayCtr2, __cArray3, __oneOfFlag, __bSetInCheckAlignment);
        ReportCell(__tableHandle, __bArray, __bArrayCtr);
        ReportCellResult(__tableHandle, __csr, __ePassFail);
      }
    
      __res = __res && __csr;
    
    }
    {
      double __nDiagValue;
      DiagGetParameterErrorHandled(__resp, "_Vector_Delivery_Number_80", __nDiagValue);
      __csr = CheckSignalMatch(__nDiagValue, syspar::`F1A2_Vector_Delivery_ID::`Vector_Delivery_Number, "==") == 1;
      snprintf(__cArray, 8192, "%s", "Diagnostic parameter \'_Vector_Delivery_Number_80\'");
      snprintf(__cArray2, 8192, "%s", __cArray);
      snprintf(__cArray3, 8192, "%s", "Vector_Delivery_Number");
      ReportTableRow(__tableHandle, 0, __cArray2, "==", syspar::`F1A2_Vector_Delivery_ID::`Vector_Delivery_Number, __cArray3, __oneOfFlag, __bSetInCheckAlignment);
      ReportCell(__tableHandle, __nDiagValue);
      ReportCellResult(__tableHandle, __csr, __ePassFail);
    
      __res = __res && __csr;
    
    }
    {
      double __nDiagValue;
      DiagGetParameterErrorHandled(__resp, "_Autosar_Revision_ASR_Major_Release_88", __nDiagValue);
      __csr = CheckSignalMatch(__nDiagValue, syspar::`F1A2_Vector_Delivery_ID::`Autosar_Revision_ASR_Major_Release, "==") == 1;
      snprintf(__cArray, 8192, "%s", "Diagnostic parameter \'_Autosar_Revision_ASR_Major_Release_88\'");
      snprintf(__cArray2, 8192, "%s", __cArray);
      snprintf(__cArray3, 8192, "%s", "Autosar_Revision_ASR_Major_Release");
      ReportTableRow(__tableHandle, 0, __cArray2, "==", syspar::`F1A2_Vector_Delivery_ID::`Autosar_Revision_ASR_Major_Release, __cArray3, __oneOfFlag, __bSetInCheckAlignment);
      ReportCell(__tableHandle, __nDiagValue);
      ReportCellResult(__tableHandle, __csr, __ePassFail);
    
      __res = __res && __csr;
    
    }
    {
      double __nDiagValue;
      DiagGetParameterErrorHandled(__resp, "_Software_License_Package_SLP_96", __nDiagValue);
      __csr = CheckSignalMatch(__nDiagValue, syspar::`F1A2_Vector_Delivery_ID::`Software_License_Package_SLP, "==") == 1;
      snprintf(__cArray, 8192, "%s", "Diagnostic parameter \'_Software_License_Package_SLP_96\'");
      snprintf(__cArray2, 8192, "%s", __cArray);
      snprintf(__cArray3, 8192, "%s", "Software_License_Package_SLP");
      ReportTableRow(__tableHandle, 0, __cArray2, "==", syspar::`F1A2_Vector_Delivery_ID::`Software_License_Package_SLP, __cArray3, __oneOfFlag, __bSetInCheckAlignment);
      ReportCell(__tableHandle, __nDiagValue);
      ReportCellResult(__tableHandle, __csr, __ePassFail);
    
      __res = __res && __csr;
    
    }
    ReportTableEndVerdict(__tableHandle, __cEvaluateResponse, __res);
	__bVerdict = __bVerdict && __res;
  }
  if (__bVerdict == __eVerdictFail)
    TestReportWriteDiagObjectList();
}

void Tt4h42sqi_F1A2_DID_with_Functional_Address()
{
  stack long __tableHandle;
  TestCommandBegin(__eDiagService, __cDiagService, "", "0");
  {
    if (DiagIsFunctionalGroup("CVADAS_0001_00000000_000"))
    {
      DiagResponse * __resp;
      DiagRequest CVADAS_0001_00000000_000._22F1A2_Vector_Delivery_ID __req;
      __diagService4h42sqi_15(__req, __resp);
    }
    else
    {
      DiagResponse CVADAS_0001_00000000_000.* __resp;
      DiagRequest CVADAS_0001_00000000_000._22F1A2_Vector_Delivery_ID __req;
      __diagService4h42sqi_15(__req, __resp);
    }
  }
  TestCommandEnd();


}

  
void __diagService4h42sqi_15(DiagRequest * __req, DiagResponse * __resp )
{
  stack long __tableHandle;
  long __res, __paramLen, __bytePos;

   __bVerdict = __eVerdictPass;

  do {
    TestReportResetDiagObjectList();
    DiagSetReportDetailLevel("CVADAS_0001_00000000_000", EnumServiceDetails_onfail);
    // Request aspect
    {

      if (0 >= DiagSendReqAndWaitForResp("CVADAS_0001_00000000_000", __req, __resp, __res, -1, -1, -1, -1, -1, EnumResult_pos, EnumServiceDetails_onfail, EnumSendingMode_functional, EnumSuppressPosResBit_asconfigured, EnumVerdictOnInvalidValues_no_impact))
        break;
    }

    __res = DiagErrCodeTestStep(__res, "Can't retrieve last response for request! No check possible.") < 0;
    if(__res)
    {
	  __bVerdict = __eVerdictFail;
      break;
    }
    {
      __res = DiagInterpretAs(__resp, "RDBI_PR");
      if(__res != 0)
      {
        __bVerdict = __eVerdictFail;
        DiagErrCodeTestStep(__res, "Can't interpret response as diagnostic primitive 'RDBI_PR'.");
        break;
      }
      else
      {
        TestStepPass( "Received primitive can be interpreted as diagnostic primitive 'RDBI_PR'.");
      }
    }
  }
  while(0);


  // Response, check & read aspect
  {
    __res = 1;
    __tableHandle = ReportTableHead5Columns(__cCheckCaption, __cTSym, __cTOp, __cRefVal, __cActual, __cRes);
    {
      __bDiagValueArrayCtr = DiagGetParameterErrorHandled(__resp, "_Vector_Release_Version_Basic_Software_BSW_24", __bDiagValueArray, elcount(__bDiagValueArray), __cDiagValueArray, elcount(__cDiagValueArray));
      {
        __bArrayCtr = __CopyBytes(__bDiagValueArray, __bDiagValueArrayCtr, __bArray);
        CheckPlainParameterGetDataBufferConsistency(sysParGetData(syspar::`F1A2_Vector_Delivery_ID::`Vector_Release_Version_BSW, __bArray2, __bArrayCtr2), __bArrayCtr2, "syspar::`F1A2_Vector_Delivery_ID::`Vector_Release_Version_BSW");
        __csr = CompareBytes(__bArray, __bArrayCtr, __bArray2, __bArrayCtr2) == 0;
        snprintf(__cArray, 8192, "%s", "Diagnostic parameter \'_Vector_Release_Version_Basic_Software_BSW_24\'");
        snprintf(__cArray2, 8192, "%s", __cArray);
        snprintf(__cArray3, 8192, "%s", "Vector_Release_Version_BSW");
        ReportTableRow(__tableHandle, 0, __cArray2, "Bytes", __bArray2, __bArrayCtr2, __cArray3, __oneOfFlag, __bSetInCheckAlignment);
        ReportCell(__tableHandle, __bArray, __bArrayCtr);
        ReportCellResult(__tableHandle, __csr, __ePassFail);
      }
    
      __res = __res && __csr;
    
    }
    {
      __bDiagValueArrayCtr = DiagGetParameterErrorHandled(__resp, "_Vector_License_Number_CBD_Number_48", __bDiagValueArray, elcount(__bDiagValueArray), __cDiagValueArray, elcount(__cDiagValueArray));
      {
        __bArrayCtr = __CopyBytes(__bDiagValueArray, __bDiagValueArrayCtr, __bArray);
        CheckPlainParameterGetDataBufferConsistency(sysParGetData(syspar::`F1A2_Vector_Delivery_ID::`Vector_License_Number_CBD_Num, __bArray2, __bArrayCtr2), __bArrayCtr2, "syspar::`F1A2_Vector_Delivery_ID::`Vector_License_Number_CBD_Num");
        __csr = CompareBytes(__bArray, __bArrayCtr, __bArray2, __bArrayCtr2) == 0;
        snprintf(__cArray, 8192, "%s", "Diagnostic parameter \'_Vector_License_Number_CBD_Number_48\'");
        snprintf(__cArray2, 8192, "%s", __cArray);
        snprintf(__cArray3, 8192, "%s", "Vector_License_Number_CBD_Num");
        ReportTableRow(__tableHandle, 0, __cArray2, "Bytes", __bArray2, __bArrayCtr2, __cArray3, __oneOfFlag, __bSetInCheckAlignment);
        ReportCell(__tableHandle, __bArray, __bArrayCtr);
        ReportCellResult(__tableHandle, __csr, __ePassFail);
      }
    
      __res = __res && __csr;
    
    }
    {
      double __nDiagValue;
      DiagGetParameterErrorHandled(__resp, "_Vector_Delivery_Number_80", __nDiagValue);
      __csr = CheckSignalMatch(__nDiagValue, syspar::`F1A2_Vector_Delivery_ID::`Vector_Delivery_Number, "==") == 1;
      snprintf(__cArray, 8192, "%s", "Diagnostic parameter \'_Vector_Delivery_Number_80\'");
      snprintf(__cArray2, 8192, "%s", __cArray);
      snprintf(__cArray3, 8192, "%s", "Vector_Delivery_Number");
      ReportTableRow(__tableHandle, 0, __cArray2, "==", syspar::`F1A2_Vector_Delivery_ID::`Vector_Delivery_Number, __cArray3, __oneOfFlag, __bSetInCheckAlignment);
      ReportCell(__tableHandle, __nDiagValue);
      ReportCellResult(__tableHandle, __csr, __ePassFail);
    
      __res = __res && __csr;
    
    }
    {
      double __nDiagValue;
      DiagGetParameterErrorHandled(__resp, "_Autosar_Revision_ASR_Major_Release_88", __nDiagValue);
      __csr = CheckSignalMatch(__nDiagValue, syspar::`F1A2_Vector_Delivery_ID::`Autosar_Revision_ASR_Major_Release, "==") == 1;
      snprintf(__cArray, 8192, "%s", "Diagnostic parameter \'_Autosar_Revision_ASR_Major_Release_88\'");
      snprintf(__cArray2, 8192, "%s", __cArray);
      snprintf(__cArray3, 8192, "%s", "Autosar_Revision_ASR_Major_Release");
      ReportTableRow(__tableHandle, 0, __cArray2, "==", syspar::`F1A2_Vector_Delivery_ID::`Autosar_Revision_ASR_Major_Release, __cArray3, __oneOfFlag, __bSetInCheckAlignment);
      ReportCell(__tableHandle, __nDiagValue);
      ReportCellResult(__tableHandle, __csr, __ePassFail);
    
      __res = __res && __csr;
    
    }
    {
      double __nDiagValue;
      DiagGetParameterErrorHandled(__resp, "_Software_License_Package_SLP_96", __nDiagValue);
      __csr = CheckSignalMatch(__nDiagValue, syspar::`F1A2_Vector_Delivery_ID::`Software_License_Package_SLP, "==") == 1;
      snprintf(__cArray, 8192, "%s", "Diagnostic parameter \'_Software_License_Package_SLP_96\'");
      snprintf(__cArray2, 8192, "%s", __cArray);
      snprintf(__cArray3, 8192, "%s", "Software_License_Package_SLP");
      ReportTableRow(__tableHandle, 0, __cArray2, "==", syspar::`F1A2_Vector_Delivery_ID::`Software_License_Package_SLP, __cArray3, __oneOfFlag, __bSetInCheckAlignment);
      ReportCell(__tableHandle, __nDiagValue);
      ReportCellResult(__tableHandle, __csr, __ePassFail);
    
      __res = __res && __csr;
    
    }
    ReportTableEndVerdict(__tableHandle, __cEvaluateResponse, __res);
	__bVerdict = __bVerdict && __res;
  }
  if (__bVerdict == __eVerdictFail)
    TestReportWriteDiagObjectList();
}

void Tt4h42sqi_F1A2_DID_with_Standard_Physical_Address()
{
  stack long __tableHandle;
  TestCommandBegin(__eRequestResponse, __cRequestResponse, "", "0");
  {
  
    long __res;
    int64 __timeout;
    __res = 0;
    __nInt64 = 1;
    __timeout = syspar::`P2_Server * 1000000LL;
    {
    
      long __testStepInitOk;
      message `FDCAN2::`DIAGNOSTIC_REQUEST_PAM __output;
      message `FDCAN2::`DIAGNOSTIC_REQUEST_PAM __msgOrig;
      __output = __msgOrig;
      __testStepInitOk = 1;
      {
        int64 __dlc;
        __dlc = 4;
        if (__dlc >= 0 && __dlc <= (__output.EDL ? 15 : 8))
          __output.DLC = __dlc;
        else
        {
          testStepErrorInTestSystem(0, __cEmpty, "Unable to set DLC=%lld in message. Please check input parameter.", __dlc);
          __testStepInitOk = 0;
        }
      }
      if (__testStepInitOk)
      {
        snprintf(__cArray, elCount(__cArray), "CAN message '%s' ID = 416981233x (0x18DAA0F1x) on bus FDCAN2", "DIAGNOSTIC_REQUEST_PAM");
        snprintf(__cArray2, elCount(__cArray2), "Send %s", __cArray);
        __tableHandle = ReportTableHead3Columns(__cArray2, "Byte", __cTOp, __cAssigned);
        ReportByteIndex("", 0, __cArray, elCount(__cArray));
        snprintf(__cArray2, 8192, "%s", __cArray);
        snprintf(__cArray3, 8192, "%s", "");
        
        ReportTableRow(__tableHandle, 0, __cArray2, __cAOp, 0x3, __cArray3, __oneOfFlag, __bSetInCheckAlignment);
        
        if (0 >= 0 && 0 < 64)
        {
          __output.byte((word)0) = 0x3;
        }
        else
        {
          testStepErrorInTestSystem(0, __cEmpty, "Index out of range. Unable to set byte %lld in message. Please check input parameter.", (int64)0);
          __testStepInitOk = 0;
        }
        ReportByteIndex("", 1, __cArray, elCount(__cArray));
        snprintf(__cArray2, 8192, "%s", __cArray);
        snprintf(__cArray3, 8192, "%s", "");
        
        ReportTableRow(__tableHandle, 0, __cArray2, __cAOp, 0x22, __cArray3, __oneOfFlag, __bSetInCheckAlignment);
        
        if (1 >= 0 && 1 < 64)
        {
          __output.byte((word)1) = 0x22;
        }
        else
        {
          testStepErrorInTestSystem(0, __cEmpty, "Index out of range. Unable to set byte %lld in message. Please check input parameter.", (int64)1);
          __testStepInitOk = 0;
        }
        ReportByteIndex("", 2, __cArray, elCount(__cArray));
        snprintf(__cArray2, 8192, "%s", __cArray);
        snprintf(__cArray3, 8192, "%s", "");
        
        ReportTableRow(__tableHandle, 0, __cArray2, __cAOp, 0xF1, __cArray3, __oneOfFlag, __bSetInCheckAlignment);
        
        if (2 >= 0 && 2 < 64)
        {
          __output.byte((word)2) = 0xF1;
        }
        else
        {
          testStepErrorInTestSystem(0, __cEmpty, "Index out of range. Unable to set byte %lld in message. Please check input parameter.", (int64)2);
          __testStepInitOk = 0;
        }
        ReportByteIndex("", 3, __cArray, elCount(__cArray));
        snprintf(__cArray2, 8192, "%s", __cArray);
        snprintf(__cArray3, 8192, "%s", "");
        
        ReportTableRow(__tableHandle, 0, __cArray2, __cAOp, 0xA2, __cArray3, __oneOfFlag, __bSetInCheckAlignment);
        
        if (3 >= 0 && 3 < 64)
        {
          __output.byte((word)3) = 0xA2;
        }
        else
        {
          testStepErrorInTestSystem(0, __cEmpty, "Index out of range. Unable to set byte %lld in message. Please check input parameter.", (int64)3);
          __testStepInitOk = 0;
        }
      
        ReportTableEndTestStep(__tableHandle, "Req1");
      }
      if (__testStepInitOk)
      {
        output(__output);
      }
    }
    if (__timeout <= 0)
    {
      testStepErrorInTestSystem(0, "1", "Unable to wait for %.3f %s. Please check input parameter.", __timeout / ((float)1000000), "ms");
    }
    else
    {
      __tt2cnt_17 = 0;
      snprintf(__cArray, elCount(__cArray), "CAN message '%s' ID = 417001888x (0x18DAF1A0x) on bus FDCAN2", "DIAGNOSTIC_RESPONSE_PAM");
      if(SetBusContextByName("FDCAN2", __eSaveCurrent, __nBusContextNew, __nBusContextOld))
        testJoinMessageEvent(`FDCAN2::`DIAGNOSTIC_RESPONSE_PAM,  __cArray,
             delegate dword(message * __m)
             {
               dword __msg_callback_ret;
               if (__tt2cnt_17 == -1)
               {
                 return 1;
               }
               __msg_callback_ret = 1;
               __tt2cnt_17++;
               if (__msg_callback_ret)
               {
                 __tt2cnt_17 = -1;
                 return 1;
               }
               return 0;
             });
      __res = testWaitForAllJoinedEventsNS(__timeout);
      if (__nInt64 != 0)
      {
        snprintf(__cArray, elCount(__cArray), "CAN message '%s' ID = 417001888x (0x18DAF1A0x) on bus FDCAN2", "DIAGNOSTIC_RESPONSE_PAM");
        if(__tt2cnt_17 == -1)
        {
          snprintf(__cArray2, 8192, "Response of %s", __cArray);
        }
        else
        {
          snprintf(__cArray2, 8192, "Response of %s (received %d times)", __cArray, __tt2cnt_17);
        }
        if (__tt2cnt_17 == 0)
        {
          testStepFail(0, "Resp1", __cArray2);
        }
        else
        {
          testStepPass(2, "Resp1", __cArray2);
        }
        __ReportRequestResponseResult(__res, 0);
      }
      ResetBusContext(__nBusContextNew, __nBusContextOld);
    }
  }
  TestCommandEnd();

}

void Tt4h42sqi_F154_DID_with_Physical_Address()
{
  stack long __tableHandle;
  TestCommandBegin(__eDiagService, __cDiagService, "", "0");
  {
    if (DiagIsFunctionalGroup("CVADAS_0001_00000000_000"))
    {
      DiagResponse * __resp;
      DiagRequest CVADAS_0001_00000000_000._22F154_Hardware_Supplier_Identification __req;
      __diagService4h42sqi_16(__req, __resp);
    }
    else
    {
      DiagResponse CVADAS_0001_00000000_000.* __resp;
      DiagRequest CVADAS_0001_00000000_000._22F154_Hardware_Supplier_Identification __req;
      __diagService4h42sqi_16(__req, __resp);
    }
  }
  TestCommandEnd();


}

  
void __diagService4h42sqi_16(DiagRequest * __req, DiagResponse * __resp )
{
  stack long __tableHandle;
  long __res, __paramLen, __bytePos;

   __bVerdict = __eVerdictPass;

  do {
    TestReportResetDiagObjectList();
    DiagSetReportDetailLevel("CVADAS_0001_00000000_000", EnumServiceDetails_onfail);
    // Request aspect
    {

      if (0 >= DiagSendReqAndWaitForResp("CVADAS_0001_00000000_000", __req, __resp, __res, -1, -1, -1, -1, -1, EnumResult_pos, EnumServiceDetails_onfail, EnumSendingMode_physical, EnumSuppressPosResBit_asconfigured, EnumVerdictOnInvalidValues_fail))
        break;
    }

    __res = DiagErrCodeTestStep(__res, "Can't retrieve last response for request! No check possible.") < 0;
    if(__res)
    {
	  __bVerdict = __eVerdictFail;
      break;
    }
    {
      __res = DiagInterpretAs(__resp, "RDBI_PR");
      if(__res != 0)
      {
        __bVerdict = __eVerdictFail;
        DiagErrCodeTestStep(__res, "Can't interpret response as diagnostic primitive 'RDBI_PR'.");
        break;
      }
      else
      {
        TestStepPass( "Received primitive can be interpreted as diagnostic primitive 'RDBI_PR'.");
      }
    }
  }
  while(0);


  // Response, check & read aspect
  {
    __res = 1;
    __tableHandle = ReportTableHead5Columns(__cCheckCaption, __cTSym, __cTOp, __cRefVal, __cActual, __cRes);
    {
      __bDiagValueArrayCtr = DiagGetParameterErrorHandled(__resp, "_Hardware_Supplier_Identification_24", __bDiagValueArray, elcount(__bDiagValueArray), __cDiagValueArray, elcount(__cDiagValueArray));
      {
        __bArrayCtr = __CopyBytes(__bDiagValueArray, __bDiagValueArrayCtr, __bArray);
        CheckPlainParameterGetDataBufferConsistency(sysParGetData(syspar::`F154_HW_Supplier_Identification::`Hardware_Supplier_Identification, __bArray2, __bArrayCtr2), __bArrayCtr2, "syspar::`F154_HW_Supplier_Identification::`Hardware_Supplier_Identification");
        __csr = CompareBytes(__bArray, __bArrayCtr, __bArray2, __bArrayCtr2) == 0;
        snprintf(__cArray, 8192, "%s", "Diagnostic parameter \'_Hardware_Supplier_Identification_24\'");
        snprintf(__cArray2, 8192, "%s", __cArray);
        snprintf(__cArray3, 8192, "%s", "Hardware_Supplier_Identification");
        ReportTableRow(__tableHandle, 0, __cArray2, "Bytes", __bArray2, __bArrayCtr2, __cArray3, __oneOfFlag, __bSetInCheckAlignment);
        ReportCell(__tableHandle, __bArray, __bArrayCtr);
        ReportCellResult(__tableHandle, __csr, __ePassFail);
      }
    
      __res = __res && __csr;
    
    }
    ReportTableEndVerdict(__tableHandle, __cEvaluateResponse, __res);
	__bVerdict = __bVerdict && __res;
  }
  if (__bVerdict == __eVerdictFail)
    TestReportWriteDiagObjectList();
}

void Tt4h42sqi_F154_DID_with_Functional_Address()
{
  stack long __tableHandle;
  TestCommandBegin(__eDiagService, __cDiagService, "", "0");
  {
    if (DiagIsFunctionalGroup("CVADAS_0001_00000000_000"))
    {
      DiagResponse * __resp;
      DiagRequest CVADAS_0001_00000000_000._22F154_Hardware_Supplier_Identification __req;
      __diagService4h42sqi_17(__req, __resp);
    }
    else
    {
      DiagResponse CVADAS_0001_00000000_000.* __resp;
      DiagRequest CVADAS_0001_00000000_000._22F154_Hardware_Supplier_Identification __req;
      __diagService4h42sqi_17(__req, __resp);
    }
  }
  TestCommandEnd();


}

  
void __diagService4h42sqi_17(DiagRequest * __req, DiagResponse * __resp )
{
  stack long __tableHandle;
  long __res, __paramLen, __bytePos;

   __bVerdict = __eVerdictPass;

  do {
    TestReportResetDiagObjectList();
    DiagSetReportDetailLevel("CVADAS_0001_00000000_000", EnumServiceDetails_onfail);
    // Request aspect
    {

      if (0 >= DiagSendReqAndWaitForResp("CVADAS_0001_00000000_000", __req, __resp, __res, -1, -1, -1, -1, -1, EnumResult_pos, EnumServiceDetails_onfail, EnumSendingMode_functional, EnumSuppressPosResBit_asconfigured, EnumVerdictOnInvalidValues_fail))
        break;
    }

    __res = DiagErrCodeTestStep(__res, "Can't retrieve last response for request! No check possible.") < 0;
    if(__res)
    {
	  __bVerdict = __eVerdictFail;
      break;
    }
    {
      __res = DiagInterpretAs(__resp, "RDBI_PR");
      if(__res != 0)
      {
        __bVerdict = __eVerdictFail;
        DiagErrCodeTestStep(__res, "Can't interpret response as diagnostic primitive 'RDBI_PR'.");
        break;
      }
      else
      {
        TestStepPass( "Received primitive can be interpreted as diagnostic primitive 'RDBI_PR'.");
      }
    }
  }
  while(0);


  // Response, check & read aspect
  {
    __res = 1;
    __tableHandle = ReportTableHead5Columns(__cCheckCaption, __cTSym, __cTOp, __cRefVal, __cActual, __cRes);
    {
      __bDiagValueArrayCtr = DiagGetParameterErrorHandled(__resp, "_Hardware_Supplier_Identification_24", __bDiagValueArray, elcount(__bDiagValueArray), __cDiagValueArray, elcount(__cDiagValueArray));
      {
        __bArrayCtr = __CopyBytes(__bDiagValueArray, __bDiagValueArrayCtr, __bArray);
        CheckPlainParameterGetDataBufferConsistency(sysParGetData(syspar::`F154_HW_Supplier_Identification::`Hardware_Supplier_Identification, __bArray2, __bArrayCtr2), __bArrayCtr2, "syspar::`F154_HW_Supplier_Identification::`Hardware_Supplier_Identification");
        __csr = CompareBytes(__bArray, __bArrayCtr, __bArray2, __bArrayCtr2) == 0;
        snprintf(__cArray, 8192, "%s", "Diagnostic parameter \'_Hardware_Supplier_Identification_24\'");
        snprintf(__cArray2, 8192, "%s", __cArray);
        snprintf(__cArray3, 8192, "%s", "Hardware_Supplier_Identification");
        ReportTableRow(__tableHandle, 0, __cArray2, "Bytes", __bArray2, __bArrayCtr2, __cArray3, __oneOfFlag, __bSetInCheckAlignment);
        ReportCell(__tableHandle, __bArray, __bArrayCtr);
        ReportCellResult(__tableHandle, __csr, __ePassFail);
      }
    
      __res = __res && __csr;
    
    }
    ReportTableEndVerdict(__tableHandle, __cEvaluateResponse, __res);
	__bVerdict = __bVerdict && __res;
  }
  if (__bVerdict == __eVerdictFail)
    TestReportWriteDiagObjectList();
}

void Tt4h42sqi_F154_DID_with_Standard_Physical_Address()
{
  stack long __tableHandle;
  TestCommandBegin(__eRequestResponse, __cRequestResponse, "", "0");
  {
  
    long __res;
    int64 __timeout;
    __res = 0;
    __nInt64 = 1;
    __timeout = syspar::`P2_Server * 1000000LL;
    {
    
      long __testStepInitOk;
      message `FDCAN2::`DIAGNOSTIC_REQUEST_PAM __output;
      message `FDCAN2::`DIAGNOSTIC_REQUEST_PAM __msgOrig;
      __output = __msgOrig;
      __testStepInitOk = 1;
      snprintf(__cArray, elCount(__cArray), "CAN message '%s' ID = 416981233x (0x18DAA0F1x) on bus FDCAN2", "DIAGNOSTIC_REQUEST_PAM");
      snprintf(__cArray2, elCount(__cArray2), "Send %s", __cArray);
      __tableHandle = ReportTableHead3Columns(__cArray2, "Byte", __cTOp, __cAssigned);
      ReportByteIndex("", 0, __cArray, elCount(__cArray));
      snprintf(__cArray2, 8192, "%s", __cArray);
      snprintf(__cArray3, 8192, "%s", "");
      
      ReportTableRow(__tableHandle, 0, __cArray2, __cAOp, 0x3, __cArray3, __oneOfFlag, __bSetInCheckAlignment);
      
      if (0 >= 0 && 0 < 64)
      {
        __output.byte((word)0) = 0x3;
      }
      else
      {
        testStepErrorInTestSystem(0, __cEmpty, "Index out of range. Unable to set byte %lld in message. Please check input parameter.", (int64)0);
        __testStepInitOk = 0;
      }
      ReportByteIndex("", 1, __cArray, elCount(__cArray));
      snprintf(__cArray2, 8192, "%s", __cArray);
      snprintf(__cArray3, 8192, "%s", "");
      
      ReportTableRow(__tableHandle, 0, __cArray2, __cAOp, 0x22, __cArray3, __oneOfFlag, __bSetInCheckAlignment);
      
      if (1 >= 0 && 1 < 64)
      {
        __output.byte((word)1) = 0x22;
      }
      else
      {
        testStepErrorInTestSystem(0, __cEmpty, "Index out of range. Unable to set byte %lld in message. Please check input parameter.", (int64)1);
        __testStepInitOk = 0;
      }
      ReportByteIndex("", 2, __cArray, elCount(__cArray));
      snprintf(__cArray2, 8192, "%s", __cArray);
      snprintf(__cArray3, 8192, "%s", "");
      
      ReportTableRow(__tableHandle, 0, __cArray2, __cAOp, 0xF1, __cArray3, __oneOfFlag, __bSetInCheckAlignment);
      
      if (2 >= 0 && 2 < 64)
      {
        __output.byte((word)2) = 0xF1;
      }
      else
      {
        testStepErrorInTestSystem(0, __cEmpty, "Index out of range. Unable to set byte %lld in message. Please check input parameter.", (int64)2);
        __testStepInitOk = 0;
      }
      ReportByteIndex("", 3, __cArray, elCount(__cArray));
      snprintf(__cArray2, 8192, "%s", __cArray);
      snprintf(__cArray3, 8192, "%s", "");
      
      ReportTableRow(__tableHandle, 0, __cArray2, __cAOp, 0x54, __cArray3, __oneOfFlag, __bSetInCheckAlignment);
      
      if (3 >= 0 && 3 < 64)
      {
        __output.byte((word)3) = 0x54;
      }
      else
      {
        testStepErrorInTestSystem(0, __cEmpty, "Index out of range. Unable to set byte %lld in message. Please check input parameter.", (int64)3);
        __testStepInitOk = 0;
      }
    
      ReportTableEndTestStep(__tableHandle, "Req1");
      if (__testStepInitOk)
      {
        output(__output);
      }
    }
    if (__timeout <= 0)
    {
      testStepErrorInTestSystem(0, "1", "Unable to wait for %.3f %s. Please check input parameter.", __timeout / ((float)1000000), "ms");
    }
    else
    {
      __tt2cnt_19 = 0;
      snprintf(__cArray, elCount(__cArray), "CAN message '%s' ID = 417001888x (0x18DAF1A0x) on bus FDCAN2", "DIAGNOSTIC_RESPONSE_PAM");
      if(SetBusContextByName("FDCAN2", __eSaveCurrent, __nBusContextNew, __nBusContextOld))
        testJoinMessageEvent(`FDCAN2::`DIAGNOSTIC_RESPONSE_PAM,  __cArray,
             delegate dword(message * __m)
             {
               dword __msg_callback_ret;
               if (__tt2cnt_19 == -1)
               {
                 return 1;
               }
               __msg_callback_ret = 1;
               __tt2cnt_19++;
               if (__msg_callback_ret)
               {
                 __tt2cnt_19 = -1;
                 return 1;
               }
               return 0;
             });
      __res = testWaitForAllJoinedEventsNS(__timeout);
      if (__nInt64 != 0)
      {
        snprintf(__cArray, elCount(__cArray), "CAN message '%s' ID = 417001888x (0x18DAF1A0x) on bus FDCAN2", "DIAGNOSTIC_RESPONSE_PAM");
        if(__tt2cnt_19 == -1)
        {
          snprintf(__cArray2, 8192, "Response of %s", __cArray);
        }
        else
        {
          snprintf(__cArray2, 8192, "Response of %s (received %d times)", __cArray, __tt2cnt_19);
        }
        if (__tt2cnt_19 == 0)
        {
          testStepFail(0, "Resp1", __cArray2);
        }
        else
        {
          testStepPass(2, "Resp1", __cArray2);
        }
        __ReportRequestResponseResult(__res, 0);
      }
      ResetBusContext(__nBusContextNew, __nBusContextOld);
    }
  }
  TestCommandEnd();

}

void Tt4h42sqi_F155_DID_with_Physical_Address()
{
  stack long __tableHandle;
  TestCommandBegin(__eDiagService, __cDiagService, "", "0");
  {
    if (DiagIsFunctionalGroup("CVADAS_0001_00000000_000"))
    {
      DiagResponse * __resp;
      DiagRequest CVADAS_0001_00000000_000._22F155_Software_Supplier_Identification __req;
      __diagService4h42sqi_18(__req, __resp);
    }
    else
    {
      DiagResponse CVADAS_0001_00000000_000.* __resp;
      DiagRequest CVADAS_0001_00000000_000._22F155_Software_Supplier_Identification __req;
      __diagService4h42sqi_18(__req, __resp);
    }
  }
  TestCommandEnd();


}

  
void __diagService4h42sqi_18(DiagRequest * __req, DiagResponse * __resp )
{
  stack long __tableHandle;
  long __res, __paramLen, __bytePos;

   __bVerdict = __eVerdictPass;

  do {
    TestReportResetDiagObjectList();
    DiagSetReportDetailLevel("CVADAS_0001_00000000_000", EnumServiceDetails_onfail);
    // Request aspect
    {

      if (0 >= DiagSendReqAndWaitForResp("CVADAS_0001_00000000_000", __req, __resp, __res, -1, -1, -1, -1, -1, EnumResult_pos, EnumServiceDetails_onfail, EnumSendingMode_physical, EnumSuppressPosResBit_asconfigured, EnumVerdictOnInvalidValues_fail))
        break;
    }

    __res = DiagErrCodeTestStep(__res, "Can't retrieve last response for request! No check possible.") < 0;
    if(__res)
    {
	  __bVerdict = __eVerdictFail;
      break;
    }
    {
      __res = DiagInterpretAs(__resp, "RDBI_PR");
      if(__res != 0)
      {
        __bVerdict = __eVerdictFail;
        DiagErrCodeTestStep(__res, "Can't interpret response as diagnostic primitive 'RDBI_PR'.");
        break;
      }
      else
      {
        TestStepPass( "Received primitive can be interpreted as diagnostic primitive 'RDBI_PR'.");
      }
    }
  }
  while(0);


  // Response, check & read aspect
  {
    __res = 1;
    __tableHandle = ReportTableHead5Columns(__cCheckCaption, __cTSym, __cTOp, __cRefVal, __cActual, __cRes);
    {
      __bDiagValueArrayCtr = DiagGetParameterErrorHandled(__resp, "_Software_Supplier_Identification_24", __bDiagValueArray, elcount(__bDiagValueArray), __cDiagValueArray, elcount(__cDiagValueArray));
      {
        __bArrayCtr = __CopyBytes(__bDiagValueArray, __bDiagValueArrayCtr, __bArray);
        CheckPlainParameterGetDataBufferConsistency(sysParGetData(syspar::`F155_SW_Supplier_Identification::`Software_Supplier_Identification, __bArray2, __bArrayCtr2), __bArrayCtr2, "syspar::`F155_SW_Supplier_Identification::`Software_Supplier_Identification");
        __csr = CompareBytes(__bArray, __bArrayCtr, __bArray2, __bArrayCtr2) == 0;
        snprintf(__cArray, 8192, "%s", "Diagnostic parameter \'_Software_Supplier_Identification_24\'");
        snprintf(__cArray2, 8192, "%s", __cArray);
        snprintf(__cArray3, 8192, "%s", "Software_Supplier_Identification");
        ReportTableRow(__tableHandle, 0, __cArray2, "Bytes", __bArray2, __bArrayCtr2, __cArray3, __oneOfFlag, __bSetInCheckAlignment);
        ReportCell(__tableHandle, __bArray, __bArrayCtr);
        ReportCellResult(__tableHandle, __csr, __ePassFail);
      }
    
      __res = __res && __csr;
    
    }
    ReportTableEndVerdict(__tableHandle, __cEvaluateResponse, __res);
	__bVerdict = __bVerdict && __res;
  }
  if (__bVerdict == __eVerdictFail)
    TestReportWriteDiagObjectList();
}

void Tt4h42sqi_F155_DID_with_Functional_Address()
{
  stack long __tableHandle;
  TestCommandBegin(__eDiagService, __cDiagService, "", "0");
  {
    if (DiagIsFunctionalGroup("CVADAS_0001_00000000_000"))
    {
      DiagResponse * __resp;
      DiagRequest CVADAS_0001_00000000_000._22F155_Software_Supplier_Identification __req;
      __diagService4h42sqi_19(__req, __resp);
    }
    else
    {
      DiagResponse CVADAS_0001_00000000_000.* __resp;
      DiagRequest CVADAS_0001_00000000_000._22F155_Software_Supplier_Identification __req;
      __diagService4h42sqi_19(__req, __resp);
    }
  }
  TestCommandEnd();


}

  
void __diagService4h42sqi_19(DiagRequest * __req, DiagResponse * __resp )
{
  stack long __tableHandle;
  long __res, __paramLen, __bytePos;

   __bVerdict = __eVerdictPass;

  do {
    TestReportResetDiagObjectList();
    DiagSetReportDetailLevel("CVADAS_0001_00000000_000", EnumServiceDetails_onfail);
    // Request aspect
    {

      if (0 >= DiagSendReqAndWaitForResp("CVADAS_0001_00000000_000", __req, __resp, __res, -1, -1, -1, -1, -1, EnumResult_pos, EnumServiceDetails_onfail, EnumSendingMode_functional, EnumSuppressPosResBit_asconfigured, EnumVerdictOnInvalidValues_fail))
        break;
    }

    __res = DiagErrCodeTestStep(__res, "Can't retrieve last response for request! No check possible.") < 0;
    if(__res)
    {
	  __bVerdict = __eVerdictFail;
      break;
    }
    {
      __res = DiagInterpretAs(__resp, "RDBI_PR");
      if(__res != 0)
      {
        __bVerdict = __eVerdictFail;
        DiagErrCodeTestStep(__res, "Can't interpret response as diagnostic primitive 'RDBI_PR'.");
        break;
      }
      else
      {
        TestStepPass( "Received primitive can be interpreted as diagnostic primitive 'RDBI_PR'.");
      }
    }
  }
  while(0);


  // Response, check & read aspect
  {
    __res = 1;
    __tableHandle = ReportTableHead5Columns(__cCheckCaption, __cTSym, __cTOp, __cRefVal, __cActual, __cRes);
    {
      __bDiagValueArrayCtr = DiagGetParameterErrorHandled(__resp, "_Software_Supplier_Identification_24", __bDiagValueArray, elcount(__bDiagValueArray), __cDiagValueArray, elcount(__cDiagValueArray));
      {
        __bArrayCtr = __CopyBytes(__bDiagValueArray, __bDiagValueArrayCtr, __bArray);
        CheckPlainParameterGetDataBufferConsistency(sysParGetData(syspar::`F155_SW_Supplier_Identification::`Software_Supplier_Identification, __bArray2, __bArrayCtr2), __bArrayCtr2, "syspar::`F155_SW_Supplier_Identification::`Software_Supplier_Identification");
        __csr = CompareBytes(__bArray, __bArrayCtr, __bArray2, __bArrayCtr2) == 0;
        snprintf(__cArray, 8192, "%s", "Diagnostic parameter \'_Software_Supplier_Identification_24\'");
        snprintf(__cArray2, 8192, "%s", __cArray);
        snprintf(__cArray3, 8192, "%s", "Software_Supplier_Identification");
        ReportTableRow(__tableHandle, 0, __cArray2, "Bytes", __bArray2, __bArrayCtr2, __cArray3, __oneOfFlag, __bSetInCheckAlignment);
        ReportCell(__tableHandle, __bArray, __bArrayCtr);
        ReportCellResult(__tableHandle, __csr, __ePassFail);
      }
    
      __res = __res && __csr;
    
    }
    ReportTableEndVerdict(__tableHandle, __cEvaluateResponse, __res);
	__bVerdict = __bVerdict && __res;
  }
  if (__bVerdict == __eVerdictFail)
    TestReportWriteDiagObjectList();
}

void Tt4h42sqi_F155_DID_with_Standard_Physical_Address()
{
  stack long __tableHandle;
  TestCommandBegin(__eRequestResponse, __cRequestResponse, "", "0");
  {
  
    long __res;
    int64 __timeout;
    __res = 0;
    __nInt64 = 1;
    __timeout = syspar::`P2_Server * 1000000LL;
    {
    
      long __testStepInitOk;
      message `FDCAN2::`DIAGNOSTIC_REQUEST_PAM __output;
      message `FDCAN2::`DIAGNOSTIC_REQUEST_PAM __msgOrig;
      __output = __msgOrig;
      __testStepInitOk = 1;
      {
        int64 __dlc;
        __dlc = 4;
        if (__dlc >= 0 && __dlc <= (__output.EDL ? 15 : 8))
          __output.DLC = __dlc;
        else
        {
          testStepErrorInTestSystem(0, __cEmpty, "Unable to set DLC=%lld in message. Please check input parameter.", __dlc);
          __testStepInitOk = 0;
        }
      }
      if (__testStepInitOk)
      {
        snprintf(__cArray, elCount(__cArray), "CAN message '%s' ID = 416981233x (0x18DAA0F1x) on bus FDCAN2", "DIAGNOSTIC_REQUEST_PAM");
        snprintf(__cArray2, elCount(__cArray2), "Send %s", __cArray);
        __tableHandle = ReportTableHead3Columns(__cArray2, "Byte", __cTOp, __cAssigned);
        ReportByteIndex("", 0, __cArray, elCount(__cArray));
        snprintf(__cArray2, 8192, "%s", __cArray);
        snprintf(__cArray3, 8192, "%s", "");
        
        ReportTableRow(__tableHandle, 0, __cArray2, __cAOp, 0x3, __cArray3, __oneOfFlag, __bSetInCheckAlignment);
        
        if (0 >= 0 && 0 < 64)
        {
          __output.byte((word)0) = 0x3;
        }
        else
        {
          testStepErrorInTestSystem(0, __cEmpty, "Index out of range. Unable to set byte %lld in message. Please check input parameter.", (int64)0);
          __testStepInitOk = 0;
        }
        ReportByteIndex("", 1, __cArray, elCount(__cArray));
        snprintf(__cArray2, 8192, "%s", __cArray);
        snprintf(__cArray3, 8192, "%s", "");
        
        ReportTableRow(__tableHandle, 0, __cArray2, __cAOp, 0x22, __cArray3, __oneOfFlag, __bSetInCheckAlignment);
        
        if (1 >= 0 && 1 < 64)
        {
          __output.byte((word)1) = 0x22;
        }
        else
        {
          testStepErrorInTestSystem(0, __cEmpty, "Index out of range. Unable to set byte %lld in message. Please check input parameter.", (int64)1);
          __testStepInitOk = 0;
        }
        ReportByteIndex("", 2, __cArray, elCount(__cArray));
        snprintf(__cArray2, 8192, "%s", __cArray);
        snprintf(__cArray3, 8192, "%s", "");
        
        ReportTableRow(__tableHandle, 0, __cArray2, __cAOp, 0xF1, __cArray3, __oneOfFlag, __bSetInCheckAlignment);
        
        if (2 >= 0 && 2 < 64)
        {
          __output.byte((word)2) = 0xF1;
        }
        else
        {
          testStepErrorInTestSystem(0, __cEmpty, "Index out of range. Unable to set byte %lld in message. Please check input parameter.", (int64)2);
          __testStepInitOk = 0;
        }
        ReportByteIndex("", 3, __cArray, elCount(__cArray));
        snprintf(__cArray2, 8192, "%s", __cArray);
        snprintf(__cArray3, 8192, "%s", "");
        
        ReportTableRow(__tableHandle, 0, __cArray2, __cAOp, 0x55, __cArray3, __oneOfFlag, __bSetInCheckAlignment);
        
        if (3 >= 0 && 3 < 64)
        {
          __output.byte((word)3) = 0x55;
        }
        else
        {
          testStepErrorInTestSystem(0, __cEmpty, "Index out of range. Unable to set byte %lld in message. Please check input parameter.", (int64)3);
          __testStepInitOk = 0;
        }
      
        ReportTableEndTestStep(__tableHandle, "Req1");
      }
      if (__testStepInitOk)
      {
        output(__output);
      }
    }
    if (__timeout <= 0)
    {
      testStepErrorInTestSystem(0, "1", "Unable to wait for %.3f %s. Please check input parameter.", __timeout / ((float)1000000), "ms");
    }
    else
    {
      __tt2cnt_21 = 0;
      snprintf(__cArray, elCount(__cArray), "CAN message '%s' ID = 417001888x (0x18DAF1A0x) on bus FDCAN2", "DIAGNOSTIC_RESPONSE_PAM");
      if(SetBusContextByName("FDCAN2", __eSaveCurrent, __nBusContextNew, __nBusContextOld))
        testJoinMessageEvent(`FDCAN2::`DIAGNOSTIC_RESPONSE_PAM,  __cArray,
             delegate dword(message * __m)
             {
               dword __msg_callback_ret;
               if (__tt2cnt_21 == -1)
               {
                 return 1;
               }
               __msg_callback_ret = 1;
               __tt2cnt_21++;
               if (__msg_callback_ret)
               {
                 __tt2cnt_21 = -1;
                 return 1;
               }
               return 0;
             });
      __res = testWaitForAllJoinedEventsNS(__timeout);
      if (__nInt64 != 0)
      {
        snprintf(__cArray, elCount(__cArray), "CAN message '%s' ID = 417001888x (0x18DAF1A0x) on bus FDCAN2", "DIAGNOSTIC_RESPONSE_PAM");
        if(__tt2cnt_21 == -1)
        {
          snprintf(__cArray2, 8192, "Response of %s", __cArray);
        }
        else
        {
          snprintf(__cArray2, 8192, "Response of %s (received %d times)", __cArray, __tt2cnt_21);
        }
        if (__tt2cnt_21 == 0)
        {
          testStepFail(0, "Resp1", __cArray2);
        }
        else
        {
          testStepPass(2, "Resp1", __cArray2);
        }
        __ReportRequestResponseResult(__res, 0);
      }
      ResetBusContext(__nBusContextNew, __nBusContextOld);
    }
  }
  TestCommandEnd();

}

void Tt4h42sqi_F187_DID_with_Physical_Address()
{
  stack long __tableHandle;
  TestCommandBegin(__eDiagService, __cDiagService, "", "0");
  {
    if (DiagIsFunctionalGroup("CVADAS_0001_00000000_000"))
    {
      DiagResponse * __resp;
      DiagRequest CVADAS_0001_00000000_000._22F187_CODEP_ECU_Part_Number __req;
      __diagService4h42sqi_20(__req, __resp);
    }
    else
    {
      DiagResponse CVADAS_0001_00000000_000.* __resp;
      DiagRequest CVADAS_0001_00000000_000._22F187_CODEP_ECU_Part_Number __req;
      __diagService4h42sqi_20(__req, __resp);
    }
  }
  TestCommandEnd();


}

  
void __diagService4h42sqi_20(DiagRequest * __req, DiagResponse * __resp )
{
  stack long __tableHandle;
  long __res, __paramLen, __bytePos;

   __bVerdict = __eVerdictPass;

  do {
    TestReportResetDiagObjectList();
    DiagSetReportDetailLevel("CVADAS_0001_00000000_000", EnumServiceDetails_onfail);
    // Request aspect
    {

      if (0 >= DiagSendReqAndWaitForResp("CVADAS_0001_00000000_000", __req, __resp, __res, -1, -1, -1, -1, -1, EnumResult_pos, EnumServiceDetails_onfail, EnumSendingMode_physical, EnumSuppressPosResBit_asconfigured, EnumVerdictOnInvalidValues_fail))
        break;
    }

    __res = DiagErrCodeTestStep(__res, "Can't retrieve last response for request! No check possible.") < 0;
    if(__res)
    {
	  __bVerdict = __eVerdictFail;
      break;
    }
    {
      __res = DiagInterpretAs(__resp, "RDBI_PR");
      if(__res != 0)
      {
        __bVerdict = __eVerdictFail;
        DiagErrCodeTestStep(__res, "Can't interpret response as diagnostic primitive 'RDBI_PR'.");
        break;
      }
      else
      {
        TestStepPass( "Received primitive can be interpreted as diagnostic primitive 'RDBI_PR'.");
      }
    }
  }
  while(0);


  // Response, check & read aspect
  {
    __res = 1;
    __tableHandle = ReportTableHead5Columns(__cCheckCaption, __cTSym, __cTOp, __cRefVal, __cActual, __cRes);
    {
      __bDiagValueArrayCtr = DiagGetParameterErrorHandled(__resp, "_CODEP_ECU_Part_Number_24", __bDiagValueArray, elcount(__bDiagValueArray), __cDiagValueArray, elcount(__cDiagValueArray));
      {
        __bArrayCtr = __CopyBytes(__bDiagValueArray, __bDiagValueArrayCtr, __bArray);
        CheckPlainParameterGetDataBufferConsistency(sysParGetData(syspar::`F187_CODEP_ECU_Part_Number::`CODEP_ECU_Part_Number, __bArray2, __bArrayCtr2), __bArrayCtr2, "syspar::`F187_CODEP_ECU_Part_Number::`CODEP_ECU_Part_Number");
        __csr = CompareBytes(__bArray, __bArrayCtr, __bArray2, __bArrayCtr2) == 0;
        snprintf(__cArray, 8192, "%s", "Diagnostic parameter \'_CODEP_ECU_Part_Number_24\'");
        snprintf(__cArray2, 8192, "%s", __cArray);
        snprintf(__cArray3, 8192, "%s", "CODEP_ECU_Part_Number");
        ReportTableRow(__tableHandle, 0, __cArray2, "Bytes", __bArray2, __bArrayCtr2, __cArray3, __oneOfFlag, __bSetInCheckAlignment);
        ReportCell(__tableHandle, __bArray, __bArrayCtr);
        ReportCellResult(__tableHandle, __csr, __ePassFail);
      }
    
      __res = __res && __csr;
    
    }
    ReportTableEndVerdict(__tableHandle, __cEvaluateResponse, __res);
	__bVerdict = __bVerdict && __res;
  }
  if (__bVerdict == __eVerdictFail)
    TestReportWriteDiagObjectList();
}

void Tt4h42sqi_F187_DID_with_Functional_Address()
{
  stack long __tableHandle;
  TestCommandBegin(__eDiagService, __cDiagService, "", "0");
  {
    if (DiagIsFunctionalGroup("CVADAS_0001_00000000_000"))
    {
      DiagResponse * __resp;
      DiagRequest CVADAS_0001_00000000_000._22F187_CODEP_ECU_Part_Number __req;
      __diagService4h42sqi_21(__req, __resp);
    }
    else
    {
      DiagResponse CVADAS_0001_00000000_000.* __resp;
      DiagRequest CVADAS_0001_00000000_000._22F187_CODEP_ECU_Part_Number __req;
      __diagService4h42sqi_21(__req, __resp);
    }
  }
  TestCommandEnd();


}

  
void __diagService4h42sqi_21(DiagRequest * __req, DiagResponse * __resp )
{
  stack long __tableHandle;
  long __res, __paramLen, __bytePos;

   __bVerdict = __eVerdictPass;

  do {
    TestReportResetDiagObjectList();
    DiagSetReportDetailLevel("CVADAS_0001_00000000_000", EnumServiceDetails_onfail);
    // Request aspect
    {

      if (0 >= DiagSendReqAndWaitForResp("CVADAS_0001_00000000_000", __req, __resp, __res, -1, -1, -1, -1, -1, EnumResult_pos, EnumServiceDetails_onfail, EnumSendingMode_functional, EnumSuppressPosResBit_asconfigured, EnumVerdictOnInvalidValues_fail))
        break;
    }

    __res = DiagErrCodeTestStep(__res, "Can't retrieve last response for request! No check possible.") < 0;
    if(__res)
    {
	  __bVerdict = __eVerdictFail;
      break;
    }
    {
      __res = DiagInterpretAs(__resp, "RDBI_PR");
      if(__res != 0)
      {
        __bVerdict = __eVerdictFail;
        DiagErrCodeTestStep(__res, "Can't interpret response as diagnostic primitive 'RDBI_PR'.");
        break;
      }
      else
      {
        TestStepPass( "Received primitive can be interpreted as diagnostic primitive 'RDBI_PR'.");
      }
    }
  }
  while(0);


  // Response, check & read aspect
  {
    __res = 1;
    __tableHandle = ReportTableHead5Columns(__cCheckCaption, __cTSym, __cTOp, __cRefVal, __cActual, __cRes);
    {
      __bDiagValueArrayCtr = DiagGetParameterErrorHandled(__resp, "_CODEP_ECU_Part_Number_24", __bDiagValueArray, elcount(__bDiagValueArray), __cDiagValueArray, elcount(__cDiagValueArray));
      {
        __bArrayCtr = __CopyBytes(__bDiagValueArray, __bDiagValueArrayCtr, __bArray);
        CheckPlainParameterGetDataBufferConsistency(sysParGetData(syspar::`F187_CODEP_ECU_Part_Number::`CODEP_ECU_Part_Number, __bArray2, __bArrayCtr2), __bArrayCtr2, "syspar::`F187_CODEP_ECU_Part_Number::`CODEP_ECU_Part_Number");
        __csr = CompareBytes(__bArray, __bArrayCtr, __bArray2, __bArrayCtr2) == 0;
        snprintf(__cArray, 8192, "%s", "Diagnostic parameter \'_CODEP_ECU_Part_Number_24\'");
        snprintf(__cArray2, 8192, "%s", __cArray);
        snprintf(__cArray3, 8192, "%s", "CODEP_ECU_Part_Number");
        ReportTableRow(__tableHandle, 0, __cArray2, "Bytes", __bArray2, __bArrayCtr2, __cArray3, __oneOfFlag, __bSetInCheckAlignment);
        ReportCell(__tableHandle, __bArray, __bArrayCtr);
        ReportCellResult(__tableHandle, __csr, __ePassFail);
      }
    
      __res = __res && __csr;
    
    }
    ReportTableEndVerdict(__tableHandle, __cEvaluateResponse, __res);
	__bVerdict = __bVerdict && __res;
  }
  if (__bVerdict == __eVerdictFail)
    TestReportWriteDiagObjectList();
}

void Tt4h42sqi_F187_DID_with_Standard_Physical_Address()
{
  stack long __tableHandle;
  TestCommandBegin(__eRequestResponse, __cRequestResponse, "", "0");
  {
  
    long __res;
    int64 __timeout;
    __res = 0;
    __nInt64 = 1;
    __timeout = syspar::`P2_Server * 1000000LL;
    {
    
      long __testStepInitOk;
      message `FDCAN2::`DIAGNOSTIC_REQUEST_PAM __output;
      message `FDCAN2::`DIAGNOSTIC_REQUEST_PAM __msgOrig;
      __output = __msgOrig;
      __testStepInitOk = 1;
      {
        int64 __dlc;
        __dlc = 4;
        if (__dlc >= 0 && __dlc <= (__output.EDL ? 15 : 8))
          __output.DLC = __dlc;
        else
        {
          testStepErrorInTestSystem(0, __cEmpty, "Unable to set DLC=%lld in message. Please check input parameter.", __dlc);
          __testStepInitOk = 0;
        }
      }
      if (__testStepInitOk)
      {
        snprintf(__cArray, elCount(__cArray), "CAN message '%s' ID = 416981233x (0x18DAA0F1x) on bus FDCAN2", "DIAGNOSTIC_REQUEST_PAM");
        snprintf(__cArray2, elCount(__cArray2), "Send %s", __cArray);
        __tableHandle = ReportTableHead3Columns(__cArray2, "Byte", __cTOp, __cAssigned);
        ReportByteIndex("", 0, __cArray, elCount(__cArray));
        snprintf(__cArray2, 8192, "%s", __cArray);
        snprintf(__cArray3, 8192, "%s", "");
        
        ReportTableRow(__tableHandle, 0, __cArray2, __cAOp, 0x3, __cArray3, __oneOfFlag, __bSetInCheckAlignment);
        
        if (0 >= 0 && 0 < 64)
        {
          __output.byte((word)0) = 0x3;
        }
        else
        {
          testStepErrorInTestSystem(0, __cEmpty, "Index out of range. Unable to set byte %lld in message. Please check input parameter.", (int64)0);
          __testStepInitOk = 0;
        }
        ReportByteIndex("", 1, __cArray, elCount(__cArray));
        snprintf(__cArray2, 8192, "%s", __cArray);
        snprintf(__cArray3, 8192, "%s", "");
        
        ReportTableRow(__tableHandle, 0, __cArray2, __cAOp, 0x22, __cArray3, __oneOfFlag, __bSetInCheckAlignment);
        
        if (1 >= 0 && 1 < 64)
        {
          __output.byte((word)1) = 0x22;
        }
        else
        {
          testStepErrorInTestSystem(0, __cEmpty, "Index out of range. Unable to set byte %lld in message. Please check input parameter.", (int64)1);
          __testStepInitOk = 0;
        }
        ReportByteIndex("", 2, __cArray, elCount(__cArray));
        snprintf(__cArray2, 8192, "%s", __cArray);
        snprintf(__cArray3, 8192, "%s", "");
        
        ReportTableRow(__tableHandle, 0, __cArray2, __cAOp, 0xF1, __cArray3, __oneOfFlag, __bSetInCheckAlignment);
        
        if (2 >= 0 && 2 < 64)
        {
          __output.byte((word)2) = 0xF1;
        }
        else
        {
          testStepErrorInTestSystem(0, __cEmpty, "Index out of range. Unable to set byte %lld in message. Please check input parameter.", (int64)2);
          __testStepInitOk = 0;
        }
        ReportByteIndex("", 3, __cArray, elCount(__cArray));
        snprintf(__cArray2, 8192, "%s", __cArray);
        snprintf(__cArray3, 8192, "%s", "");
        
        ReportTableRow(__tableHandle, 0, __cArray2, __cAOp, 0x87, __cArray3, __oneOfFlag, __bSetInCheckAlignment);
        
        if (3 >= 0 && 3 < 64)
        {
          __output.byte((word)3) = 0x87;
        }
        else
        {
          testStepErrorInTestSystem(0, __cEmpty, "Index out of range. Unable to set byte %lld in message. Please check input parameter.", (int64)3);
          __testStepInitOk = 0;
        }
      
        ReportTableEndTestStep(__tableHandle, "Req1");
      }
      if (__testStepInitOk)
      {
        output(__output);
      }
    }
    if (__timeout <= 0)
    {
      testStepErrorInTestSystem(0, "1", "Unable to wait for %.3f %s. Please check input parameter.", __timeout / ((float)1000000), "ms");
    }
    else
    {
      __tt2cnt_23 = 0;
      snprintf(__cArray, elCount(__cArray), "CAN message '%s' ID = 417001888x (0x18DAF1A0x) on bus FDCAN2", "DIAGNOSTIC_RESPONSE_PAM");
      if(SetBusContextByName("FDCAN2", __eSaveCurrent, __nBusContextNew, __nBusContextOld))
        testJoinMessageEvent(`FDCAN2::`DIAGNOSTIC_RESPONSE_PAM,  __cArray,
             delegate dword(message * __m)
             {
               dword __msg_callback_ret;
               if (__tt2cnt_23 == -1)
               {
                 return 1;
               }
               __msg_callback_ret = 1;
               __tt2cnt_23++;
               if (__msg_callback_ret)
               {
                 __tt2cnt_23 = -1;
                 return 1;
               }
               return 0;
             });
      __res = testWaitForAllJoinedEventsNS(__timeout);
      if (__nInt64 != 0)
      {
        snprintf(__cArray, elCount(__cArray), "CAN message '%s' ID = 417001888x (0x18DAF1A0x) on bus FDCAN2", "DIAGNOSTIC_RESPONSE_PAM");
        if(__tt2cnt_23 == -1)
        {
          snprintf(__cArray2, 8192, "Response of %s", __cArray);
        }
        else
        {
          snprintf(__cArray2, 8192, "Response of %s (received %d times)", __cArray, __tt2cnt_23);
        }
        if (__tt2cnt_23 == 0)
        {
          testStepFail(0, "Resp1", __cArray2);
        }
        else
        {
          testStepPass(2, "Resp1", __cArray2);
        }
        __ReportRequestResponseResult(__res, 0);
      }
      ResetBusContext(__nBusContextNew, __nBusContextOld);
    }
  }
  TestCommandEnd();

}

void Tt4h42sqi_F110_DID_with_Physical_Address()
{
  stack long __tableHandle;
  TestCommandBegin(__eDiagService, __cDiagService, "", "0");
  {
    if (DiagIsFunctionalGroup("CVADAS_0001_00000000_000"))
    {
      DiagResponse * __resp;
      DiagRequest CVADAS_0001_00000000_000._22F110_ECU_Diagnostic_Identification __req;
      __diagService4h42sqi_22(__req, __resp);
    }
    else
    {
      DiagResponse CVADAS_0001_00000000_000.* __resp;
      DiagRequest CVADAS_0001_00000000_000._22F110_ECU_Diagnostic_Identification __req;
      __diagService4h42sqi_22(__req, __resp);
    }
  }
  TestCommandEnd();


}

  
void __diagService4h42sqi_22(DiagRequest * __req, DiagResponse * __resp )
{
  stack long __tableHandle;
  long __res, __paramLen, __bytePos;

   __bVerdict = __eVerdictPass;

  do {
    TestReportResetDiagObjectList();
    DiagSetReportDetailLevel("CVADAS_0001_00000000_000", EnumServiceDetails_onfail);
    // Request aspect
    {

      if (0 >= DiagSendReqAndWaitForResp("CVADAS_0001_00000000_000", __req, __resp, __res, -1, -1, -1, -1, -1, EnumResult_pos, EnumServiceDetails_onfail, EnumSendingMode_physical, EnumSuppressPosResBit_asconfigured, EnumVerdictOnInvalidValues_fail))
        break;
    }

    __res = DiagErrCodeTestStep(__res, "Can't retrieve last response for request! No check possible.") < 0;
    if(__res)
    {
	  __bVerdict = __eVerdictFail;
      break;
    }
    {
      __res = DiagInterpretAs(__resp, "RDBI_PR");
      if(__res != 0)
      {
        __bVerdict = __eVerdictFail;
        DiagErrCodeTestStep(__res, "Can't interpret response as diagnostic primitive 'RDBI_PR'.");
        break;
      }
      else
      {
        TestStepPass( "Received primitive can be interpreted as diagnostic primitive 'RDBI_PR'.");
      }
    }
  }
  while(0);


  // Response, check & read aspect
  {
    __res = 1;
    __tableHandle = ReportTableHead5Columns(__cCheckCaption, __cTSym, __cTOp, __cRefVal, __cActual, __cRes);
    {
      __bDiagValueArrayCtr = DiagGetParameterErrorHandled(__resp, "_Diagnostic_Variant_24", __bDiagValueArray, elcount(__bDiagValueArray), __cDiagValueArray, elcount(__cDiagValueArray));
      {
        __bArrayCtr = __CopyBytes(__bDiagValueArray, __bDiagValueArrayCtr, __bArray);
        CheckPlainParameterGetDataBufferConsistency(sysParGetData(syspar::`F110_ECU_Diagnostic_Identification::`Diagnostic_Variant, __bArray2, __bArrayCtr2), __bArrayCtr2, "syspar::`F110_ECU_Diagnostic_Identification::`Diagnostic_Variant");
        __csr = CompareBytes(__bArray, __bArrayCtr, __bArray2, __bArrayCtr2) == 0;
        snprintf(__cArray, 8192, "%s", "Diagnostic parameter \'_Diagnostic_Variant_24\'");
        snprintf(__cArray2, 8192, "%s", __cArray);
        snprintf(__cArray3, 8192, "%s", "Diagnostic_Variant");
        ReportTableRow(__tableHandle, 0, __cArray2, "Bytes", __bArray2, __bArrayCtr2, __cArray3, __oneOfFlag, __bSetInCheckAlignment);
        ReportCell(__tableHandle, __bArray, __bArrayCtr);
        ReportCellResult(__tableHandle, __csr, __ePassFail);
      }
    
      __res = __res && __csr;
    
    }
    {
      double __nDiagValue;
      DiagGetParameterErrorHandled(__resp, "_Diagnostic_Version_40", __nDiagValue);
      __csr = CheckSignalMatch(__nDiagValue, 0, ">=") == 1;
      snprintf(__cArray, 8192, "%s", "Diagnostic parameter \'_Diagnostic_Version_40\'");
      snprintf(__cArray2, 8192, "%s", __cArray);
      snprintf(__cArray3, 8192, "%s", "");
      ReportTableRow(__tableHandle, 0, __cArray2, ">=", 0, __cArray3, __oneOfFlag, __bSetInCheckAlignment);
      ReportCell(__tableHandle, __nDiagValue);
      ReportCellResult(__tableHandle, __csr, __ePassFail);
    
      __res = __res && __csr;
    
    }
    {
      double __nDiagValue;
      DiagGetParameterErrorHandled(__resp, "_Flash_Definition_Number_FDN_72", __nDiagValue);
      __csr = CheckSignalMatch(__nDiagValue, 0, ">=") == 1;
      snprintf(__cArray, 8192, "%s", "Diagnostic parameter \'_Flash_Definition_Number_FDN_72\'");
      snprintf(__cArray2, 8192, "%s", __cArray);
      snprintf(__cArray3, 8192, "%s", "");
      ReportTableRow(__tableHandle, 0, __cArray2, ">=", 0, __cArray3, __oneOfFlag, __bSetInCheckAlignment);
      ReportCell(__tableHandle, __nDiagValue);
      ReportCellResult(__tableHandle, __csr, __ePassFail);
    
      __res = __res && __csr;
    
    }
    {
      DiagGetParameterErrorHandled(__resp, "_Supplier_ID_88", __bDiagValueArray, elcount(__bDiagValueArray), __cDiagValueArray, elcount(__cDiagValueArray));
      CheckCaplGenVarStringBufferConsistency(__cDiagValueArray, 8192);
      snprintf(__cArray, 8192, "%s", __cDiagValueArray);
      CheckLiteralGetStringBufferConsistency("0", 8192);
      snprintf(__cArray2, 8192, "%s", "0");
      __csr = strncmp(__cArray, __cArray2, 8192) >= 0;
      snprintf(__cArray3, 8192, "%s", "Diagnostic parameter \'_Supplier_ID_88\'");
      snprintf(__cArray4, 8192, "%s", __cArray3);
      snprintf(__cArray5, 8192, "%s", "");
      ReportTableRow(__tableHandle, 0, __cArray4, ">=", __cArray2, __cArray5, __oneOfFlag, __bSetInCheckAlignment);
      ReportCell(__tableHandle, __cArray);
      ReportCellResult(__tableHandle, __csr, __ePassFail);
    
      __res = __res && __csr;
    
    }
    ReportTableEndVerdict(__tableHandle, __cEvaluateResponse, __res);
	__bVerdict = __bVerdict && __res;
  }
  if (__bVerdict == __eVerdictFail)
    TestReportWriteDiagObjectList();
}

void Tt4h42sqi_F110_DID_with_Functional_Address()
{
  stack long __tableHandle;
  TestCommandBegin(__eDiagService, __cDiagService, "", "0");
  {
    if (DiagIsFunctionalGroup("CVADAS_0001_00000000_000"))
    {
      DiagResponse * __resp;
      DiagRequest CVADAS_0001_00000000_000._22F110_ECU_Diagnostic_Identification __req;
      __diagService4h42sqi_23(__req, __resp);
    }
    else
    {
      DiagResponse CVADAS_0001_00000000_000.* __resp;
      DiagRequest CVADAS_0001_00000000_000._22F110_ECU_Diagnostic_Identification __req;
      __diagService4h42sqi_23(__req, __resp);
    }
  }
  TestCommandEnd();


}

  
void __diagService4h42sqi_23(DiagRequest * __req, DiagResponse * __resp )
{
  stack long __tableHandle;
  long __res, __paramLen, __bytePos;

   __bVerdict = __eVerdictPass;

  do {
    TestReportResetDiagObjectList();
    DiagSetReportDetailLevel("CVADAS_0001_00000000_000", EnumServiceDetails_onfail);
    // Request aspect
    {

      if (0 >= DiagSendReqAndWaitForResp("CVADAS_0001_00000000_000", __req, __resp, __res, -1, -1, -1, -1, -1, EnumResult_pos, EnumServiceDetails_onfail, EnumSendingMode_physical, EnumSuppressPosResBit_asconfigured, EnumVerdictOnInvalidValues_fail))
        break;
    }

    __res = DiagErrCodeTestStep(__res, "Can't retrieve last response for request! No check possible.") < 0;
    if(__res)
    {
	  __bVerdict = __eVerdictFail;
      break;
    }
    {
      __res = DiagInterpretAs(__resp, "RDBI_PR");
      if(__res != 0)
      {
        __bVerdict = __eVerdictFail;
        DiagErrCodeTestStep(__res, "Can't interpret response as diagnostic primitive 'RDBI_PR'.");
        break;
      }
      else
      {
        TestStepPass( "Received primitive can be interpreted as diagnostic primitive 'RDBI_PR'.");
      }
    }
  }
  while(0);


  // Response, check & read aspect
  {
    __res = 1;
    __tableHandle = ReportTableHead5Columns(__cCheckCaption, __cTSym, __cTOp, __cRefVal, __cActual, __cRes);
    {
      __bDiagValueArrayCtr = DiagGetParameterErrorHandled(__resp, "_Diagnostic_Variant_24", __bDiagValueArray, elcount(__bDiagValueArray), __cDiagValueArray, elcount(__cDiagValueArray));
      {
        __bArrayCtr = __CopyBytes(__bDiagValueArray, __bDiagValueArrayCtr, __bArray);
        CheckPlainParameterGetDataBufferConsistency(sysParGetData(syspar::`F110_ECU_Diagnostic_Identification::`Diagnostic_Variant, __bArray2, __bArrayCtr2), __bArrayCtr2, "syspar::`F110_ECU_Diagnostic_Identification::`Diagnostic_Variant");
        __csr = CompareBytes(__bArray, __bArrayCtr, __bArray2, __bArrayCtr2) == 0;
        snprintf(__cArray, 8192, "%s", "Diagnostic parameter \'_Diagnostic_Variant_24\'");
        snprintf(__cArray2, 8192, "%s", __cArray);
        snprintf(__cArray3, 8192, "%s", "Diagnostic_Variant");
        ReportTableRow(__tableHandle, 0, __cArray2, "Bytes", __bArray2, __bArrayCtr2, __cArray3, __oneOfFlag, __bSetInCheckAlignment);
        ReportCell(__tableHandle, __bArray, __bArrayCtr);
        ReportCellResult(__tableHandle, __csr, __ePassFail);
      }
    
      __res = __res && __csr;
    
    }
    {
      double __nDiagValue;
      DiagGetParameterErrorHandled(__resp, "_Diagnostic_Version_40", __nDiagValue);
      __csr = CheckSignalMatch(__nDiagValue, 0, ">=") == 1;
      snprintf(__cArray, 8192, "%s", "Diagnostic parameter \'_Diagnostic_Version_40\'");
      snprintf(__cArray2, 8192, "%s", __cArray);
      snprintf(__cArray3, 8192, "%s", "");
      ReportTableRow(__tableHandle, 0, __cArray2, ">=", 0, __cArray3, __oneOfFlag, __bSetInCheckAlignment);
      ReportCell(__tableHandle, __nDiagValue);
      ReportCellResult(__tableHandle, __csr, __ePassFail);
    
      __res = __res && __csr;
    
    }
    {
      double __nDiagValue;
      DiagGetParameterErrorHandled(__resp, "_Flash_Definition_Number_FDN_72", __nDiagValue);
      __csr = CheckSignalMatch(__nDiagValue, 0, ">=") == 1;
      snprintf(__cArray, 8192, "%s", "Diagnostic parameter \'_Flash_Definition_Number_FDN_72\'");
      snprintf(__cArray2, 8192, "%s", __cArray);
      snprintf(__cArray3, 8192, "%s", "");
      ReportTableRow(__tableHandle, 0, __cArray2, ">=", 0, __cArray3, __oneOfFlag, __bSetInCheckAlignment);
      ReportCell(__tableHandle, __nDiagValue);
      ReportCellResult(__tableHandle, __csr, __ePassFail);
    
      __res = __res && __csr;
    
    }
    {
      DiagGetParameterErrorHandled(__resp, "_Supplier_ID_88", __bDiagValueArray, elcount(__bDiagValueArray), __cDiagValueArray, elcount(__cDiagValueArray));
      CheckCaplGenVarStringBufferConsistency(__cDiagValueArray, 8192);
      snprintf(__cArray, 8192, "%s", __cDiagValueArray);
      CheckLiteralGetStringBufferConsistency("0", 8192);
      snprintf(__cArray2, 8192, "%s", "0");
      __csr = strncmp(__cArray, __cArray2, 8192) >= 0;
      snprintf(__cArray3, 8192, "%s", "Diagnostic parameter \'_Supplier_ID_88\'");
      snprintf(__cArray4, 8192, "%s", __cArray3);
      snprintf(__cArray5, 8192, "%s", "");
      ReportTableRow(__tableHandle, 0, __cArray4, ">=", __cArray2, __cArray5, __oneOfFlag, __bSetInCheckAlignment);
      ReportCell(__tableHandle, __cArray);
      ReportCellResult(__tableHandle, __csr, __ePassFail);
    
      __res = __res && __csr;
    
    }
    ReportTableEndVerdict(__tableHandle, __cEvaluateResponse, __res);
	__bVerdict = __bVerdict && __res;
  }
  if (__bVerdict == __eVerdictFail)
    TestReportWriteDiagObjectList();
}

void Tt4h42sqi_F110_DID_with_Standard_Physical_Address()
{
  stack long __tableHandle;
  TestCommandBegin(__eRequestResponse, __cRequestResponse, "", "0");
  {
  
    long __res;
    int64 __timeout;
    __res = 0;
    __nInt64 = 1;
    __timeout = syspar::`P2_Server * 1000000LL;
    {
    
      long __testStepInitOk;
      message `FDCAN2::`DIAGNOSTIC_REQUEST_PAM __output;
      message `FDCAN2::`DIAGNOSTIC_REQUEST_PAM __msgOrig;
      __output = __msgOrig;
      __testStepInitOk = 1;
      {
        int64 __dlc;
        __dlc = 8;
        if (__dlc >= 0 && __dlc <= (__output.EDL ? 15 : 8))
          __output.DLC = __dlc;
        else
        {
          testStepErrorInTestSystem(0, __cEmpty, "Unable to set DLC=%lld in message. Please check input parameter.", __dlc);
          __testStepInitOk = 0;
        }
      }
      if (__testStepInitOk)
      {
        snprintf(__cArray, elCount(__cArray), "CAN message '%s' ID = 416981233x (0x18DAA0F1x) on bus FDCAN2", "DIAGNOSTIC_REQUEST_PAM");
        snprintf(__cArray2, elCount(__cArray2), "Send %s", __cArray);
        __tableHandle = ReportTableHead3Columns(__cArray2, "Byte", __cTOp, __cAssigned);
        ReportByteIndex("", 0, __cArray, elCount(__cArray));
        snprintf(__cArray2, 8192, "%s", __cArray);
        snprintf(__cArray3, 8192, "%s", "");
        
        ReportTableRow(__tableHandle, 0, __cArray2, __cAOp, 0x3, __cArray3, __oneOfFlag, __bSetInCheckAlignment);
        
        if (0 >= 0 && 0 < 64)
        {
          __output.byte((word)0) = 0x3;
        }
        else
        {
          testStepErrorInTestSystem(0, __cEmpty, "Index out of range. Unable to set byte %lld in message. Please check input parameter.", (int64)0);
          __testStepInitOk = 0;
        }
        ReportByteIndex("", 1, __cArray, elCount(__cArray));
        snprintf(__cArray2, 8192, "%s", __cArray);
        snprintf(__cArray3, 8192, "%s", "");
        
        ReportTableRow(__tableHandle, 0, __cArray2, __cAOp, 0x22, __cArray3, __oneOfFlag, __bSetInCheckAlignment);
        
        if (1 >= 0 && 1 < 64)
        {
          __output.byte((word)1) = 0x22;
        }
        else
        {
          testStepErrorInTestSystem(0, __cEmpty, "Index out of range. Unable to set byte %lld in message. Please check input parameter.", (int64)1);
          __testStepInitOk = 0;
        }
        ReportByteIndex("", 2, __cArray, elCount(__cArray));
        snprintf(__cArray2, 8192, "%s", __cArray);
        snprintf(__cArray3, 8192, "%s", "");
        
        ReportTableRow(__tableHandle, 0, __cArray2, __cAOp, 0xF1, __cArray3, __oneOfFlag, __bSetInCheckAlignment);
        
        if (2 >= 0 && 2 < 64)
        {
          __output.byte((word)2) = 0xF1;
        }
        else
        {
          testStepErrorInTestSystem(0, __cEmpty, "Index out of range. Unable to set byte %lld in message. Please check input parameter.", (int64)2);
          __testStepInitOk = 0;
        }
        ReportByteIndex("", 3, __cArray, elCount(__cArray));
        snprintf(__cArray2, 8192, "%s", __cArray);
        snprintf(__cArray3, 8192, "%s", "");
        
        ReportTableRow(__tableHandle, 0, __cArray2, __cAOp, 0x10, __cArray3, __oneOfFlag, __bSetInCheckAlignment);
        
        if (3 >= 0 && 3 < 64)
        {
          __output.byte((word)3) = 0x10;
        }
        else
        {
          testStepErrorInTestSystem(0, __cEmpty, "Index out of range. Unable to set byte %lld in message. Please check input parameter.", (int64)3);
          __testStepInitOk = 0;
        }
      
        ReportTableEndTestStep(__tableHandle, "Req1");
      }
      if (__testStepInitOk)
      {
        output(__output);
      }
    }
    if (__timeout <= 0)
    {
      testStepErrorInTestSystem(0, "1", "Unable to wait for %.3f %s. Please check input parameter.", __timeout / ((float)1000000), "ms");
    }
    else
    {
      __tt2cnt_25 = 0;
      snprintf(__cArray, elCount(__cArray), "CAN message '%s' ID = 417001888x (0x18DAF1A0x) on bus FDCAN2", "DIAGNOSTIC_RESPONSE_PAM");
      if(SetBusContextByName("FDCAN2", __eSaveCurrent, __nBusContextNew, __nBusContextOld))
        testJoinMessageEvent(`FDCAN2::`DIAGNOSTIC_RESPONSE_PAM,  __cArray,
             delegate dword(message * __m)
             {
               dword __msg_callback_ret;
               if (__tt2cnt_25 == -1)
               {
                 return 1;
               }
               __msg_callback_ret = 1;
               __tt2cnt_25++;
               if (__msg_callback_ret)
               {
                 __tt2cnt_25 = -1;
                 return 1;
               }
               return 0;
             });
      __res = testWaitForAllJoinedEventsNS(__timeout);
      if (__nInt64 != 0)
      {
        snprintf(__cArray, elCount(__cArray), "CAN message '%s' ID = 417001888x (0x18DAF1A0x) on bus FDCAN2", "DIAGNOSTIC_RESPONSE_PAM");
        if(__tt2cnt_25 == -1)
        {
          snprintf(__cArray2, 8192, "Response of %s", __cArray);
        }
        else
        {
          snprintf(__cArray2, 8192, "Response of %s (received %d times)", __cArray, __tt2cnt_25);
        }
        if (__tt2cnt_25 == 0)
        {
          testStepFail(0, "Resp1", __cArray2);
        }
        else
        {
          testStepPass(2, "Resp1", __cArray2);
        }
        __ReportRequestResponseResult(__res, 0);
      }
      ResetBusContext(__nBusContextNew, __nBusContextOld);
    }
  }
  TestCommandEnd();

}

void Tt4h42sqi_F186_DID_with_PhysicalAdd_DefaultSession()
{
  stack long __tableHandle;
  TestCommandBegin(__eDiagService, __cDiagService, "", "0");
  {
    if (DiagIsFunctionalGroup("CVADAS_0001_00000000_000"))
    {
      DiagResponse * __resp;
      DiagRequest CVADAS_0001_00000000_000._22F186_Active_Diagnostic_Session __req;
      __diagService4h42sqi_24(__req, __resp);
    }
    else
    {
      DiagResponse CVADAS_0001_00000000_000.* __resp;
      DiagRequest CVADAS_0001_00000000_000._22F186_Active_Diagnostic_Session __req;
      __diagService4h42sqi_24(__req, __resp);
    }
  }
  TestCommandEnd();


}

  
void __diagService4h42sqi_24(DiagRequest * __req, DiagResponse * __resp )
{
  stack long __tableHandle;
  long __res, __paramLen, __bytePos;

   __bVerdict = __eVerdictPass;

  do {
    TestReportResetDiagObjectList();
    DiagSetReportDetailLevel("CVADAS_0001_00000000_000", EnumServiceDetails_onfail);
    // Request aspect
    {

      if (0 >= DiagSendReqAndWaitForResp("CVADAS_0001_00000000_000", __req, __resp, __res, -1, -1, -1, -1, -1, EnumResult_pos, EnumServiceDetails_onfail, EnumSendingMode_physical, EnumSuppressPosResBit_asconfigured, EnumVerdictOnInvalidValues_fail))
        break;
    }

    __res = DiagErrCodeTestStep(__res, "Can't retrieve last response for request! No check possible.") < 0;
    if(__res)
    {
	  __bVerdict = __eVerdictFail;
      break;
    }
    {
      __res = DiagInterpretAs(__resp, "RDBI_PR");
      if(__res != 0)
      {
        __bVerdict = __eVerdictFail;
        DiagErrCodeTestStep(__res, "Can't interpret response as diagnostic primitive 'RDBI_PR'.");
        break;
      }
      else
      {
        TestStepPass( "Received primitive can be interpreted as diagnostic primitive 'RDBI_PR'.");
      }
    }
  }
  while(0);


  // Response, check & read aspect
  {
    __res = 1;
    __tableHandle = ReportTableHead5Columns(__cCheckCaption, __cTSym, __cTOp, __cRefVal, __cActual, __cRes);
    {
      double __nDiagValue;
      DiagGetParameterErrorHandled(__resp, "_Active_Diagnostic_Session_24", __nDiagValue);
      __csr = CheckSignalMatch(__nDiagValue, syspar::`F186_Active_Diagnostic_Session::`Default_Session, "==") == 1;
      snprintf(__cArray, 8192, "%s", "Diagnostic parameter \'_Active_Diagnostic_Session_24\'");
      snprintf(__cArray2, 8192, "%s", __cArray);
      snprintf(__cArray3, 8192, "%s", "Default_Session");
      ReportTableRow(__tableHandle, 0, __cArray2, "==", syspar::`F186_Active_Diagnostic_Session::`Default_Session, __cArray3, __oneOfFlag, __bSetInCheckAlignment);
      ReportCell(__tableHandle, __nDiagValue);
      ReportCellResult(__tableHandle, __csr, __ePassFail);
    
      __res = __res && __csr;
    
    }
    {
      __bDiagValueArrayCtr = DiagGetParameterErrorHandled(__resp, "Bitfield/Bitfield._Active_Diagnostic_Session_of_ECU__ECU_Software_Mode_32", __bDiagValueArray, elcount(__bDiagValueArray), __cDiagValueArray, elcount(__cDiagValueArray));
      CheckPlainParameterGetStringBufferConsistency(syspar::`F186_Active_Diagnostic_Session::`Application_Mode,"syspar::`F186_Active_Diagnostic_Session::`Application_Mode", 8192);
    snprintf(__cArray, 8192, "%s", syspar::`F186_Active_Diagnostic_Session::`Application_Mode);  
      __bDiagValueArrayCtr2 = __MapChar2ByteAtDiagCheck(__cArray, __bDiagValueArray2);
      snprintf(__cArray10, 8192, "%s", "Application_Mode");
      {
        __bArrayCtr = __CopyBytes(__bDiagValueArray, __bDiagValueArrayCtr, __bArray);
        __bArrayCtr2 = __CopyBytes(__bDiagValueArray2, __bDiagValueArrayCtr2, __bArray2);
        __csr = CompareBytes(__bArray, __bArrayCtr, __bArray2, __bArrayCtr2) == 0;
        snprintf(__cArray, 8192, "%s", "Diagnostic parameter \'Bitfield/Bitfield._Active_Diagnostic_Session_of_ECU__ECU_Software_Mode_32\'");
        snprintf(__cArray2, 8192, "%s", __cArray);
        snprintf(__cArray3, 8192, "%s", __cArray10);
        ReportTableRow(__tableHandle, 0, __cArray2, "Bytes", __bArray2, __bArrayCtr2, __cArray3, __oneOfFlag, __bSetInCheckAlignment);
        ReportCell(__tableHandle, __bArray, __bArrayCtr);
        ReportCellResult(__tableHandle, __csr, __ePassFail);
      }
    
      __res = __res && __csr;
    
    }
    ReportTableEndVerdict(__tableHandle, __cEvaluateResponse, __res);
	__bVerdict = __bVerdict && __res;
  }
  if (__bVerdict == __eVerdictFail)
    TestReportWriteDiagObjectList();
}

void Tt4h42sqi_F186_DID_with_Standard_Physical_Address_Default_Session()
{
  stack long __tableHandle;
  TestCommandBegin(__eRequestResponse, __cRequestResponse, "", "0");
  {
    message `FDCAN2::`DIAGNOSTIC_RESPONSE_PAM __tt2msg_26;
  
    long __res;
    int64 __timeout;
    __res = 0;
    __nInt64 = 1;
    __timeout = syspar::`P2_Server * 1000000LL;
    {
    
      long __testStepInitOk;
      message `FDCAN2::`DIAGNOSTIC_REQUEST_PAM __output;
      message `FDCAN2::`DIAGNOSTIC_REQUEST_PAM __msgOrig;
      __output = __msgOrig;
      __testStepInitOk = 1;
      {
        int64 __dlc;
        __dlc = 8;
        if (__dlc >= 0 && __dlc <= (__output.EDL ? 15 : 8))
          __output.DLC = __dlc;
        else
        {
          testStepErrorInTestSystem(0, __cEmpty, "Unable to set DLC=%lld in message. Please check input parameter.", __dlc);
          __testStepInitOk = 0;
        }
      }
      if (__testStepInitOk)
      {
        snprintf(__cArray, elCount(__cArray), "CAN message '%s' ID = 416981233x (0x18DAA0F1x) on bus FDCAN2", "DIAGNOSTIC_REQUEST_PAM");
        snprintf(__cArray2, elCount(__cArray2), "Send %s", __cArray);
        __tableHandle = ReportTableHead3Columns(__cArray2, "Byte", __cTOp, __cAssigned);
        ReportByteIndex("", 0, __cArray, elCount(__cArray));
        snprintf(__cArray2, 8192, "%s", __cArray);
        snprintf(__cArray3, 8192, "%s", "");
        
        ReportTableRow(__tableHandle, 0, __cArray2, __cAOp, 0x3, __cArray3, __oneOfFlag, __bSetInCheckAlignment);
        
        if (0 >= 0 && 0 < 64)
        {
          __output.byte((word)0) = 0x3;
        }
        else
        {
          testStepErrorInTestSystem(0, __cEmpty, "Index out of range. Unable to set byte %lld in message. Please check input parameter.", (int64)0);
          __testStepInitOk = 0;
        }
        ReportByteIndex("", 1, __cArray, elCount(__cArray));
        snprintf(__cArray2, 8192, "%s", __cArray);
        snprintf(__cArray3, 8192, "%s", "");
        
        ReportTableRow(__tableHandle, 0, __cArray2, __cAOp, 0x22, __cArray3, __oneOfFlag, __bSetInCheckAlignment);
        
        if (1 >= 0 && 1 < 64)
        {
          __output.byte((word)1) = 0x22;
        }
        else
        {
          testStepErrorInTestSystem(0, __cEmpty, "Index out of range. Unable to set byte %lld in message. Please check input parameter.", (int64)1);
          __testStepInitOk = 0;
        }
        ReportByteIndex("", 2, __cArray, elCount(__cArray));
        snprintf(__cArray2, 8192, "%s", __cArray);
        snprintf(__cArray3, 8192, "%s", "");
        
        ReportTableRow(__tableHandle, 0, __cArray2, __cAOp, 0xF1, __cArray3, __oneOfFlag, __bSetInCheckAlignment);
        
        if (2 >= 0 && 2 < 64)
        {
          __output.byte((word)2) = 0xF1;
        }
        else
        {
          testStepErrorInTestSystem(0, __cEmpty, "Index out of range. Unable to set byte %lld in message. Please check input parameter.", (int64)2);
          __testStepInitOk = 0;
        }
        ReportByteIndex("", 3, __cArray, elCount(__cArray));
        snprintf(__cArray2, 8192, "%s", __cArray);
        snprintf(__cArray3, 8192, "%s", "");
        
        ReportTableRow(__tableHandle, 0, __cArray2, __cAOp, 0x86, __cArray3, __oneOfFlag, __bSetInCheckAlignment);
        
        if (3 >= 0 && 3 < 64)
        {
          __output.byte((word)3) = 0x86;
        }
        else
        {
          testStepErrorInTestSystem(0, __cEmpty, "Index out of range. Unable to set byte %lld in message. Please check input parameter.", (int64)3);
          __testStepInitOk = 0;
        }
      
        ReportTableEndTestStep(__tableHandle, "Req1");
      }
      if (__testStepInitOk)
      {
        output(__output);
      }
    }
    if (__timeout <= 0)
    {
      testStepErrorInTestSystem(0, "1", "Unable to wait for %.3f %s. Please check input parameter.", __timeout / ((float)1000000), "ms");
    }
    else
    {
      if (0 < 0 || 64 <= 0)
      {
        testStepErrorInTestSystem(0, __cEmpty, "Index out of range. Unable to get byte %lld in message.", (int64) 0);
        __nInt64 = 0;
      }
      if (1 < 0 || 64 <= 1)
      {
        testStepErrorInTestSystem(0, __cEmpty, "Index out of range. Unable to get byte %lld in message.", (int64) 1);
        __nInt64 = 0;
      }
      if (2 < 0 || 64 <= 2)
      {
        testStepErrorInTestSystem(0, __cEmpty, "Index out of range. Unable to get byte %lld in message.", (int64) 2);
        __nInt64 = 0;
      }
      if (3 < 0 || 64 <= 3)
      {
        testStepErrorInTestSystem(0, __cEmpty, "Index out of range. Unable to get byte %lld in message.", (int64) 3);
        __nInt64 = 0;
      }
      if (4 < 0 || 64 <= 4)
      {
        testStepErrorInTestSystem(0, __cEmpty, "Index out of range. Unable to get byte %lld in message.", (int64) 4);
        __nInt64 = 0;
      }
      if (5 < 0 || 64 <= 5)
      {
        testStepErrorInTestSystem(0, __cEmpty, "Index out of range. Unable to get byte %lld in message.", (int64) 5);
        __nInt64 = 0;
      }
      if (6 < 0 || 64 <= 6)
      {
        testStepErrorInTestSystem(0, __cEmpty, "Index out of range. Unable to get byte %lld in message.", (int64) 6);
        __nInt64 = 0;
      }
      __tt2cnt_27 = 0;
      snprintf(__cArray, elCount(__cArray), "CAN message '%s' ID = 417001888x (0x18DAF1A0x) on bus FDCAN2", "DIAGNOSTIC_RESPONSE_PAM");
      if(SetBusContextByName("FDCAN2", __eSaveCurrent, __nBusContextNew, __nBusContextOld))
        testJoinMessageEvent(`FDCAN2::`DIAGNOSTIC_RESPONSE_PAM,  __cArray,
             delegate dword(message * __m)
             {
               dword __msg_callback_ret;
               byte __b0;
               byte __b1;
               byte __b2;
               byte __b3;
               byte __b4;
               byte __b5;
               byte __b6;
               if (__tt2cnt_27 == -1)
               {
                 return 1;
               }
               __tt2msg_26 = __m;
               __msg_callback_ret = 1;
               __tt2cnt_27++;
               if (0 < 0 || 64 <= 0) return 0;
               __csr = CheckSignalMatch(__tt2msg_26.byte((word)0), 0x6, "==") == 1;
               __msg_callback_ret &= __csr;
               if (1 < 0 || 64 <= 1) return 0;
               __csr = CheckSignalMatch(__tt2msg_26.byte((word)1), 0x62, "==") == 1;
               __msg_callback_ret &= __csr;
               if (2 < 0 || 64 <= 2) return 0;
               __csr = CheckSignalMatch(__tt2msg_26.byte((word)2), 0xF1, "==") == 1;
               __msg_callback_ret &= __csr;
               if (3 < 0 || 64 <= 3) return 0;
               __csr = CheckSignalMatch(__tt2msg_26.byte((word)3), 0x86, "==") == 1;
               __msg_callback_ret &= __csr;
               if (4 < 0 || 64 <= 4) return 0;
               __csr = CheckSignalMatch(__tt2msg_26.byte((word)4), 0x1, "==") == 1;
               __msg_callback_ret &= __csr;
               if (5 < 0 || 64 <= 5) return 0;
               __csr = CheckSignalMatch(__tt2msg_26.byte((word)5), 0x5, "==") == 1;
               __msg_callback_ret &= __csr;
               if (6 < 0 || 64 <= 6) return 0;
               __csr = CheckSignalMatch(__tt2msg_26.byte((word)6), 0x0, "==") == 1;
               __msg_callback_ret &= __csr;
               if (__msg_callback_ret)
               {
                 __tt2cnt_27 = -1;
                 return 1;
               }
               return 0;
             });
      __res = testWaitForAllJoinedEventsNS(__timeout);
      if (__nInt64 != 0)
      {
        snprintf(__cArray, elCount(__cArray), "CAN message '%s' ID = 417001888x (0x18DAF1A0x) on bus FDCAN2", "DIAGNOSTIC_RESPONSE_PAM");
        if(__tt2cnt_27 == -1)
        {
          snprintf(__cArray2, 8192, "Response of %s", __cArray);
        snprintf(__cArray, 8192, "%s", __cActual);
        }
        else
        {
          snprintf(__cArray2, 8192, "Response of %s (received %d times)", __cArray, __tt2cnt_27);
          snprintf(__cArray, 8192, "Last Received");
        }
        if (__tt2cnt_27 == 0)
        {
          testStepFail(0, "Resp1", __cArray2);
        }
        else
        {
          byte __b0;
          byte __b1;
          byte __b2;
          byte __b3;
          byte __b4;
          byte __b5;
          byte __b6;
          __bVerdict = __eVerdictPass;
          __tableHandle = ReportTableHead5Columns(__cArray2, "Signal/Byte", __cTOp, __cRefVal, __cArray, __cRes);
        __csr = CheckSignalMatch(__tt2msg_26.byte((word)0), 0x6, "==") == 1;
        ReportByteIndex("", 0, __cArray, elCount(__cArray));
        snprintf(__cArray2, 8192, "%s", __cArray);
        snprintf(__cArray3, 8192, "%s", "");
        ReportTableRow(__tableHandle, 0, __cArray2, "==", 0x6, __cArray3, __oneOfFlag, __bSetInCheckAlignment);
        ReportCell(__tableHandle, __tt2msg_26.byte((word)0));
        ReportCellResult(__tableHandle, __csr, __ePassFail);
          __bVerdict &= __csr;
        __csr = CheckSignalMatch(__tt2msg_26.byte((word)1), 0x62, "==") == 1;
        ReportByteIndex("", 1, __cArray, elCount(__cArray));
        snprintf(__cArray2, 8192, "%s", __cArray);
        snprintf(__cArray3, 8192, "%s", "");
        ReportTableRow(__tableHandle, 0, __cArray2, "==", 0x62, __cArray3, __oneOfFlag, __bSetInCheckAlignment);
        ReportCell(__tableHandle, __tt2msg_26.byte((word)1));
        ReportCellResult(__tableHandle, __csr, __ePassFail);
          __bVerdict &= __csr;
        __csr = CheckSignalMatch(__tt2msg_26.byte((word)2), 0xF1, "==") == 1;
        ReportByteIndex("", 2, __cArray, elCount(__cArray));
        snprintf(__cArray2, 8192, "%s", __cArray);
        snprintf(__cArray3, 8192, "%s", "");
        ReportTableRow(__tableHandle, 0, __cArray2, "==", 0xF1, __cArray3, __oneOfFlag, __bSetInCheckAlignment);
        ReportCell(__tableHandle, __tt2msg_26.byte((word)2));
        ReportCellResult(__tableHandle, __csr, __ePassFail);
          __bVerdict &= __csr;
        __csr = CheckSignalMatch(__tt2msg_26.byte((word)3), 0x86, "==") == 1;
        ReportByteIndex("", 3, __cArray, elCount(__cArray));
        snprintf(__cArray2, 8192, "%s", __cArray);
        snprintf(__cArray3, 8192, "%s", "");
        ReportTableRow(__tableHandle, 0, __cArray2, "==", 0x86, __cArray3, __oneOfFlag, __bSetInCheckAlignment);
        ReportCell(__tableHandle, __tt2msg_26.byte((word)3));
        ReportCellResult(__tableHandle, __csr, __ePassFail);
          __bVerdict &= __csr;
        __csr = CheckSignalMatch(__tt2msg_26.byte((word)4), 0x1, "==") == 1;
        ReportByteIndex("", 4, __cArray, elCount(__cArray));
        snprintf(__cArray2, 8192, "%s", __cArray);
        snprintf(__cArray3, 8192, "%s", "");
        ReportTableRow(__tableHandle, 0, __cArray2, "==", 0x1, __cArray3, __oneOfFlag, __bSetInCheckAlignment);
        ReportCell(__tableHandle, __tt2msg_26.byte((word)4));
        ReportCellResult(__tableHandle, __csr, __ePassFail);
          __bVerdict &= __csr;
        __csr = CheckSignalMatch(__tt2msg_26.byte((word)5), 0x5, "==") == 1;
        ReportByteIndex("", 5, __cArray, elCount(__cArray));
        snprintf(__cArray2, 8192, "%s", __cArray);
        snprintf(__cArray3, 8192, "%s", "");
        ReportTableRow(__tableHandle, 0, __cArray2, "==", 0x5, __cArray3, __oneOfFlag, __bSetInCheckAlignment);
        ReportCell(__tableHandle, __tt2msg_26.byte((word)5));
        ReportCellResult(__tableHandle, __csr, __ePassFail);
          __bVerdict &= __csr;
        __csr = CheckSignalMatch(__tt2msg_26.byte((word)6), 0x0, "==") == 1;
        ReportByteIndex("", 6, __cArray, elCount(__cArray));
        snprintf(__cArray2, 8192, "%s", __cArray);
        snprintf(__cArray3, 8192, "%s", "");
        ReportTableRow(__tableHandle, 0, __cArray2, "==", 0x0, __cArray3, __oneOfFlag, __bSetInCheckAlignment);
        ReportCell(__tableHandle, __tt2msg_26.byte((word)6));
        ReportCellResult(__tableHandle, __csr, __ePassFail);
          __bVerdict &= __csr;
          ReportTableEndVerdict(__tableHandle, "Resp1", __bVerdict);
        }
        __ReportRequestResponseResult(__res, 0);
      }
      ResetBusContext(__nBusContextNew, __nBusContextOld);
    }
  }
  TestCommandEnd();

}

void Tt4h42sqi_F186_DID_with_PhysicalAdd_ExtendedSession()
{
  stack long __tableHandle;
  TestCommandBegin(__eDiagService, __cDiagService, "", "0");
  {
    if (DiagIsFunctionalGroup("CVADAS_0001_00000000_000"))
    {
      DiagResponse * __resp;
      DiagRequest CVADAS_0001_00000000_000._22F186_Active_Diagnostic_Session __req;
      __diagService4h42sqi_25(__req, __resp);
    }
    else
    {
      DiagResponse CVADAS_0001_00000000_000.* __resp;
      DiagRequest CVADAS_0001_00000000_000._22F186_Active_Diagnostic_Session __req;
      __diagService4h42sqi_25(__req, __resp);
    }
  }
  TestCommandEnd();


}

  
void __diagService4h42sqi_25(DiagRequest * __req, DiagResponse * __resp )
{
  stack long __tableHandle;
  long __res, __paramLen, __bytePos;

   __bVerdict = __eVerdictPass;

  do {
    TestReportResetDiagObjectList();
    DiagSetReportDetailLevel("CVADAS_0001_00000000_000", EnumServiceDetails_onfail);
    // Request aspect
    {

      if (0 >= DiagSendReqAndWaitForResp("CVADAS_0001_00000000_000", __req, __resp, __res, -1, -1, -1, -1, -1, EnumResult_pos, EnumServiceDetails_onfail, EnumSendingMode_physical, EnumSuppressPosResBit_asconfigured, EnumVerdictOnInvalidValues_fail))
        break;
    }

    __res = DiagErrCodeTestStep(__res, "Can't retrieve last response for request! No check possible.") < 0;
    if(__res)
    {
	  __bVerdict = __eVerdictFail;
      break;
    }
    {
      __res = DiagInterpretAs(__resp, "RDBI_PR");
      if(__res != 0)
      {
        __bVerdict = __eVerdictFail;
        DiagErrCodeTestStep(__res, "Can't interpret response as diagnostic primitive 'RDBI_PR'.");
        break;
      }
      else
      {
        TestStepPass( "Received primitive can be interpreted as diagnostic primitive 'RDBI_PR'.");
      }
    }
  }
  while(0);


  // Response, check & read aspect
  {
    __res = 1;
    __tableHandle = ReportTableHead5Columns(__cCheckCaption, __cTSym, __cTOp, __cRefVal, __cActual, __cRes);
    {
      double __nDiagValue;
      DiagGetParameterErrorHandled(__resp, "_Active_Diagnostic_Session_24", __nDiagValue);
      __csr = CheckSignalMatch(__nDiagValue, syspar::`F186_Active_Diagnostic_Session::`Extended_Session, "==") == 1;
      snprintf(__cArray, 8192, "%s", "Diagnostic parameter \'_Active_Diagnostic_Session_24\'");
      snprintf(__cArray2, 8192, "%s", __cArray);
      snprintf(__cArray3, 8192, "%s", "Extended_Session");
      ReportTableRow(__tableHandle, 0, __cArray2, "==", syspar::`F186_Active_Diagnostic_Session::`Extended_Session, __cArray3, __oneOfFlag, __bSetInCheckAlignment);
      ReportCell(__tableHandle, __nDiagValue);
      ReportCellResult(__tableHandle, __csr, __ePassFail);
    
      __res = __res && __csr;
    
    }
    {
      __bDiagValueArrayCtr = DiagGetParameterErrorHandled(__resp, "Bitfield/Bitfield._Active_Diagnostic_Session_of_ECU__ECU_Software_Mode_32", __bDiagValueArray, elcount(__bDiagValueArray), __cDiagValueArray, elcount(__cDiagValueArray));
      CheckPlainParameterGetStringBufferConsistency(syspar::`F186_Active_Diagnostic_Session::`Application_Mode,"syspar::`F186_Active_Diagnostic_Session::`Application_Mode", 8192);
    snprintf(__cArray, 8192, "%s", syspar::`F186_Active_Diagnostic_Session::`Application_Mode);  
      __bDiagValueArrayCtr2 = __MapChar2ByteAtDiagCheck(__cArray, __bDiagValueArray2);
      snprintf(__cArray10, 8192, "%s", "Application_Mode");
      {
        __bArrayCtr = __CopyBytes(__bDiagValueArray, __bDiagValueArrayCtr, __bArray);
        __bArrayCtr2 = __CopyBytes(__bDiagValueArray2, __bDiagValueArrayCtr2, __bArray2);
        __csr = CompareBytes(__bArray, __bArrayCtr, __bArray2, __bArrayCtr2) == 0;
        snprintf(__cArray, 8192, "%s", "Diagnostic parameter \'Bitfield/Bitfield._Active_Diagnostic_Session_of_ECU__ECU_Software_Mode_32\'");
        snprintf(__cArray2, 8192, "%s", __cArray);
        snprintf(__cArray3, 8192, "%s", __cArray10);
        ReportTableRow(__tableHandle, 0, __cArray2, "Bytes", __bArray2, __bArrayCtr2, __cArray3, __oneOfFlag, __bSetInCheckAlignment);
        ReportCell(__tableHandle, __bArray, __bArrayCtr);
        ReportCellResult(__tableHandle, __csr, __ePassFail);
      }
    
      __res = __res && __csr;
    
    }
    ReportTableEndVerdict(__tableHandle, __cEvaluateResponse, __res);
	__bVerdict = __bVerdict && __res;
  }
  if (__bVerdict == __eVerdictFail)
    TestReportWriteDiagObjectList();
}

void Tt4h42sqi_F186_DID_with_Standard_Physical_Address_Extended_Session()
{
  stack long __tableHandle;
  TestCommandBegin(__eRequestResponse, __cRequestResponse, "", "0");
  {
    message `FDCAN2::`DIAGNOSTIC_RESPONSE_PAM __tt2msg_28;
  
    long __res;
    int64 __timeout;
    __res = 0;
    __nInt64 = 1;
    __timeout = syspar::`P2_Server * 1000000LL;
    {
    
      long __testStepInitOk;
      message `FDCAN2::`DIAGNOSTIC_REQUEST_PAM __output;
      message `FDCAN2::`DIAGNOSTIC_REQUEST_PAM __msgOrig;
      __output = __msgOrig;
      __testStepInitOk = 1;
      {
        int64 __dlc;
        __dlc = 8;
        if (__dlc >= 0 && __dlc <= (__output.EDL ? 15 : 8))
          __output.DLC = __dlc;
        else
        {
          testStepErrorInTestSystem(0, __cEmpty, "Unable to set DLC=%lld in message. Please check input parameter.", __dlc);
          __testStepInitOk = 0;
        }
      }
      if (__testStepInitOk)
      {
        snprintf(__cArray, elCount(__cArray), "CAN message '%s' ID = 416981233x (0x18DAA0F1x) on bus FDCAN2", "DIAGNOSTIC_REQUEST_PAM");
        snprintf(__cArray2, elCount(__cArray2), "Send %s", __cArray);
        __tableHandle = ReportTableHead3Columns(__cArray2, "Byte", __cTOp, __cAssigned);
        ReportByteIndex("", 0, __cArray, elCount(__cArray));
        snprintf(__cArray2, 8192, "%s", __cArray);
        snprintf(__cArray3, 8192, "%s", "");
        
        ReportTableRow(__tableHandle, 0, __cArray2, __cAOp, 0x3, __cArray3, __oneOfFlag, __bSetInCheckAlignment);
        
        if (0 >= 0 && 0 < 64)
        {
          __output.byte((word)0) = 0x3;
        }
        else
        {
          testStepErrorInTestSystem(0, __cEmpty, "Index out of range. Unable to set byte %lld in message. Please check input parameter.", (int64)0);
          __testStepInitOk = 0;
        }
        ReportByteIndex("", 1, __cArray, elCount(__cArray));
        snprintf(__cArray2, 8192, "%s", __cArray);
        snprintf(__cArray3, 8192, "%s", "");
        
        ReportTableRow(__tableHandle, 0, __cArray2, __cAOp, 0x22, __cArray3, __oneOfFlag, __bSetInCheckAlignment);
        
        if (1 >= 0 && 1 < 64)
        {
          __output.byte((word)1) = 0x22;
        }
        else
        {
          testStepErrorInTestSystem(0, __cEmpty, "Index out of range. Unable to set byte %lld in message. Please check input parameter.", (int64)1);
          __testStepInitOk = 0;
        }
        ReportByteIndex("", 2, __cArray, elCount(__cArray));
        snprintf(__cArray2, 8192, "%s", __cArray);
        snprintf(__cArray3, 8192, "%s", "");
        
        ReportTableRow(__tableHandle, 0, __cArray2, __cAOp, 0xF1, __cArray3, __oneOfFlag, __bSetInCheckAlignment);
        
        if (2 >= 0 && 2 < 64)
        {
          __output.byte((word)2) = 0xF1;
        }
        else
        {
          testStepErrorInTestSystem(0, __cEmpty, "Index out of range. Unable to set byte %lld in message. Please check input parameter.", (int64)2);
          __testStepInitOk = 0;
        }
        ReportByteIndex("", 3, __cArray, elCount(__cArray));
        snprintf(__cArray2, 8192, "%s", __cArray);
        snprintf(__cArray3, 8192, "%s", "");
        
        ReportTableRow(__tableHandle, 0, __cArray2, __cAOp, 0x86, __cArray3, __oneOfFlag, __bSetInCheckAlignment);
        
        if (3 >= 0 && 3 < 64)
        {
          __output.byte((word)3) = 0x86;
        }
        else
        {
          testStepErrorInTestSystem(0, __cEmpty, "Index out of range. Unable to set byte %lld in message. Please check input parameter.", (int64)3);
          __testStepInitOk = 0;
        }
      
        ReportTableEndTestStep(__tableHandle, "Req1");
      }
      if (__testStepInitOk)
      {
        output(__output);
      }
    }
    if (__timeout <= 0)
    {
      testStepErrorInTestSystem(0, "1", "Unable to wait for %.3f %s. Please check input parameter.", __timeout / ((float)1000000), "ms");
    }
    else
    {
      if (0 < 0 || 64 <= 0)
      {
        testStepErrorInTestSystem(0, __cEmpty, "Index out of range. Unable to get byte %lld in message.", (int64) 0);
        __nInt64 = 0;
      }
      if (1 < 0 || 64 <= 1)
      {
        testStepErrorInTestSystem(0, __cEmpty, "Index out of range. Unable to get byte %lld in message.", (int64) 1);
        __nInt64 = 0;
      }
      if (2 < 0 || 64 <= 2)
      {
        testStepErrorInTestSystem(0, __cEmpty, "Index out of range. Unable to get byte %lld in message.", (int64) 2);
        __nInt64 = 0;
      }
      if (3 < 0 || 64 <= 3)
      {
        testStepErrorInTestSystem(0, __cEmpty, "Index out of range. Unable to get byte %lld in message.", (int64) 3);
        __nInt64 = 0;
      }
      if (4 < 0 || 64 <= 4)
      {
        testStepErrorInTestSystem(0, __cEmpty, "Index out of range. Unable to get byte %lld in message.", (int64) 4);
        __nInt64 = 0;
      }
      if (5 < 0 || 64 <= 5)
      {
        testStepErrorInTestSystem(0, __cEmpty, "Index out of range. Unable to get byte %lld in message.", (int64) 5);
        __nInt64 = 0;
      }
      if (6 < 0 || 64 <= 6)
      {
        testStepErrorInTestSystem(0, __cEmpty, "Index out of range. Unable to get byte %lld in message.", (int64) 6);
        __nInt64 = 0;
      }
      __tt2cnt_29 = 0;
      snprintf(__cArray, elCount(__cArray), "CAN message '%s' ID = 417001888x (0x18DAF1A0x) on bus FDCAN2", "DIAGNOSTIC_RESPONSE_PAM");
      if(SetBusContextByName("FDCAN2", __eSaveCurrent, __nBusContextNew, __nBusContextOld))
        testJoinMessageEvent(`FDCAN2::`DIAGNOSTIC_RESPONSE_PAM,  __cArray,
             delegate dword(message * __m)
             {
               dword __msg_callback_ret;
               byte __b0;
               byte __b1;
               byte __b2;
               byte __b3;
               byte __b4;
               byte __b5;
               byte __b6;
               if (__tt2cnt_29 == -1)
               {
                 return 1;
               }
               __tt2msg_28 = __m;
               __msg_callback_ret = 1;
               __tt2cnt_29++;
               if (0 < 0 || 64 <= 0) return 0;
               __csr = CheckSignalMatch(__tt2msg_28.byte((word)0), 0x6, "==") == 1;
               __msg_callback_ret &= __csr;
               if (1 < 0 || 64 <= 1) return 0;
               __csr = CheckSignalMatch(__tt2msg_28.byte((word)1), 0x62, "==") == 1;
               __msg_callback_ret &= __csr;
               if (2 < 0 || 64 <= 2) return 0;
               __csr = CheckSignalMatch(__tt2msg_28.byte((word)2), 0xF1, "==") == 1;
               __msg_callback_ret &= __csr;
               if (3 < 0 || 64 <= 3) return 0;
               __csr = CheckSignalMatch(__tt2msg_28.byte((word)3), 0x86, "==") == 1;
               __msg_callback_ret &= __csr;
               if (4 < 0 || 64 <= 4) return 0;
               __csr = CheckSignalMatch(__tt2msg_28.byte((word)4), 0x3, "==") == 1;
               __msg_callback_ret &= __csr;
               if (5 < 0 || 64 <= 5) return 0;
               __csr = CheckSignalMatch(__tt2msg_28.byte((word)5), 0x5, "==") == 1;
               __msg_callback_ret &= __csr;
               if (6 < 0 || 64 <= 6) return 0;
               __csr = CheckSignalMatch(__tt2msg_28.byte((word)6), 0x0, "==") == 1;
               __msg_callback_ret &= __csr;
               if (__msg_callback_ret)
               {
                 __tt2cnt_29 = -1;
                 return 1;
               }
               return 0;
             });
      __res = testWaitForAllJoinedEventsNS(__timeout);
      if (__nInt64 != 0)
      {
        snprintf(__cArray, elCount(__cArray), "CAN message '%s' ID = 417001888x (0x18DAF1A0x) on bus FDCAN2", "DIAGNOSTIC_RESPONSE_PAM");
        if(__tt2cnt_29 == -1)
        {
          snprintf(__cArray2, 8192, "Response of %s", __cArray);
        snprintf(__cArray, 8192, "%s", __cActual);
        }
        else
        {
          snprintf(__cArray2, 8192, "Response of %s (received %d times)", __cArray, __tt2cnt_29);
          snprintf(__cArray, 8192, "Last Received");
        }
        if (__tt2cnt_29 == 0)
        {
          testStepFail(0, "Resp1", __cArray2);
        }
        else
        {
          byte __b0;
          byte __b1;
          byte __b2;
          byte __b3;
          byte __b4;
          byte __b5;
          byte __b6;
          __bVerdict = __eVerdictPass;
          __tableHandle = ReportTableHead5Columns(__cArray2, "Signal/Byte", __cTOp, __cRefVal, __cArray, __cRes);
        __csr = CheckSignalMatch(__tt2msg_28.byte((word)0), 0x6, "==") == 1;
        ReportByteIndex("", 0, __cArray, elCount(__cArray));
        snprintf(__cArray2, 8192, "%s", __cArray);
        snprintf(__cArray3, 8192, "%s", "");
        ReportTableRow(__tableHandle, 0, __cArray2, "==", 0x6, __cArray3, __oneOfFlag, __bSetInCheckAlignment);
        ReportCell(__tableHandle, __tt2msg_28.byte((word)0));
        ReportCellResult(__tableHandle, __csr, __ePassFail);
          __bVerdict &= __csr;
        __csr = CheckSignalMatch(__tt2msg_28.byte((word)1), 0x62, "==") == 1;
        ReportByteIndex("", 1, __cArray, elCount(__cArray));
        snprintf(__cArray2, 8192, "%s", __cArray);
        snprintf(__cArray3, 8192, "%s", "");
        ReportTableRow(__tableHandle, 0, __cArray2, "==", 0x62, __cArray3, __oneOfFlag, __bSetInCheckAlignment);
        ReportCell(__tableHandle, __tt2msg_28.byte((word)1));
        ReportCellResult(__tableHandle, __csr, __ePassFail);
          __bVerdict &= __csr;
        __csr = CheckSignalMatch(__tt2msg_28.byte((word)2), 0xF1, "==") == 1;
        ReportByteIndex("", 2, __cArray, elCount(__cArray));
        snprintf(__cArray2, 8192, "%s", __cArray);
        snprintf(__cArray3, 8192, "%s", "");
        ReportTableRow(__tableHandle, 0, __cArray2, "==", 0xF1, __cArray3, __oneOfFlag, __bSetInCheckAlignment);
        ReportCell(__tableHandle, __tt2msg_28.byte((word)2));
        ReportCellResult(__tableHandle, __csr, __ePassFail);
          __bVerdict &= __csr;
        __csr = CheckSignalMatch(__tt2msg_28.byte((word)3), 0x86, "==") == 1;
        ReportByteIndex("", 3, __cArray, elCount(__cArray));
        snprintf(__cArray2, 8192, "%s", __cArray);
        snprintf(__cArray3, 8192, "%s", "");
        ReportTableRow(__tableHandle, 0, __cArray2, "==", 0x86, __cArray3, __oneOfFlag, __bSetInCheckAlignment);
        ReportCell(__tableHandle, __tt2msg_28.byte((word)3));
        ReportCellResult(__tableHandle, __csr, __ePassFail);
          __bVerdict &= __csr;
        __csr = CheckSignalMatch(__tt2msg_28.byte((word)4), 0x3, "==") == 1;
        ReportByteIndex("", 4, __cArray, elCount(__cArray));
        snprintf(__cArray2, 8192, "%s", __cArray);
        snprintf(__cArray3, 8192, "%s", "");
        ReportTableRow(__tableHandle, 0, __cArray2, "==", 0x3, __cArray3, __oneOfFlag, __bSetInCheckAlignment);
        ReportCell(__tableHandle, __tt2msg_28.byte((word)4));
        ReportCellResult(__tableHandle, __csr, __ePassFail);
          __bVerdict &= __csr;
        __csr = CheckSignalMatch(__tt2msg_28.byte((word)5), 0x5, "==") == 1;
        ReportByteIndex("", 5, __cArray, elCount(__cArray));
        snprintf(__cArray2, 8192, "%s", __cArray);
        snprintf(__cArray3, 8192, "%s", "");
        ReportTableRow(__tableHandle, 0, __cArray2, "==", 0x5, __cArray3, __oneOfFlag, __bSetInCheckAlignment);
        ReportCell(__tableHandle, __tt2msg_28.byte((word)5));
        ReportCellResult(__tableHandle, __csr, __ePassFail);
          __bVerdict &= __csr;
        __csr = CheckSignalMatch(__tt2msg_28.byte((word)6), 0x0, "==") == 1;
        ReportByteIndex("", 6, __cArray, elCount(__cArray));
        snprintf(__cArray2, 8192, "%s", __cArray);
        snprintf(__cArray3, 8192, "%s", "");
        ReportTableRow(__tableHandle, 0, __cArray2, "==", 0x0, __cArray3, __oneOfFlag, __bSetInCheckAlignment);
        ReportCell(__tableHandle, __tt2msg_28.byte((word)6));
        ReportCellResult(__tableHandle, __csr, __ePassFail);
          __bVerdict &= __csr;
          ReportTableEndVerdict(__tableHandle, "Resp1", __bVerdict);
        }
        __ReportRequestResponseResult(__res, 0);
      }
      ResetBusContext(__nBusContextNew, __nBusContextOld);
    }
  }
  TestCommandEnd();

}

void Tt4h42sqi_F186_DID_with_PhysicalAdd_ProgrammingSession()
{
  stack long __tableHandle;
  TestCommandBegin(__eWait, __cWait, "", "0");
  {
    Wait("1", (1100 * 1000000LL), 1000000, "");
  }
  TestCommandEnd();

  TestCommandBegin(__eDiagService, __cDiagService, "", "1");
  {
    if (DiagIsFunctionalGroup("CVADAS_0001_00000000_000"))
    {
      DiagResponse * __resp;
      DiagRequest CVADAS_0001_00000000_000._22F186_Active_Diagnostic_Session __req;
      __diagService4h42sqi_26(__req, __resp);
    }
    else
    {
      DiagResponse CVADAS_0001_00000000_000.* __resp;
      DiagRequest CVADAS_0001_00000000_000._22F186_Active_Diagnostic_Session __req;
      __diagService4h42sqi_26(__req, __resp);
    }
  }
  TestCommandEnd();


}

  
void __diagService4h42sqi_26(DiagRequest * __req, DiagResponse * __resp )
{
  stack long __tableHandle;
  long __res, __paramLen, __bytePos;

   __bVerdict = __eVerdictPass;

  do {
    TestReportResetDiagObjectList();
    DiagSetReportDetailLevel("CVADAS_0001_00000000_000", EnumServiceDetails_onfail);
    // Request aspect
    {

      if (0 >= DiagSendReqAndWaitForResp("CVADAS_0001_00000000_000", __req, __resp, __res, -1, -1, -1, -1, -1, EnumResult_pos, EnumServiceDetails_onfail, EnumSendingMode_physical, EnumSuppressPosResBit_asconfigured, EnumVerdictOnInvalidValues_fail))
        break;
    }

    __res = DiagErrCodeTestStep(__res, "Can't retrieve last response for request! No check possible.") < 0;
    if(__res)
    {
	  __bVerdict = __eVerdictFail;
      break;
    }
    {
      __res = DiagInterpretAs(__resp, "RDBI_PR");
      if(__res != 0)
      {
        __bVerdict = __eVerdictFail;
        DiagErrCodeTestStep(__res, "Can't interpret response as diagnostic primitive 'RDBI_PR'.");
        break;
      }
      else
      {
        TestStepPass( "Received primitive can be interpreted as diagnostic primitive 'RDBI_PR'.");
      }
    }
  }
  while(0);


  // Response, check & read aspect
  {
    __res = 1;
    __tableHandle = ReportTableHead5Columns(__cCheckCaption, __cTSym, __cTOp, __cRefVal, __cActual, __cRes);
    {
      double __nDiagValue;
      DiagGetParameterErrorHandled(__resp, "_Active_Diagnostic_Session_24", __nDiagValue);
      __csr = CheckSignalMatch(__nDiagValue, syspar::`F186_Active_Diagnostic_Session::`Programming_Session, "==") == 1;
      snprintf(__cArray, 8192, "%s", "Diagnostic parameter \'_Active_Diagnostic_Session_24\'");
      snprintf(__cArray2, 8192, "%s", __cArray);
      snprintf(__cArray3, 8192, "%s", "Programming_Session");
      ReportTableRow(__tableHandle, 0, __cArray2, "==", syspar::`F186_Active_Diagnostic_Session::`Programming_Session, __cArray3, __oneOfFlag, __bSetInCheckAlignment);
      ReportCell(__tableHandle, __nDiagValue);
      ReportCellResult(__tableHandle, __csr, __ePassFail);
    
      __res = __res && __csr;
    
    }
    {
      __bDiagValueArrayCtr = DiagGetParameterErrorHandled(__resp, "Bitfield/Bitfield._Active_Diagnostic_Session_of_ECU__ECU_Software_Mode_32", __bDiagValueArray, elcount(__bDiagValueArray), __cDiagValueArray, elcount(__cDiagValueArray));
      CheckPlainParameterGetStringBufferConsistency(syspar::`F186_Active_Diagnostic_Session::`Bootloader_Mode,"syspar::`F186_Active_Diagnostic_Session::`Bootloader_Mode", 8192);
    snprintf(__cArray, 8192, "%s", syspar::`F186_Active_Diagnostic_Session::`Bootloader_Mode);  
      __bDiagValueArrayCtr2 = __MapChar2ByteAtDiagCheck(__cArray, __bDiagValueArray2);
      snprintf(__cArray10, 8192, "%s", "Bootloader_Mode");
      {
        __bArrayCtr = __CopyBytes(__bDiagValueArray, __bDiagValueArrayCtr, __bArray);
        __bArrayCtr2 = __CopyBytes(__bDiagValueArray2, __bDiagValueArrayCtr2, __bArray2);
        __csr = CompareBytes(__bArray, __bArrayCtr, __bArray2, __bArrayCtr2) == 0;
        snprintf(__cArray, 8192, "%s", "Diagnostic parameter \'Bitfield/Bitfield._Active_Diagnostic_Session_of_ECU__ECU_Software_Mode_32\'");
        snprintf(__cArray2, 8192, "%s", __cArray);
        snprintf(__cArray3, 8192, "%s", __cArray10);
        ReportTableRow(__tableHandle, 0, __cArray2, "Bytes", __bArray2, __bArrayCtr2, __cArray3, __oneOfFlag, __bSetInCheckAlignment);
        ReportCell(__tableHandle, __bArray, __bArrayCtr);
        ReportCellResult(__tableHandle, __csr, __ePassFail);
      }
    
      __res = __res && __csr;
    
    }
    ReportTableEndVerdict(__tableHandle, __cEvaluateResponse, __res);
	__bVerdict = __bVerdict && __res;
  }
  if (__bVerdict == __eVerdictFail)
    TestReportWriteDiagObjectList();
}

void Tt4h42sqi_F186_DID_with_Standard_Physical_Address_Programming_Session()
{
  stack long __tableHandle;
  TestCommandBegin(__eRequestResponse, __cRequestResponse, "", "0");
  {
    message `FDCAN2::`DIAGNOSTIC_RESPONSE_PAM __tt2msg_30;
  
    long __res;
    int64 __timeout;
    __res = 0;
    __nInt64 = 1;
    __timeout = syspar::`P2_Server * 1000000LL;
    {
    
      long __testStepInitOk;
      message `FDCAN2::`DIAGNOSTIC_REQUEST_PAM __output;
      message `FDCAN2::`DIAGNOSTIC_REQUEST_PAM __msgOrig;
      __output = __msgOrig;
      __testStepInitOk = 1;
      {
        int64 __dlc;
        __dlc = 8;
        if (__dlc >= 0 && __dlc <= (__output.EDL ? 15 : 8))
          __output.DLC = __dlc;
        else
        {
          testStepErrorInTestSystem(0, __cEmpty, "Unable to set DLC=%lld in message. Please check input parameter.", __dlc);
          __testStepInitOk = 0;
        }
      }
      if (__testStepInitOk)
      {
        snprintf(__cArray, elCount(__cArray), "CAN message '%s' ID = 416981233x (0x18DAA0F1x) on bus FDCAN2", "DIAGNOSTIC_REQUEST_PAM");
        snprintf(__cArray2, elCount(__cArray2), "Send %s", __cArray);
        __tableHandle = ReportTableHead3Columns(__cArray2, "Byte", __cTOp, __cAssigned);
        ReportByteIndex("", 0, __cArray, elCount(__cArray));
        snprintf(__cArray2, 8192, "%s", __cArray);
        snprintf(__cArray3, 8192, "%s", "");
        
        ReportTableRow(__tableHandle, 0, __cArray2, __cAOp, 0x3, __cArray3, __oneOfFlag, __bSetInCheckAlignment);
        
        if (0 >= 0 && 0 < 64)
        {
          __output.byte((word)0) = 0x3;
        }
        else
        {
          testStepErrorInTestSystem(0, __cEmpty, "Index out of range. Unable to set byte %lld in message. Please check input parameter.", (int64)0);
          __testStepInitOk = 0;
        }
        ReportByteIndex("", 1, __cArray, elCount(__cArray));
        snprintf(__cArray2, 8192, "%s", __cArray);
        snprintf(__cArray3, 8192, "%s", "");
        
        ReportTableRow(__tableHandle, 0, __cArray2, __cAOp, 0x22, __cArray3, __oneOfFlag, __bSetInCheckAlignment);
        
        if (1 >= 0 && 1 < 64)
        {
          __output.byte((word)1) = 0x22;
        }
        else
        {
          testStepErrorInTestSystem(0, __cEmpty, "Index out of range. Unable to set byte %lld in message. Please check input parameter.", (int64)1);
          __testStepInitOk = 0;
        }
        ReportByteIndex("", 2, __cArray, elCount(__cArray));
        snprintf(__cArray2, 8192, "%s", __cArray);
        snprintf(__cArray3, 8192, "%s", "");
        
        ReportTableRow(__tableHandle, 0, __cArray2, __cAOp, 0xF1, __cArray3, __oneOfFlag, __bSetInCheckAlignment);
        
        if (2 >= 0 && 2 < 64)
        {
          __output.byte((word)2) = 0xF1;
        }
        else
        {
          testStepErrorInTestSystem(0, __cEmpty, "Index out of range. Unable to set byte %lld in message. Please check input parameter.", (int64)2);
          __testStepInitOk = 0;
        }
        ReportByteIndex("", 3, __cArray, elCount(__cArray));
        snprintf(__cArray2, 8192, "%s", __cArray);
        snprintf(__cArray3, 8192, "%s", "");
        
        ReportTableRow(__tableHandle, 0, __cArray2, __cAOp, 0x86, __cArray3, __oneOfFlag, __bSetInCheckAlignment);
        
        if (3 >= 0 && 3 < 64)
        {
          __output.byte((word)3) = 0x86;
        }
        else
        {
          testStepErrorInTestSystem(0, __cEmpty, "Index out of range. Unable to set byte %lld in message. Please check input parameter.", (int64)3);
          __testStepInitOk = 0;
        }
      
        ReportTableEndTestStep(__tableHandle, "Req1");
      }
      if (__testStepInitOk)
      {
        output(__output);
      }
    }
    if (__timeout <= 0)
    {
      testStepErrorInTestSystem(0, "1", "Unable to wait for %.3f %s. Please check input parameter.", __timeout / ((float)1000000), "ms");
    }
    else
    {
      if (0 < 0 || 64 <= 0)
      {
        testStepErrorInTestSystem(0, __cEmpty, "Index out of range. Unable to get byte %lld in message.", (int64) 0);
        __nInt64 = 0;
      }
      if (1 < 0 || 64 <= 1)
      {
        testStepErrorInTestSystem(0, __cEmpty, "Index out of range. Unable to get byte %lld in message.", (int64) 1);
        __nInt64 = 0;
      }
      if (2 < 0 || 64 <= 2)
      {
        testStepErrorInTestSystem(0, __cEmpty, "Index out of range. Unable to get byte %lld in message.", (int64) 2);
        __nInt64 = 0;
      }
      if (3 < 0 || 64 <= 3)
      {
        testStepErrorInTestSystem(0, __cEmpty, "Index out of range. Unable to get byte %lld in message.", (int64) 3);
        __nInt64 = 0;
      }
      if (4 < 0 || 64 <= 4)
      {
        testStepErrorInTestSystem(0, __cEmpty, "Index out of range. Unable to get byte %lld in message.", (int64) 4);
        __nInt64 = 0;
      }
      if (5 < 0 || 64 <= 5)
      {
        testStepErrorInTestSystem(0, __cEmpty, "Index out of range. Unable to get byte %lld in message.", (int64) 5);
        __nInt64 = 0;
      }
      if (6 < 0 || 64 <= 6)
      {
        testStepErrorInTestSystem(0, __cEmpty, "Index out of range. Unable to get byte %lld in message.", (int64) 6);
        __nInt64 = 0;
      }
      __tt2cnt_31 = 0;
      snprintf(__cArray, elCount(__cArray), "CAN message '%s' ID = 417001888x (0x18DAF1A0x) on bus FDCAN2", "DIAGNOSTIC_RESPONSE_PAM");
      if(SetBusContextByName("FDCAN2", __eSaveCurrent, __nBusContextNew, __nBusContextOld))
        testJoinMessageEvent(`FDCAN2::`DIAGNOSTIC_RESPONSE_PAM,  __cArray,
             delegate dword(message * __m)
             {
               dword __msg_callback_ret;
               byte __b0;
               byte __b1;
               byte __b2;
               byte __b3;
               byte __b4;
               byte __b5;
               byte __b6;
               if (__tt2cnt_31 == -1)
               {
                 return 1;
               }
               __tt2msg_30 = __m;
               __msg_callback_ret = 1;
               __tt2cnt_31++;
               if (0 < 0 || 64 <= 0) return 0;
               __csr = CheckSignalMatch(__tt2msg_30.byte((word)0), 0x6, "==") == 1;
               __msg_callback_ret &= __csr;
               if (1 < 0 || 64 <= 1) return 0;
               __csr = CheckSignalMatch(__tt2msg_30.byte((word)1), 0x62, "==") == 1;
               __msg_callback_ret &= __csr;
               if (2 < 0 || 64 <= 2) return 0;
               __csr = CheckSignalMatch(__tt2msg_30.byte((word)2), 0xF1, "==") == 1;
               __msg_callback_ret &= __csr;
               if (3 < 0 || 64 <= 3) return 0;
               __csr = CheckSignalMatch(__tt2msg_30.byte((word)3), 0x86, "==") == 1;
               __msg_callback_ret &= __csr;
               if (4 < 0 || 64 <= 4) return 0;
               __csr = CheckSignalMatch(__tt2msg_30.byte((word)4), 0x2, "==") == 1;
               __msg_callback_ret &= __csr;
               if (5 < 0 || 64 <= 5) return 0;
               __csr = CheckSignalMatch(__tt2msg_30.byte((word)5), 0x5, "==") == 1;
               __msg_callback_ret &= __csr;
               if (6 < 0 || 64 <= 6) return 0;
               __csr = CheckSignalMatch(__tt2msg_30.byte((word)6), 0x0, "==") == 1;
               __msg_callback_ret &= __csr;
               if (__msg_callback_ret)
               {
                 __tt2cnt_31 = -1;
                 return 1;
               }
               return 0;
             });
      __res = testWaitForAllJoinedEventsNS(__timeout);
      if (__nInt64 != 0)
      {
        snprintf(__cArray, elCount(__cArray), "CAN message '%s' ID = 417001888x (0x18DAF1A0x) on bus FDCAN2", "DIAGNOSTIC_RESPONSE_PAM");
        if(__tt2cnt_31 == -1)
        {
          snprintf(__cArray2, 8192, "Response of %s", __cArray);
        snprintf(__cArray, 8192, "%s", __cActual);
        }
        else
        {
          snprintf(__cArray2, 8192, "Response of %s (received %d times)", __cArray, __tt2cnt_31);
          snprintf(__cArray, 8192, "Last Received");
        }
        if (__tt2cnt_31 == 0)
        {
          testStepFail(0, "Resp1", __cArray2);
        }
        else
        {
          byte __b0;
          byte __b1;
          byte __b2;
          byte __b3;
          byte __b4;
          byte __b5;
          byte __b6;
          __bVerdict = __eVerdictPass;
          __tableHandle = ReportTableHead5Columns(__cArray2, "Signal/Byte", __cTOp, __cRefVal, __cArray, __cRes);
        __csr = CheckSignalMatch(__tt2msg_30.byte((word)0), 0x6, "==") == 1;
        ReportByteIndex("", 0, __cArray, elCount(__cArray));
        snprintf(__cArray2, 8192, "%s", __cArray);
        snprintf(__cArray3, 8192, "%s", "");
        ReportTableRow(__tableHandle, 0, __cArray2, "==", 0x6, __cArray3, __oneOfFlag, __bSetInCheckAlignment);
        ReportCell(__tableHandle, __tt2msg_30.byte((word)0));
        ReportCellResult(__tableHandle, __csr, __ePassFail);
          __bVerdict &= __csr;
        __csr = CheckSignalMatch(__tt2msg_30.byte((word)1), 0x62, "==") == 1;
        ReportByteIndex("", 1, __cArray, elCount(__cArray));
        snprintf(__cArray2, 8192, "%s", __cArray);
        snprintf(__cArray3, 8192, "%s", "");
        ReportTableRow(__tableHandle, 0, __cArray2, "==", 0x62, __cArray3, __oneOfFlag, __bSetInCheckAlignment);
        ReportCell(__tableHandle, __tt2msg_30.byte((word)1));
        ReportCellResult(__tableHandle, __csr, __ePassFail);
          __bVerdict &= __csr;
        __csr = CheckSignalMatch(__tt2msg_30.byte((word)2), 0xF1, "==") == 1;
        ReportByteIndex("", 2, __cArray, elCount(__cArray));
        snprintf(__cArray2, 8192, "%s", __cArray);
        snprintf(__cArray3, 8192, "%s", "");
        ReportTableRow(__tableHandle, 0, __cArray2, "==", 0xF1, __cArray3, __oneOfFlag, __bSetInCheckAlignment);
        ReportCell(__tableHandle, __tt2msg_30.byte((word)2));
        ReportCellResult(__tableHandle, __csr, __ePassFail);
          __bVerdict &= __csr;
        __csr = CheckSignalMatch(__tt2msg_30.byte((word)3), 0x86, "==") == 1;
        ReportByteIndex("", 3, __cArray, elCount(__cArray));
        snprintf(__cArray2, 8192, "%s", __cArray);
        snprintf(__cArray3, 8192, "%s", "");
        ReportTableRow(__tableHandle, 0, __cArray2, "==", 0x86, __cArray3, __oneOfFlag, __bSetInCheckAlignment);
        ReportCell(__tableHandle, __tt2msg_30.byte((word)3));
        ReportCellResult(__tableHandle, __csr, __ePassFail);
          __bVerdict &= __csr;
        __csr = CheckSignalMatch(__tt2msg_30.byte((word)4), 0x2, "==") == 1;
        ReportByteIndex("", 4, __cArray, elCount(__cArray));
        snprintf(__cArray2, 8192, "%s", __cArray);
        snprintf(__cArray3, 8192, "%s", "");
        ReportTableRow(__tableHandle, 0, __cArray2, "==", 0x2, __cArray3, __oneOfFlag, __bSetInCheckAlignment);
        ReportCell(__tableHandle, __tt2msg_30.byte((word)4));
        ReportCellResult(__tableHandle, __csr, __ePassFail);
          __bVerdict &= __csr;
        __csr = CheckSignalMatch(__tt2msg_30.byte((word)5), 0x5, "==") == 1;
        ReportByteIndex("", 5, __cArray, elCount(__cArray));
        snprintf(__cArray2, 8192, "%s", __cArray);
        snprintf(__cArray3, 8192, "%s", "");
        ReportTableRow(__tableHandle, 0, __cArray2, "==", 0x5, __cArray3, __oneOfFlag, __bSetInCheckAlignment);
        ReportCell(__tableHandle, __tt2msg_30.byte((word)5));
        ReportCellResult(__tableHandle, __csr, __ePassFail);
          __bVerdict &= __csr;
        __csr = CheckSignalMatch(__tt2msg_30.byte((word)6), 0x0, "==") == 1;
        ReportByteIndex("", 6, __cArray, elCount(__cArray));
        snprintf(__cArray2, 8192, "%s", __cArray);
        snprintf(__cArray3, 8192, "%s", "");
        ReportTableRow(__tableHandle, 0, __cArray2, "==", 0x0, __cArray3, __oneOfFlag, __bSetInCheckAlignment);
        ReportCell(__tableHandle, __tt2msg_30.byte((word)6));
        ReportCellResult(__tableHandle, __csr, __ePassFail);
          __bVerdict &= __csr;
          ReportTableEndVerdict(__tableHandle, "Resp1", __bVerdict);
        }
        __ReportRequestResponseResult(__res, 0);
      }
      ResetBusContext(__nBusContextNew, __nBusContextOld);
    }
  }
  TestCommandEnd();

}

void Tt4h42sqi_F186_DID_with_FunctionalAdd_DefaultSession()
{
  stack long __tableHandle;
  TestCommandBegin(__eDiagService, __cDiagService, "", "0");
  {
    if (DiagIsFunctionalGroup("CVADAS_0001_00000000_000"))
    {
      DiagResponse * __resp;
      DiagRequest CVADAS_0001_00000000_000._22F186_Active_Diagnostic_Session __req;
      __diagService4h42sqi_27(__req, __resp);
    }
    else
    {
      DiagResponse CVADAS_0001_00000000_000.* __resp;
      DiagRequest CVADAS_0001_00000000_000._22F186_Active_Diagnostic_Session __req;
      __diagService4h42sqi_27(__req, __resp);
    }
  }
  TestCommandEnd();


}

  
void __diagService4h42sqi_27(DiagRequest * __req, DiagResponse * __resp )
{
  stack long __tableHandle;
  long __res, __paramLen, __bytePos;

   __bVerdict = __eVerdictPass;

  do {
    TestReportResetDiagObjectList();
    DiagSetReportDetailLevel("CVADAS_0001_00000000_000", EnumServiceDetails_onfail);
    // Request aspect
    {

      if (0 >= DiagSendReqAndWaitForResp("CVADAS_0001_00000000_000", __req, __resp, __res, -1, -1, -1, -1, -1, EnumResult_pos, EnumServiceDetails_onfail, EnumSendingMode_functional, EnumSuppressPosResBit_asconfigured, EnumVerdictOnInvalidValues_fail))
        break;
    }

    __res = DiagErrCodeTestStep(__res, "Can't retrieve last response for request! No check possible.") < 0;
    if(__res)
    {
	  __bVerdict = __eVerdictFail;
      break;
    }
    {
      __res = DiagInterpretAs(__resp, "RDBI_PR");
      if(__res != 0)
      {
        __bVerdict = __eVerdictFail;
        DiagErrCodeTestStep(__res, "Can't interpret response as diagnostic primitive 'RDBI_PR'.");
        break;
      }
      else
      {
        TestStepPass( "Received primitive can be interpreted as diagnostic primitive 'RDBI_PR'.");
      }
    }
  }
  while(0);


  // Response, check & read aspect
  {
    __res = 1;
    __tableHandle = ReportTableHead5Columns(__cCheckCaption, __cTSym, __cTOp, __cRefVal, __cActual, __cRes);
    {
      double __nDiagValue;
      DiagGetParameterErrorHandled(__resp, "_Active_Diagnostic_Session_24", __nDiagValue);
      __csr = CheckSignalMatch(__nDiagValue, syspar::`F186_Active_Diagnostic_Session::`Default_Session, "==") == 1;
      snprintf(__cArray, 8192, "%s", "Diagnostic parameter \'_Active_Diagnostic_Session_24\'");
      snprintf(__cArray2, 8192, "%s", __cArray);
      snprintf(__cArray3, 8192, "%s", "Default_Session");
      ReportTableRow(__tableHandle, 0, __cArray2, "==", syspar::`F186_Active_Diagnostic_Session::`Default_Session, __cArray3, __oneOfFlag, __bSetInCheckAlignment);
      ReportCell(__tableHandle, __nDiagValue);
      ReportCellResult(__tableHandle, __csr, __ePassFail);
    
      __res = __res && __csr;
    
    }
    {
      __bDiagValueArrayCtr = DiagGetParameterErrorHandled(__resp, "Bitfield/Bitfield._Active_Diagnostic_Session_of_ECU__ECU_Software_Mode_32", __bDiagValueArray, elcount(__bDiagValueArray), __cDiagValueArray, elcount(__cDiagValueArray));
      CheckPlainParameterGetStringBufferConsistency(syspar::`F186_Active_Diagnostic_Session::`Application_Mode,"syspar::`F186_Active_Diagnostic_Session::`Application_Mode", 8192);
    snprintf(__cArray, 8192, "%s", syspar::`F186_Active_Diagnostic_Session::`Application_Mode);  
      __bDiagValueArrayCtr2 = __MapChar2ByteAtDiagCheck(__cArray, __bDiagValueArray2);
      snprintf(__cArray10, 8192, "%s", "Application_Mode");
      {
        __bArrayCtr = __CopyBytes(__bDiagValueArray, __bDiagValueArrayCtr, __bArray);
        __bArrayCtr2 = __CopyBytes(__bDiagValueArray2, __bDiagValueArrayCtr2, __bArray2);
        __csr = CompareBytes(__bArray, __bArrayCtr, __bArray2, __bArrayCtr2) == 0;
        snprintf(__cArray, 8192, "%s", "Diagnostic parameter \'Bitfield/Bitfield._Active_Diagnostic_Session_of_ECU__ECU_Software_Mode_32\'");
        snprintf(__cArray2, 8192, "%s", __cArray);
        snprintf(__cArray3, 8192, "%s", __cArray10);
        ReportTableRow(__tableHandle, 0, __cArray2, "Bytes", __bArray2, __bArrayCtr2, __cArray3, __oneOfFlag, __bSetInCheckAlignment);
        ReportCell(__tableHandle, __bArray, __bArrayCtr);
        ReportCellResult(__tableHandle, __csr, __ePassFail);
      }
    
      __res = __res && __csr;
    
    }
    ReportTableEndVerdict(__tableHandle, __cEvaluateResponse, __res);
	__bVerdict = __bVerdict && __res;
  }
  if (__bVerdict == __eVerdictFail)
    TestReportWriteDiagObjectList();
}

void Tt4h42sqi_F186_DID_with_FunctionalAdd_ExtendedSession()
{
  stack long __tableHandle;
  TestCommandBegin(__eDiagService, __cDiagService, "", "0");
  {
    if (DiagIsFunctionalGroup("CVADAS_0001_00000000_000"))
    {
      DiagResponse * __resp;
      DiagRequest CVADAS_0001_00000000_000._22F186_Active_Diagnostic_Session __req;
      __diagService4h42sqi_28(__req, __resp);
    }
    else
    {
      DiagResponse CVADAS_0001_00000000_000.* __resp;
      DiagRequest CVADAS_0001_00000000_000._22F186_Active_Diagnostic_Session __req;
      __diagService4h42sqi_28(__req, __resp);
    }
  }
  TestCommandEnd();


}

  
void __diagService4h42sqi_28(DiagRequest * __req, DiagResponse * __resp )
{
  stack long __tableHandle;
  long __res, __paramLen, __bytePos;

   __bVerdict = __eVerdictPass;

  do {
    TestReportResetDiagObjectList();
    DiagSetReportDetailLevel("CVADAS_0001_00000000_000", EnumServiceDetails_onfail);
    // Request aspect
    {

      if (0 >= DiagSendReqAndWaitForResp("CVADAS_0001_00000000_000", __req, __resp, __res, -1, -1, -1, -1, -1, EnumResult_pos, EnumServiceDetails_onfail, EnumSendingMode_functional, EnumSuppressPosResBit_asconfigured, EnumVerdictOnInvalidValues_fail))
        break;
    }

    __res = DiagErrCodeTestStep(__res, "Can't retrieve last response for request! No check possible.") < 0;
    if(__res)
    {
	  __bVerdict = __eVerdictFail;
      break;
    }
    {
      __res = DiagInterpretAs(__resp, "RDBI_PR");
      if(__res != 0)
      {
        __bVerdict = __eVerdictFail;
        DiagErrCodeTestStep(__res, "Can't interpret response as diagnostic primitive 'RDBI_PR'.");
        break;
      }
      else
      {
        TestStepPass( "Received primitive can be interpreted as diagnostic primitive 'RDBI_PR'.");
      }
    }
  }
  while(0);


  // Response, check & read aspect
  {
    __res = 1;
    __tableHandle = ReportTableHead5Columns(__cCheckCaption, __cTSym, __cTOp, __cRefVal, __cActual, __cRes);
    {
      double __nDiagValue;
      DiagGetParameterErrorHandled(__resp, "_Active_Diagnostic_Session_24", __nDiagValue);
      __csr = CheckSignalMatch(__nDiagValue, syspar::`F186_Active_Diagnostic_Session::`Extended_Session, "==") == 1;
      snprintf(__cArray, 8192, "%s", "Diagnostic parameter \'_Active_Diagnostic_Session_24\'");
      snprintf(__cArray2, 8192, "%s", __cArray);
      snprintf(__cArray3, 8192, "%s", "Extended_Session");
      ReportTableRow(__tableHandle, 0, __cArray2, "==", syspar::`F186_Active_Diagnostic_Session::`Extended_Session, __cArray3, __oneOfFlag, __bSetInCheckAlignment);
      ReportCell(__tableHandle, __nDiagValue);
      ReportCellResult(__tableHandle, __csr, __ePassFail);
    
      __res = __res && __csr;
    
    }
    {
      __bDiagValueArrayCtr = DiagGetParameterErrorHandled(__resp, "Bitfield/Bitfield._Active_Diagnostic_Session_of_ECU__ECU_Software_Mode_32", __bDiagValueArray, elcount(__bDiagValueArray), __cDiagValueArray, elcount(__cDiagValueArray));
      CheckPlainParameterGetStringBufferConsistency(syspar::`F186_Active_Diagnostic_Session::`Application_Mode,"syspar::`F186_Active_Diagnostic_Session::`Application_Mode", 8192);
    snprintf(__cArray, 8192, "%s", syspar::`F186_Active_Diagnostic_Session::`Application_Mode);  
      __bDiagValueArrayCtr2 = __MapChar2ByteAtDiagCheck(__cArray, __bDiagValueArray2);
      snprintf(__cArray10, 8192, "%s", "Application_Mode");
      {
        __bArrayCtr = __CopyBytes(__bDiagValueArray, __bDiagValueArrayCtr, __bArray);
        __bArrayCtr2 = __CopyBytes(__bDiagValueArray2, __bDiagValueArrayCtr2, __bArray2);
        __csr = CompareBytes(__bArray, __bArrayCtr, __bArray2, __bArrayCtr2) == 0;
        snprintf(__cArray, 8192, "%s", "Diagnostic parameter \'Bitfield/Bitfield._Active_Diagnostic_Session_of_ECU__ECU_Software_Mode_32\'");
        snprintf(__cArray2, 8192, "%s", __cArray);
        snprintf(__cArray3, 8192, "%s", __cArray10);
        ReportTableRow(__tableHandle, 0, __cArray2, "Bytes", __bArray2, __bArrayCtr2, __cArray3, __oneOfFlag, __bSetInCheckAlignment);
        ReportCell(__tableHandle, __bArray, __bArrayCtr);
        ReportCellResult(__tableHandle, __csr, __ePassFail);
      }
    
      __res = __res && __csr;
    
    }
    ReportTableEndVerdict(__tableHandle, __cEvaluateResponse, __res);
	__bVerdict = __bVerdict && __res;
  }
  if (__bVerdict == __eVerdictFail)
    TestReportWriteDiagObjectList();
}

void Tt4h42sqi_F186_DID_with_FunctionalAdd_ProgrammingSession()
{
  stack long __tableHandle;
  TestCommandBegin(__eWait, __cWait, "", "0");
  {
    Wait("1", (1100 * 1000000LL), 1000000, "");
  }
  TestCommandEnd();

  TestCommandBegin(__eDiagService, __cDiagService, "", "1");
  {
    if (DiagIsFunctionalGroup("CVADAS_0001_00000000_000"))
    {
      DiagResponse * __resp;
      DiagRequest CVADAS_0001_00000000_000._22F186_Active_Diagnostic_Session __req;
      __diagService4h42sqi_29(__req, __resp);
    }
    else
    {
      DiagResponse CVADAS_0001_00000000_000.* __resp;
      DiagRequest CVADAS_0001_00000000_000._22F186_Active_Diagnostic_Session __req;
      __diagService4h42sqi_29(__req, __resp);
    }
  }
  TestCommandEnd();


}

  
void __diagService4h42sqi_29(DiagRequest * __req, DiagResponse * __resp )
{
  stack long __tableHandle;
  long __res, __paramLen, __bytePos;

   __bVerdict = __eVerdictPass;

  do {
    TestReportResetDiagObjectList();
    DiagSetReportDetailLevel("CVADAS_0001_00000000_000", EnumServiceDetails_onfail);
    // Request aspect
    {

      if (0 >= DiagSendReqAndWaitForResp("CVADAS_0001_00000000_000", __req, __resp, __res, -1, -1, -1, -1, -1, EnumResult_pos, EnumServiceDetails_onfail, EnumSendingMode_functional, EnumSuppressPosResBit_asconfigured, EnumVerdictOnInvalidValues_fail))
        break;
    }

    __res = DiagErrCodeTestStep(__res, "Can't retrieve last response for request! No check possible.") < 0;
    if(__res)
    {
	  __bVerdict = __eVerdictFail;
      break;
    }
    {
      __res = DiagInterpretAs(__resp, "RDBI_PR");
      if(__res != 0)
      {
        __bVerdict = __eVerdictFail;
        DiagErrCodeTestStep(__res, "Can't interpret response as diagnostic primitive 'RDBI_PR'.");
        break;
      }
      else
      {
        TestStepPass( "Received primitive can be interpreted as diagnostic primitive 'RDBI_PR'.");
      }
    }
  }
  while(0);


  // Response, check & read aspect
  {
    __res = 1;
    __tableHandle = ReportTableHead5Columns(__cCheckCaption, __cTSym, __cTOp, __cRefVal, __cActual, __cRes);
    {
      double __nDiagValue;
      DiagGetParameterErrorHandled(__resp, "_Active_Diagnostic_Session_24", __nDiagValue);
      __csr = CheckSignalMatch(__nDiagValue, syspar::`F186_Active_Diagnostic_Session::`Programming_Session, "==") == 1;
      snprintf(__cArray, 8192, "%s", "Diagnostic parameter \'_Active_Diagnostic_Session_24\'");
      snprintf(__cArray2, 8192, "%s", __cArray);
      snprintf(__cArray3, 8192, "%s", "Programming_Session");
      ReportTableRow(__tableHandle, 0, __cArray2, "==", syspar::`F186_Active_Diagnostic_Session::`Programming_Session, __cArray3, __oneOfFlag, __bSetInCheckAlignment);
      ReportCell(__tableHandle, __nDiagValue);
      ReportCellResult(__tableHandle, __csr, __ePassFail);
    
      __res = __res && __csr;
    
    }
    {
      __bDiagValueArrayCtr = DiagGetParameterErrorHandled(__resp, "Bitfield/Bitfield._Active_Diagnostic_Session_of_ECU__ECU_Software_Mode_32", __bDiagValueArray, elcount(__bDiagValueArray), __cDiagValueArray, elcount(__cDiagValueArray));
      CheckPlainParameterGetStringBufferConsistency(syspar::`F186_Active_Diagnostic_Session::`Bootloader_Mode,"syspar::`F186_Active_Diagnostic_Session::`Bootloader_Mode", 8192);
    snprintf(__cArray, 8192, "%s", syspar::`F186_Active_Diagnostic_Session::`Bootloader_Mode);  
      __bDiagValueArrayCtr2 = __MapChar2ByteAtDiagCheck(__cArray, __bDiagValueArray2);
      snprintf(__cArray10, 8192, "%s", "Bootloader_Mode");
      {
        __bArrayCtr = __CopyBytes(__bDiagValueArray, __bDiagValueArrayCtr, __bArray);
        __bArrayCtr2 = __CopyBytes(__bDiagValueArray2, __bDiagValueArrayCtr2, __bArray2);
        __csr = CompareBytes(__bArray, __bArrayCtr, __bArray2, __bArrayCtr2) == 0;
        snprintf(__cArray, 8192, "%s", "Diagnostic parameter \'Bitfield/Bitfield._Active_Diagnostic_Session_of_ECU__ECU_Software_Mode_32\'");
        snprintf(__cArray2, 8192, "%s", __cArray);
        snprintf(__cArray3, 8192, "%s", __cArray10);
        ReportTableRow(__tableHandle, 0, __cArray2, "Bytes", __bArray2, __bArrayCtr2, __cArray3, __oneOfFlag, __bSetInCheckAlignment);
        ReportCell(__tableHandle, __bArray, __bArrayCtr);
        ReportCellResult(__tableHandle, __csr, __ePassFail);
      }
    
      __res = __res && __csr;
    
    }
    ReportTableEndVerdict(__tableHandle, __cEvaluateResponse, __res);
	__bVerdict = __bVerdict && __res;
  }
  if (__bVerdict == __eVerdictFail)
    TestReportWriteDiagObjectList();
}

void Tt4h42sqi_F10D_DID_with_Physical_Address()
{
  stack long __tableHandle;
  TestCommandBegin(__eDiagService, __cDiagService, "", "0");
  {
    if (DiagIsFunctionalGroup("CVADAS_0001_00000000_000"))
    {
      DiagResponse * __resp;
      DiagRequest CVADAS_0001_00000000_000._22F10D_Diagnostic_Specification_Information __req;
      __diagService4h42sqi_30(__req, __resp);
    }
    else
    {
      DiagResponse CVADAS_0001_00000000_000.* __resp;
      DiagRequest CVADAS_0001_00000000_000._22F10D_Diagnostic_Specification_Information __req;
      __diagService4h42sqi_30(__req, __resp);
    }
  }
  TestCommandEnd();


}

  
void __diagService4h42sqi_30(DiagRequest * __req, DiagResponse * __resp )
{
  stack long __tableHandle;
  long __res, __paramLen, __bytePos;

   __bVerdict = __eVerdictPass;

  do {
    TestReportResetDiagObjectList();
    DiagSetReportDetailLevel("CVADAS_0001_00000000_000", EnumServiceDetails_onfail);
    // Request aspect
    {

      if (0 >= DiagSendReqAndWaitForResp("CVADAS_0001_00000000_000", __req, __resp, __res, -1, -1, -1, -1, -1, EnumResult_pos, EnumServiceDetails_onfail, EnumSendingMode_physical, EnumSuppressPosResBit_asconfigured, EnumVerdictOnInvalidValues_fail))
        break;
    }

    __res = DiagErrCodeTestStep(__res, "Can't retrieve last response for request! No check possible.") < 0;
    if(__res)
    {
	  __bVerdict = __eVerdictFail;
      break;
    }
    {
      __res = DiagInterpretAs(__resp, "RDBI_PR");
      if(__res != 0)
      {
        __bVerdict = __eVerdictFail;
        DiagErrCodeTestStep(__res, "Can't interpret response as diagnostic primitive 'RDBI_PR'.");
        break;
      }
      else
      {
        TestStepPass( "Received primitive can be interpreted as diagnostic primitive 'RDBI_PR'.");
      }
    }
  }
  while(0);


  // Response, check & read aspect
  {
    __res = 1;
    __tableHandle = ReportTableHead5Columns(__cCheckCaption, __cTSym, __cTOp, __cRefVal, __cActual, __cRes);
    {
      __bDiagValueArrayCtr = DiagGetParameterErrorHandled(__resp, "_Unified_Diagnostic_Services_UDS__Diagnostic_Protocol_Version_24", __bDiagValueArray, elcount(__bDiagValueArray), __cDiagValueArray, elcount(__cDiagValueArray));
      {
        __bArrayCtr = __CopyBytes(__bDiagValueArray, __bDiagValueArrayCtr, __bArray);
        CheckPlainParameterGetDataBufferConsistency(sysParGetData(syspar::`F10D_Diagnostic_Specification_Information::`UDS_Diagnostic_Protocol_Version, __bArray2, __bArrayCtr2), __bArrayCtr2, "syspar::`F10D_Diagnostic_Specification_Information::`UDS_Diagnostic_Protocol_Version");
        __csr = CompareBytes(__bArray, __bArrayCtr, __bArray2, __bArrayCtr2) == 0;
        snprintf(__cArray, 8192, "%s", "Diagnostic parameter \'_Unified_Diagnostic_Services_UDS__Diagnostic_Protocol_Version_24\'");
        snprintf(__cArray2, 8192, "%s", __cArray);
        snprintf(__cArray3, 8192, "%s", "UDS_Diagnostic_Protocol_Version");
        ReportTableRow(__tableHandle, 0, __cArray2, "Bytes", __bArray2, __bArrayCtr2, __cArray3, __oneOfFlag, __bSetInCheckAlignment);
        ReportCell(__tableHandle, __bArray, __bArrayCtr);
        ReportCellResult(__tableHandle, __csr, __ePassFail);
      }
    
      __res = __res && __csr;
    
    }
    {
      __bDiagValueArrayCtr = DiagGetParameterErrorHandled(__resp, "_ECU_Flash_Reprogramming_Requirements_Version_32", __bDiagValueArray, elcount(__bDiagValueArray), __cDiagValueArray, elcount(__cDiagValueArray));
      {
        __bArrayCtr = __CopyBytes(__bDiagValueArray, __bDiagValueArrayCtr, __bArray);
        CheckPlainParameterGetDataBufferConsistency(sysParGetData(syspar::`F10D_Diagnostic_Specification_Information::`ECU_Flash_Reprogramming_Requirement_Version, __bArray2, __bArrayCtr2), __bArrayCtr2, "syspar::`F10D_Diagnostic_Specification_Information::`ECU_Flash_Reprogramming_Requirement_Version");
        __csr = CompareBytes(__bArray, __bArrayCtr, __bArray2, __bArrayCtr2) == 0;
        snprintf(__cArray, 8192, "%s", "Diagnostic parameter \'_ECU_Flash_Reprogramming_Requirements_Version_32\'");
        snprintf(__cArray2, 8192, "%s", __cArray);
        snprintf(__cArray3, 8192, "%s", "ECU_Flash_Reprogramming_Requirement_Version");
        ReportTableRow(__tableHandle, 0, __cArray2, "Bytes", __bArray2, __bArrayCtr2, __cArray3, __oneOfFlag, __bSetInCheckAlignment);
        ReportCell(__tableHandle, __bArray, __bArrayCtr);
        ReportCellResult(__tableHandle, __csr, __ePassFail);
      }
    
      __res = __res && __csr;
    
    }
    {
      __bDiagValueArrayCtr = DiagGetParameterErrorHandled(__resp, "_Standard_Diagnostic_Data_UDS_Version_40", __bDiagValueArray, elcount(__bDiagValueArray), __cDiagValueArray, elcount(__cDiagValueArray));
      {
        __bArrayCtr = __CopyBytes(__bDiagValueArray, __bDiagValueArrayCtr, __bArray);
        CheckPlainParameterGetDataBufferConsistency(sysParGetData(syspar::`F10D_Diagnostic_Specification_Information::`Standard_Diagnostic_Data_UDS_Version, __bArray2, __bArrayCtr2), __bArrayCtr2, "syspar::`F10D_Diagnostic_Specification_Information::`Standard_Diagnostic_Data_UDS_Version");
        __csr = CompareBytes(__bArray, __bArrayCtr, __bArray2, __bArrayCtr2) == 0;
        snprintf(__cArray, 8192, "%s", "Diagnostic parameter \'_Standard_Diagnostic_Data_UDS_Version_40\'");
        snprintf(__cArray2, 8192, "%s", __cArray);
        snprintf(__cArray3, 8192, "%s", "Standard_Diagnostic_Data_UDS_Version");
        ReportTableRow(__tableHandle, 0, __cArray2, "Bytes", __bArray2, __bArrayCtr2, __cArray3, __oneOfFlag, __bSetInCheckAlignment);
        ReportCell(__tableHandle, __bArray, __bArrayCtr);
        ReportCellResult(__tableHandle, __csr, __ePassFail);
      }
    
      __res = __res && __csr;
    
    }
    {
      __bDiagValueArrayCtr = DiagGetParameterErrorHandled(__resp, "_Diagnostic_Requirements_Standard_Version_48", __bDiagValueArray, elcount(__bDiagValueArray), __cDiagValueArray, elcount(__cDiagValueArray));
      {
        __bArrayCtr = __CopyBytes(__bDiagValueArray, __bDiagValueArrayCtr, __bArray);
        CheckPlainParameterGetDataBufferConsistency(sysParGetData(syspar::`F10D_Diagnostic_Specification_Information::`Diagnostic_Requirement_Standard_Version, __bArray2, __bArrayCtr2), __bArrayCtr2, "syspar::`F10D_Diagnostic_Specification_Information::`Diagnostic_Requirement_Standard_Version");
        __csr = CompareBytes(__bArray, __bArrayCtr, __bArray2, __bArrayCtr2) == 0;
        snprintf(__cArray, 8192, "%s", "Diagnostic parameter \'_Diagnostic_Requirements_Standard_Version_48\'");
        snprintf(__cArray2, 8192, "%s", __cArray);
        snprintf(__cArray3, 8192, "%s", "Diagnostic_Requirement_Standard_Version");
        ReportTableRow(__tableHandle, 0, __cArray2, "Bytes", __bArray2, __bArrayCtr2, __cArray3, __oneOfFlag, __bSetInCheckAlignment);
        ReportCell(__tableHandle, __bArray, __bArrayCtr);
        ReportCellResult(__tableHandle, __csr, __ePassFail);
      }
    
      __res = __res && __csr;
    
    }
    ReportTableEndVerdict(__tableHandle, __cEvaluateResponse, __res);
	__bVerdict = __bVerdict && __res;
  }
  if (__bVerdict == __eVerdictFail)
    TestReportWriteDiagObjectList();
}

void Tt4h42sqi_F10D_DID_with_Functional_Address()
{
  stack long __tableHandle;
  TestCommandBegin(__eDiagService, __cDiagService, "", "0");
  {
    if (DiagIsFunctionalGroup("CVADAS_0001_00000000_000"))
    {
      DiagResponse * __resp;
      DiagRequest CVADAS_0001_00000000_000._22F10D_Diagnostic_Specification_Information __req;
      __diagService4h42sqi_31(__req, __resp);
    }
    else
    {
      DiagResponse CVADAS_0001_00000000_000.* __resp;
      DiagRequest CVADAS_0001_00000000_000._22F10D_Diagnostic_Specification_Information __req;
      __diagService4h42sqi_31(__req, __resp);
    }
  }
  TestCommandEnd();


}

  
void __diagService4h42sqi_31(DiagRequest * __req, DiagResponse * __resp )
{
  stack long __tableHandle;
  long __res, __paramLen, __bytePos;

   __bVerdict = __eVerdictPass;

  do {
    TestReportResetDiagObjectList();
    DiagSetReportDetailLevel("CVADAS_0001_00000000_000", EnumServiceDetails_onfail);
    // Request aspect
    {

      if (0 >= DiagSendReqAndWaitForResp("CVADAS_0001_00000000_000", __req, __resp, __res, -1, -1, -1, -1, -1, EnumResult_pos, EnumServiceDetails_onfail, EnumSendingMode_functional, EnumSuppressPosResBit_asconfigured, EnumVerdictOnInvalidValues_fail))
        break;
    }

    __res = DiagErrCodeTestStep(__res, "Can't retrieve last response for request! No check possible.") < 0;
    if(__res)
    {
	  __bVerdict = __eVerdictFail;
      break;
    }
    {
      __res = DiagInterpretAs(__resp, "RDBI_PR");
      if(__res != 0)
      {
        __bVerdict = __eVerdictFail;
        DiagErrCodeTestStep(__res, "Can't interpret response as diagnostic primitive 'RDBI_PR'.");
        break;
      }
      else
      {
        TestStepPass( "Received primitive can be interpreted as diagnostic primitive 'RDBI_PR'.");
      }
    }
  }
  while(0);


  // Response, check & read aspect
  {
    __res = 1;
    __tableHandle = ReportTableHead5Columns(__cCheckCaption, __cTSym, __cTOp, __cRefVal, __cActual, __cRes);
    {
      __bDiagValueArrayCtr = DiagGetParameterErrorHandled(__resp, "_Unified_Diagnostic_Services_UDS__Diagnostic_Protocol_Version_24", __bDiagValueArray, elcount(__bDiagValueArray), __cDiagValueArray, elcount(__cDiagValueArray));
      {
        __bArrayCtr = __CopyBytes(__bDiagValueArray, __bDiagValueArrayCtr, __bArray);
        CheckPlainParameterGetDataBufferConsistency(sysParGetData(syspar::`F10D_Diagnostic_Specification_Information::`UDS_Diagnostic_Protocol_Version, __bArray2, __bArrayCtr2), __bArrayCtr2, "syspar::`F10D_Diagnostic_Specification_Information::`UDS_Diagnostic_Protocol_Version");
        __csr = CompareBytes(__bArray, __bArrayCtr, __bArray2, __bArrayCtr2) == 0;
        snprintf(__cArray, 8192, "%s", "Diagnostic parameter \'_Unified_Diagnostic_Services_UDS__Diagnostic_Protocol_Version_24\'");
        snprintf(__cArray2, 8192, "%s", __cArray);
        snprintf(__cArray3, 8192, "%s", "UDS_Diagnostic_Protocol_Version");
        ReportTableRow(__tableHandle, 0, __cArray2, "Bytes", __bArray2, __bArrayCtr2, __cArray3, __oneOfFlag, __bSetInCheckAlignment);
        ReportCell(__tableHandle, __bArray, __bArrayCtr);
        ReportCellResult(__tableHandle, __csr, __ePassFail);
      }
    
      __res = __res && __csr;
    
    }
    {
      __bDiagValueArrayCtr = DiagGetParameterErrorHandled(__resp, "_ECU_Flash_Reprogramming_Requirements_Version_32", __bDiagValueArray, elcount(__bDiagValueArray), __cDiagValueArray, elcount(__cDiagValueArray));
      {
        __bArrayCtr = __CopyBytes(__bDiagValueArray, __bDiagValueArrayCtr, __bArray);
        CheckPlainParameterGetDataBufferConsistency(sysParGetData(syspar::`F10D_Diagnostic_Specification_Information::`ECU_Flash_Reprogramming_Requirement_Version, __bArray2, __bArrayCtr2), __bArrayCtr2, "syspar::`F10D_Diagnostic_Specification_Information::`ECU_Flash_Reprogramming_Requirement_Version");
        __csr = CompareBytes(__bArray, __bArrayCtr, __bArray2, __bArrayCtr2) == 0;
        snprintf(__cArray, 8192, "%s", "Diagnostic parameter \'_ECU_Flash_Reprogramming_Requirements_Version_32\'");
        snprintf(__cArray2, 8192, "%s", __cArray);
        snprintf(__cArray3, 8192, "%s", "ECU_Flash_Reprogramming_Requirement_Version");
        ReportTableRow(__tableHandle, 0, __cArray2, "Bytes", __bArray2, __bArrayCtr2, __cArray3, __oneOfFlag, __bSetInCheckAlignment);
        ReportCell(__tableHandle, __bArray, __bArrayCtr);
        ReportCellResult(__tableHandle, __csr, __ePassFail);
      }
    
      __res = __res && __csr;
    
    }
    {
      __bDiagValueArrayCtr = DiagGetParameterErrorHandled(__resp, "_Standard_Diagnostic_Data_UDS_Version_40", __bDiagValueArray, elcount(__bDiagValueArray), __cDiagValueArray, elcount(__cDiagValueArray));
      {
        __bArrayCtr = __CopyBytes(__bDiagValueArray, __bDiagValueArrayCtr, __bArray);
        CheckPlainParameterGetDataBufferConsistency(sysParGetData(syspar::`F10D_Diagnostic_Specification_Information::`Standard_Diagnostic_Data_UDS_Version, __bArray2, __bArrayCtr2), __bArrayCtr2, "syspar::`F10D_Diagnostic_Specification_Information::`Standard_Diagnostic_Data_UDS_Version");
        __csr = CompareBytes(__bArray, __bArrayCtr, __bArray2, __bArrayCtr2) == 0;
        snprintf(__cArray, 8192, "%s", "Diagnostic parameter \'_Standard_Diagnostic_Data_UDS_Version_40\'");
        snprintf(__cArray2, 8192, "%s", __cArray);
        snprintf(__cArray3, 8192, "%s", "Standard_Diagnostic_Data_UDS_Version");
        ReportTableRow(__tableHandle, 0, __cArray2, "Bytes", __bArray2, __bArrayCtr2, __cArray3, __oneOfFlag, __bSetInCheckAlignment);
        ReportCell(__tableHandle, __bArray, __bArrayCtr);
        ReportCellResult(__tableHandle, __csr, __ePassFail);
      }
    
      __res = __res && __csr;
    
    }
    {
      __bDiagValueArrayCtr = DiagGetParameterErrorHandled(__resp, "_Diagnostic_Requirements_Standard_Version_48", __bDiagValueArray, elcount(__bDiagValueArray), __cDiagValueArray, elcount(__cDiagValueArray));
      {
        __bArrayCtr = __CopyBytes(__bDiagValueArray, __bDiagValueArrayCtr, __bArray);
        CheckPlainParameterGetDataBufferConsistency(sysParGetData(syspar::`F10D_Diagnostic_Specification_Information::`Diagnostic_Requirement_Standard_Version, __bArray2, __bArrayCtr2), __bArrayCtr2, "syspar::`F10D_Diagnostic_Specification_Information::`Diagnostic_Requirement_Standard_Version");
        __csr = CompareBytes(__bArray, __bArrayCtr, __bArray2, __bArrayCtr2) == 0;
        snprintf(__cArray, 8192, "%s", "Diagnostic parameter \'_Diagnostic_Requirements_Standard_Version_48\'");
        snprintf(__cArray2, 8192, "%s", __cArray);
        snprintf(__cArray3, 8192, "%s", "Diagnostic_Requirement_Standard_Version");
        ReportTableRow(__tableHandle, 0, __cArray2, "Bytes", __bArray2, __bArrayCtr2, __cArray3, __oneOfFlag, __bSetInCheckAlignment);
        ReportCell(__tableHandle, __bArray, __bArrayCtr);
        ReportCellResult(__tableHandle, __csr, __ePassFail);
      }
    
      __res = __res && __csr;
    
    }
    ReportTableEndVerdict(__tableHandle, __cEvaluateResponse, __res);
	__bVerdict = __bVerdict && __res;
  }
  if (__bVerdict == __eVerdictFail)
    TestReportWriteDiagObjectList();
}

void Tt4h42sqi_F10D_DID_with_Standard_Physical_Address()
{
  stack long __tableHandle;
  TestCommandBegin(__eRequestResponse, __cRequestResponse, "", "0");
  {
  
    long __res;
    int64 __timeout;
    __res = 0;
    __nInt64 = 1;
    __timeout = syspar::`P2_Server * 1000000LL;
    {
    
      long __testStepInitOk;
      message `FDCAN2::`DIAGNOSTIC_REQUEST_PAM __output;
      message `FDCAN2::`DIAGNOSTIC_REQUEST_PAM __msgOrig;
      __output = __msgOrig;
      __testStepInitOk = 1;
      snprintf(__cArray, elCount(__cArray), "CAN message '%s' ID = 416981233x (0x18DAA0F1x) on bus FDCAN2", "DIAGNOSTIC_REQUEST_PAM");
      snprintf(__cArray2, elCount(__cArray2), "Send %s", __cArray);
      __tableHandle = ReportTableHead3Columns(__cArray2, "Byte", __cTOp, __cAssigned);
      ReportByteIndex("", 0, __cArray, elCount(__cArray));
      snprintf(__cArray2, 8192, "%s", __cArray);
      snprintf(__cArray3, 8192, "%s", "");
      
      ReportTableRow(__tableHandle, 0, __cArray2, __cAOp, 0x3, __cArray3, __oneOfFlag, __bSetInCheckAlignment);
      
      if (0 >= 0 && 0 < 64)
      {
        __output.byte((word)0) = 0x3;
      }
      else
      {
        testStepErrorInTestSystem(0, __cEmpty, "Index out of range. Unable to set byte %lld in message. Please check input parameter.", (int64)0);
        __testStepInitOk = 0;
      }
      ReportByteIndex("", 1, __cArray, elCount(__cArray));
      snprintf(__cArray2, 8192, "%s", __cArray);
      snprintf(__cArray3, 8192, "%s", "");
      
      ReportTableRow(__tableHandle, 0, __cArray2, __cAOp, 0x22, __cArray3, __oneOfFlag, __bSetInCheckAlignment);
      
      if (1 >= 0 && 1 < 64)
      {
        __output.byte((word)1) = 0x22;
      }
      else
      {
        testStepErrorInTestSystem(0, __cEmpty, "Index out of range. Unable to set byte %lld in message. Please check input parameter.", (int64)1);
        __testStepInitOk = 0;
      }
      ReportByteIndex("", 2, __cArray, elCount(__cArray));
      snprintf(__cArray2, 8192, "%s", __cArray);
      snprintf(__cArray3, 8192, "%s", "");
      
      ReportTableRow(__tableHandle, 0, __cArray2, __cAOp, 0xF1, __cArray3, __oneOfFlag, __bSetInCheckAlignment);
      
      if (2 >= 0 && 2 < 64)
      {
        __output.byte((word)2) = 0xF1;
      }
      else
      {
        testStepErrorInTestSystem(0, __cEmpty, "Index out of range. Unable to set byte %lld in message. Please check input parameter.", (int64)2);
        __testStepInitOk = 0;
      }
      ReportByteIndex("", 3, __cArray, elCount(__cArray));
      snprintf(__cArray2, 8192, "%s", __cArray);
      snprintf(__cArray3, 8192, "%s", "");
      
      ReportTableRow(__tableHandle, 0, __cArray2, __cAOp, 0xD, __cArray3, __oneOfFlag, __bSetInCheckAlignment);
      
      if (3 >= 0 && 3 < 64)
      {
        __output.byte((word)3) = 0xD;
      }
      else
      {
        testStepErrorInTestSystem(0, __cEmpty, "Index out of range. Unable to set byte %lld in message. Please check input parameter.", (int64)3);
        __testStepInitOk = 0;
      }
    
      ReportTableEndTestStep(__tableHandle, "Req1");
      if (__testStepInitOk)
      {
        output(__output);
      }
    }
    if (__timeout <= 0)
    {
      testStepErrorInTestSystem(0, "1", "Unable to wait for %.3f %s. Please check input parameter.", __timeout / ((float)1000000), "ms");
    }
    else
    {
      __tt2cnt_33 = 0;
      snprintf(__cArray, elCount(__cArray), "CAN message '%s' ID = 417001888x (0x18DAF1A0x) on bus FDCAN2", "DIAGNOSTIC_RESPONSE_PAM");
      if(SetBusContextByName("FDCAN2", __eSaveCurrent, __nBusContextNew, __nBusContextOld))
        testJoinMessageEvent(`FDCAN2::`DIAGNOSTIC_RESPONSE_PAM,  __cArray,
             delegate dword(message * __m)
             {
               dword __msg_callback_ret;
               if (__tt2cnt_33 == -1)
               {
                 return 1;
               }
               __msg_callback_ret = 1;
               __tt2cnt_33++;
               if (__msg_callback_ret)
               {
                 __tt2cnt_33 = -1;
                 return 1;
               }
               return 0;
             });
      __res = testWaitForAllJoinedEventsNS(__timeout);
      if (__nInt64 != 0)
      {
        snprintf(__cArray, elCount(__cArray), "CAN message '%s' ID = 417001888x (0x18DAF1A0x) on bus FDCAN2", "DIAGNOSTIC_RESPONSE_PAM");
        if(__tt2cnt_33 == -1)
        {
          snprintf(__cArray2, 8192, "Response of %s", __cArray);
        }
        else
        {
          snprintf(__cArray2, 8192, "Response of %s (received %d times)", __cArray, __tt2cnt_33);
        }
        if (__tt2cnt_33 == 0)
        {
          testStepFail(0, "Resp1", __cArray2);
        }
        else
        {
          testStepPass(2, "Resp1", __cArray2);
        }
        __ReportRequestResponseResult(__res, 0);
      }
      ResetBusContext(__nBusContextNew, __nBusContextOld);
    }
  }
  TestCommandEnd();

}

void Tt4h42sqi_F112_DID_with_Physical_Addressing()
{
  stack long __tableHandle;
  TestCommandBegin(__eDiagService, __cDiagService, "", "0");
  {
    if (DiagIsFunctionalGroup("CVADAS_0001_00000000_000"))
    {
      DiagResponse * __resp;
      DiagRequest CVADAS_0001_00000000_000._22F112_PTESLM_Hardware_Number __req;
      __diagService4h42sqi_32(__req, __resp);
    }
    else
    {
      DiagResponse CVADAS_0001_00000000_000.* __resp;
      DiagRequest CVADAS_0001_00000000_000._22F112_PTESLM_Hardware_Number __req;
      __diagService4h42sqi_32(__req, __resp);
    }
  }
  TestCommandEnd();


}

  
void __diagService4h42sqi_32(DiagRequest * __req, DiagResponse * __resp )
{
  stack long __tableHandle;
  long __res, __paramLen, __bytePos;

   __bVerdict = __eVerdictPass;

  do {
    TestReportResetDiagObjectList();
    DiagSetReportDetailLevel("CVADAS_0001_00000000_000", EnumServiceDetails_onfail);
    // Request aspect
    {

      if (0 >= DiagSendReqAndWaitForResp("CVADAS_0001_00000000_000", __req, __resp, __res, -1, -1, -1, -1, -1, EnumResult_pos, EnumServiceDetails_onfail, EnumSendingMode_physical, EnumSuppressPosResBit_asconfigured, EnumVerdictOnInvalidValues_no_impact))
        break;
    }

  }
  while(0);


  if (__bVerdict == __eVerdictFail)
    TestReportWriteDiagObjectList();
}

void Tt4h42sqi_F112_DID_with_Functional_Address()
{
  stack long __tableHandle;
  TestCommandBegin(__eDiagService, __cDiagService, "", "0");
  {
    if (DiagIsFunctionalGroup("CVADAS_0001_00000000_000"))
    {
      DiagResponse * __resp;
      DiagRequest CVADAS_0001_00000000_000._22F112_PTESLM_Hardware_Number __req;
      __diagService4h42sqi_33(__req, __resp);
    }
    else
    {
      DiagResponse CVADAS_0001_00000000_000.* __resp;
      DiagRequest CVADAS_0001_00000000_000._22F112_PTESLM_Hardware_Number __req;
      __diagService4h42sqi_33(__req, __resp);
    }
  }
  TestCommandEnd();


}

  
void __diagService4h42sqi_33(DiagRequest * __req, DiagResponse * __resp )
{
  stack long __tableHandle;
  long __res, __paramLen, __bytePos;

   __bVerdict = __eVerdictPass;

  do {
    TestReportResetDiagObjectList();
    DiagSetReportDetailLevel("CVADAS_0001_00000000_000", EnumServiceDetails_onfail);
    // Request aspect
    {

      if (0 >= DiagSendReqAndWaitForResp("CVADAS_0001_00000000_000", __req, __resp, __res, -1, -1, -1, -1, -1, EnumResult_pos, EnumServiceDetails_onfail, EnumSendingMode_functional, EnumSuppressPosResBit_asconfigured, EnumVerdictOnInvalidValues_no_impact))
        break;
    }

  }
  while(0);


  if (__bVerdict == __eVerdictFail)
    TestReportWriteDiagObjectList();
}

void Tt4h42sqi_F112_DID_with_Standard_Physical_Address()
{
  stack long __tableHandle;
  TestCommandBegin(__eRequestResponse, __cRequestResponse, "", "0");
  {
  
    long __res;
    int64 __timeout;
    __res = 0;
    __nInt64 = 1;
    __timeout = syspar::`P2_Server * 1000000LL;
    {
    
      long __testStepInitOk;
      message `FDCAN2::`DIAGNOSTIC_REQUEST_PAM __output;
      message `FDCAN2::`DIAGNOSTIC_REQUEST_PAM __msgOrig;
      __output = __msgOrig;
      __testStepInitOk = 1;
      {
        int64 __dlc;
        __dlc = 4;
        if (__dlc >= 0 && __dlc <= (__output.EDL ? 15 : 8))
          __output.DLC = __dlc;
        else
        {
          testStepErrorInTestSystem(0, __cEmpty, "Unable to set DLC=%lld in message. Please check input parameter.", __dlc);
          __testStepInitOk = 0;
        }
      }
      if (__testStepInitOk)
      {
        snprintf(__cArray, elCount(__cArray), "CAN message '%s' ID = 416981233x (0x18DAA0F1x) on bus FDCAN2", "DIAGNOSTIC_REQUEST_PAM");
        snprintf(__cArray2, elCount(__cArray2), "Send %s", __cArray);
        __tableHandle = ReportTableHead3Columns(__cArray2, "Byte", __cTOp, __cAssigned);
        ReportByteIndex("", 0, __cArray, elCount(__cArray));
        snprintf(__cArray2, 8192, "%s", __cArray);
        snprintf(__cArray3, 8192, "%s", "");
        
        ReportTableRow(__tableHandle, 0, __cArray2, __cAOp, 0x3, __cArray3, __oneOfFlag, __bSetInCheckAlignment);
        
        if (0 >= 0 && 0 < 64)
        {
          __output.byte((word)0) = 0x3;
        }
        else
        {
          testStepErrorInTestSystem(0, __cEmpty, "Index out of range. Unable to set byte %lld in message. Please check input parameter.", (int64)0);
          __testStepInitOk = 0;
        }
        ReportByteIndex("", 1, __cArray, elCount(__cArray));
        snprintf(__cArray2, 8192, "%s", __cArray);
        snprintf(__cArray3, 8192, "%s", "");
        
        ReportTableRow(__tableHandle, 0, __cArray2, __cAOp, 0x22, __cArray3, __oneOfFlag, __bSetInCheckAlignment);
        
        if (1 >= 0 && 1 < 64)
        {
          __output.byte((word)1) = 0x22;
        }
        else
        {
          testStepErrorInTestSystem(0, __cEmpty, "Index out of range. Unable to set byte %lld in message. Please check input parameter.", (int64)1);
          __testStepInitOk = 0;
        }
        ReportByteIndex("", 2, __cArray, elCount(__cArray));
        snprintf(__cArray2, 8192, "%s", __cArray);
        snprintf(__cArray3, 8192, "%s", "");
        
        ReportTableRow(__tableHandle, 0, __cArray2, __cAOp, 0xF1, __cArray3, __oneOfFlag, __bSetInCheckAlignment);
        
        if (2 >= 0 && 2 < 64)
        {
          __output.byte((word)2) = 0xF1;
        }
        else
        {
          testStepErrorInTestSystem(0, __cEmpty, "Index out of range. Unable to set byte %lld in message. Please check input parameter.", (int64)2);
          __testStepInitOk = 0;
        }
        ReportByteIndex("", 3, __cArray, elCount(__cArray));
        snprintf(__cArray2, 8192, "%s", __cArray);
        snprintf(__cArray3, 8192, "%s", "");
        
        ReportTableRow(__tableHandle, 0, __cArray2, __cAOp, 0x12, __cArray3, __oneOfFlag, __bSetInCheckAlignment);
        
        if (3 >= 0 && 3 < 64)
        {
          __output.byte((word)3) = 0x12;
        }
        else
        {
          testStepErrorInTestSystem(0, __cEmpty, "Index out of range. Unable to set byte %lld in message. Please check input parameter.", (int64)3);
          __testStepInitOk = 0;
        }
      
        ReportTableEndTestStep(__tableHandle, "Req1");
      }
      if (__testStepInitOk)
      {
        output(__output);
      }
    }
    if (__timeout <= 0)
    {
      testStepErrorInTestSystem(0, "1", "Unable to wait for %.3f %s. Please check input parameter.", __timeout / ((float)1000000), "ms");
    }
    else
    {
      __tt2cnt_35 = 0;
      snprintf(__cArray, elCount(__cArray), "CAN message '%s' ID = 417001888x (0x18DAF1A0x) on bus FDCAN2", "DIAGNOSTIC_RESPONSE_PAM");
      if(SetBusContextByName("FDCAN2", __eSaveCurrent, __nBusContextNew, __nBusContextOld))
        testJoinMessageEvent(`FDCAN2::`DIAGNOSTIC_RESPONSE_PAM,  __cArray,
             delegate dword(message * __m)
             {
               dword __msg_callback_ret;
               if (__tt2cnt_35 == -1)
               {
                 return 1;
               }
               __msg_callback_ret = 1;
               __tt2cnt_35++;
               if (__msg_callback_ret)
               {
                 __tt2cnt_35 = -1;
                 return 1;
               }
               return 0;
             });
      __res = testWaitForAllJoinedEventsNS(__timeout);
      if (__nInt64 != 0)
      {
        snprintf(__cArray, elCount(__cArray), "CAN message '%s' ID = 417001888x (0x18DAF1A0x) on bus FDCAN2", "DIAGNOSTIC_RESPONSE_PAM");
        if(__tt2cnt_35 == -1)
        {
          snprintf(__cArray2, 8192, "Response of %s", __cArray);
        }
        else
        {
          snprintf(__cArray2, 8192, "Response of %s (received %d times)", __cArray, __tt2cnt_35);
        }
        if (__tt2cnt_35 == 0)
        {
          testStepFail(0, "Resp1", __cArray2);
        }
        else
        {
          testStepPass(2, "Resp1", __cArray2);
        }
        __ReportRequestResponseResult(__res, 0);
      }
      ResetBusContext(__nBusContextNew, __nBusContextOld);
    }
  }
  TestCommandEnd();

}

void Tt4h42sqi_FD1D_DID_with_Physical_Address()
{
  stack long __tableHandle;
  TestCommandBegin(__eDiagService, __cDiagService, "", "0");
  {
    if (DiagIsFunctionalGroup("CVADAS_0001_00000000_000"))
    {
      DiagResponse * __resp;
      DiagRequest CVADAS_0001_00000000_000._22FD1D_PCB_Serial_Number __req;
      __diagService4h42sqi_34(__req, __resp);
    }
    else
    {
      DiagResponse CVADAS_0001_00000000_000.* __resp;
      DiagRequest CVADAS_0001_00000000_000._22FD1D_PCB_Serial_Number __req;
      __diagService4h42sqi_34(__req, __resp);
    }
  }
  TestCommandEnd();


}

  
void __diagService4h42sqi_34(DiagRequest * __req, DiagResponse * __resp )
{
  stack long __tableHandle;
  long __res, __paramLen, __bytePos;

   __bVerdict = __eVerdictPass;

  do {
    TestReportResetDiagObjectList();
    DiagSetReportDetailLevel("CVADAS_0001_00000000_000", EnumServiceDetails_onfail);
    // Request aspect
    {
      {
        CheckLiteralGetStringBufferConsistency("FD1D", 8192);
      snprintf(__cDiagValueArray, 8192, "%s", "FD1D");
        __bDiagValueArrayCtr = __MapChar2ByteAtDiagSet(__cDiagValueArray, __bDiagValueArray);
        if (__bDiagValueArrayCtr >= 0)
        {
          __res = DiagSetParameterErrorHandled(__req, "RecordDataIdentifier", __bDiagValueArray, __bDiagValueArrayCtr);
          if(__res < 0)
          {
            __bVerdict = __eVerdictFail;
            DiagErrCodeTestStep(__res, "Cannot set diagnostic parameter 'RecordDataIdentifier'");
            break;
          }
        }
        else
        {
      	__bVerdict = __eVerdictFail;
          snprintf(__cArray2, 8192, "SetParameter: illegal byte sequence: '%s' (parameter %s). Use hex tuples like '01 AF ...'", __cDiagValueArray, "RecordDataIdentifier");
          DiagErrCodeTestStep(__bDiagValueArrayCtr, __cArray2);
          DiagErrCodeTestStep(-1, "Cannot set diagnostic parameter 'RecordDataIdentifier'");
      	break;
        }
      }

      if (0 >= DiagSendReqAndWaitForResp("CVADAS_0001_00000000_000", __req, __resp, __res, -1, -1, -1, -1, -1, EnumResult_pos, EnumServiceDetails_onfail, EnumSendingMode_physical, EnumSuppressPosResBit_asconfigured, EnumVerdictOnInvalidValues_fail))
        break;
    }

    __res = DiagErrCodeTestStep(__res, "Can't retrieve last response for request! No check possible.") < 0;
    if(__res)
    {
	  __bVerdict = __eVerdictFail;
      break;
    }
    {
      __res = DiagInterpretAs(__resp, "RDBI_PR");
      if(__res != 0)
      {
        __bVerdict = __eVerdictFail;
        DiagErrCodeTestStep(__res, "Can't interpret response as diagnostic primitive 'RDBI_PR'.");
        break;
      }
      else
      {
        TestStepPass( "Received primitive can be interpreted as diagnostic primitive 'RDBI_PR'.");
      }
    }
  }
  while(0);


  if (__bVerdict == __eVerdictFail)
    TestReportWriteDiagObjectList();
}

void Tt4h42sqi_FD1D_DID_with_Functional_Address()
{
  stack long __tableHandle;
  TestCommandBegin(__eDiagService, __cDiagService, "", "0");
  {
    if (DiagIsFunctionalGroup("CVADAS_0001_00000000_000"))
    {
      DiagResponse * __resp;
      DiagRequest CVADAS_0001_00000000_000._22FD1D_PCB_Serial_Number __req;
      __diagService4h42sqi_35(__req, __resp);
    }
    else
    {
      DiagResponse CVADAS_0001_00000000_000.* __resp;
      DiagRequest CVADAS_0001_00000000_000._22FD1D_PCB_Serial_Number __req;
      __diagService4h42sqi_35(__req, __resp);
    }
  }
  TestCommandEnd();


}

  
void __diagService4h42sqi_35(DiagRequest * __req, DiagResponse * __resp )
{
  stack long __tableHandle;
  long __res, __paramLen, __bytePos;

   __bVerdict = __eVerdictPass;

  do {
    TestReportResetDiagObjectList();
    DiagSetReportDetailLevel("CVADAS_0001_00000000_000", EnumServiceDetails_onfail);
    // Request aspect
    {
      {
        CheckLiteralGetStringBufferConsistency("FD1D", 8192);
      snprintf(__cDiagValueArray, 8192, "%s", "FD1D");
        __bDiagValueArrayCtr = __MapChar2ByteAtDiagSet(__cDiagValueArray, __bDiagValueArray);
        if (__bDiagValueArrayCtr >= 0)
        {
          __res = DiagSetParameterErrorHandled(__req, "RecordDataIdentifier", __bDiagValueArray, __bDiagValueArrayCtr);
          if(__res < 0)
          {
            __bVerdict = __eVerdictFail;
            DiagErrCodeTestStep(__res, "Cannot set diagnostic parameter 'RecordDataIdentifier'");
            break;
          }
        }
        else
        {
      	__bVerdict = __eVerdictFail;
          snprintf(__cArray2, 8192, "SetParameter: illegal byte sequence: '%s' (parameter %s). Use hex tuples like '01 AF ...'", __cDiagValueArray, "RecordDataIdentifier");
          DiagErrCodeTestStep(__bDiagValueArrayCtr, __cArray2);
          DiagErrCodeTestStep(-1, "Cannot set diagnostic parameter 'RecordDataIdentifier'");
      	break;
        }
      }

      if (0 >= DiagSendReqAndWaitForResp("CVADAS_0001_00000000_000", __req, __resp, __res, -1, -1, -1, -1, -1, EnumResult_pos, EnumServiceDetails_onfail, EnumSendingMode_functional, EnumSuppressPosResBit_asconfigured, EnumVerdictOnInvalidValues_fail))
        break;
    }

    __res = DiagErrCodeTestStep(__res, "Can't retrieve last response for request! No check possible.") < 0;
    if(__res)
    {
	  __bVerdict = __eVerdictFail;
      break;
    }
    {
      __res = DiagInterpretAs(__resp, "RDBI_PR");
      if(__res != 0)
      {
        __bVerdict = __eVerdictFail;
        DiagErrCodeTestStep(__res, "Can't interpret response as diagnostic primitive 'RDBI_PR'.");
        break;
      }
      else
      {
        TestStepPass( "Received primitive can be interpreted as diagnostic primitive 'RDBI_PR'.");
      }
    }
  }
  while(0);


  if (__bVerdict == __eVerdictFail)
    TestReportWriteDiagObjectList();
}

void Tt4h42sqi_FD1D_DID_with_Standard_Physical_Address()
{
  stack long __tableHandle;
  TestCommandBegin(__eRequestResponse, __cRequestResponse, "", "0");
  {
  
    long __res;
    int64 __timeout;
    __res = 0;
    __nInt64 = 1;
    __timeout = syspar::`P2_Server * 1000000LL;
    {
    
      long __testStepInitOk;
      message `FDCAN2::`DIAGNOSTIC_REQUEST_PAM __output;
      message `FDCAN2::`DIAGNOSTIC_REQUEST_PAM __msgOrig;
      __output = __msgOrig;
      __testStepInitOk = 1;
      {
        int64 __dlc;
        __dlc = 4;
        if (__dlc >= 0 && __dlc <= (__output.EDL ? 15 : 8))
          __output.DLC = __dlc;
        else
        {
          testStepErrorInTestSystem(0, __cEmpty, "Unable to set DLC=%lld in message. Please check input parameter.", __dlc);
          __testStepInitOk = 0;
        }
      }
      if (__testStepInitOk)
      {
        snprintf(__cArray, elCount(__cArray), "CAN message '%s' ID = 416981233x (0x18DAA0F1x) on bus FDCAN2", "DIAGNOSTIC_REQUEST_PAM");
        snprintf(__cArray2, elCount(__cArray2), "Send %s", __cArray);
        __tableHandle = ReportTableHead3Columns(__cArray2, "Byte", __cTOp, __cAssigned);
        ReportByteIndex("", 0, __cArray, elCount(__cArray));
        snprintf(__cArray2, 8192, "%s", __cArray);
        snprintf(__cArray3, 8192, "%s", "");
        
        ReportTableRow(__tableHandle, 0, __cArray2, __cAOp, 0x3, __cArray3, __oneOfFlag, __bSetInCheckAlignment);
        
        if (0 >= 0 && 0 < 64)
        {
          __output.byte((word)0) = 0x3;
        }
        else
        {
          testStepErrorInTestSystem(0, __cEmpty, "Index out of range. Unable to set byte %lld in message. Please check input parameter.", (int64)0);
          __testStepInitOk = 0;
        }
        ReportByteIndex("", 1, __cArray, elCount(__cArray));
        snprintf(__cArray2, 8192, "%s", __cArray);
        snprintf(__cArray3, 8192, "%s", "");
        
        ReportTableRow(__tableHandle, 0, __cArray2, __cAOp, 0x22, __cArray3, __oneOfFlag, __bSetInCheckAlignment);
        
        if (1 >= 0 && 1 < 64)
        {
          __output.byte((word)1) = 0x22;
        }
        else
        {
          testStepErrorInTestSystem(0, __cEmpty, "Index out of range. Unable to set byte %lld in message. Please check input parameter.", (int64)1);
          __testStepInitOk = 0;
        }
        ReportByteIndex("", 2, __cArray, elCount(__cArray));
        snprintf(__cArray2, 8192, "%s", __cArray);
        snprintf(__cArray3, 8192, "%s", "");
        
        ReportTableRow(__tableHandle, 0, __cArray2, __cAOp, 0xFD, __cArray3, __oneOfFlag, __bSetInCheckAlignment);
        
        if (2 >= 0 && 2 < 64)
        {
          __output.byte((word)2) = 0xFD;
        }
        else
        {
          testStepErrorInTestSystem(0, __cEmpty, "Index out of range. Unable to set byte %lld in message. Please check input parameter.", (int64)2);
          __testStepInitOk = 0;
        }
        ReportByteIndex("", 3, __cArray, elCount(__cArray));
        snprintf(__cArray2, 8192, "%s", __cArray);
        snprintf(__cArray3, 8192, "%s", "");
        
        ReportTableRow(__tableHandle, 0, __cArray2, __cAOp, 0x1D, __cArray3, __oneOfFlag, __bSetInCheckAlignment);
        
        if (3 >= 0 && 3 < 64)
        {
          __output.byte((word)3) = 0x1D;
        }
        else
        {
          testStepErrorInTestSystem(0, __cEmpty, "Index out of range. Unable to set byte %lld in message. Please check input parameter.", (int64)3);
          __testStepInitOk = 0;
        }
      
        ReportTableEndTestStep(__tableHandle, "Req1");
      }
      if (__testStepInitOk)
      {
        output(__output);
      }
    }
    if (__timeout <= 0)
    {
      testStepErrorInTestSystem(0, "1", "Unable to wait for %.3f %s. Please check input parameter.", __timeout / ((float)1000000), "ms");
    }
    else
    {
      __tt2cnt_37 = 0;
      snprintf(__cArray, elCount(__cArray), "CAN message '%s' ID = 417001888x (0x18DAF1A0x) on bus FDCAN2", "DIAGNOSTIC_RESPONSE_PAM");
      if(SetBusContextByName("FDCAN2", __eSaveCurrent, __nBusContextNew, __nBusContextOld))
        testJoinMessageEvent(`FDCAN2::`DIAGNOSTIC_RESPONSE_PAM,  __cArray,
             delegate dword(message * __m)
             {
               dword __msg_callback_ret;
               if (__tt2cnt_37 == -1)
               {
                 return 1;
               }
               __msg_callback_ret = 1;
               __tt2cnt_37++;
               if (__msg_callback_ret)
               {
                 __tt2cnt_37 = -1;
                 return 1;
               }
               return 0;
             });
      __res = testWaitForAllJoinedEventsNS(__timeout);
      if (__nInt64 != 0)
      {
        snprintf(__cArray, elCount(__cArray), "CAN message '%s' ID = 417001888x (0x18DAF1A0x) on bus FDCAN2", "DIAGNOSTIC_RESPONSE_PAM");
        if(__tt2cnt_37 == -1)
        {
          snprintf(__cArray2, 8192, "Response of %s", __cArray);
        }
        else
        {
          snprintf(__cArray2, 8192, "Response of %s (received %d times)", __cArray, __tt2cnt_37);
        }
        if (__tt2cnt_37 == 0)
        {
          testStepFail(0, "Resp1", __cArray2);
        }
        else
        {
          testStepPass(2, "Resp1", __cArray2);
        }
        __ReportRequestResponseResult(__res, 0);
      }
      ResetBusContext(__nBusContextNew, __nBusContextOld);
    }
  }
  TestCommandEnd();

}

void Tt4h42sqi_F11D_DID_with_Standard_Physical_Address()
{
  stack long __tableHandle;
  TestCommandBegin(__eRequestResponse, __cRequestResponse, "", "0");
  {
  
    long __res;
    int64 __timeout;
    __res = 0;
    __nInt64 = 1;
    __timeout = syspar::`P2_Server * 1000000LL;
    {
    
      long __testStepInitOk;
      message `FDCAN2::`DIAGNOSTIC_REQUEST_PAM __output;
      message `FDCAN2::`DIAGNOSTIC_REQUEST_PAM __msgOrig;
      __output = __msgOrig;
      __testStepInitOk = 1;
      {
        int64 __dlc;
        __dlc = 4;
        if (__dlc >= 0 && __dlc <= (__output.EDL ? 15 : 8))
          __output.DLC = __dlc;
        else
        {
          testStepErrorInTestSystem(0, __cEmpty, "Unable to set DLC=%lld in message. Please check input parameter.", __dlc);
          __testStepInitOk = 0;
        }
      }
      if (__testStepInitOk)
      {
        snprintf(__cArray, elCount(__cArray), "CAN message '%s' ID = 416981233x (0x18DAA0F1x) on bus FDCAN2", "DIAGNOSTIC_REQUEST_PAM");
        snprintf(__cArray2, elCount(__cArray2), "Send %s", __cArray);
        __tableHandle = ReportTableHead3Columns(__cArray2, "Byte", __cTOp, __cAssigned);
        ReportByteIndex("", 0, __cArray, elCount(__cArray));
        snprintf(__cArray2, 8192, "%s", __cArray);
        snprintf(__cArray3, 8192, "%s", "");
        
        ReportTableRow(__tableHandle, 0, __cArray2, __cAOp, 0x3, __cArray3, __oneOfFlag, __bSetInCheckAlignment);
        
        if (0 >= 0 && 0 < 64)
        {
          __output.byte((word)0) = 0x3;
        }
        else
        {
          testStepErrorInTestSystem(0, __cEmpty, "Index out of range. Unable to set byte %lld in message. Please check input parameter.", (int64)0);
          __testStepInitOk = 0;
        }
        ReportByteIndex("", 1, __cArray, elCount(__cArray));
        snprintf(__cArray2, 8192, "%s", __cArray);
        snprintf(__cArray3, 8192, "%s", "");
        
        ReportTableRow(__tableHandle, 0, __cArray2, __cAOp, 0x22, __cArray3, __oneOfFlag, __bSetInCheckAlignment);
        
        if (1 >= 0 && 1 < 64)
        {
          __output.byte((word)1) = 0x22;
        }
        else
        {
          testStepErrorInTestSystem(0, __cEmpty, "Index out of range. Unable to set byte %lld in message. Please check input parameter.", (int64)1);
          __testStepInitOk = 0;
        }
        ReportByteIndex("", 2, __cArray, elCount(__cArray));
        snprintf(__cArray2, 8192, "%s", __cArray);
        snprintf(__cArray3, 8192, "%s", "");
        
        ReportTableRow(__tableHandle, 0, __cArray2, __cAOp, 0xF1, __cArray3, __oneOfFlag, __bSetInCheckAlignment);
        
        if (2 >= 0 && 2 < 64)
        {
          __output.byte((word)2) = 0xF1;
        }
        else
        {
          testStepErrorInTestSystem(0, __cEmpty, "Index out of range. Unable to set byte %lld in message. Please check input parameter.", (int64)2);
          __testStepInitOk = 0;
        }
        ReportByteIndex("", 3, __cArray, elCount(__cArray));
        snprintf(__cArray2, 8192, "%s", __cArray);
        snprintf(__cArray3, 8192, "%s", "");
        
        ReportTableRow(__tableHandle, 0, __cArray2, __cAOp, 0x1D, __cArray3, __oneOfFlag, __bSetInCheckAlignment);
        
        if (3 >= 0 && 3 < 64)
        {
          __output.byte((word)3) = 0x1D;
        }
        else
        {
          testStepErrorInTestSystem(0, __cEmpty, "Index out of range. Unable to set byte %lld in message. Please check input parameter.", (int64)3);
          __testStepInitOk = 0;
        }
      
        ReportTableEndTestStep(__tableHandle, "Req1");
      }
      if (__testStepInitOk)
      {
        output(__output);
      }
    }
    if (__timeout <= 0)
    {
      testStepErrorInTestSystem(0, "1", "Unable to wait for %.3f %s. Please check input parameter.", __timeout / ((float)1000000), "ms");
    }
    else
    {
      __tt2cnt_39 = 0;
      snprintf(__cArray, elCount(__cArray), "CAN message '%s' ID = 417001888x (0x18DAF1A0x) on bus FDCAN2", "DIAGNOSTIC_RESPONSE_PAM");
      if(SetBusContextByName("FDCAN2", __eSaveCurrent, __nBusContextNew, __nBusContextOld))
        testJoinMessageEvent(`FDCAN2::`DIAGNOSTIC_RESPONSE_PAM,  __cArray,
             delegate dword(message * __m)
             {
               dword __msg_callback_ret;
               if (__tt2cnt_39 == -1)
               {
                 return 1;
               }
               __msg_callback_ret = 1;
               __tt2cnt_39++;
               if (__msg_callback_ret)
               {
                 __tt2cnt_39 = -1;
                 return 1;
               }
               return 0;
             });
      __res = testWaitForAllJoinedEventsNS(__timeout);
      if (__nInt64 != 0)
      {
        snprintf(__cArray, elCount(__cArray), "CAN message '%s' ID = 417001888x (0x18DAF1A0x) on bus FDCAN2", "DIAGNOSTIC_RESPONSE_PAM");
        if(__tt2cnt_39 == -1)
        {
          snprintf(__cArray2, 8192, "Response of %s", __cArray);
        }
        else
        {
          snprintf(__cArray2, 8192, "Response of %s (received %d times)", __cArray, __tt2cnt_39);
        }
        if (__tt2cnt_39 == 0)
        {
          testStepFail(0, "Resp1", __cArray2);
        }
        else
        {
          testStepPass(2, "Resp1", __cArray2);
        }
        __ReportRequestResponseResult(__res, 0);
      }
      ResetBusContext(__nBusContextNew, __nBusContextOld);
    }
  }
  TestCommandEnd();

}

void Tt4h42sqi_FD38_DID_with_Physical_Address()
{
  stack long __tableHandle;
  TestCommandBegin(__eDiagService, __cDiagService, "", "0");
  {
    if (DiagIsFunctionalGroup("CVADAS_0001_00000000_000"))
    {
      DiagResponse * __resp;
      DiagRequest CVADAS_0001_00000000_000._22FD38_Programmed_Assembly __req;
      __diagService4h42sqi_36(__req, __resp);
    }
    else
    {
      DiagResponse CVADAS_0001_00000000_000.* __resp;
      DiagRequest CVADAS_0001_00000000_000._22FD38_Programmed_Assembly __req;
      __diagService4h42sqi_36(__req, __resp);
    }
  }
  TestCommandEnd();


}

  
void __diagService4h42sqi_36(DiagRequest * __req, DiagResponse * __resp )
{
  stack long __tableHandle;
  long __res, __paramLen, __bytePos;

   __bVerdict = __eVerdictPass;

  do {
    TestReportResetDiagObjectList();
    DiagSetReportDetailLevel("CVADAS_0001_00000000_000", EnumServiceDetails_onfail);
    // Request aspect
    {
      {
        CheckLiteralGetStringBufferConsistency("FD38", 8192);
      snprintf(__cDiagValueArray, 8192, "%s", "FD38");
        __bDiagValueArrayCtr = __MapChar2ByteAtDiagSet(__cDiagValueArray, __bDiagValueArray);
        if (__bDiagValueArrayCtr >= 0)
        {
          __res = DiagSetParameterErrorHandled(__req, "RecordDataIdentifier", __bDiagValueArray, __bDiagValueArrayCtr);
          if(__res < 0)
          {
            __bVerdict = __eVerdictFail;
            DiagErrCodeTestStep(__res, "Cannot set diagnostic parameter 'RecordDataIdentifier'");
            break;
          }
        }
        else
        {
      	__bVerdict = __eVerdictFail;
          snprintf(__cArray2, 8192, "SetParameter: illegal byte sequence: '%s' (parameter %s). Use hex tuples like '01 AF ...'", __cDiagValueArray, "RecordDataIdentifier");
          DiagErrCodeTestStep(__bDiagValueArrayCtr, __cArray2);
          DiagErrCodeTestStep(-1, "Cannot set diagnostic parameter 'RecordDataIdentifier'");
      	break;
        }
      }

      if (0 >= DiagSendReqAndWaitForResp("CVADAS_0001_00000000_000", __req, __resp, __res, -1, -1, -1, -1, -1, EnumResult_pos, EnumServiceDetails_onfail, EnumSendingMode_physical, EnumSuppressPosResBit_asconfigured, EnumVerdictOnInvalidValues_fail))
        break;
    }

    __res = DiagErrCodeTestStep(__res, "Can't retrieve last response for request! No check possible.") < 0;
    if(__res)
    {
	  __bVerdict = __eVerdictFail;
      break;
    }
    {
      __res = DiagInterpretAs(__resp, "RDBI_PR");
      if(__res != 0)
      {
        __bVerdict = __eVerdictFail;
        DiagErrCodeTestStep(__res, "Can't interpret response as diagnostic primitive 'RDBI_PR'.");
        break;
      }
      else
      {
        TestStepPass( "Received primitive can be interpreted as diagnostic primitive 'RDBI_PR'.");
      }
    }
  }
  while(0);


  // Response, check & read aspect
  {
    __res = 1;
    __tableHandle = ReportTableHead5Columns(__cCheckCaption, __cTSym, __cTOp, __cRefVal, __cActual, __cRes);
    {
      __bDiagValueArrayCtr = DiagGetParameterErrorHandled(__resp, "RecordDataIdentifier", __bDiagValueArray, elcount(__bDiagValueArray), __cDiagValueArray, elcount(__cDiagValueArray));
      CheckLiteralGetStringBufferConsistency("FD38", 8192);
    snprintf(__cArray, 8192, "%s", "FD38");  
      __bDiagValueArrayCtr2 = __MapChar2ByteAtDiagCheck(__cArray, __bDiagValueArray2);
      snprintf(__cArray10, 8192, "%s", "FD38");
      {
        __bArrayCtr = __CopyBytes(__bDiagValueArray, __bDiagValueArrayCtr, __bArray);
        __bArrayCtr2 = __CopyBytes(__bDiagValueArray2, __bDiagValueArrayCtr2, __bArray2);
        __csr = CompareBytes(__bArray, __bArrayCtr, __bArray2, __bArrayCtr2) == 0;
        snprintf(__cArray, 8192, "%s", "Diagnostic parameter \'RecordDataIdentifier\'");
        snprintf(__cArray2, 8192, "%s", __cArray);
        snprintf(__cArray3, 8192, "%s", __cArray10);
        ReportTableRow(__tableHandle, 0, __cArray2, "Bytes", __bArray2, __bArrayCtr2, __cArray3, __oneOfFlag, __bSetInCheckAlignment);
        ReportCell(__tableHandle, __bArray, __bArrayCtr);
        ReportCellResult(__tableHandle, __csr, __ePassFail);
      }
    
      __res = __res && __csr;
    
    }
    ReportTableEndVerdict(__tableHandle, __cEvaluateResponse, __res);
	__bVerdict = __bVerdict && __res;
  }
  if (__bVerdict == __eVerdictFail)
    TestReportWriteDiagObjectList();
}

void Tt4h42sqi_FD38_DID_with_Functional_Address()
{
  stack long __tableHandle;
  TestCommandBegin(__eDiagService, __cDiagService, "", "0");
  {
    if (DiagIsFunctionalGroup("CVADAS_0001_00000000_000"))
    {
      DiagResponse * __resp;
      DiagRequest CVADAS_0001_00000000_000._22FD38_Programmed_Assembly __req;
      __diagService4h42sqi_37(__req, __resp);
    }
    else
    {
      DiagResponse CVADAS_0001_00000000_000.* __resp;
      DiagRequest CVADAS_0001_00000000_000._22FD38_Programmed_Assembly __req;
      __diagService4h42sqi_37(__req, __resp);
    }
  }
  TestCommandEnd();


}

  
void __diagService4h42sqi_37(DiagRequest * __req, DiagResponse * __resp )
{
  stack long __tableHandle;
  long __res, __paramLen, __bytePos;

   __bVerdict = __eVerdictPass;

  do {
    TestReportResetDiagObjectList();
    DiagSetReportDetailLevel("CVADAS_0001_00000000_000", EnumServiceDetails_onfail);
    // Request aspect
    {

      if (0 >= DiagSendReqAndWaitForResp("CVADAS_0001_00000000_000", __req, __resp, __res, -1, -1, -1, -1, -1, EnumResult_pos, EnumServiceDetails_onfail, EnumSendingMode_functional, EnumSuppressPosResBit_asconfigured, EnumVerdictOnInvalidValues_fail))
        break;
    }

    __res = DiagErrCodeTestStep(__res, "Can't retrieve last response for request! No check possible.") < 0;
    if(__res)
    {
	  __bVerdict = __eVerdictFail;
      break;
    }
    {
      __res = DiagInterpretAs(__resp, "RDBI_PR");
      if(__res != 0)
      {
        __bVerdict = __eVerdictFail;
        DiagErrCodeTestStep(__res, "Can't interpret response as diagnostic primitive 'RDBI_PR'.");
        break;
      }
      else
      {
        TestStepPass( "Received primitive can be interpreted as diagnostic primitive 'RDBI_PR'.");
      }
    }
  }
  while(0);


  if (__bVerdict == __eVerdictFail)
    TestReportWriteDiagObjectList();
}

void Tt4h42sqi_FD38_DID_with_Standard_Physical_Address()
{
  stack long __tableHandle;
  TestCommandBegin(__eRequestResponse, __cRequestResponse, "", "0");
  {
  
    long __res;
    int64 __timeout;
    __res = 0;
    __nInt64 = 1;
    __timeout = syspar::`P2_Server * 1000000LL;
    {
    
      long __testStepInitOk;
      message `FDCAN2::`DIAGNOSTIC_REQUEST_PAM __output;
      message `FDCAN2::`DIAGNOSTIC_REQUEST_PAM __msgOrig;
      __output = __msgOrig;
      __testStepInitOk = 1;
      {
        int64 __dlc;
        __dlc = 4;
        if (__dlc >= 0 && __dlc <= (__output.EDL ? 15 : 8))
          __output.DLC = __dlc;
        else
        {
          testStepErrorInTestSystem(0, __cEmpty, "Unable to set DLC=%lld in message. Please check input parameter.", __dlc);
          __testStepInitOk = 0;
        }
      }
      if (__testStepInitOk)
      {
        snprintf(__cArray, elCount(__cArray), "CAN message '%s' ID = 416981233x (0x18DAA0F1x) on bus FDCAN2", "DIAGNOSTIC_REQUEST_PAM");
        snprintf(__cArray2, elCount(__cArray2), "Send %s", __cArray);
        __tableHandle = ReportTableHead3Columns(__cArray2, "Byte", __cTOp, __cAssigned);
        ReportByteIndex("", 0, __cArray, elCount(__cArray));
        snprintf(__cArray2, 8192, "%s", __cArray);
        snprintf(__cArray3, 8192, "%s", "");
        
        ReportTableRow(__tableHandle, 0, __cArray2, __cAOp, 0x3, __cArray3, __oneOfFlag, __bSetInCheckAlignment);
        
        if (0 >= 0 && 0 < 64)
        {
          __output.byte((word)0) = 0x3;
        }
        else
        {
          testStepErrorInTestSystem(0, __cEmpty, "Index out of range. Unable to set byte %lld in message. Please check input parameter.", (int64)0);
          __testStepInitOk = 0;
        }
        ReportByteIndex("", 1, __cArray, elCount(__cArray));
        snprintf(__cArray2, 8192, "%s", __cArray);
        snprintf(__cArray3, 8192, "%s", "");
        
        ReportTableRow(__tableHandle, 0, __cArray2, __cAOp, 0x22, __cArray3, __oneOfFlag, __bSetInCheckAlignment);
        
        if (1 >= 0 && 1 < 64)
        {
          __output.byte((word)1) = 0x22;
        }
        else
        {
          testStepErrorInTestSystem(0, __cEmpty, "Index out of range. Unable to set byte %lld in message. Please check input parameter.", (int64)1);
          __testStepInitOk = 0;
        }
        ReportByteIndex("", 2, __cArray, elCount(__cArray));
        snprintf(__cArray2, 8192, "%s", __cArray);
        snprintf(__cArray3, 8192, "%s", "");
        
        ReportTableRow(__tableHandle, 0, __cArray2, __cAOp, 0xFD, __cArray3, __oneOfFlag, __bSetInCheckAlignment);
        
        if (2 >= 0 && 2 < 64)
        {
          __output.byte((word)2) = 0xFD;
        }
        else
        {
          testStepErrorInTestSystem(0, __cEmpty, "Index out of range. Unable to set byte %lld in message. Please check input parameter.", (int64)2);
          __testStepInitOk = 0;
        }
        ReportByteIndex("", 3, __cArray, elCount(__cArray));
        snprintf(__cArray2, 8192, "%s", __cArray);
        snprintf(__cArray3, 8192, "%s", "");
        
        ReportTableRow(__tableHandle, 0, __cArray2, __cAOp, 0x38, __cArray3, __oneOfFlag, __bSetInCheckAlignment);
        
        if (3 >= 0 && 3 < 64)
        {
          __output.byte((word)3) = 0x38;
        }
        else
        {
          testStepErrorInTestSystem(0, __cEmpty, "Index out of range. Unable to set byte %lld in message. Please check input parameter.", (int64)3);
          __testStepInitOk = 0;
        }
      
        ReportTableEndTestStep(__tableHandle, "Req1");
      }
      if (__testStepInitOk)
      {
        output(__output);
      }
    }
    if (__timeout <= 0)
    {
      testStepErrorInTestSystem(0, "1", "Unable to wait for %.3f %s. Please check input parameter.", __timeout / ((float)1000000), "ms");
    }
    else
    {
      __tt2cnt_41 = 0;
      snprintf(__cArray, elCount(__cArray), "CAN message '%s' ID = 417001888x (0x18DAF1A0x) on bus FDCAN2", "DIAGNOSTIC_RESPONSE_PAM");
      if(SetBusContextByName("FDCAN2", __eSaveCurrent, __nBusContextNew, __nBusContextOld))
        testJoinMessageEvent(`FDCAN2::`DIAGNOSTIC_RESPONSE_PAM,  __cArray,
             delegate dword(message * __m)
             {
               dword __msg_callback_ret;
               if (__tt2cnt_41 == -1)
               {
                 return 1;
               }
               __msg_callback_ret = 1;
               __tt2cnt_41++;
               if (__msg_callback_ret)
               {
                 __tt2cnt_41 = -1;
                 return 1;
               }
               return 0;
             });
      __res = testWaitForAllJoinedEventsNS(__timeout);
      if (__nInt64 != 0)
      {
        snprintf(__cArray, elCount(__cArray), "CAN message '%s' ID = 417001888x (0x18DAF1A0x) on bus FDCAN2", "DIAGNOSTIC_RESPONSE_PAM");
        if(__tt2cnt_41 == -1)
        {
          snprintf(__cArray2, 8192, "Response of %s", __cArray);
        }
        else
        {
          snprintf(__cArray2, 8192, "Response of %s (received %d times)", __cArray, __tt2cnt_41);
        }
        if (__tt2cnt_41 == 0)
        {
          testStepFail(0, "Resp1", __cArray2);
        }
        else
        {
          testStepPass(2, "Resp1", __cArray2);
        }
        __ReportRequestResponseResult(__res, 0);
      }
      ResetBusContext(__nBusContextNew, __nBusContextOld);
    }
  }
  TestCommandEnd();

}

void Tt4h42sqi_FD13_DID_with_Physical_Address()
{
  stack long __tableHandle;
  TestCommandBegin(__eDiagService, __cDiagService, "", "0");
  {
    if (DiagIsFunctionalGroup("CVADAS_0001_00000000_000"))
    {
      DiagResponse * __resp;
      DiagRequest CVADAS_0001_00000000_000._22FD13_Magna_Software_Version __req;
      __diagService4h42sqi_38(__req, __resp);
    }
    else
    {
      DiagResponse CVADAS_0001_00000000_000.* __resp;
      DiagRequest CVADAS_0001_00000000_000._22FD13_Magna_Software_Version __req;
      __diagService4h42sqi_38(__req, __resp);
    }
  }
  TestCommandEnd();


}

  
void __diagService4h42sqi_38(DiagRequest * __req, DiagResponse * __resp )
{
  stack long __tableHandle;
  long __res, __paramLen, __bytePos;

   __bVerdict = __eVerdictPass;

  do {
    TestReportResetDiagObjectList();
    DiagSetReportDetailLevel("CVADAS_0001_00000000_000", EnumServiceDetails_onfail);
    // Request aspect
    {
      {
        CheckLiteralGetStringBufferConsistency("FD13", 8192);
      snprintf(__cDiagValueArray, 8192, "%s", "FD13");
        __bDiagValueArrayCtr = __MapChar2ByteAtDiagSet(__cDiagValueArray, __bDiagValueArray);
        if (__bDiagValueArrayCtr >= 0)
        {
          __res = DiagSetParameterErrorHandled(__req, "RecordDataIdentifier", __bDiagValueArray, __bDiagValueArrayCtr);
          if(__res < 0)
          {
            __bVerdict = __eVerdictFail;
            DiagErrCodeTestStep(__res, "Cannot set diagnostic parameter 'RecordDataIdentifier'");
            break;
          }
        }
        else
        {
      	__bVerdict = __eVerdictFail;
          snprintf(__cArray2, 8192, "SetParameter: illegal byte sequence: '%s' (parameter %s). Use hex tuples like '01 AF ...'", __cDiagValueArray, "RecordDataIdentifier");
          DiagErrCodeTestStep(__bDiagValueArrayCtr, __cArray2);
          DiagErrCodeTestStep(-1, "Cannot set diagnostic parameter 'RecordDataIdentifier'");
      	break;
        }
      }

      if (0 >= DiagSendReqAndWaitForResp("CVADAS_0001_00000000_000", __req, __resp, __res, -1, -1, -1, -1, -1, EnumResult_pos, EnumServiceDetails_onfail, EnumSendingMode_physical, EnumSuppressPosResBit_asconfigured, EnumVerdictOnInvalidValues_fail))
        break;
    }

    __res = DiagErrCodeTestStep(__res, "Can't retrieve last response for request! No check possible.") < 0;
    if(__res)
    {
	  __bVerdict = __eVerdictFail;
      break;
    }
    {
      __res = DiagInterpretAs(__resp, "RDBI_PR");
      if(__res != 0)
      {
        __bVerdict = __eVerdictFail;
        DiagErrCodeTestStep(__res, "Can't interpret response as diagnostic primitive 'RDBI_PR'.");
        break;
      }
      else
      {
        TestStepPass( "Received primitive can be interpreted as diagnostic primitive 'RDBI_PR'.");
      }
    }
  }
  while(0);


  // Response, check & read aspect
  {
    __res = 1;
    __tableHandle = ReportTableHead5Columns(__cCheckCaption, __cTSym, __cTOp, __cRefVal, __cActual, __cRes);
    {
      __bDiagValueArrayCtr = DiagGetParameterErrorHandled(__resp, "RecordDataIdentifier", __bDiagValueArray, elcount(__bDiagValueArray), __cDiagValueArray, elcount(__cDiagValueArray));
      CheckLiteralGetStringBufferConsistency("FD13", 8192);
    snprintf(__cArray, 8192, "%s", "FD13");  
      __bDiagValueArrayCtr2 = __MapChar2ByteAtDiagCheck(__cArray, __bDiagValueArray2);
      snprintf(__cArray10, 8192, "%s", "FD13");
      {
        __bArrayCtr = __CopyBytes(__bDiagValueArray, __bDiagValueArrayCtr, __bArray);
        __bArrayCtr2 = __CopyBytes(__bDiagValueArray2, __bDiagValueArrayCtr2, __bArray2);
        __csr = CompareBytes(__bArray, __bArrayCtr, __bArray2, __bArrayCtr2) == 0;
        snprintf(__cArray, 8192, "%s", "Diagnostic parameter \'RecordDataIdentifier\'");
        snprintf(__cArray2, 8192, "%s", __cArray);
        snprintf(__cArray3, 8192, "%s", __cArray10);
        ReportTableRow(__tableHandle, 0, __cArray2, "Bytes", __bArray2, __bArrayCtr2, __cArray3, __oneOfFlag, __bSetInCheckAlignment);
        ReportCell(__tableHandle, __bArray, __bArrayCtr);
        ReportCellResult(__tableHandle, __csr, __ePassFail);
      }
    
      __res = __res && __csr;
    
    }
    {
      double __nDiagValue;
      DiagGetParameterErrorHandled(__resp, "Magna_Software_Version/CVADAS_DC_Applicaion_SW_Year", __nDiagValue);
      __csr = CheckSignalMatch(__nDiagValue, 24, ">=") == 1;
      snprintf(__cArray, 8192, "%s", "Diagnostic parameter \'Magna_Software_Version/CVADAS_DC_Applicaion_SW_Year\'");
      snprintf(__cArray2, 8192, "%s", __cArray);
      snprintf(__cArray3, 8192, "%s", "");
      ReportTableRow(__tableHandle, 0, __cArray2, ">=", 24, __cArray3, __oneOfFlag, __bSetInCheckAlignment);
      ReportCell(__tableHandle, __nDiagValue);
      ReportCellResult(__tableHandle, __csr, __ePassFail);
    
      __res = __res && __csr;
    
    }
    {
      double __nDiagValue;
      DiagGetParameterErrorHandled(__resp, "Magna_Software_Version/CVADAS_DC_Applicaion_SW_Week", __nDiagValue);
      __csr = CheckSignalMatch(__nDiagValue, 1, ">=") == 1;
      snprintf(__cArray, 8192, "%s", "Diagnostic parameter \'Magna_Software_Version/CVADAS_DC_Applicaion_SW_Week\'");
      snprintf(__cArray2, 8192, "%s", __cArray);
      snprintf(__cArray3, 8192, "%s", "");
      ReportTableRow(__tableHandle, 0, __cArray2, ">=", 1, __cArray3, __oneOfFlag, __bSetInCheckAlignment);
      ReportCell(__tableHandle, __nDiagValue);
      ReportCellResult(__tableHandle, __csr, __ePassFail);
    
      __res = __res && __csr;
    
    }
    {
      __bDiagValueArrayCtr = DiagGetParameterErrorHandled(__resp, "Magna_Software_Version/CVADAS_DC_Application_SW_Day_1", __bDiagValueArray, elcount(__bDiagValueArray), __cDiagValueArray, elcount(__cDiagValueArray));
      {
        __bArrayCtr = __CopyBytes(__bDiagValueArray, __bDiagValueArrayCtr, __bArray);
        CheckPlainParameterGetDataBufferConsistency(sysParGetData(syspar::`FD13_Magna_SW_Version::`App_Sw_Day, __bArray2, __bArrayCtr2), __bArrayCtr2, "syspar::`FD13_Magna_SW_Version::`App_Sw_Day");
        __csr = CompareBytes(__bArray, __bArrayCtr, __bArray2, __bArrayCtr2) == 0;
        snprintf(__cArray, 8192, "%s", "Diagnostic parameter \'Magna_Software_Version/CVADAS_DC_Application_SW_Day_1\'");
        snprintf(__cArray2, 8192, "%s", __cArray);
        snprintf(__cArray3, 8192, "%s", "App_Sw_Day");
        ReportTableRow(__tableHandle, 0, __cArray2, "Bytes", __bArray2, __bArrayCtr2, __cArray3, __oneOfFlag, __bSetInCheckAlignment);
        ReportCell(__tableHandle, __bArray, __bArrayCtr);
        ReportCellResult(__tableHandle, __csr, __ePassFail);
      }
    
      __res = __res && __csr;
    
    }
    {
      __bDiagValueArrayCtr = DiagGetParameterErrorHandled(__resp, "Magna_Software_Version/CVADAS_DC_Applicaion_SW_Build_Number", __bDiagValueArray, elcount(__bDiagValueArray), __cDiagValueArray, elcount(__cDiagValueArray));
      {
        __bArrayCtr = __CopyBytes(__bDiagValueArray, __bDiagValueArrayCtr, __bArray);
        CheckPlainParameterGetDataBufferConsistency(sysParGetData(syspar::`FD13_Magna_SW_Version::`App_Sw_Build_Number, __bArray2, __bArrayCtr2), __bArrayCtr2, "syspar::`FD13_Magna_SW_Version::`App_Sw_Build_Number");
        __csr = CompareBytes(__bArray, __bArrayCtr, __bArray2, __bArrayCtr2) == 0;
        snprintf(__cArray, 8192, "%s", "Diagnostic parameter \'Magna_Software_Version/CVADAS_DC_Applicaion_SW_Build_Number\'");
        snprintf(__cArray2, 8192, "%s", __cArray);
        snprintf(__cArray3, 8192, "%s", "App_Sw_Build_Number");
        ReportTableRow(__tableHandle, 0, __cArray2, "Bytes", __bArray2, __bArrayCtr2, __cArray3, __oneOfFlag, __bSetInCheckAlignment);
        ReportCell(__tableHandle, __bArray, __bArrayCtr);
        ReportCellResult(__tableHandle, __csr, __ePassFail);
      }
    
      __res = __res && __csr;
    
    }
    {
      double __nDiagValue;
      DiagGetParameterErrorHandled(__resp, "Magna_Software_Version/CVADAS_DC_Bootloader_SW_Year", __nDiagValue);
      __csr = CheckSignalMatch(__nDiagValue, 24, ">=") == 1;
      snprintf(__cArray, 8192, "%s", "Diagnostic parameter \'Magna_Software_Version/CVADAS_DC_Bootloader_SW_Year\'");
      snprintf(__cArray2, 8192, "%s", __cArray);
      snprintf(__cArray3, 8192, "%s", "");
      ReportTableRow(__tableHandle, 0, __cArray2, ">=", 24, __cArray3, __oneOfFlag, __bSetInCheckAlignment);
      ReportCell(__tableHandle, __nDiagValue);
      ReportCellResult(__tableHandle, __csr, __ePassFail);
    
      __res = __res && __csr;
    
    }
    {
      double __nDiagValue;
      DiagGetParameterErrorHandled(__resp, "Magna_Software_Version/CVADAS_DC_Bootloader_SW_Week", __nDiagValue);
      __csr = CheckSignalMatch(__nDiagValue, 1, ">=") == 1;
      snprintf(__cArray, 8192, "%s", "Diagnostic parameter \'Magna_Software_Version/CVADAS_DC_Bootloader_SW_Week\'");
      snprintf(__cArray2, 8192, "%s", __cArray);
      snprintf(__cArray3, 8192, "%s", "");
      ReportTableRow(__tableHandle, 0, __cArray2, ">=", 1, __cArray3, __oneOfFlag, __bSetInCheckAlignment);
      ReportCell(__tableHandle, __nDiagValue);
      ReportCellResult(__tableHandle, __csr, __ePassFail);
    
      __res = __res && __csr;
    
    }
    {
      double __nDiagValue;
      DiagGetParameterErrorHandled(__resp, "Magna_Software_Version/CVADAS_DC_Bootloader_SW_Day", __nDiagValue);
      __csr = CheckSignalMatch(__nDiagValue, 1, ">=") == 1;
      snprintf(__cArray, 8192, "%s", "Diagnostic parameter \'Magna_Software_Version/CVADAS_DC_Bootloader_SW_Day\'");
      snprintf(__cArray2, 8192, "%s", __cArray);
      snprintf(__cArray3, 8192, "%s", "");
      ReportTableRow(__tableHandle, 0, __cArray2, ">=", 1, __cArray3, __oneOfFlag, __bSetInCheckAlignment);
      ReportCell(__tableHandle, __nDiagValue);
      ReportCellResult(__tableHandle, __csr, __ePassFail);
    
      __res = __res && __csr;
    
    }
    {
      __bDiagValueArrayCtr = DiagGetParameterErrorHandled(__resp, "Magna_Software_Version/CVADAS_DC_Bootloader_SW_Build_Number", __bDiagValueArray, elcount(__bDiagValueArray), __cDiagValueArray, elcount(__cDiagValueArray));
      {
        __bArrayCtr = __CopyBytes(__bDiagValueArray, __bDiagValueArrayCtr, __bArray);
        CheckPlainParameterGetDataBufferConsistency(sysParGetData(syspar::`FD13_Magna_SW_Version::`Bootloader_Sw_Build_Number, __bArray2, __bArrayCtr2), __bArrayCtr2, "syspar::`FD13_Magna_SW_Version::`Bootloader_Sw_Build_Number");
        __csr = CompareBytes(__bArray, __bArrayCtr, __bArray2, __bArrayCtr2) == 0;
        snprintf(__cArray, 8192, "%s", "Diagnostic parameter \'Magna_Software_Version/CVADAS_DC_Bootloader_SW_Build_Number\'");
        snprintf(__cArray2, 8192, "%s", __cArray);
        snprintf(__cArray3, 8192, "%s", "Bootloader_Sw_Build_Number");
        ReportTableRow(__tableHandle, 0, __cArray2, "Bytes", __bArray2, __bArrayCtr2, __cArray3, __oneOfFlag, __bSetInCheckAlignment);
        ReportCell(__tableHandle, __bArray, __bArrayCtr);
        ReportCellResult(__tableHandle, __csr, __ePassFail);
      }
    
      __res = __res && __csr;
    
    }
    {
      __bDiagValueArrayCtr = DiagGetParameterErrorHandled(__resp, "Magna_Software_Version/CVADAS_DC_HSM_High_Security_Module_SW_Year", __bDiagValueArray, elcount(__bDiagValueArray), __cDiagValueArray, elcount(__cDiagValueArray));
      {
        __bArrayCtr = __CopyBytes(__bDiagValueArray, __bDiagValueArrayCtr, __bArray);
        CheckPlainParameterGetDataBufferConsistency(sysParGetData(syspar::`FD13_Magna_SW_Version::`HSM_Year, __bArray2, __bArrayCtr2), __bArrayCtr2, "syspar::`FD13_Magna_SW_Version::`HSM_Year");
        __csr = CompareBytes(__bArray, __bArrayCtr, __bArray2, __bArrayCtr2) == 0;
        snprintf(__cArray, 8192, "%s", "Diagnostic parameter \'Magna_Software_Version/CVADAS_DC_HSM_High_Security_Module_SW_Year\'");
        snprintf(__cArray2, 8192, "%s", __cArray);
        snprintf(__cArray3, 8192, "%s", "HSM_Year");
        ReportTableRow(__tableHandle, 0, __cArray2, "Bytes", __bArray2, __bArrayCtr2, __cArray3, __oneOfFlag, __bSetInCheckAlignment);
        ReportCell(__tableHandle, __bArray, __bArrayCtr);
        ReportCellResult(__tableHandle, __csr, __ePassFail);
      }
    
      __res = __res && __csr;
    
    }
    {
      double __nDiagValue;
      DiagGetParameterErrorHandled(__resp, "Magna_Software_Version/CVADAS_DC_HSM_High_Security_Module_SW_Week", __nDiagValue);
      __csr = CheckSignalMatch(__nDiagValue, 1, ">=") == 1;
      snprintf(__cArray, 8192, "%s", "Diagnostic parameter \'Magna_Software_Version/CVADAS_DC_HSM_High_Security_Module_SW_Week\'");
      snprintf(__cArray2, 8192, "%s", __cArray);
      snprintf(__cArray3, 8192, "%s", "");
      ReportTableRow(__tableHandle, 0, __cArray2, ">=", 1, __cArray3, __oneOfFlag, __bSetInCheckAlignment);
      ReportCell(__tableHandle, __nDiagValue);
      ReportCellResult(__tableHandle, __csr, __ePassFail);
    
      __res = __res && __csr;
    
    }
    {
      double __nDiagValue;
      DiagGetParameterErrorHandled(__resp, "Magna_Software_Version/CVADAS_DC_HSM_High_Security_Module_SW_Day", __nDiagValue);
      __csr = CheckSignalMatch(__nDiagValue, 1, ">=") == 1;
      snprintf(__cArray, 8192, "%s", "Diagnostic parameter \'Magna_Software_Version/CVADAS_DC_HSM_High_Security_Module_SW_Day\'");
      snprintf(__cArray2, 8192, "%s", __cArray);
      snprintf(__cArray3, 8192, "%s", "");
      ReportTableRow(__tableHandle, 0, __cArray2, ">=", 1, __cArray3, __oneOfFlag, __bSetInCheckAlignment);
      ReportCell(__tableHandle, __nDiagValue);
      ReportCellResult(__tableHandle, __csr, __ePassFail);
    
      __res = __res && __csr;
    
    }
    {
      __bDiagValueArrayCtr = DiagGetParameterErrorHandled(__resp, "Magna_Software_Version/CVADAS_DC_HSM_High_Security_Module_SW_Build_Number", __bDiagValueArray, elcount(__bDiagValueArray), __cDiagValueArray, elcount(__cDiagValueArray));
      {
        __bArrayCtr = __CopyBytes(__bDiagValueArray, __bDiagValueArrayCtr, __bArray);
        CheckPlainParameterGetDataBufferConsistency(sysParGetData(syspar::`FD13_Magna_SW_Version::`HSM_Build_Number, __bArray2, __bArrayCtr2), __bArrayCtr2, "syspar::`FD13_Magna_SW_Version::`HSM_Build_Number");
        __csr = CompareBytes(__bArray, __bArrayCtr, __bArray2, __bArrayCtr2) == 0;
        snprintf(__cArray, 8192, "%s", "Diagnostic parameter \'Magna_Software_Version/CVADAS_DC_HSM_High_Security_Module_SW_Build_Number\'");
        snprintf(__cArray2, 8192, "%s", __cArray);
        snprintf(__cArray3, 8192, "%s", "HSM_Build_Number");
        ReportTableRow(__tableHandle, 0, __cArray2, "Bytes", __bArray2, __bArrayCtr2, __cArray3, __oneOfFlag, __bSetInCheckAlignment);
        ReportCell(__tableHandle, __bArray, __bArrayCtr);
        ReportCellResult(__tableHandle, __csr, __ePassFail);
      }
    
      __res = __res && __csr;
    
    }
    {
      __bDiagValueArrayCtr = DiagGetParameterErrorHandled(__resp, "Magna_Software_Version/USS_Firmware_version", __bDiagValueArray, elcount(__bDiagValueArray), __cDiagValueArray, elcount(__cDiagValueArray));
      {
        __bArrayCtr = __CopyBytes(__bDiagValueArray, __bDiagValueArrayCtr, __bArray);
        CheckPlainParameterGetDataBufferConsistency(sysParGetData(syspar::`FD13_Magna_SW_Version::`USS_Firmware_Version_, __bArray2, __bArrayCtr2), __bArrayCtr2, "syspar::`FD13_Magna_SW_Version::`USS_Firmware_Version_");
        __csr = CompareBytes(__bArray, __bArrayCtr, __bArray2, __bArrayCtr2) == 0;
        snprintf(__cArray, 8192, "%s", "Diagnostic parameter \'Magna_Software_Version/USS_Firmware_version\'");
        snprintf(__cArray2, 8192, "%s", __cArray);
        snprintf(__cArray3, 8192, "%s", "USS_Firmware_Version_");
        ReportTableRow(__tableHandle, 0, __cArray2, "Bytes", __bArray2, __bArrayCtr2, __cArray3, __oneOfFlag, __bSetInCheckAlignment);
        ReportCell(__tableHandle, __bArray, __bArrayCtr);
        ReportCellResult(__tableHandle, __csr, __ePassFail);
      }
    
      __res = __res && __csr;
    
    }
    {
      __bDiagValueArrayCtr = DiagGetParameterErrorHandled(__resp, "Magna_Software_Version/USS_SW_Year", __bDiagValueArray, elcount(__bDiagValueArray), __cDiagValueArray, elcount(__cDiagValueArray));
      {
        __bArrayCtr = __CopyBytes(__bDiagValueArray, __bDiagValueArrayCtr, __bArray);
        CheckPlainParameterGetDataBufferConsistency(sysParGetData(syspar::`FD13_Magna_SW_Version::`USS_Sw_Year, __bArray2, __bArrayCtr2), __bArrayCtr2, "syspar::`FD13_Magna_SW_Version::`USS_Sw_Year");
        __csr = CompareBytes(__bArray, __bArrayCtr, __bArray2, __bArrayCtr2) == 0;
        snprintf(__cArray, 8192, "%s", "Diagnostic parameter \'Magna_Software_Version/USS_SW_Year\'");
        snprintf(__cArray2, 8192, "%s", __cArray);
        snprintf(__cArray3, 8192, "%s", "USS_Sw_Year");
        ReportTableRow(__tableHandle, 0, __cArray2, "Bytes", __bArray2, __bArrayCtr2, __cArray3, __oneOfFlag, __bSetInCheckAlignment);
        ReportCell(__tableHandle, __bArray, __bArrayCtr);
        ReportCellResult(__tableHandle, __csr, __ePassFail);
      }
    
      __res = __res && __csr;
    
    }
    {
      double __nDiagValue;
      DiagGetParameterErrorHandled(__resp, "Magna_Software_Version/USS_SW_Week", __nDiagValue);
      __csr = CheckSignalMatch(__nDiagValue, 1, ">=") == 1;
      snprintf(__cArray, 8192, "%s", "Diagnostic parameter \'Magna_Software_Version/USS_SW_Week\'");
      snprintf(__cArray2, 8192, "%s", __cArray);
      snprintf(__cArray3, 8192, "%s", "");
      ReportTableRow(__tableHandle, 0, __cArray2, ">=", 1, __cArray3, __oneOfFlag, __bSetInCheckAlignment);
      ReportCell(__tableHandle, __nDiagValue);
      ReportCellResult(__tableHandle, __csr, __ePassFail);
    
      __res = __res && __csr;
    
    }
    {
      double __nDiagValue;
      DiagGetParameterErrorHandled(__resp, "Magna_Software_Version/USS_SW_Day", __nDiagValue);
      __csr = CheckSignalMatch(__nDiagValue, 1, ">=") == 1;
      snprintf(__cArray, 8192, "%s", "Diagnostic parameter \'Magna_Software_Version/USS_SW_Day\'");
      snprintf(__cArray2, 8192, "%s", __cArray);
      snprintf(__cArray3, 8192, "%s", "");
      ReportTableRow(__tableHandle, 0, __cArray2, ">=", 1, __cArray3, __oneOfFlag, __bSetInCheckAlignment);
      ReportCell(__tableHandle, __nDiagValue);
      ReportCellResult(__tableHandle, __csr, __ePassFail);
    
      __res = __res && __csr;
    
    }
    {
      __bDiagValueArrayCtr = DiagGetParameterErrorHandled(__resp, "Magna_Software_Version/USS_SW_Build_Number", __bDiagValueArray, elcount(__bDiagValueArray), __cDiagValueArray, elcount(__cDiagValueArray));
      {
        __bArrayCtr = __CopyBytes(__bDiagValueArray, __bDiagValueArrayCtr, __bArray);
        CheckPlainParameterGetDataBufferConsistency(sysParGetData(syspar::`FD13_Magna_SW_Version::`USS_Sw_Build_Number, __bArray2, __bArrayCtr2), __bArrayCtr2, "syspar::`FD13_Magna_SW_Version::`USS_Sw_Build_Number");
        __csr = CompareBytes(__bArray, __bArrayCtr, __bArray2, __bArrayCtr2) == 0;
        snprintf(__cArray, 8192, "%s", "Diagnostic parameter \'Magna_Software_Version/USS_SW_Build_Number\'");
        snprintf(__cArray2, 8192, "%s", __cArray);
        snprintf(__cArray3, 8192, "%s", "USS_Sw_Build_Number");
        ReportTableRow(__tableHandle, 0, __cArray2, "Bytes", __bArray2, __bArrayCtr2, __cArray3, __oneOfFlag, __bSetInCheckAlignment);
        ReportCell(__tableHandle, __bArray, __bArrayCtr);
        ReportCellResult(__tableHandle, __csr, __ePassFail);
      }
    
      __res = __res && __csr;
    
    }
    {
      DiagGetParameterErrorHandled(__resp, "Magna_Software_Version/Planned_Release", __bDiagValueArray, elcount(__bDiagValueArray), __cDiagValueArray, elcount(__cDiagValueArray));
      CheckCaplGenVarStringBufferConsistency(__cDiagValueArray, 8192);
      snprintf(__cArray, 8192, "%s", __cDiagValueArray);
      CheckLiteralGetStringBufferConsistency("0", 8192);
      snprintf(__cArray2, 8192, "%s", "0");
      __csr = strncmp(__cArray, __cArray2, 8192) >= 0;
      snprintf(__cArray3, 8192, "%s", "Diagnostic parameter \'Magna_Software_Version/Planned_Release\'");
      snprintf(__cArray4, 8192, "%s", __cArray3);
      snprintf(__cArray5, 8192, "%s", "");
      ReportTableRow(__tableHandle, 0, __cArray4, ">=", __cArray2, __cArray5, __oneOfFlag, __bSetInCheckAlignment);
      ReportCell(__tableHandle, __cArray);
      ReportCellResult(__tableHandle, __csr, __ePassFail);
    
      __res = __res && __csr;
    
    }
    {
      __bDiagValueArrayCtr = DiagGetParameterErrorHandled(__resp, "Magna_Software_Version/Reserved_for_6_more_blocks_to_accommodate", __bDiagValueArray, elcount(__bDiagValueArray), __cDiagValueArray, elcount(__cDiagValueArray));
      {
        __bArrayCtr = __CopyBytes(__bDiagValueArray, __bDiagValueArrayCtr, __bArray);
        CheckPlainParameterGetDataBufferConsistency(sysParGetData(syspar::`FD13_Magna_SW_Version::`Reserved_6_Bytes, __bArray2, __bArrayCtr2), __bArrayCtr2, "syspar::`FD13_Magna_SW_Version::`Reserved_6_Bytes");
        __csr = CompareBytes(__bArray, __bArrayCtr, __bArray2, __bArrayCtr2) == 0;
        snprintf(__cArray, 8192, "%s", "Diagnostic parameter \'Magna_Software_Version/Reserved_for_6_more_blocks_to_accommodate\'");
        snprintf(__cArray2, 8192, "%s", __cArray);
        snprintf(__cArray3, 8192, "%s", "Reserved_6_Bytes");
        ReportTableRow(__tableHandle, 0, __cArray2, "Bytes", __bArray2, __bArrayCtr2, __cArray3, __oneOfFlag, __bSetInCheckAlignment);
        ReportCell(__tableHandle, __bArray, __bArrayCtr);
        ReportCellResult(__tableHandle, __csr, __ePassFail);
      }
    
      __res = __res && __csr;
    
    }
    ReportTableEndVerdict(__tableHandle, __cEvaluateResponse, __res);
	__bVerdict = __bVerdict && __res;
  }
  if (__bVerdict == __eVerdictFail)
    TestReportWriteDiagObjectList();
}

void Tt4h42sqi_FD13_DID_with_Functional_Address()
{
  stack long __tableHandle;
  TestCommandBegin(__eDiagService, __cDiagService, "", "0");
  {
    if (DiagIsFunctionalGroup("CVADAS_0001_00000000_000"))
    {
      DiagResponse * __resp;
      DiagRequest CVADAS_0001_00000000_000._22FD13_Magna_Software_Version __req;
      __diagService4h42sqi_39(__req, __resp);
    }
    else
    {
      DiagResponse CVADAS_0001_00000000_000.* __resp;
      DiagRequest CVADAS_0001_00000000_000._22FD13_Magna_Software_Version __req;
      __diagService4h42sqi_39(__req, __resp);
    }
  }
  TestCommandEnd();


}

  
void __diagService4h42sqi_39(DiagRequest * __req, DiagResponse * __resp )
{
  stack long __tableHandle;
  long __res, __paramLen, __bytePos;

   __bVerdict = __eVerdictPass;

  do {
    TestReportResetDiagObjectList();
    DiagSetReportDetailLevel("CVADAS_0001_00000000_000", EnumServiceDetails_onfail);
    // Request aspect
    {
      {
        CheckLiteralGetStringBufferConsistency("FD13", 8192);
      snprintf(__cDiagValueArray, 8192, "%s", "FD13");
        __bDiagValueArrayCtr = __MapChar2ByteAtDiagSet(__cDiagValueArray, __bDiagValueArray);
        if (__bDiagValueArrayCtr >= 0)
        {
          __res = DiagSetParameterErrorHandled(__req, "RecordDataIdentifier", __bDiagValueArray, __bDiagValueArrayCtr);
          if(__res < 0)
          {
            __bVerdict = __eVerdictFail;
            DiagErrCodeTestStep(__res, "Cannot set diagnostic parameter 'RecordDataIdentifier'");
            break;
          }
        }
        else
        {
      	__bVerdict = __eVerdictFail;
          snprintf(__cArray2, 8192, "SetParameter: illegal byte sequence: '%s' (parameter %s). Use hex tuples like '01 AF ...'", __cDiagValueArray, "RecordDataIdentifier");
          DiagErrCodeTestStep(__bDiagValueArrayCtr, __cArray2);
          DiagErrCodeTestStep(-1, "Cannot set diagnostic parameter 'RecordDataIdentifier'");
      	break;
        }
      }

      if (0 >= DiagSendReqAndWaitForResp("CVADAS_0001_00000000_000", __req, __resp, __res, -1, -1, -1, -1, -1, EnumResult_pos, EnumServiceDetails_onfail, EnumSendingMode_functional, EnumSuppressPosResBit_asconfigured, EnumVerdictOnInvalidValues_fail))
        break;
    }

    __res = DiagErrCodeTestStep(__res, "Can't retrieve last response for request! No check possible.") < 0;
    if(__res)
    {
	  __bVerdict = __eVerdictFail;
      break;
    }
    {
      __res = DiagInterpretAs(__resp, "RDBI_PR");
      if(__res != 0)
      {
        __bVerdict = __eVerdictFail;
        DiagErrCodeTestStep(__res, "Can't interpret response as diagnostic primitive 'RDBI_PR'.");
        break;
      }
      else
      {
        TestStepPass( "Received primitive can be interpreted as diagnostic primitive 'RDBI_PR'.");
      }
    }
  }
  while(0);


  // Response, check & read aspect
  {
    __res = 1;
    __tableHandle = ReportTableHead5Columns(__cCheckCaption, __cTSym, __cTOp, __cRefVal, __cActual, __cRes);
    {
      __bDiagValueArrayCtr = DiagGetParameterErrorHandled(__resp, "RecordDataIdentifier", __bDiagValueArray, elcount(__bDiagValueArray), __cDiagValueArray, elcount(__cDiagValueArray));
      CheckLiteralGetStringBufferConsistency("FD13", 8192);
    snprintf(__cArray, 8192, "%s", "FD13");  
      __bDiagValueArrayCtr2 = __MapChar2ByteAtDiagCheck(__cArray, __bDiagValueArray2);
      snprintf(__cArray10, 8192, "%s", "FD13");
      {
        __bArrayCtr = __CopyBytes(__bDiagValueArray, __bDiagValueArrayCtr, __bArray);
        __bArrayCtr2 = __CopyBytes(__bDiagValueArray2, __bDiagValueArrayCtr2, __bArray2);
        __csr = CompareBytes(__bArray, __bArrayCtr, __bArray2, __bArrayCtr2) == 0;
        snprintf(__cArray, 8192, "%s", "Diagnostic parameter \'RecordDataIdentifier\'");
        snprintf(__cArray2, 8192, "%s", __cArray);
        snprintf(__cArray3, 8192, "%s", __cArray10);
        ReportTableRow(__tableHandle, 0, __cArray2, "Bytes", __bArray2, __bArrayCtr2, __cArray3, __oneOfFlag, __bSetInCheckAlignment);
        ReportCell(__tableHandle, __bArray, __bArrayCtr);
        ReportCellResult(__tableHandle, __csr, __ePassFail);
      }
    
      __res = __res && __csr;
    
    }
    {
      __bDiagValueArrayCtr = DiagGetParameterErrorHandled(__resp, "Magna_Software_Version/CVADAS_DC_Applicaion_SW_Year", __bDiagValueArray, elcount(__bDiagValueArray), __cDiagValueArray, elcount(__cDiagValueArray));
      {
        __bArrayCtr = __CopyBytes(__bDiagValueArray, __bDiagValueArrayCtr, __bArray);
        CheckPlainParameterGetDataBufferConsistency(sysParGetData(syspar::`FD13_Magna_SW_Version::`App_Sw_Year, __bArray2, __bArrayCtr2), __bArrayCtr2, "syspar::`FD13_Magna_SW_Version::`App_Sw_Year");
        __csr = CompareBytes(__bArray, __bArrayCtr, __bArray2, __bArrayCtr2) == 0;
        snprintf(__cArray, 8192, "%s", "Diagnostic parameter \'Magna_Software_Version/CVADAS_DC_Applicaion_SW_Year\'");
        snprintf(__cArray2, 8192, "%s", __cArray);
        snprintf(__cArray3, 8192, "%s", "App_Sw_Year");
        ReportTableRow(__tableHandle, 0, __cArray2, "Bytes", __bArray2, __bArrayCtr2, __cArray3, __oneOfFlag, __bSetInCheckAlignment);
        ReportCell(__tableHandle, __bArray, __bArrayCtr);
        ReportCellResult(__tableHandle, __csr, __ePassFail);
      }
    
      __res = __res && __csr;
    
    }
    {
      __bDiagValueArrayCtr = DiagGetParameterErrorHandled(__resp, "Magna_Software_Version/CVADAS_DC_Applicaion_SW_Week", __bDiagValueArray, elcount(__bDiagValueArray), __cDiagValueArray, elcount(__cDiagValueArray));
      {
        __bArrayCtr = __CopyBytes(__bDiagValueArray, __bDiagValueArrayCtr, __bArray);
        CheckPlainParameterGetDataBufferConsistency(sysParGetData(syspar::`FD13_Magna_SW_Version::`App_Sw_Week, __bArray2, __bArrayCtr2), __bArrayCtr2, "syspar::`FD13_Magna_SW_Version::`App_Sw_Week");
        __csr = CompareBytes(__bArray, __bArrayCtr, __bArray2, __bArrayCtr2) == 0;
        snprintf(__cArray, 8192, "%s", "Diagnostic parameter \'Magna_Software_Version/CVADAS_DC_Applicaion_SW_Week\'");
        snprintf(__cArray2, 8192, "%s", __cArray);
        snprintf(__cArray3, 8192, "%s", "App_Sw_Week");
        ReportTableRow(__tableHandle, 0, __cArray2, "Bytes", __bArray2, __bArrayCtr2, __cArray3, __oneOfFlag, __bSetInCheckAlignment);
        ReportCell(__tableHandle, __bArray, __bArrayCtr);
        ReportCellResult(__tableHandle, __csr, __ePassFail);
      }
    
      __res = __res && __csr;
    
    }
    {
      __bDiagValueArrayCtr = DiagGetParameterErrorHandled(__resp, "Magna_Software_Version/CVADAS_DC_Application_SW_Day_1", __bDiagValueArray, elcount(__bDiagValueArray), __cDiagValueArray, elcount(__cDiagValueArray));
      {
        __bArrayCtr = __CopyBytes(__bDiagValueArray, __bDiagValueArrayCtr, __bArray);
        CheckPlainParameterGetDataBufferConsistency(sysParGetData(syspar::`FD13_Magna_SW_Version::`App_Sw_Day, __bArray2, __bArrayCtr2), __bArrayCtr2, "syspar::`FD13_Magna_SW_Version::`App_Sw_Day");
        __csr = CompareBytes(__bArray, __bArrayCtr, __bArray2, __bArrayCtr2) == 0;
        snprintf(__cArray, 8192, "%s", "Diagnostic parameter \'Magna_Software_Version/CVADAS_DC_Application_SW_Day_1\'");
        snprintf(__cArray2, 8192, "%s", __cArray);
        snprintf(__cArray3, 8192, "%s", "App_Sw_Day");
        ReportTableRow(__tableHandle, 0, __cArray2, "Bytes", __bArray2, __bArrayCtr2, __cArray3, __oneOfFlag, __bSetInCheckAlignment);
        ReportCell(__tableHandle, __bArray, __bArrayCtr);
        ReportCellResult(__tableHandle, __csr, __ePassFail);
      }
    
      __res = __res && __csr;
    
    }
    {
      __bDiagValueArrayCtr = DiagGetParameterErrorHandled(__resp, "Magna_Software_Version/CVADAS_DC_Applicaion_SW_Build_Number", __bDiagValueArray, elcount(__bDiagValueArray), __cDiagValueArray, elcount(__cDiagValueArray));
      {
        __bArrayCtr = __CopyBytes(__bDiagValueArray, __bDiagValueArrayCtr, __bArray);
        CheckPlainParameterGetDataBufferConsistency(sysParGetData(syspar::`FD13_Magna_SW_Version::`App_Sw_Build_Number, __bArray2, __bArrayCtr2), __bArrayCtr2, "syspar::`FD13_Magna_SW_Version::`App_Sw_Build_Number");
        __csr = CompareBytes(__bArray, __bArrayCtr, __bArray2, __bArrayCtr2) == 0;
        snprintf(__cArray, 8192, "%s", "Diagnostic parameter \'Magna_Software_Version/CVADAS_DC_Applicaion_SW_Build_Number\'");
        snprintf(__cArray2, 8192, "%s", __cArray);
        snprintf(__cArray3, 8192, "%s", "App_Sw_Build_Number");
        ReportTableRow(__tableHandle, 0, __cArray2, "Bytes", __bArray2, __bArrayCtr2, __cArray3, __oneOfFlag, __bSetInCheckAlignment);
        ReportCell(__tableHandle, __bArray, __bArrayCtr);
        ReportCellResult(__tableHandle, __csr, __ePassFail);
      }
    
      __res = __res && __csr;
    
    }
    {
      __bDiagValueArrayCtr = DiagGetParameterErrorHandled(__resp, "Magna_Software_Version/CVADAS_DC_Bootloader_SW_Year", __bDiagValueArray, elcount(__bDiagValueArray), __cDiagValueArray, elcount(__cDiagValueArray));
      {
        __bArrayCtr = __CopyBytes(__bDiagValueArray, __bDiagValueArrayCtr, __bArray);
        CheckPlainParameterGetDataBufferConsistency(sysParGetData(syspar::`FD13_Magna_SW_Version::`Bootloader_Sw_Year, __bArray2, __bArrayCtr2), __bArrayCtr2, "syspar::`FD13_Magna_SW_Version::`Bootloader_Sw_Year");
        __csr = CompareBytes(__bArray, __bArrayCtr, __bArray2, __bArrayCtr2) == 0;
        snprintf(__cArray, 8192, "%s", "Diagnostic parameter \'Magna_Software_Version/CVADAS_DC_Bootloader_SW_Year\'");
        snprintf(__cArray2, 8192, "%s", __cArray);
        snprintf(__cArray3, 8192, "%s", "Bootloader_Sw_Year");
        ReportTableRow(__tableHandle, 0, __cArray2, "Bytes", __bArray2, __bArrayCtr2, __cArray3, __oneOfFlag, __bSetInCheckAlignment);
        ReportCell(__tableHandle, __bArray, __bArrayCtr);
        ReportCellResult(__tableHandle, __csr, __ePassFail);
      }
    
      __res = __res && __csr;
    
    }
    {
      __bDiagValueArrayCtr = DiagGetParameterErrorHandled(__resp, "Magna_Software_Version/CVADAS_DC_Bootloader_SW_Week", __bDiagValueArray, elcount(__bDiagValueArray), __cDiagValueArray, elcount(__cDiagValueArray));
      {
        __bArrayCtr = __CopyBytes(__bDiagValueArray, __bDiagValueArrayCtr, __bArray);
        CheckPlainParameterGetDataBufferConsistency(sysParGetData(syspar::`FD13_Magna_SW_Version::`Bootloader_Sw_Week, __bArray2, __bArrayCtr2), __bArrayCtr2, "syspar::`FD13_Magna_SW_Version::`Bootloader_Sw_Week");
        __csr = CompareBytes(__bArray, __bArrayCtr, __bArray2, __bArrayCtr2) == 0;
        snprintf(__cArray, 8192, "%s", "Diagnostic parameter \'Magna_Software_Version/CVADAS_DC_Bootloader_SW_Week\'");
        snprintf(__cArray2, 8192, "%s", __cArray);
        snprintf(__cArray3, 8192, "%s", "Bootloader_Sw_Week");
        ReportTableRow(__tableHandle, 0, __cArray2, "Bytes", __bArray2, __bArrayCtr2, __cArray3, __oneOfFlag, __bSetInCheckAlignment);
        ReportCell(__tableHandle, __bArray, __bArrayCtr);
        ReportCellResult(__tableHandle, __csr, __ePassFail);
      }
    
      __res = __res && __csr;
    
    }
    {
      __bDiagValueArrayCtr = DiagGetParameterErrorHandled(__resp, "Magna_Software_Version/CVADAS_DC_Bootloader_SW_Day", __bDiagValueArray, elcount(__bDiagValueArray), __cDiagValueArray, elcount(__cDiagValueArray));
      {
        __bArrayCtr = __CopyBytes(__bDiagValueArray, __bDiagValueArrayCtr, __bArray);
        CheckPlainParameterGetDataBufferConsistency(sysParGetData(syspar::`FD13_Magna_SW_Version::`Bootloader_Sw_Day, __bArray2, __bArrayCtr2), __bArrayCtr2, "syspar::`FD13_Magna_SW_Version::`Bootloader_Sw_Day");
        __csr = CompareBytes(__bArray, __bArrayCtr, __bArray2, __bArrayCtr2) == 0;
        snprintf(__cArray, 8192, "%s", "Diagnostic parameter \'Magna_Software_Version/CVADAS_DC_Bootloader_SW_Day\'");
        snprintf(__cArray2, 8192, "%s", __cArray);
        snprintf(__cArray3, 8192, "%s", "Bootloader_Sw_Day");
        ReportTableRow(__tableHandle, 0, __cArray2, "Bytes", __bArray2, __bArrayCtr2, __cArray3, __oneOfFlag, __bSetInCheckAlignment);
        ReportCell(__tableHandle, __bArray, __bArrayCtr);
        ReportCellResult(__tableHandle, __csr, __ePassFail);
      }
    
      __res = __res && __csr;
    
    }
    {
      __bDiagValueArrayCtr = DiagGetParameterErrorHandled(__resp, "Magna_Software_Version/CVADAS_DC_Bootloader_SW_Build_Number", __bDiagValueArray, elcount(__bDiagValueArray), __cDiagValueArray, elcount(__cDiagValueArray));
      {
        __bArrayCtr = __CopyBytes(__bDiagValueArray, __bDiagValueArrayCtr, __bArray);
        CheckPlainParameterGetDataBufferConsistency(sysParGetData(syspar::`FD13_Magna_SW_Version::`Bootloader_Sw_Build_Number, __bArray2, __bArrayCtr2), __bArrayCtr2, "syspar::`FD13_Magna_SW_Version::`Bootloader_Sw_Build_Number");
        __csr = CompareBytes(__bArray, __bArrayCtr, __bArray2, __bArrayCtr2) == 0;
        snprintf(__cArray, 8192, "%s", "Diagnostic parameter \'Magna_Software_Version/CVADAS_DC_Bootloader_SW_Build_Number\'");
        snprintf(__cArray2, 8192, "%s", __cArray);
        snprintf(__cArray3, 8192, "%s", "Bootloader_Sw_Build_Number");
        ReportTableRow(__tableHandle, 0, __cArray2, "Bytes", __bArray2, __bArrayCtr2, __cArray3, __oneOfFlag, __bSetInCheckAlignment);
        ReportCell(__tableHandle, __bArray, __bArrayCtr);
        ReportCellResult(__tableHandle, __csr, __ePassFail);
      }
    
      __res = __res && __csr;
    
    }
    {
      __bDiagValueArrayCtr = DiagGetParameterErrorHandled(__resp, "Magna_Software_Version/CVADAS_DC_HSM_High_Security_Module_SW_Year", __bDiagValueArray, elcount(__bDiagValueArray), __cDiagValueArray, elcount(__cDiagValueArray));
      {
        __bArrayCtr = __CopyBytes(__bDiagValueArray, __bDiagValueArrayCtr, __bArray);
        CheckPlainParameterGetDataBufferConsistency(sysParGetData(syspar::`FD13_Magna_SW_Version::`HSM_Year, __bArray2, __bArrayCtr2), __bArrayCtr2, "syspar::`FD13_Magna_SW_Version::`HSM_Year");
        __csr = CompareBytes(__bArray, __bArrayCtr, __bArray2, __bArrayCtr2) == 0;
        snprintf(__cArray, 8192, "%s", "Diagnostic parameter \'Magna_Software_Version/CVADAS_DC_HSM_High_Security_Module_SW_Year\'");
        snprintf(__cArray2, 8192, "%s", __cArray);
        snprintf(__cArray3, 8192, "%s", "HSM_Year");
        ReportTableRow(__tableHandle, 0, __cArray2, "Bytes", __bArray2, __bArrayCtr2, __cArray3, __oneOfFlag, __bSetInCheckAlignment);
        ReportCell(__tableHandle, __bArray, __bArrayCtr);
        ReportCellResult(__tableHandle, __csr, __ePassFail);
      }
    
      __res = __res && __csr;
    
    }
    {
      __bDiagValueArrayCtr = DiagGetParameterErrorHandled(__resp, "Magna_Software_Version/CVADAS_DC_HSM_High_Security_Module_SW_Week", __bDiagValueArray, elcount(__bDiagValueArray), __cDiagValueArray, elcount(__cDiagValueArray));
      {
        __bArrayCtr = __CopyBytes(__bDiagValueArray, __bDiagValueArrayCtr, __bArray);
        CheckPlainParameterGetDataBufferConsistency(sysParGetData(syspar::`FD13_Magna_SW_Version::`HSM_Week, __bArray2, __bArrayCtr2), __bArrayCtr2, "syspar::`FD13_Magna_SW_Version::`HSM_Week");
        __csr = CompareBytes(__bArray, __bArrayCtr, __bArray2, __bArrayCtr2) == 0;
        snprintf(__cArray, 8192, "%s", "Diagnostic parameter \'Magna_Software_Version/CVADAS_DC_HSM_High_Security_Module_SW_Week\'");
        snprintf(__cArray2, 8192, "%s", __cArray);
        snprintf(__cArray3, 8192, "%s", "HSM_Week");
        ReportTableRow(__tableHandle, 0, __cArray2, "Bytes", __bArray2, __bArrayCtr2, __cArray3, __oneOfFlag, __bSetInCheckAlignment);
        ReportCell(__tableHandle, __bArray, __bArrayCtr);
        ReportCellResult(__tableHandle, __csr, __ePassFail);
      }
    
      __res = __res && __csr;
    
    }
    {
      __bDiagValueArrayCtr = DiagGetParameterErrorHandled(__resp, "Magna_Software_Version/CVADAS_DC_HSM_High_Security_Module_SW_Day", __bDiagValueArray, elcount(__bDiagValueArray), __cDiagValueArray, elcount(__cDiagValueArray));
      {
        __bArrayCtr = __CopyBytes(__bDiagValueArray, __bDiagValueArrayCtr, __bArray);
        CheckPlainParameterGetDataBufferConsistency(sysParGetData(syspar::`FD13_Magna_SW_Version::`HSM_Day, __bArray2, __bArrayCtr2), __bArrayCtr2, "syspar::`FD13_Magna_SW_Version::`HSM_Day");
        __csr = CompareBytes(__bArray, __bArrayCtr, __bArray2, __bArrayCtr2) == 0;
        snprintf(__cArray, 8192, "%s", "Diagnostic parameter \'Magna_Software_Version/CVADAS_DC_HSM_High_Security_Module_SW_Day\'");
        snprintf(__cArray2, 8192, "%s", __cArray);
        snprintf(__cArray3, 8192, "%s", "HSM_Day");
        ReportTableRow(__tableHandle, 0, __cArray2, "Bytes", __bArray2, __bArrayCtr2, __cArray3, __oneOfFlag, __bSetInCheckAlignment);
        ReportCell(__tableHandle, __bArray, __bArrayCtr);
        ReportCellResult(__tableHandle, __csr, __ePassFail);
      }
    
      __res = __res && __csr;
    
    }
    {
      __bDiagValueArrayCtr = DiagGetParameterErrorHandled(__resp, "Magna_Software_Version/CVADAS_DC_HSM_High_Security_Module_SW_Build_Number", __bDiagValueArray, elcount(__bDiagValueArray), __cDiagValueArray, elcount(__cDiagValueArray));
      {
        __bArrayCtr = __CopyBytes(__bDiagValueArray, __bDiagValueArrayCtr, __bArray);
        CheckPlainParameterGetDataBufferConsistency(sysParGetData(syspar::`FD13_Magna_SW_Version::`HSM_Build_Number, __bArray2, __bArrayCtr2), __bArrayCtr2, "syspar::`FD13_Magna_SW_Version::`HSM_Build_Number");
        __csr = CompareBytes(__bArray, __bArrayCtr, __bArray2, __bArrayCtr2) == 0;
        snprintf(__cArray, 8192, "%s", "Diagnostic parameter \'Magna_Software_Version/CVADAS_DC_HSM_High_Security_Module_SW_Build_Number\'");
        snprintf(__cArray2, 8192, "%s", __cArray);
        snprintf(__cArray3, 8192, "%s", "HSM_Build_Number");
        ReportTableRow(__tableHandle, 0, __cArray2, "Bytes", __bArray2, __bArrayCtr2, __cArray3, __oneOfFlag, __bSetInCheckAlignment);
        ReportCell(__tableHandle, __bArray, __bArrayCtr);
        ReportCellResult(__tableHandle, __csr, __ePassFail);
      }
    
      __res = __res && __csr;
    
    }
    {
      __bDiagValueArrayCtr = DiagGetParameterErrorHandled(__resp, "Magna_Software_Version/USS_Firmware_version", __bDiagValueArray, elcount(__bDiagValueArray), __cDiagValueArray, elcount(__cDiagValueArray));
      {
        __bArrayCtr = __CopyBytes(__bDiagValueArray, __bDiagValueArrayCtr, __bArray);
        CheckPlainParameterGetDataBufferConsistency(sysParGetData(syspar::`FD13_Magna_SW_Version::`USS_Firmware_Version_, __bArray2, __bArrayCtr2), __bArrayCtr2, "syspar::`FD13_Magna_SW_Version::`USS_Firmware_Version_");
        __csr = CompareBytes(__bArray, __bArrayCtr, __bArray2, __bArrayCtr2) == 0;
        snprintf(__cArray, 8192, "%s", "Diagnostic parameter \'Magna_Software_Version/USS_Firmware_version\'");
        snprintf(__cArray2, 8192, "%s", __cArray);
        snprintf(__cArray3, 8192, "%s", "USS_Firmware_Version_");
        ReportTableRow(__tableHandle, 0, __cArray2, "Bytes", __bArray2, __bArrayCtr2, __cArray3, __oneOfFlag, __bSetInCheckAlignment);
        ReportCell(__tableHandle, __bArray, __bArrayCtr);
        ReportCellResult(__tableHandle, __csr, __ePassFail);
      }
    
      __res = __res && __csr;
    
    }
    {
      __bDiagValueArrayCtr = DiagGetParameterErrorHandled(__resp, "Magna_Software_Version/USS_SW_Year", __bDiagValueArray, elcount(__bDiagValueArray), __cDiagValueArray, elcount(__cDiagValueArray));
      {
        __bArrayCtr = __CopyBytes(__bDiagValueArray, __bDiagValueArrayCtr, __bArray);
        CheckPlainParameterGetDataBufferConsistency(sysParGetData(syspar::`FD13_Magna_SW_Version::`USS_Sw_Year, __bArray2, __bArrayCtr2), __bArrayCtr2, "syspar::`FD13_Magna_SW_Version::`USS_Sw_Year");
        __csr = CompareBytes(__bArray, __bArrayCtr, __bArray2, __bArrayCtr2) == 0;
        snprintf(__cArray, 8192, "%s", "Diagnostic parameter \'Magna_Software_Version/USS_SW_Year\'");
        snprintf(__cArray2, 8192, "%s", __cArray);
        snprintf(__cArray3, 8192, "%s", "USS_Sw_Year");
        ReportTableRow(__tableHandle, 0, __cArray2, "Bytes", __bArray2, __bArrayCtr2, __cArray3, __oneOfFlag, __bSetInCheckAlignment);
        ReportCell(__tableHandle, __bArray, __bArrayCtr);
        ReportCellResult(__tableHandle, __csr, __ePassFail);
      }
    
      __res = __res && __csr;
    
    }
    {
      __bDiagValueArrayCtr = DiagGetParameterErrorHandled(__resp, "Magna_Software_Version/USS_SW_Week", __bDiagValueArray, elcount(__bDiagValueArray), __cDiagValueArray, elcount(__cDiagValueArray));
      {
        __bArrayCtr = __CopyBytes(__bDiagValueArray, __bDiagValueArrayCtr, __bArray);
        CheckPlainParameterGetDataBufferConsistency(sysParGetData(syspar::`FD13_Magna_SW_Version::`USS_Sw_Week, __bArray2, __bArrayCtr2), __bArrayCtr2, "syspar::`FD13_Magna_SW_Version::`USS_Sw_Week");
        __csr = CompareBytes(__bArray, __bArrayCtr, __bArray2, __bArrayCtr2) == 0;
        snprintf(__cArray, 8192, "%s", "Diagnostic parameter \'Magna_Software_Version/USS_SW_Week\'");
        snprintf(__cArray2, 8192, "%s", __cArray);
        snprintf(__cArray3, 8192, "%s", "USS_Sw_Week");
        ReportTableRow(__tableHandle, 0, __cArray2, "Bytes", __bArray2, __bArrayCtr2, __cArray3, __oneOfFlag, __bSetInCheckAlignment);
        ReportCell(__tableHandle, __bArray, __bArrayCtr);
        ReportCellResult(__tableHandle, __csr, __ePassFail);
      }
    
      __res = __res && __csr;
    
    }
    {
      double __nDiagValue;
      DiagGetParameterErrorHandled(__resp, "Magna_Software_Version/USS_SW_Day", __nDiagValue);
      __csr = CheckSignalMatch(__nDiagValue, 1, ">=") == 1;
      snprintf(__cArray, 8192, "%s", "Diagnostic parameter \'Magna_Software_Version/USS_SW_Day\'");
      snprintf(__cArray2, 8192, "%s", __cArray);
      snprintf(__cArray3, 8192, "%s", "");
      ReportTableRow(__tableHandle, 0, __cArray2, ">=", 1, __cArray3, __oneOfFlag, __bSetInCheckAlignment);
      ReportCell(__tableHandle, __nDiagValue);
      ReportCellResult(__tableHandle, __csr, __ePassFail);
    
      __res = __res && __csr;
    
    }
    {
      __bDiagValueArrayCtr = DiagGetParameterErrorHandled(__resp, "Magna_Software_Version/USS_SW_Build_Number", __bDiagValueArray, elcount(__bDiagValueArray), __cDiagValueArray, elcount(__cDiagValueArray));
      {
        __bArrayCtr = __CopyBytes(__bDiagValueArray, __bDiagValueArrayCtr, __bArray);
        CheckPlainParameterGetDataBufferConsistency(sysParGetData(syspar::`FD13_Magna_SW_Version::`USS_Sw_Build_Number, __bArray2, __bArrayCtr2), __bArrayCtr2, "syspar::`FD13_Magna_SW_Version::`USS_Sw_Build_Number");
        __csr = CompareBytes(__bArray, __bArrayCtr, __bArray2, __bArrayCtr2) == 0;
        snprintf(__cArray, 8192, "%s", "Diagnostic parameter \'Magna_Software_Version/USS_SW_Build_Number\'");
        snprintf(__cArray2, 8192, "%s", __cArray);
        snprintf(__cArray3, 8192, "%s", "USS_Sw_Build_Number");
        ReportTableRow(__tableHandle, 0, __cArray2, "Bytes", __bArray2, __bArrayCtr2, __cArray3, __oneOfFlag, __bSetInCheckAlignment);
        ReportCell(__tableHandle, __bArray, __bArrayCtr);
        ReportCellResult(__tableHandle, __csr, __ePassFail);
      }
    
      __res = __res && __csr;
    
    }
    {
      DiagGetParameterErrorHandled(__resp, "Magna_Software_Version/Planned_Release", __bDiagValueArray, elcount(__bDiagValueArray), __cDiagValueArray, elcount(__cDiagValueArray));
      CheckCaplGenVarStringBufferConsistency(__cDiagValueArray, 8192);
      snprintf(__cArray, 8192, "%s", __cDiagValueArray);
      CheckLiteralGetStringBufferConsistency("0", 8192);
      snprintf(__cArray2, 8192, "%s", "0");
      __csr = strncmp(__cArray, __cArray2, 8192) >= 0;
      snprintf(__cArray3, 8192, "%s", "Diagnostic parameter \'Magna_Software_Version/Planned_Release\'");
      snprintf(__cArray4, 8192, "%s", __cArray3);
      snprintf(__cArray5, 8192, "%s", "");
      ReportTableRow(__tableHandle, 0, __cArray4, ">=", __cArray2, __cArray5, __oneOfFlag, __bSetInCheckAlignment);
      ReportCell(__tableHandle, __cArray);
      ReportCellResult(__tableHandle, __csr, __ePassFail);
    
      __res = __res && __csr;
    
    }
    {
      __bDiagValueArrayCtr = DiagGetParameterErrorHandled(__resp, "Magna_Software_Version/Reserved_for_6_more_blocks_to_accommodate", __bDiagValueArray, elcount(__bDiagValueArray), __cDiagValueArray, elcount(__cDiagValueArray));
      {
        __bArrayCtr = __CopyBytes(__bDiagValueArray, __bDiagValueArrayCtr, __bArray);
        CheckPlainParameterGetDataBufferConsistency(sysParGetData(syspar::`FD13_Magna_SW_Version::`Reserved_6_Bytes, __bArray2, __bArrayCtr2), __bArrayCtr2, "syspar::`FD13_Magna_SW_Version::`Reserved_6_Bytes");
        __csr = CompareBytes(__bArray, __bArrayCtr, __bArray2, __bArrayCtr2) == 0;
        snprintf(__cArray, 8192, "%s", "Diagnostic parameter \'Magna_Software_Version/Reserved_for_6_more_blocks_to_accommodate\'");
        snprintf(__cArray2, 8192, "%s", __cArray);
        snprintf(__cArray3, 8192, "%s", "Reserved_6_Bytes");
        ReportTableRow(__tableHandle, 0, __cArray2, "Bytes", __bArray2, __bArrayCtr2, __cArray3, __oneOfFlag, __bSetInCheckAlignment);
        ReportCell(__tableHandle, __bArray, __bArrayCtr);
        ReportCellResult(__tableHandle, __csr, __ePassFail);
      }
    
      __res = __res && __csr;
    
    }
    ReportTableEndVerdict(__tableHandle, __cEvaluateResponse, __res);
	__bVerdict = __bVerdict && __res;
  }
  if (__bVerdict == __eVerdictFail)
    TestReportWriteDiagObjectList();
}

void Tt4h42sqi_FD13_DID_with_Standard_Physical_Address()
{
  stack long __tableHandle;
  TestCommandBegin(__eRequestResponse, __cRequestResponse, "", "0");
  {
  
    long __res;
    int64 __timeout;
    __res = 0;
    __nInt64 = 1;
    __timeout = syspar::`P2_Server * 1000000LL;
    {
    
      long __testStepInitOk;
      message `FDCAN2::`DIAGNOSTIC_REQUEST_PAM __output;
      message `FDCAN2::`DIAGNOSTIC_REQUEST_PAM __msgOrig;
      __output = __msgOrig;
      __testStepInitOk = 1;
      {
        int64 __dlc;
        __dlc = 4;
        if (__dlc >= 0 && __dlc <= (__output.EDL ? 15 : 8))
          __output.DLC = __dlc;
        else
        {
          testStepErrorInTestSystem(0, __cEmpty, "Unable to set DLC=%lld in message. Please check input parameter.", __dlc);
          __testStepInitOk = 0;
        }
      }
      if (__testStepInitOk)
      {
        snprintf(__cArray, elCount(__cArray), "CAN message '%s' ID = 416981233x (0x18DAA0F1x) on bus FDCAN2", "DIAGNOSTIC_REQUEST_PAM");
        snprintf(__cArray2, elCount(__cArray2), "Send %s", __cArray);
        __tableHandle = ReportTableHead3Columns(__cArray2, "Byte", __cTOp, __cAssigned);
        ReportByteIndex("", 0, __cArray, elCount(__cArray));
        snprintf(__cArray2, 8192, "%s", __cArray);
        snprintf(__cArray3, 8192, "%s", "");
        
        ReportTableRow(__tableHandle, 0, __cArray2, __cAOp, 0x3, __cArray3, __oneOfFlag, __bSetInCheckAlignment);
        
        if (0 >= 0 && 0 < 64)
        {
          __output.byte((word)0) = 0x3;
        }
        else
        {
          testStepErrorInTestSystem(0, __cEmpty, "Index out of range. Unable to set byte %lld in message. Please check input parameter.", (int64)0);
          __testStepInitOk = 0;
        }
        ReportByteIndex("", 1, __cArray, elCount(__cArray));
        snprintf(__cArray2, 8192, "%s", __cArray);
        snprintf(__cArray3, 8192, "%s", "");
        
        ReportTableRow(__tableHandle, 0, __cArray2, __cAOp, 0x22, __cArray3, __oneOfFlag, __bSetInCheckAlignment);
        
        if (1 >= 0 && 1 < 64)
        {
          __output.byte((word)1) = 0x22;
        }
        else
        {
          testStepErrorInTestSystem(0, __cEmpty, "Index out of range. Unable to set byte %lld in message. Please check input parameter.", (int64)1);
          __testStepInitOk = 0;
        }
        ReportByteIndex("", 2, __cArray, elCount(__cArray));
        snprintf(__cArray2, 8192, "%s", __cArray);
        snprintf(__cArray3, 8192, "%s", "");
        
        ReportTableRow(__tableHandle, 0, __cArray2, __cAOp, 0xFD, __cArray3, __oneOfFlag, __bSetInCheckAlignment);
        
        if (2 >= 0 && 2 < 64)
        {
          __output.byte((word)2) = 0xFD;
        }
        else
        {
          testStepErrorInTestSystem(0, __cEmpty, "Index out of range. Unable to set byte %lld in message. Please check input parameter.", (int64)2);
          __testStepInitOk = 0;
        }
        ReportByteIndex("", 3, __cArray, elCount(__cArray));
        snprintf(__cArray2, 8192, "%s", __cArray);
        snprintf(__cArray3, 8192, "%s", "");
        
        ReportTableRow(__tableHandle, 0, __cArray2, __cAOp, 0x13, __cArray3, __oneOfFlag, __bSetInCheckAlignment);
        
        if (3 >= 0 && 3 < 64)
        {
          __output.byte((word)3) = 0x13;
        }
        else
        {
          testStepErrorInTestSystem(0, __cEmpty, "Index out of range. Unable to set byte %lld in message. Please check input parameter.", (int64)3);
          __testStepInitOk = 0;
        }
      
        ReportTableEndTestStep(__tableHandle, "Req1");
      }
      if (__testStepInitOk)
      {
        output(__output);
      }
    }
    if (__timeout <= 0)
    {
      testStepErrorInTestSystem(0, "1", "Unable to wait for %.3f %s. Please check input parameter.", __timeout / ((float)1000000), "ms");
    }
    else
    {
      __tt2cnt_43 = 0;
      snprintf(__cArray, elCount(__cArray), "CAN message '%s' ID = 417001888x (0x18DAF1A0x) on bus FDCAN2", "DIAGNOSTIC_RESPONSE_PAM");
      if(SetBusContextByName("FDCAN2", __eSaveCurrent, __nBusContextNew, __nBusContextOld))
        testJoinMessageEvent(`FDCAN2::`DIAGNOSTIC_RESPONSE_PAM,  __cArray,
             delegate dword(message * __m)
             {
               dword __msg_callback_ret;
               if (__tt2cnt_43 == -1)
               {
                 return 1;
               }
               __msg_callback_ret = 1;
               __tt2cnt_43++;
               if (__msg_callback_ret)
               {
                 __tt2cnt_43 = -1;
                 return 1;
               }
               return 0;
             });
      __res = testWaitForAllJoinedEventsNS(__timeout);
      if (__nInt64 != 0)
      {
        snprintf(__cArray, elCount(__cArray), "CAN message '%s' ID = 417001888x (0x18DAF1A0x) on bus FDCAN2", "DIAGNOSTIC_RESPONSE_PAM");
        if(__tt2cnt_43 == -1)
        {
          snprintf(__cArray2, 8192, "Response of %s", __cArray);
        }
        else
        {
          snprintf(__cArray2, 8192, "Response of %s (received %d times)", __cArray, __tt2cnt_43);
        }
        if (__tt2cnt_43 == 0)
        {
          testStepFail(0, "Resp1", __cArray2);
        }
        else
        {
          testStepPass(2, "Resp1", __cArray2);
        }
        __ReportRequestResponseResult(__res, 0);
      }
      ResetBusContext(__nBusContextNew, __nBusContextOld);
    }
  }
  TestCommandEnd();

}

void Tt4h42sqi_F18C_DID_with_Physical_Addressing()
{
  stack long __tableHandle;
  TestCommandBegin(__eRequestResponse, __cRequestResponse, "", "0");
  {
  
    long __res;
    int64 __timeout;
    __res = 0;
    __nInt64 = 1;
    __timeout = syspar::`P2_Server * 1000000LL;
    {
    
      long __testStepInitOk;
      message `FDCAN2::`DIAGNOSTIC_REQUEST_FD_PAM __output;
      message `FDCAN2::`DIAGNOSTIC_REQUEST_FD_PAM __msgOrig;
      __output = __msgOrig;
      __testStepInitOk = 1;
      {
        int64 __dlc;
        __dlc = 4;
        if (__dlc >= 0 && __dlc <= (__output.EDL ? 15 : 8))
          __output.DLC = __dlc;
        else
        {
          testStepErrorInTestSystem(0, __cEmpty, "Unable to set DLC=%lld in message. Please check input parameter.", __dlc);
          __testStepInitOk = 0;
        }
      }
      if (__testStepInitOk)
      {
        snprintf(__cArray, elCount(__cArray), "CAN message '%s' ID = 416981234x (0x18DAA0F2x) on bus FDCAN2", "DIAGNOSTIC_REQUEST_FD_PAM");
        snprintf(__cArray2, elCount(__cArray2), "Send %s", __cArray);
        __tableHandle = ReportTableHead3Columns(__cArray2, "Byte", __cTOp, __cAssigned);
        ReportByteIndex("", 0, __cArray, elCount(__cArray));
        snprintf(__cArray2, 8192, "%s", __cArray);
        snprintf(__cArray3, 8192, "%s", "");
        
        ReportTableRow(__tableHandle, 0, __cArray2, __cAOp, 0x3, __cArray3, __oneOfFlag, __bSetInCheckAlignment);
        
        if (0 >= 0 && 0 < 64)
        {
          __output.byte((word)0) = 0x3;
        }
        else
        {
          testStepErrorInTestSystem(0, __cEmpty, "Index out of range. Unable to set byte %lld in message. Please check input parameter.", (int64)0);
          __testStepInitOk = 0;
        }
        ReportByteIndex("", 1, __cArray, elCount(__cArray));
        snprintf(__cArray2, 8192, "%s", __cArray);
        snprintf(__cArray3, 8192, "%s", "");
        
        ReportTableRow(__tableHandle, 0, __cArray2, __cAOp, 0x22, __cArray3, __oneOfFlag, __bSetInCheckAlignment);
        
        if (1 >= 0 && 1 < 64)
        {
          __output.byte((word)1) = 0x22;
        }
        else
        {
          testStepErrorInTestSystem(0, __cEmpty, "Index out of range. Unable to set byte %lld in message. Please check input parameter.", (int64)1);
          __testStepInitOk = 0;
        }
        ReportByteIndex("", 2, __cArray, elCount(__cArray));
        snprintf(__cArray2, 8192, "%s", __cArray);
        snprintf(__cArray3, 8192, "%s", "");
        
        ReportTableRow(__tableHandle, 0, __cArray2, __cAOp, 0xF1, __cArray3, __oneOfFlag, __bSetInCheckAlignment);
        
        if (2 >= 0 && 2 < 64)
        {
          __output.byte((word)2) = 0xF1;
        }
        else
        {
          testStepErrorInTestSystem(0, __cEmpty, "Index out of range. Unable to set byte %lld in message. Please check input parameter.", (int64)2);
          __testStepInitOk = 0;
        }
        ReportByteIndex("", 3, __cArray, elCount(__cArray));
        snprintf(__cArray2, 8192, "%s", __cArray);
        snprintf(__cArray3, 8192, "%s", "");
        
        ReportTableRow(__tableHandle, 0, __cArray2, __cAOp, 0x8C, __cArray3, __oneOfFlag, __bSetInCheckAlignment);
        
        if (3 >= 0 && 3 < 64)
        {
          __output.byte((word)3) = 0x8C;
        }
        else
        {
          testStepErrorInTestSystem(0, __cEmpty, "Index out of range. Unable to set byte %lld in message. Please check input parameter.", (int64)3);
          __testStepInitOk = 0;
        }
      
        ReportTableEndTestStep(__tableHandle, "Req1");
      }
      if (__testStepInitOk)
      {
        output(__output);
      }
    }
    if (__timeout <= 0)
    {
      testStepErrorInTestSystem(0, "1", "Unable to wait for %.3f %s. Please check input parameter.", __timeout / ((float)1000000), "ms");
    }
    else
    {
      __tt2cnt_45 = 0;
      snprintf(__cArray, elCount(__cArray), "CAN message '%s' ID = 417002144x (0x18DAF2A0x) on bus FDCAN2", "DIAGNOSTIC_RESPONSE_FD_PAM");
      if(SetBusContextByName("FDCAN2", __eSaveCurrent, __nBusContextNew, __nBusContextOld))
        testJoinMessageEvent(`FDCAN2::`DIAGNOSTIC_RESPONSE_FD_PAM,  __cArray,
             delegate dword(message * __m)
             {
               dword __msg_callback_ret;
               if (__tt2cnt_45 == -1)
               {
                 return 1;
               }
               __msg_callback_ret = 1;
               __tt2cnt_45++;
               if (__msg_callback_ret)
               {
                 __tt2cnt_45 = -1;
                 return 1;
               }
               return 0;
             });
      __res = testWaitForAllJoinedEventsNS(__timeout);
      if (__nInt64 != 0)
      {
        snprintf(__cArray, elCount(__cArray), "CAN message '%s' ID = 417002144x (0x18DAF2A0x) on bus FDCAN2", "DIAGNOSTIC_RESPONSE_FD_PAM");
        if(__tt2cnt_45 == -1)
        {
          snprintf(__cArray2, 8192, "Response of %s", __cArray);
        }
        else
        {
          snprintf(__cArray2, 8192, "Response of %s (received %d times)", __cArray, __tt2cnt_45);
        }
        if (__tt2cnt_45 == 0)
        {
          testStepFail(0, "Resp1", __cArray2);
        }
        else
        {
          testStepPass(2, "Resp1", __cArray2);
        }
        __ReportRequestResponseResult(__res, 0);
      }
      ResetBusContext(__nBusContextNew, __nBusContextOld);
    }
  }
  TestCommandEnd();

}

void Tt4h42sqi_F18C_DID_with_Functional_Addressing()
{
  stack long __tableHandle;
  TestCommandBegin(__eDiagService, __cDiagService, "", "0");
  {
    if (DiagIsFunctionalGroup("CVADAS_0001_00000000_000"))
    {
      DiagResponse * __resp;
      DiagRequest CVADAS_0001_00000000_000._22F18C_ECU_Serial_Number __req;
      __diagService4h42sqi_40(__req, __resp);
    }
    else
    {
      DiagResponse CVADAS_0001_00000000_000.* __resp;
      DiagRequest CVADAS_0001_00000000_000._22F18C_ECU_Serial_Number __req;
      __diagService4h42sqi_40(__req, __resp);
    }
  }
  TestCommandEnd();


}

  
void __diagService4h42sqi_40(DiagRequest * __req, DiagResponse * __resp )
{
  stack long __tableHandle;
  long __res, __paramLen, __bytePos;

   __bVerdict = __eVerdictPass;

  do {
    TestReportResetDiagObjectList();
    DiagSetReportDetailLevel("CVADAS_0001_00000000_000", EnumServiceDetails_onfail);
    // Request aspect
    {

      if (0 >= DiagSendReqAndWaitForResp("CVADAS_0001_00000000_000", __req, __resp, __res, -1, -1, -1, -1, -1, EnumResult_pos, EnumServiceDetails_onfail, EnumSendingMode_functional, EnumSuppressPosResBit_asconfigured, EnumVerdictOnInvalidValues_fail))
        break;
    }

    __res = DiagErrCodeTestStep(__res, "Can't retrieve last response for request! No check possible.") < 0;
    if(__res)
    {
	  __bVerdict = __eVerdictFail;
      break;
    }
    {
      __res = DiagInterpretAs(__resp, "RDBI_PR");
      if(__res != 0)
      {
        __bVerdict = __eVerdictFail;
        DiagErrCodeTestStep(__res, "Can't interpret response as diagnostic primitive 'RDBI_PR'.");
        break;
      }
      else
      {
        TestStepPass( "Received primitive can be interpreted as diagnostic primitive 'RDBI_PR'.");
      }
    }
  }
  while(0);


  if (__bVerdict == __eVerdictFail)
    TestReportWriteDiagObjectList();
}

void Tt4h42sqi_F192_DID_with_Physical_Addressing()
{
  stack long __tableHandle;
  TestCommandBegin(__eDiagService, __cDiagService, "", "0");
  {
    if (DiagIsFunctionalGroup("CVADAS_0001_00000000_000"))
    {
      DiagResponse * __resp;
      DiagRequest CVADAS_0001_00000000_000._22F192_Supplier_ECU_Hardware_Part_Number __req;
      __diagService4h42sqi_41(__req, __resp);
    }
    else
    {
      DiagResponse CVADAS_0001_00000000_000.* __resp;
      DiagRequest CVADAS_0001_00000000_000._22F192_Supplier_ECU_Hardware_Part_Number __req;
      __diagService4h42sqi_41(__req, __resp);
    }
  }
  TestCommandEnd();


}

  
void __diagService4h42sqi_41(DiagRequest * __req, DiagResponse * __resp )
{
  stack long __tableHandle;
  long __res, __paramLen, __bytePos;

   __bVerdict = __eVerdictPass;

  do {
    TestReportResetDiagObjectList();
    DiagSetReportDetailLevel("CVADAS_0001_00000000_000", EnumServiceDetails_never);
    // Request aspect
    {
      {
        CheckLiteralGetStringBufferConsistency("F192", 8192);
      snprintf(__cDiagValueArray, 8192, "%s", "F192");
        __bDiagValueArrayCtr = __MapChar2ByteAtDiagSet(__cDiagValueArray, __bDiagValueArray);
        if (__bDiagValueArrayCtr >= 0)
        {
          __res = DiagSetParameterErrorHandled(__req, "RecordDataIdentifier", __bDiagValueArray, __bDiagValueArrayCtr);
          if(__res < 0)
          {
            __bVerdict = __eVerdictFail;
            DiagErrCodeTestStep(__res, "Cannot set diagnostic parameter 'RecordDataIdentifier'");
            break;
          }
        }
        else
        {
      	__bVerdict = __eVerdictFail;
          snprintf(__cArray2, 8192, "SetParameter: illegal byte sequence: '%s' (parameter %s). Use hex tuples like '01 AF ...'", __cDiagValueArray, "RecordDataIdentifier");
          DiagErrCodeTestStep(__bDiagValueArrayCtr, __cArray2);
          DiagErrCodeTestStep(-1, "Cannot set diagnostic parameter 'RecordDataIdentifier'");
      	break;
        }
      }

      if (0 >= DiagSendReqAndWaitForResp("CVADAS_0001_00000000_000", __req, __resp, __res, -1, -1, -1, -1, -1, EnumResult_pos, EnumServiceDetails_never, EnumSendingMode_physical, EnumSuppressPosResBit_asconfigured, EnumVerdictOnInvalidValues_fail))
        break;
    }

    __res = DiagErrCodeTestStep(__res, "Can't retrieve last response for request! No check possible.") < 0;
    if(__res)
    {
	  __bVerdict = __eVerdictFail;
      break;
    }
    {
      __res = DiagInterpretAs(__resp, "RDBI_PR");
      if(__res != 0)
      {
        __bVerdict = __eVerdictFail;
        DiagErrCodeTestStep(__res, "Can't interpret response as diagnostic primitive 'RDBI_PR'.");
        break;
      }
      else
      {
        TestStepPass( "Received primitive can be interpreted as diagnostic primitive 'RDBI_PR'.");
      }
    }
  }
  while(0);


  if (__bVerdict == __eVerdictFail)
    TestReportWriteDiagObjectList();
}

void Tt4h42sqi_F193_DID_with_Physical_Addressing()
{
  stack long __tableHandle;
  TestCommandBegin(__eDiagService, __cDiagService, "", "0");
  {
    if (DiagIsFunctionalGroup("CVADAS_0001_00000000_000"))
    {
      DiagResponse * __resp;
      DiagRequest CVADAS_0001_00000000_000._22F193_Supplier_ECU_Hardware_Version_Number __req;
      __diagService4h42sqi_42(__req, __resp);
    }
    else
    {
      DiagResponse CVADAS_0001_00000000_000.* __resp;
      DiagRequest CVADAS_0001_00000000_000._22F193_Supplier_ECU_Hardware_Version_Number __req;
      __diagService4h42sqi_42(__req, __resp);
    }
  }
  TestCommandEnd();


}

  
void __diagService4h42sqi_42(DiagRequest * __req, DiagResponse * __resp )
{
  stack long __tableHandle;
  long __res, __paramLen, __bytePos;

   __bVerdict = __eVerdictPass;

  do {
    TestReportResetDiagObjectList();
    DiagSetReportDetailLevel("CVADAS_0001_00000000_000", EnumServiceDetails_onfail);
    // Request aspect
    {
      {
        CheckLiteralGetStringBufferConsistency("F193", 8192);
      snprintf(__cDiagValueArray, 8192, "%s", "F193");
        __bDiagValueArrayCtr = __MapChar2ByteAtDiagSet(__cDiagValueArray, __bDiagValueArray);
        if (__bDiagValueArrayCtr >= 0)
        {
          __res = DiagSetParameterErrorHandled(__req, "RecordDataIdentifier", __bDiagValueArray, __bDiagValueArrayCtr);
          if(__res < 0)
          {
            __bVerdict = __eVerdictFail;
            DiagErrCodeTestStep(__res, "Cannot set diagnostic parameter 'RecordDataIdentifier'");
            break;
          }
        }
        else
        {
      	__bVerdict = __eVerdictFail;
          snprintf(__cArray2, 8192, "SetParameter: illegal byte sequence: '%s' (parameter %s). Use hex tuples like '01 AF ...'", __cDiagValueArray, "RecordDataIdentifier");
          DiagErrCodeTestStep(__bDiagValueArrayCtr, __cArray2);
          DiagErrCodeTestStep(-1, "Cannot set diagnostic parameter 'RecordDataIdentifier'");
      	break;
        }
      }

      if (0 >= DiagSendReqAndWaitForResp("CVADAS_0001_00000000_000", __req, __resp, __res, -1, -1, -1, -1, -1, EnumResult_pos, EnumServiceDetails_onfail, EnumSendingMode_physical, EnumSuppressPosResBit_asconfigured, EnumVerdictOnInvalidValues_fail))
        break;
    }

    __res = DiagErrCodeTestStep(__res, "Can't retrieve last response for request! No check possible.") < 0;
    if(__res)
    {
	  __bVerdict = __eVerdictFail;
      break;
    }
    {
      __res = DiagInterpretAs(__resp, "RDBI_PR");
      if(__res != 0)
      {
        __bVerdict = __eVerdictFail;
        DiagErrCodeTestStep(__res, "Can't interpret response as diagnostic primitive 'RDBI_PR'.");
        break;
      }
      else
      {
        TestStepPass( "Received primitive can be interpreted as diagnostic primitive 'RDBI_PR'.");
      }
    }
  }
  while(0);


  if (__bVerdict == __eVerdictFail)
    TestReportWriteDiagObjectList();
}

void Tt4h42sqi_FD15_DID_with_Physical_Address()
{
  stack long __tableHandle;
  TestCommandBegin(__eDiagService, __cDiagService, "", "0");
  {
    if (DiagIsFunctionalGroup("CVADAS_0001_00000000_000"))
    {
      DiagResponse * __resp;
      DiagRequest CVADAS_0001_00000000_000._22FD15_Magna_Production_HW_Number_Read __req;
      __diagService4h42sqi_43(__req, __resp);
    }
    else
    {
      DiagResponse CVADAS_0001_00000000_000.* __resp;
      DiagRequest CVADAS_0001_00000000_000._22FD15_Magna_Production_HW_Number_Read __req;
      __diagService4h42sqi_43(__req, __resp);
    }
  }
  TestCommandEnd();


}

  
void __diagService4h42sqi_43(DiagRequest * __req, DiagResponse * __resp )
{
  stack long __tableHandle;
  long __res, __paramLen, __bytePos;

   __bVerdict = __eVerdictPass;

  do {
    TestReportResetDiagObjectList();
    DiagSetReportDetailLevel("CVADAS_0001_00000000_000", EnumServiceDetails_onfail);
    // Request aspect
    {
      {
        CheckLiteralGetStringBufferConsistency("FD15", 8192);
      snprintf(__cDiagValueArray, 8192, "%s", "FD15");
        __bDiagValueArrayCtr = __MapChar2ByteAtDiagSet(__cDiagValueArray, __bDiagValueArray);
        if (__bDiagValueArrayCtr >= 0)
        {
          __res = DiagSetParameterErrorHandled(__req, "RecordDataIdentifier", __bDiagValueArray, __bDiagValueArrayCtr);
          if(__res < 0)
          {
            __bVerdict = __eVerdictFail;
            DiagErrCodeTestStep(__res, "Cannot set diagnostic parameter 'RecordDataIdentifier'");
            break;
          }
        }
        else
        {
      	__bVerdict = __eVerdictFail;
          snprintf(__cArray2, 8192, "SetParameter: illegal byte sequence: '%s' (parameter %s). Use hex tuples like '01 AF ...'", __cDiagValueArray, "RecordDataIdentifier");
          DiagErrCodeTestStep(__bDiagValueArrayCtr, __cArray2);
          DiagErrCodeTestStep(-1, "Cannot set diagnostic parameter 'RecordDataIdentifier'");
      	break;
        }
      }

      if (0 >= DiagSendReqAndWaitForResp("CVADAS_0001_00000000_000", __req, __resp, __res, -1, -1, -1, -1, -1, EnumResult_pos, EnumServiceDetails_onfail, EnumSendingMode_physical, EnumSuppressPosResBit_asconfigured, EnumVerdictOnInvalidValues_fail))
        break;
    }

    __res = DiagErrCodeTestStep(__res, "Can't retrieve last response for request! No check possible.") < 0;
    if(__res)
    {
	  __bVerdict = __eVerdictFail;
      break;
    }
    {
      __res = DiagInterpretAs(__resp, "RDBI_PR");
      if(__res != 0)
      {
        __bVerdict = __eVerdictFail;
        DiagErrCodeTestStep(__res, "Can't interpret response as diagnostic primitive 'RDBI_PR'.");
        break;
      }
      else
      {
        TestStepPass( "Received primitive can be interpreted as diagnostic primitive 'RDBI_PR'.");
      }
    }
  }
  while(0);


  if (__bVerdict == __eVerdictFail)
    TestReportWriteDiagObjectList();
}

void Tt4h42sqi_FD15_DID_with_Standard_Physical_Address()
{
  stack long __tableHandle;
  TestCommandBegin(__eRequestResponse, __cRequestResponse, "", "0");
  {
  
    long __res;
    int64 __timeout;
    __res = 0;
    __nInt64 = 1;
    __timeout = syspar::`P2_Server * 1000000LL;
    {
    
      long __testStepInitOk;
      message `FDCAN2::`DIAGNOSTIC_REQUEST_PAM __output;
      message `FDCAN2::`DIAGNOSTIC_REQUEST_PAM __msgOrig;
      __output = __msgOrig;
      __testStepInitOk = 1;
      {
        int64 __dlc;
        __dlc = 4;
        if (__dlc >= 0 && __dlc <= (__output.EDL ? 15 : 8))
          __output.DLC = __dlc;
        else
        {
          testStepErrorInTestSystem(0, __cEmpty, "Unable to set DLC=%lld in message. Please check input parameter.", __dlc);
          __testStepInitOk = 0;
        }
      }
      if (__testStepInitOk)
      {
        snprintf(__cArray, elCount(__cArray), "CAN message '%s' ID = 416981233x (0x18DAA0F1x) on bus FDCAN2", "DIAGNOSTIC_REQUEST_PAM");
        snprintf(__cArray2, elCount(__cArray2), "Send %s", __cArray);
        __tableHandle = ReportTableHead3Columns(__cArray2, "Byte", __cTOp, __cAssigned);
        ReportByteIndex("", 0, __cArray, elCount(__cArray));
        snprintf(__cArray2, 8192, "%s", __cArray);
        snprintf(__cArray3, 8192, "%s", "");
        
        ReportTableRow(__tableHandle, 0, __cArray2, __cAOp, 0x3, __cArray3, __oneOfFlag, __bSetInCheckAlignment);
        
        if (0 >= 0 && 0 < 64)
        {
          __output.byte((word)0) = 0x3;
        }
        else
        {
          testStepErrorInTestSystem(0, __cEmpty, "Index out of range. Unable to set byte %lld in message. Please check input parameter.", (int64)0);
          __testStepInitOk = 0;
        }
        ReportByteIndex("", 1, __cArray, elCount(__cArray));
        snprintf(__cArray2, 8192, "%s", __cArray);
        snprintf(__cArray3, 8192, "%s", "");
        
        ReportTableRow(__tableHandle, 0, __cArray2, __cAOp, 0x22, __cArray3, __oneOfFlag, __bSetInCheckAlignment);
        
        if (1 >= 0 && 1 < 64)
        {
          __output.byte((word)1) = 0x22;
        }
        else
        {
          testStepErrorInTestSystem(0, __cEmpty, "Index out of range. Unable to set byte %lld in message. Please check input parameter.", (int64)1);
          __testStepInitOk = 0;
        }
        ReportByteIndex("", 2, __cArray, elCount(__cArray));
        snprintf(__cArray2, 8192, "%s", __cArray);
        snprintf(__cArray3, 8192, "%s", "");
        
        ReportTableRow(__tableHandle, 0, __cArray2, __cAOp, 0xFD, __cArray3, __oneOfFlag, __bSetInCheckAlignment);
        
        if (2 >= 0 && 2 < 64)
        {
          __output.byte((word)2) = 0xFD;
        }
        else
        {
          testStepErrorInTestSystem(0, __cEmpty, "Index out of range. Unable to set byte %lld in message. Please check input parameter.", (int64)2);
          __testStepInitOk = 0;
        }
        ReportByteIndex("", 3, __cArray, elCount(__cArray));
        snprintf(__cArray2, 8192, "%s", __cArray);
        snprintf(__cArray3, 8192, "%s", "");
        
        ReportTableRow(__tableHandle, 0, __cArray2, __cAOp, 0x15, __cArray3, __oneOfFlag, __bSetInCheckAlignment);
        
        if (3 >= 0 && 3 < 64)
        {
          __output.byte((word)3) = 0x15;
        }
        else
        {
          testStepErrorInTestSystem(0, __cEmpty, "Index out of range. Unable to set byte %lld in message. Please check input parameter.", (int64)3);
          __testStepInitOk = 0;
        }
      
        ReportTableEndTestStep(__tableHandle, "Req1");
      }
      if (__testStepInitOk)
      {
        output(__output);
      }
    }
    if (__timeout <= 0)
    {
      testStepErrorInTestSystem(0, "1", "Unable to wait for %.3f %s. Please check input parameter.", __timeout / ((float)1000000), "ms");
    }
    else
    {
      __tt2cnt_47 = 0;
      snprintf(__cArray, elCount(__cArray), "CAN message '%s' ID = 417001888x (0x18DAF1A0x) on bus FDCAN2", "DIAGNOSTIC_RESPONSE_PAM");
      if(SetBusContextByName("FDCAN2", __eSaveCurrent, __nBusContextNew, __nBusContextOld))
        testJoinMessageEvent(`FDCAN2::`DIAGNOSTIC_RESPONSE_PAM,  __cArray,
             delegate dword(message * __m)
             {
               dword __msg_callback_ret;
               if (__tt2cnt_47 == -1)
               {
                 return 1;
               }
               __msg_callback_ret = 1;
               __tt2cnt_47++;
               if (__msg_callback_ret)
               {
                 __tt2cnt_47 = -1;
                 return 1;
               }
               return 0;
             });
      __res = testWaitForAllJoinedEventsNS(__timeout);
      if (__nInt64 != 0)
      {
        snprintf(__cArray, elCount(__cArray), "CAN message '%s' ID = 417001888x (0x18DAF1A0x) on bus FDCAN2", "DIAGNOSTIC_RESPONSE_PAM");
        if(__tt2cnt_47 == -1)
        {
          snprintf(__cArray2, 8192, "Response of %s", __cArray);
        }
        else
        {
          snprintf(__cArray2, 8192, "Response of %s (received %d times)", __cArray, __tt2cnt_47);
        }
        if (__tt2cnt_47 == 0)
        {
          testStepFail(0, "Resp1", __cArray2);
        }
        else
        {
          testStepPass(2, "Resp1", __cArray2);
        }
        __ReportRequestResponseResult(__res, 0);
      }
      ResetBusContext(__nBusContextNew, __nBusContextOld);
    }
  }
  TestCommandEnd();

}

void Tt4h42sqi_FD17_DID_with_Physical_Address()
{
  stack long __tableHandle;
  TestCommandBegin(__eDiagService, __cDiagService, "", "0");
  {
    if (DiagIsFunctionalGroup("CVADAS_0001_00000000_000"))
    {
      DiagResponse * __resp;
      DiagRequest CVADAS_0001_00000000_000._22FD17_Magna_Production_HW_Version_information_Read __req;
      __diagService4h42sqi_44(__req, __resp);
    }
    else
    {
      DiagResponse CVADAS_0001_00000000_000.* __resp;
      DiagRequest CVADAS_0001_00000000_000._22FD17_Magna_Production_HW_Version_information_Read __req;
      __diagService4h42sqi_44(__req, __resp);
    }
  }
  TestCommandEnd();


}

  
void __diagService4h42sqi_44(DiagRequest * __req, DiagResponse * __resp )
{
  stack long __tableHandle;
  long __res, __paramLen, __bytePos;

   __bVerdict = __eVerdictPass;

  do {
    TestReportResetDiagObjectList();
    DiagSetReportDetailLevel("CVADAS_0001_00000000_000", EnumServiceDetails_onfail);
    // Request aspect
    {
      {
        CheckLiteralGetStringBufferConsistency("FD17", 8192);
      snprintf(__cDiagValueArray, 8192, "%s", "FD17");
        __bDiagValueArrayCtr = __MapChar2ByteAtDiagSet(__cDiagValueArray, __bDiagValueArray);
        if (__bDiagValueArrayCtr >= 0)
        {
          __res = DiagSetParameterErrorHandled(__req, "RecordDataIdentifier", __bDiagValueArray, __bDiagValueArrayCtr);
          if(__res < 0)
          {
            __bVerdict = __eVerdictFail;
            DiagErrCodeTestStep(__res, "Cannot set diagnostic parameter 'RecordDataIdentifier'");
            break;
          }
        }
        else
        {
      	__bVerdict = __eVerdictFail;
          snprintf(__cArray2, 8192, "SetParameter: illegal byte sequence: '%s' (parameter %s). Use hex tuples like '01 AF ...'", __cDiagValueArray, "RecordDataIdentifier");
          DiagErrCodeTestStep(__bDiagValueArrayCtr, __cArray2);
          DiagErrCodeTestStep(-1, "Cannot set diagnostic parameter 'RecordDataIdentifier'");
      	break;
        }
      }

      if (0 >= DiagSendReqAndWaitForResp("CVADAS_0001_00000000_000", __req, __resp, __res, -1, -1, -1, -1, -1, EnumResult_pos, EnumServiceDetails_onfail, EnumSendingMode_physical, EnumSuppressPosResBit_asconfigured, EnumVerdictOnInvalidValues_fail))
        break;
    }

    __res = DiagErrCodeTestStep(__res, "Can't retrieve last response for request! No check possible.") < 0;
    if(__res)
    {
	  __bVerdict = __eVerdictFail;
      break;
    }
    {
      __res = DiagInterpretAs(__resp, "RDBI_PR");
      if(__res != 0)
      {
        __bVerdict = __eVerdictFail;
        DiagErrCodeTestStep(__res, "Can't interpret response as diagnostic primitive 'RDBI_PR'.");
        break;
      }
      else
      {
        TestStepPass( "Received primitive can be interpreted as diagnostic primitive 'RDBI_PR'.");
      }
    }
  }
  while(0);


  if (__bVerdict == __eVerdictFail)
    TestReportWriteDiagObjectList();
}

void Tt4h42sqi_FD17_DID_with_Standard_Physical_Address()
{
  stack long __tableHandle;
  TestCommandBegin(__eRequestResponse, __cRequestResponse, "", "0");
  {
  
    long __res;
    int64 __timeout;
    __res = 0;
    __nInt64 = 1;
    __timeout = syspar::`P2_Server * 1000000LL;
    {
    
      long __testStepInitOk;
      message `FDCAN2::`DIAGNOSTIC_REQUEST_PAM __output;
      message `FDCAN2::`DIAGNOSTIC_REQUEST_PAM __msgOrig;
      __output = __msgOrig;
      __testStepInitOk = 1;
      {
        int64 __dlc;
        __dlc = 4;
        if (__dlc >= 0 && __dlc <= (__output.EDL ? 15 : 8))
          __output.DLC = __dlc;
        else
        {
          testStepErrorInTestSystem(0, __cEmpty, "Unable to set DLC=%lld in message. Please check input parameter.", __dlc);
          __testStepInitOk = 0;
        }
      }
      if (__testStepInitOk)
      {
        snprintf(__cArray, elCount(__cArray), "CAN message '%s' ID = 416981233x (0x18DAA0F1x) on bus FDCAN2", "DIAGNOSTIC_REQUEST_PAM");
        snprintf(__cArray2, elCount(__cArray2), "Send %s", __cArray);
        __tableHandle = ReportTableHead3Columns(__cArray2, "Byte", __cTOp, __cAssigned);
        ReportByteIndex("", 0, __cArray, elCount(__cArray));
        snprintf(__cArray2, 8192, "%s", __cArray);
        snprintf(__cArray3, 8192, "%s", "");
        
        ReportTableRow(__tableHandle, 0, __cArray2, __cAOp, 0x3, __cArray3, __oneOfFlag, __bSetInCheckAlignment);
        
        if (0 >= 0 && 0 < 64)
        {
          __output.byte((word)0) = 0x3;
        }
        else
        {
          testStepErrorInTestSystem(0, __cEmpty, "Index out of range. Unable to set byte %lld in message. Please check input parameter.", (int64)0);
          __testStepInitOk = 0;
        }
        ReportByteIndex("", 1, __cArray, elCount(__cArray));
        snprintf(__cArray2, 8192, "%s", __cArray);
        snprintf(__cArray3, 8192, "%s", "");
        
        ReportTableRow(__tableHandle, 0, __cArray2, __cAOp, 0x22, __cArray3, __oneOfFlag, __bSetInCheckAlignment);
        
        if (1 >= 0 && 1 < 64)
        {
          __output.byte((word)1) = 0x22;
        }
        else
        {
          testStepErrorInTestSystem(0, __cEmpty, "Index out of range. Unable to set byte %lld in message. Please check input parameter.", (int64)1);
          __testStepInitOk = 0;
        }
        ReportByteIndex("", 2, __cArray, elCount(__cArray));
        snprintf(__cArray2, 8192, "%s", __cArray);
        snprintf(__cArray3, 8192, "%s", "");
        
        ReportTableRow(__tableHandle, 0, __cArray2, __cAOp, 0xFD, __cArray3, __oneOfFlag, __bSetInCheckAlignment);
        
        if (2 >= 0 && 2 < 64)
        {
          __output.byte((word)2) = 0xFD;
        }
        else
        {
          testStepErrorInTestSystem(0, __cEmpty, "Index out of range. Unable to set byte %lld in message. Please check input parameter.", (int64)2);
          __testStepInitOk = 0;
        }
        ReportByteIndex("", 3, __cArray, elCount(__cArray));
        snprintf(__cArray2, 8192, "%s", __cArray);
        snprintf(__cArray3, 8192, "%s", "");
        
        ReportTableRow(__tableHandle, 0, __cArray2, __cAOp, 0x17, __cArray3, __oneOfFlag, __bSetInCheckAlignment);
        
        if (3 >= 0 && 3 < 64)
        {
          __output.byte((word)3) = 0x17;
        }
        else
        {
          testStepErrorInTestSystem(0, __cEmpty, "Index out of range. Unable to set byte %lld in message. Please check input parameter.", (int64)3);
          __testStepInitOk = 0;
        }
      
        ReportTableEndTestStep(__tableHandle, "Req1");
      }
      if (__testStepInitOk)
      {
        output(__output);
      }
    }
    if (__timeout <= 0)
    {
      testStepErrorInTestSystem(0, "1", "Unable to wait for %.3f %s. Please check input parameter.", __timeout / ((float)1000000), "ms");
    }
    else
    {
      __tt2cnt_49 = 0;
      snprintf(__cArray, elCount(__cArray), "CAN message '%s' ID = 417001888x (0x18DAF1A0x) on bus FDCAN2", "DIAGNOSTIC_RESPONSE_PAM");
      if(SetBusContextByName("FDCAN2", __eSaveCurrent, __nBusContextNew, __nBusContextOld))
        testJoinMessageEvent(`FDCAN2::`DIAGNOSTIC_RESPONSE_PAM,  __cArray,
             delegate dword(message * __m)
             {
               dword __msg_callback_ret;
               if (__tt2cnt_49 == -1)
               {
                 return 1;
               }
               __msg_callback_ret = 1;
               __tt2cnt_49++;
               if (__msg_callback_ret)
               {
                 __tt2cnt_49 = -1;
                 return 1;
               }
               return 0;
             });
      __res = testWaitForAllJoinedEventsNS(__timeout);
      if (__nInt64 != 0)
      {
        snprintf(__cArray, elCount(__cArray), "CAN message '%s' ID = 417001888x (0x18DAF1A0x) on bus FDCAN2", "DIAGNOSTIC_RESPONSE_PAM");
        if(__tt2cnt_49 == -1)
        {
          snprintf(__cArray2, 8192, "Response of %s", __cArray);
        }
        else
        {
          snprintf(__cArray2, 8192, "Response of %s (received %d times)", __cArray, __tt2cnt_49);
        }
        if (__tt2cnt_49 == 0)
        {
          testStepFail(0, "Resp1", __cArray2);
        }
        else
        {
          testStepPass(2, "Resp1", __cArray2);
        }
        __ReportRequestResponseResult(__res, 0);
      }
      ResetBusContext(__nBusContextNew, __nBusContextOld);
    }
  }
  TestCommandEnd();

}

void Tt4h42sqi_FD16_DID_with_Physical_Address()
{
  stack long __tableHandle;
  TestCommandBegin(__eDiagService, __cDiagService, "", "0");
  {
    if (DiagIsFunctionalGroup("CVADAS_0001_00000000_000"))
    {
      DiagResponse * __resp;
      DiagRequest CVADAS_0001_00000000_000._22FD16_Magna_Production_ICT_Data_Read __req;
      __diagService4h42sqi_45(__req, __resp);
    }
    else
    {
      DiagResponse CVADAS_0001_00000000_000.* __resp;
      DiagRequest CVADAS_0001_00000000_000._22FD16_Magna_Production_ICT_Data_Read __req;
      __diagService4h42sqi_45(__req, __resp);
    }
  }
  TestCommandEnd();


}

  
void __diagService4h42sqi_45(DiagRequest * __req, DiagResponse * __resp )
{
  stack long __tableHandle;
  long __res, __paramLen, __bytePos;

   __bVerdict = __eVerdictPass;

  do {
    TestReportResetDiagObjectList();
    DiagSetReportDetailLevel("CVADAS_0001_00000000_000", EnumServiceDetails_onfail);
    // Request aspect
    {
      {
        CheckLiteralGetStringBufferConsistency("FD16", 8192);
      snprintf(__cDiagValueArray, 8192, "%s", "FD16");
        __bDiagValueArrayCtr = __MapChar2ByteAtDiagSet(__cDiagValueArray, __bDiagValueArray);
        if (__bDiagValueArrayCtr >= 0)
        {
          __res = DiagSetParameterErrorHandled(__req, "RecordDataIdentifier", __bDiagValueArray, __bDiagValueArrayCtr);
          if(__res < 0)
          {
            __bVerdict = __eVerdictFail;
            DiagErrCodeTestStep(__res, "Cannot set diagnostic parameter 'RecordDataIdentifier'");
            break;
          }
        }
        else
        {
      	__bVerdict = __eVerdictFail;
          snprintf(__cArray2, 8192, "SetParameter: illegal byte sequence: '%s' (parameter %s). Use hex tuples like '01 AF ...'", __cDiagValueArray, "RecordDataIdentifier");
          DiagErrCodeTestStep(__bDiagValueArrayCtr, __cArray2);
          DiagErrCodeTestStep(-1, "Cannot set diagnostic parameter 'RecordDataIdentifier'");
      	break;
        }
      }

      if (0 >= DiagSendReqAndWaitForResp("CVADAS_0001_00000000_000", __req, __resp, __res, -1, -1, -1, -1, -1, EnumResult_pos, EnumServiceDetails_onfail, EnumSendingMode_physical, EnumSuppressPosResBit_asconfigured, EnumVerdictOnInvalidValues_fail))
        break;
    }

    __res = DiagErrCodeTestStep(__res, "Can't retrieve last response for request! No check possible.") < 0;
    if(__res)
    {
	  __bVerdict = __eVerdictFail;
      break;
    }
    {
      __res = DiagInterpretAs(__resp, "RDBI_PR");
      if(__res != 0)
      {
        __bVerdict = __eVerdictFail;
        DiagErrCodeTestStep(__res, "Can't interpret response as diagnostic primitive 'RDBI_PR'.");
        break;
      }
      else
      {
        TestStepPass( "Received primitive can be interpreted as diagnostic primitive 'RDBI_PR'.");
      }
    }
  }
  while(0);


  if (__bVerdict == __eVerdictFail)
    TestReportWriteDiagObjectList();
}

void Tt4h42sqi_FD16_DID_with_Standard_Physical_Address()
{
  stack long __tableHandle;
  TestCommandBegin(__eRequestResponse, __cRequestResponse, "", "0");
  {
  
    long __res;
    int64 __timeout;
    __res = 0;
    __nInt64 = 1;
    __timeout = syspar::`P2_Server * 1000000LL;
    {
    
      long __testStepInitOk;
      message `FDCAN2::`DIAGNOSTIC_REQUEST_PAM __output;
      message `FDCAN2::`DIAGNOSTIC_REQUEST_PAM __msgOrig;
      __output = __msgOrig;
      __testStepInitOk = 1;
      {
        int64 __dlc;
        __dlc = 4;
        if (__dlc >= 0 && __dlc <= (__output.EDL ? 15 : 8))
          __output.DLC = __dlc;
        else
        {
          testStepErrorInTestSystem(0, __cEmpty, "Unable to set DLC=%lld in message. Please check input parameter.", __dlc);
          __testStepInitOk = 0;
        }
      }
      if (__testStepInitOk)
      {
        snprintf(__cArray, elCount(__cArray), "CAN message '%s' ID = 416981233x (0x18DAA0F1x) on bus FDCAN2", "DIAGNOSTIC_REQUEST_PAM");
        snprintf(__cArray2, elCount(__cArray2), "Send %s", __cArray);
        __tableHandle = ReportTableHead3Columns(__cArray2, "Byte", __cTOp, __cAssigned);
        ReportByteIndex("", 0, __cArray, elCount(__cArray));
        snprintf(__cArray2, 8192, "%s", __cArray);
        snprintf(__cArray3, 8192, "%s", "");
        
        ReportTableRow(__tableHandle, 0, __cArray2, __cAOp, 0x3, __cArray3, __oneOfFlag, __bSetInCheckAlignment);
        
        if (0 >= 0 && 0 < 64)
        {
          __output.byte((word)0) = 0x3;
        }
        else
        {
          testStepErrorInTestSystem(0, __cEmpty, "Index out of range. Unable to set byte %lld in message. Please check input parameter.", (int64)0);
          __testStepInitOk = 0;
        }
        ReportByteIndex("", 1, __cArray, elCount(__cArray));
        snprintf(__cArray2, 8192, "%s", __cArray);
        snprintf(__cArray3, 8192, "%s", "");
        
        ReportTableRow(__tableHandle, 0, __cArray2, __cAOp, 0x22, __cArray3, __oneOfFlag, __bSetInCheckAlignment);
        
        if (1 >= 0 && 1 < 64)
        {
          __output.byte((word)1) = 0x22;
        }
        else
        {
          testStepErrorInTestSystem(0, __cEmpty, "Index out of range. Unable to set byte %lld in message. Please check input parameter.", (int64)1);
          __testStepInitOk = 0;
        }
        ReportByteIndex("", 2, __cArray, elCount(__cArray));
        snprintf(__cArray2, 8192, "%s", __cArray);
        snprintf(__cArray3, 8192, "%s", "");
        
        ReportTableRow(__tableHandle, 0, __cArray2, __cAOp, 0xFD, __cArray3, __oneOfFlag, __bSetInCheckAlignment);
        
        if (2 >= 0 && 2 < 64)
        {
          __output.byte((word)2) = 0xFD;
        }
        else
        {
          testStepErrorInTestSystem(0, __cEmpty, "Index out of range. Unable to set byte %lld in message. Please check input parameter.", (int64)2);
          __testStepInitOk = 0;
        }
        ReportByteIndex("", 3, __cArray, elCount(__cArray));
        snprintf(__cArray2, 8192, "%s", __cArray);
        snprintf(__cArray3, 8192, "%s", "");
        
        ReportTableRow(__tableHandle, 0, __cArray2, __cAOp, 0x16, __cArray3, __oneOfFlag, __bSetInCheckAlignment);
        
        if (3 >= 0 && 3 < 64)
        {
          __output.byte((word)3) = 0x16;
        }
        else
        {
          testStepErrorInTestSystem(0, __cEmpty, "Index out of range. Unable to set byte %lld in message. Please check input parameter.", (int64)3);
          __testStepInitOk = 0;
        }
      
        ReportTableEndTestStep(__tableHandle, "Req1");
      }
      if (__testStepInitOk)
      {
        output(__output);
      }
    }
    if (__timeout <= 0)
    {
      testStepErrorInTestSystem(0, "1", "Unable to wait for %.3f %s. Please check input parameter.", __timeout / ((float)1000000), "ms");
    }
    else
    {
      __tt2cnt_51 = 0;
      snprintf(__cArray, elCount(__cArray), "CAN message '%s' ID = 417001888x (0x18DAF1A0x) on bus FDCAN2", "DIAGNOSTIC_RESPONSE_PAM");
      if(SetBusContextByName("FDCAN2", __eSaveCurrent, __nBusContextNew, __nBusContextOld))
        testJoinMessageEvent(`FDCAN2::`DIAGNOSTIC_RESPONSE_PAM,  __cArray,
             delegate dword(message * __m)
             {
               dword __msg_callback_ret;
               if (__tt2cnt_51 == -1)
               {
                 return 1;
               }
               __msg_callback_ret = 1;
               __tt2cnt_51++;
               if (__msg_callback_ret)
               {
                 __tt2cnt_51 = -1;
                 return 1;
               }
               return 0;
             });
      __res = testWaitForAllJoinedEventsNS(__timeout);
      if (__nInt64 != 0)
      {
        snprintf(__cArray, elCount(__cArray), "CAN message '%s' ID = 417001888x (0x18DAF1A0x) on bus FDCAN2", "DIAGNOSTIC_RESPONSE_PAM");
        if(__tt2cnt_51 == -1)
        {
          snprintf(__cArray2, 8192, "Response of %s", __cArray);
        }
        else
        {
          snprintf(__cArray2, 8192, "Response of %s (received %d times)", __cArray, __tt2cnt_51);
        }
        if (__tt2cnt_51 == 0)
        {
          testStepFail(0, "Resp1", __cArray2);
        }
        else
        {
          testStepPass(2, "Resp1", __cArray2);
        }
        __ReportRequestResponseResult(__res, 0);
      }
      ResetBusContext(__nBusContextNew, __nBusContextOld);
    }
  }
  TestCommandEnd();

}

void Tt4h42sqi_Hard_Reset_with_Physical_Address()
{
  stack long __tableHandle;
  TestCommandBegin(__eDiagService, __cDiagService, "", "0");
  {
    if (DiagIsFunctionalGroup("CVADAS_0001_00000000_000"))
    {
      DiagResponse * __resp;
      DiagRequest CVADAS_0001_00000000_000.HardReset_Reset __req;
      __diagService4h42sqi_46(__req, __resp);
    }
    else
    {
      DiagResponse CVADAS_0001_00000000_000.* __resp;
      DiagRequest CVADAS_0001_00000000_000.HardReset_Reset __req;
      __diagService4h42sqi_46(__req, __resp);
    }
  }
  TestCommandEnd();


}

  
void __diagService4h42sqi_46(DiagRequest * __req, DiagResponse * __resp )
{
  stack long __tableHandle;
  long __res, __paramLen, __bytePos;

   __bVerdict = __eVerdictPass;

  do {
    TestReportResetDiagObjectList();
    DiagSetReportDetailLevel("CVADAS_0001_00000000_000", EnumServiceDetails_onfail);
    // Request aspect
    {

      if (0 >= DiagSendReqAndWaitForResp("CVADAS_0001_00000000_000", __req, __resp, __res, -1, -1, -1, -1, -1, EnumResult_pos, EnumServiceDetails_onfail, EnumSendingMode_physical, EnumSuppressPosResBit_clear, EnumVerdictOnInvalidValues_fail))
        break;
    }

    __res = DiagErrCodeTestStep(__res, "Can't retrieve last response for request! No check possible.") < 0;
    if(__res)
    {
	  __bVerdict = __eVerdictFail;
      break;
    }
    {
      __res = DiagInterpretAs(__resp, "ER_PR");
      if(__res != 0)
      {
        __bVerdict = __eVerdictFail;
        DiagErrCodeTestStep(__res, "Can't interpret response as diagnostic primitive 'ER_PR'.");
        break;
      }
      else
      {
        TestStepPass( "Received primitive can be interpreted as diagnostic primitive 'ER_PR'.");
      }
    }
  }
  while(0);


  // Response, check & read aspect
  {
    __res = 1;
    __tableHandle = ReportTableHead5Columns(__cCheckCaption, __cTSym, __cTOp, __cRefVal, __cActual, __cRes);
    {
      double __nDiagValue;
      DiagGetParameterErrorHandled(__resp, "ResetType", __nDiagValue);
      __csr = CheckSignalMatch(__nDiagValue, syspar::`ECU_Reset::`Hard_Reset, "==") == 1;
      snprintf(__cArray, 8192, "%s", "Diagnostic parameter \'ResetType\'");
      snprintf(__cArray2, 8192, "%s", __cArray);
      snprintf(__cArray3, 8192, "%s", "Hard_Reset");
      ReportTableRow(__tableHandle, 0, __cArray2, "==", syspar::`ECU_Reset::`Hard_Reset, __cArray3, __oneOfFlag, __bSetInCheckAlignment);
      ReportCell(__tableHandle, __nDiagValue);
      ReportCellResult(__tableHandle, __csr, __ePassFail);
    
      __res = __res && __csr;
    
    }
    ReportTableEndVerdict(__tableHandle, __cEvaluateResponse, __res);
	__bVerdict = __bVerdict && __res;
  }
  if (__bVerdict == __eVerdictFail)
    TestReportWriteDiagObjectList();
}

void Tt4h42sqi_Hard_Reset_with_Functional_Address()
{
  stack long __tableHandle;
  TestCommandBegin(__eDiagService, __cDiagService, "", "0");
  {
    if (DiagIsFunctionalGroup("CVADAS_0001_00000000_000"))
    {
      DiagResponse * __resp;
      DiagRequest CVADAS_0001_00000000_000.HardReset_Reset __req;
      __diagService4h42sqi_47(__req, __resp);
    }
    else
    {
      DiagResponse CVADAS_0001_00000000_000.* __resp;
      DiagRequest CVADAS_0001_00000000_000.HardReset_Reset __req;
      __diagService4h42sqi_47(__req, __resp);
    }
  }
  TestCommandEnd();


}

  
void __diagService4h42sqi_47(DiagRequest * __req, DiagResponse * __resp )
{
  stack long __tableHandle;
  long __res, __paramLen, __bytePos;

   __bVerdict = __eVerdictPass;

  do {
    TestReportResetDiagObjectList();
    DiagSetReportDetailLevel("CVADAS_0001_00000000_000", EnumServiceDetails_onfail);
    // Request aspect
    {

      if (0 >= DiagSendReqAndWaitForResp("CVADAS_0001_00000000_000", __req, __resp, __res, -1, -1, -1, -1, -1, EnumResult_pos, EnumServiceDetails_onfail, EnumSendingMode_functional, EnumSuppressPosResBit_clear, EnumVerdictOnInvalidValues_fail))
        break;
    }

    __res = DiagErrCodeTestStep(__res, "Can't retrieve last response for request! No check possible.") < 0;
    if(__res)
    {
	  __bVerdict = __eVerdictFail;
      break;
    }
    {
      __res = DiagInterpretAs(__resp, "ER_PR");
      if(__res != 0)
      {
        __bVerdict = __eVerdictFail;
        DiagErrCodeTestStep(__res, "Can't interpret response as diagnostic primitive 'ER_PR'.");
        break;
      }
      else
      {
        TestStepPass( "Received primitive can be interpreted as diagnostic primitive 'ER_PR'.");
      }
    }
  }
  while(0);


  // Response, check & read aspect
  {
    __res = 1;
    __tableHandle = ReportTableHead5Columns(__cCheckCaption, __cTSym, __cTOp, __cRefVal, __cActual, __cRes);
    {
      double __nDiagValue;
      DiagGetParameterErrorHandled(__resp, "ResetType", __nDiagValue);
      __csr = CheckSignalMatch(__nDiagValue, syspar::`ECU_Reset::`Hard_Reset, "==") == 1;
      snprintf(__cArray, 8192, "%s", "Diagnostic parameter \'ResetType\'");
      snprintf(__cArray2, 8192, "%s", __cArray);
      snprintf(__cArray3, 8192, "%s", "Hard_Reset");
      ReportTableRow(__tableHandle, 0, __cArray2, "==", syspar::`ECU_Reset::`Hard_Reset, __cArray3, __oneOfFlag, __bSetInCheckAlignment);
      ReportCell(__tableHandle, __nDiagValue);
      ReportCellResult(__tableHandle, __csr, __ePassFail);
    
      __res = __res && __csr;
    
    }
    ReportTableEndVerdict(__tableHandle, __cEvaluateResponse, __res);
	__bVerdict = __bVerdict && __res;
  }
  if (__bVerdict == __eVerdictFail)
    TestReportWriteDiagObjectList();
}

void Tt4h42sqi__19_02_Report_DTC_By_Status_Mask_Physical_Add()
{
  stack long __tableHandle;
  TestCommandBegin(__eDiagService, __cDiagService, "", "0");
  {
    if (DiagIsFunctionalGroup("CVADAS_0001_00000000_000"))
    {
      DiagResponse * __resp;
      DiagRequest CVADAS_0001_00000000_000.FaultMemory_ReadAllIdentified __req;
      __diagService4h42sqi_48(__req, __resp);
    }
    else
    {
      DiagResponse CVADAS_0001_00000000_000.* __resp;
      DiagRequest CVADAS_0001_00000000_000.FaultMemory_ReadAllIdentified __req;
      __diagService4h42sqi_48(__req, __resp);
    }
  }
  TestCommandEnd();


}

  
void __diagService4h42sqi_48(DiagRequest * __req, DiagResponse * __resp )
{
  stack long __tableHandle;
  long __res, __paramLen, __bytePos;

   __bVerdict = __eVerdictPass;

  do {
    TestReportResetDiagObjectList();
    DiagSetReportDetailLevel("CVADAS_0001_00000000_000", EnumServiceDetails_onfail);
    // Request aspect
    {
      {
        {
          byte __bArray[1] = { 0x02 };
          __bArrayCtr = elCount(__bArray);
          __bDiagValueArrayCtr = __CopyBytes(__bArray, __bArrayCtr, __bDiagValueArray);
        }
      
        __res = DiagSetParameterErrorHandled(__req, "ReportDtcByStatusMask", __bDiagValueArray, __bDiagValueArrayCtr);
        if(__res < 0)
        {
          __bVerdict = __eVerdictFail;
          DiagErrCodeTestStep(__res, "Cannot set diagnostic parameter 'ReportDtcByStatusMask'");
          break;
        }
      }
      {
        {
          byte __bArray[1] = { 0x7F };
          __bArrayCtr = elCount(__bArray);
          __bDiagValueArrayCtr = __CopyBytes(__bArray, __bArrayCtr, __bDiagValueArray);
        }
      
        __res = DiagSetParameterErrorHandled(__req, "DTCStatusMask", __bDiagValueArray, __bDiagValueArrayCtr);
        if(__res < 0)
        {
          __bVerdict = __eVerdictFail;
          DiagErrCodeTestStep(__res, "Cannot set diagnostic parameter 'DTCStatusMask'");
          break;
        }
      }

      if (0 >= DiagSendReqAndWaitForResp("CVADAS_0001_00000000_000", __req, __resp, __res, -1, -1, -1, -1, -1, EnumResult_pos, EnumServiceDetails_onfail, EnumSendingMode_physical, EnumSuppressPosResBit_asconfigured, EnumVerdictOnInvalidValues_fail))
        break;
    }

    __res = DiagErrCodeTestStep(__res, "Can't retrieve last response for request! No check possible.") < 0;
    if(__res)
    {
	  __bVerdict = __eVerdictFail;
      break;
    }
    {
      __res = DiagInterpretAs(__resp, "RDI_RDTCBSM_PR");
      if(__res != 0)
      {
        __bVerdict = __eVerdictFail;
        DiagErrCodeTestStep(__res, "Can't interpret response as diagnostic primitive 'RDI_RDTCBSM_PR'.");
        break;
      }
      else
      {
        TestStepPass( "Received primitive can be interpreted as diagnostic primitive 'RDI_RDTCBSM_PR'.");
      }
    }
  }
  while(0);


  // Response, check & read aspect
  {
    __res = 1;
    __tableHandle = ReportTableHead5Columns(__cCheckCaption, __cTSym, __cTOp, __cRefVal, __cActual, __cRes);
    {
      __bDiagValueArrayCtr = DiagGetParameterErrorHandled(__resp, "ReportDtcByStatusMask", __bDiagValueArray, elcount(__bDiagValueArray), __cDiagValueArray, elcount(__cDiagValueArray));
      {
        byte __bArray2[1] = { 0x02 };
        __bArrayCtr = __CopyBytes(__bDiagValueArray, __bDiagValueArrayCtr, __bArray);
        __bArrayCtr2 = elCount(__bArray2);
        __csr = CompareBytes(__bArray, __bArrayCtr, __bArray2, __bArrayCtr2) == 0;
        snprintf(__cArray, 8192, "%s", "Diagnostic parameter \'ReportDtcByStatusMask\'");
        snprintf(__cArray2, 8192, "%s", __cArray);
        snprintf(__cArray3, 8192, "%s", "");
        ReportTableRow(__tableHandle, 0, __cArray2, "Bytes", __bArray2, __bArrayCtr2, __cArray3, __oneOfFlag, __bSetInCheckAlignment);
        ReportCell(__tableHandle, __bArray, __bArrayCtr);
        ReportCellResult(__tableHandle, __csr, __ePassFail);
      }
    
      __res = __res && __csr;
    
    }
    {
      __bDiagValueArrayCtr = DiagGetParameterErrorHandled(__resp, "DtcAvailabilityMask", __bDiagValueArray, elcount(__bDiagValueArray), __cDiagValueArray, elcount(__cDiagValueArray));
      {
        byte __bArray2[1] = { 0x7F };
        __bArrayCtr = __CopyBytes(__bDiagValueArray, __bDiagValueArrayCtr, __bArray);
        __bArrayCtr2 = elCount(__bArray2);
        __csr = CompareBytes(__bArray, __bArrayCtr, __bArray2, __bArrayCtr2) == 0;
        snprintf(__cArray, 8192, "%s", "Diagnostic parameter \'DtcAvailabilityMask\'");
        snprintf(__cArray2, 8192, "%s", __cArray);
        snprintf(__cArray3, 8192, "%s", "");
        ReportTableRow(__tableHandle, 0, __cArray2, "Bytes", __bArray2, __bArrayCtr2, __cArray3, __oneOfFlag, __bSetInCheckAlignment);
        ReportCell(__tableHandle, __bArray, __bArrayCtr);
        ReportCellResult(__tableHandle, __csr, __ePassFail);
      }
    
      __res = __res && __csr;
    
    }
    ReportTableEndVerdict(__tableHandle, __cEvaluateResponse, __res);
	__bVerdict = __bVerdict && __res;
  }
  if (__bVerdict == __eVerdictFail)
    TestReportWriteDiagObjectList();
}

void Tt4h42sqi__14_Clear_Diag_Info_Physical_Add()
{
  stack long __tableHandle;
  TestCommandBegin(__eDiagService, __cDiagService, "", "0");
  {
    if (DiagIsFunctionalGroup("CVADAS_0001_00000000_000"))
    {
      DiagResponse * __resp;
      DiagRequest CVADAS_0001_00000000_000.FaultMemory_Clear __req;
      __diagService4h42sqi_49(__req, __resp);
    }
    else
    {
      DiagResponse CVADAS_0001_00000000_000.* __resp;
      DiagRequest CVADAS_0001_00000000_000.FaultMemory_Clear __req;
      __diagService4h42sqi_49(__req, __resp);
    }
  }
  TestCommandEnd();


}

  
void __diagService4h42sqi_49(DiagRequest * __req, DiagResponse * __resp )
{
  stack long __tableHandle;
  long __res, __paramLen, __bytePos;

   __bVerdict = __eVerdictPass;

  do {
    TestReportResetDiagObjectList();
    DiagSetReportDetailLevel("CVADAS_0001_00000000_000", EnumServiceDetails_onfail);
    // Request aspect
    {
      {
        CheckLiteralGetStringBufferConsistency("FFFFFF", 8192);
      snprintf(__cDiagValueArray, 8192, "%s", "FFFFFF");
        __bDiagValueArrayCtr = __MapChar2ByteAtDiagSet(__cDiagValueArray, __bDiagValueArray);
        if (__bDiagValueArrayCtr >= 0)
        {
          __res = DiagSetParameterErrorHandled(__req, "GroupOfDtc", __bDiagValueArray, __bDiagValueArrayCtr);
          if(__res < 0)
          {
            __bVerdict = __eVerdictFail;
            DiagErrCodeTestStep(__res, "Cannot set diagnostic parameter 'GroupOfDtc'");
            break;
          }
        }
        else
        {
      	__bVerdict = __eVerdictFail;
          snprintf(__cArray2, 8192, "SetParameter: illegal byte sequence: '%s' (parameter %s). Use hex tuples like '01 AF ...'", __cDiagValueArray, "GroupOfDtc");
          DiagErrCodeTestStep(__bDiagValueArrayCtr, __cArray2);
          DiagErrCodeTestStep(-1, "Cannot set diagnostic parameter 'GroupOfDtc'");
      	break;
        }
      }

      if (0 >= DiagSendReqAndWaitForResp("CVADAS_0001_00000000_000", __req, __resp, __res, -1, -1, -1, -1, -1, EnumResult_pos, EnumServiceDetails_onfail, EnumSendingMode_physical, EnumSuppressPosResBit_asconfigured, EnumVerdictOnInvalidValues_fail))
        break;
    }

    __res = DiagErrCodeTestStep(__res, "Can't retrieve last response for request! No check possible.") < 0;
    if(__res)
    {
	  __bVerdict = __eVerdictFail;
      break;
    }
    {
      __res = DiagInterpretAs(__resp, "CDI_PR");
      if(__res != 0)
      {
        __bVerdict = __eVerdictFail;
        DiagErrCodeTestStep(__res, "Can't interpret response as diagnostic primitive 'CDI_PR'.");
        break;
      }
      else
      {
        TestStepPass( "Received primitive can be interpreted as diagnostic primitive 'CDI_PR'.");
      }
    }
  }
  while(0);


  if (__bVerdict == __eVerdictFail)
    TestReportWriteDiagObjectList();
}

void Tt4h42sqi_CaptureImage()
{
  stack long __tableHandle;
  TestCommandBegin(__eCANoeStandardService, __cCANoeStandardService, "testValidateSystemCall", "0");
  {
    snprintf(__cArray3, 8192, "%s", "workingDir");
    snprintf(__cArray4, 8192, "%s", "captureImage_command");
    snprintf(__cArray5, 8192, "%s", "60000");
    testStep(2, __cEmpty, "Execute testValidateSystemCall(%s, %s, %s)", __cArray3, __cArray4, __cArray5);
  
    CheckPlainParameterGetStringBufferConsistency(syspar::`workingDir,"syspar::`workingDir", 8192);
    snprintf(__cArray3, 8192, "%s", syspar::`workingDir);
    CheckPlainParameterGetStringBufferConsistency(syspar::`captureImage_command,"syspar::`captureImage_command", 8192);
    snprintf(__cArray4, 8192, "%s", syspar::`captureImage_command);
    testValidateSystemCall(__cArray3, __cArray4, 60000);
  
  }
  TestCommandEnd();


}

testsequence Tt4h42sqi_EOL_Calibration()
{
  stack long __tableHandle;
  SetBreakOnFail(0);

  CreateTTEIFFunction("Tt4h42sqi_TsTc0", __eTcDef, __eLocal);
  AddIFParameterTestCaseAttribute("TC_ID", "");
  AddIFParameterTestCaseAttribute("Test Case ID", "");
  CallInterfaceFunction("21189419_Calibrate_All_Cameras", __cEmpty , "71505474-bf5a-4a7a-9268-bfc9a3cb984d");

}

testcase Tt4h42sqi_TsTc0()
{
  stack long __tableHandle;
  SetBreakOnFail(1);

  TestPreparationBegin();
  {
  }
  TestPreparationEnd();

  TestCommandBegin(__eDiagService, __cDiagService, "", "0");
  {
    if (DiagIsFunctionalGroup("CVADAS_0001_00000000_000"))
    {
      DiagResponse * __resp;
      DiagRequest CVADAS_0001_00000000_000.Extended_Diagnostic_Session_Start __req;
      __diagService4h42sqi_50(__req, __resp);
    }
    else
    {
      DiagResponse CVADAS_0001_00000000_000.* __resp;
      DiagRequest CVADAS_0001_00000000_000.Extended_Diagnostic_Session_Start __req;
      __diagService4h42sqi_50(__req, __resp);
    }
  }
  TestCommandEnd();


  TestCommandBegin(__eDiagService, __cDiagService, "", "1");
  {
    if (DiagIsFunctionalGroup("CVADAS_0001_00000000_000"))
    {
      DiagResponse * __resp;
      DiagRequest CVADAS_0001_00000000_000._22FD00_Plant_Camera_Calibration_Data_Write __req;
      __diagService4h42sqi_51(__req, __resp);
    }
    else
    {
      DiagResponse CVADAS_0001_00000000_000.* __resp;
      DiagRequest CVADAS_0001_00000000_000._22FD00_Plant_Camera_Calibration_Data_Write __req;
      __diagService4h42sqi_51(__req, __resp);
    }
  }
  TestCommandEnd();


  TestCommandBegin(__eWait, __cWait, "", "2");
  {
    Wait("1", (1000 * 1000000LL), 1000000, "");
  }
  TestCommandEnd();

  {
    CreateCaplIFFunction("Hard_Reset", __eFct);
    CallInterfaceFunction(__cEmpty, __cEmpty, "3");
  }


  {
    CreateTTEIFFunction("Tt4h42sqi_CaptureImage", __eFct, __eLocal);
    CallInterfaceFunction(__cEmpty, __cEmpty, "6684ffe3-1b9d-493e-a7be-53a7c51a24bb");
  }


}

  
void __diagService4h42sqi_50(DiagRequest * __req, DiagResponse * __resp )
{
  stack long __tableHandle;
  long __res, __paramLen, __bytePos;

   __bVerdict = __eVerdictPass;

  do {
    TestReportResetDiagObjectList();
    DiagSetReportDetailLevel("CVADAS_0001_00000000_000", EnumServiceDetails_onfail);
    // Request aspect
    {
      {
        __res = DiagSetParameterErrorHandled(__req, "DiagSessionType", 03);
        if(__res < 0)
        {
          __bVerdict = __eVerdictFail;
          DiagErrCodeTestStep(__res, "Cannot set diagnostic parameter 'DiagSessionType'");
          break;
        }
      }

      if (0 >= DiagSendReqAndWaitForResp("CVADAS_0001_00000000_000", __req, __resp, __res, -1, -1, -1, -1, -1, EnumResult_pos, EnumServiceDetails_onfail, EnumSendingMode_physical, EnumSuppressPosResBit_asconfigured, EnumVerdictOnInvalidValues_fail))
        break;
    }

    __res = DiagErrCodeTestStep(__res, "Can't retrieve last response for request! No check possible.") < 0;
    if(__res)
    {
	  __bVerdict = __eVerdictFail;
      break;
    }
    {
      __res = DiagInterpretAs(__resp, "DSC_PR");
      if(__res != 0)
      {
        __bVerdict = __eVerdictFail;
        DiagErrCodeTestStep(__res, "Can't interpret response as diagnostic primitive 'DSC_PR'.");
        break;
      }
      else
      {
        TestStepPass( "Received primitive can be interpreted as diagnostic primitive 'DSC_PR'.");
      }
    }
  }
  while(0);


  // Response, check & read aspect
  {
    __res = 1;
    __tableHandle = ReportTableHead5Columns(__cCheckCaption, __cTSym, __cTOp, __cRefVal, __cActual, __cRes);
    {
      double __nDiagValue;
      DiagGetParameterErrorHandled(__resp, "DiagSessionType", __nDiagValue);
      __csr = CheckSignalMatch(__nDiagValue, 03, "==") == 1;
      snprintf(__cArray, 8192, "%s", "Diagnostic parameter \'DiagSessionType\'");
      snprintf(__cArray2, 8192, "%s", __cArray);
      snprintf(__cArray3, 8192, "%s", "");
      ReportTableRow(__tableHandle, 0, __cArray2, "==", 03, __cArray3, __oneOfFlag, __bSetInCheckAlignment);
      ReportCell(__tableHandle, __nDiagValue);
      ReportCellResult(__tableHandle, __csr, __ePassFail);
    
      __res = __res && __csr;
    
    }
    ReportTableEndVerdict(__tableHandle, __cEvaluateResponse, __res);
	__bVerdict = __bVerdict && __res;
  }
  if (__bVerdict == __eVerdictFail)
    TestReportWriteDiagObjectList();
}
  
void __diagService4h42sqi_51(DiagRequest * __req, DiagResponse * __resp )
{
  stack long __tableHandle;
  long __res, __paramLen, __bytePos;

   __bVerdict = __eVerdictPass;

  do {
    TestReportResetDiagObjectList();
    DiagSetReportDetailLevel("CVADAS_0001_00000000_000", EnumServiceDetails_onfail);
    // Request aspect
    {
      {
        {
          byte __bArray[1] = { 0x03 };
          __bArrayCtr = elCount(__bArray);
          __bDiagValueArrayCtr = __CopyBytes(__bArray, __bArrayCtr, __bDiagValueArray);
        }
      
        __res = DiagSetParameterErrorHandled(__req, "CalibrationStatus_Front", __bDiagValueArray, __bDiagValueArrayCtr);
        if(__res < 0)
        {
          __bVerdict = __eVerdictFail;
          DiagErrCodeTestStep(__res, "Cannot set diagnostic parameter 'CalibrationStatus_Front'");
          break;
        }
      }
      {
        {
          byte __bArray[1] = { 0x03 };
          __bArrayCtr = elCount(__bArray);
          __bDiagValueArrayCtr = __CopyBytes(__bArray, __bArrayCtr, __bDiagValueArray);
        }
      
        __res = DiagSetParameterErrorHandled(__req, "CalibrationStatus_Left", __bDiagValueArray, __bDiagValueArrayCtr);
        if(__res < 0)
        {
          __bVerdict = __eVerdictFail;
          DiagErrCodeTestStep(__res, "Cannot set diagnostic parameter 'CalibrationStatus_Left'");
          break;
        }
      }
      {
        {
          byte __bArray[1] = { 0x03 };
          __bArrayCtr = elCount(__bArray);
          __bDiagValueArrayCtr = __CopyBytes(__bArray, __bArrayCtr, __bDiagValueArray);
        }
      
        __res = DiagSetParameterErrorHandled(__req, "CalibrationStatus_Rear", __bDiagValueArray, __bDiagValueArrayCtr);
        if(__res < 0)
        {
          __bVerdict = __eVerdictFail;
          DiagErrCodeTestStep(__res, "Cannot set diagnostic parameter 'CalibrationStatus_Rear'");
          break;
        }
      }
      {
        {
          byte __bArray[1] = { 0x03 };
          __bArrayCtr = elCount(__bArray);
          __bDiagValueArrayCtr = __CopyBytes(__bArray, __bArrayCtr, __bDiagValueArray);
        }
      
        __res = DiagSetParameterErrorHandled(__req, "CalibrationStatus_Right", __bDiagValueArray, __bDiagValueArrayCtr);
        if(__res < 0)
        {
          __bVerdict = __eVerdictFail;
          DiagErrCodeTestStep(__res, "Cannot set diagnostic parameter 'CalibrationStatus_Right'");
          break;
        }
      }

      if (0 >= DiagSendReqAndWaitForResp("CVADAS_0001_00000000_000", __req, __resp, __res, -1, -1, -1, -1, -1, EnumResult_pos, EnumServiceDetails_onfail, EnumSendingMode_physical, EnumSuppressPosResBit_asconfigured, EnumVerdictOnInvalidValues_fail))
        break;
    }

    __res = DiagErrCodeTestStep(__res, "Can't retrieve last response for request! No check possible.") < 0;
    if(__res)
    {
	  __bVerdict = __eVerdictFail;
      break;
    }
    {
      __res = DiagInterpretAs(__resp, "WDBI_PR");
      if(__res != 0)
      {
        __bVerdict = __eVerdictFail;
        DiagErrCodeTestStep(__res, "Can't interpret response as diagnostic primitive 'WDBI_PR'.");
        break;
      }
      else
      {
        TestStepPass( "Received primitive can be interpreted as diagnostic primitive 'WDBI_PR'.");
      }
    }
  }
  while(0);


  if (__bVerdict == __eVerdictFail)
    TestReportWriteDiagObjectList();
}

testsequence Tt4h42sqi_Reset_NVM()
{
  stack long __tableHandle;
  SetBreakOnFail(0);

  CreateTTEIFFunction("Tt4h42sqi_TsTc1", __eTcDef, __eLocal);
  AddIFParameterTestCaseAttribute("TC_ID", "");
  AddIFParameterTestCaseAttribute("Test Case ID", "");
  CallInterfaceFunction("20657328_Reset_NVM", __cEmpty , "1a76e259-9169-4a9a-bc48-cbffdb860cb2");

}

testcase Tt4h42sqi_TsTc1()
{
  stack long __tableHandle;
  SetBreakOnFail(1);

  TestPreparationBegin();
  {
  }
  TestPreparationEnd();

  TestCaseDescription("");

  TestCommandBegin(__eWait, __cWait, "Wait for boot up initally after flash", "0");
  {
    Wait("1", (45000 * 1000000LL), 1000000, "");
  }
  TestCommandEnd();

  TestCommandBegin(__eDiagService, __cDiagService, "", "1");
  {
    if (DiagIsFunctionalGroup("CVADAS_0001_00000000_000"))
    {
      DiagResponse * __resp;
      DiagRequest CVADAS_0001_00000000_000.Extended_Diagnostic_Session_Start __req;
      __diagService4h42sqi_52(__req, __resp);
    }
    else
    {
      DiagResponse CVADAS_0001_00000000_000.* __resp;
      DiagRequest CVADAS_0001_00000000_000.Extended_Diagnostic_Session_Start __req;
      __diagService4h42sqi_52(__req, __resp);
    }
  }
  TestCommandEnd();


  TestCommandBegin(__eDiagService, __cDiagService, "", "2");
  {
    if (DiagIsFunctionalGroup("CVADAS_0001_00000000_000"))
    {
      DiagResponse * __resp;
      DiagRequest CVADAS_0001_00000000_000._2EFD4E_Reset_NVM_Write __req;
      __diagService4h42sqi_53(__req, __resp);
    }
    else
    {
      DiagResponse CVADAS_0001_00000000_000.* __resp;
      DiagRequest CVADAS_0001_00000000_000._2EFD4E_Reset_NVM_Write __req;
      __diagService4h42sqi_53(__req, __resp);
    }
  }
  TestCommandEnd();


  TestCommandBegin(__eWait, __cWait, "", "3");
  {
    Wait("1", (10000 * 1000000LL), 1000000, "");
  }
  TestCommandEnd();

  {
    CreateCaplIFFunction("Hard_Reset", __eFct);
    CallInterfaceFunction(__cEmpty, __cEmpty, "4");
  }


  TestCommandBegin(__eWait, __cWait, "", "5");
  {
    Wait("1", (45000 * 1000000LL), 1000000, "");
  }
  TestCommandEnd();

}

  
void __diagService4h42sqi_52(DiagRequest * __req, DiagResponse * __resp )
{
  stack long __tableHandle;
  long __res, __paramLen, __bytePos;

   __bVerdict = __eVerdictPass;

  do {
    TestReportResetDiagObjectList();
    DiagSetReportDetailLevel("CVADAS_0001_00000000_000", EnumServiceDetails_onfail);
    // Request aspect
    {
      {
        __res = DiagSetParameterErrorHandled(__req, "DiagSessionType", 03);
        if(__res < 0)
        {
          __bVerdict = __eVerdictFail;
          DiagErrCodeTestStep(__res, "Cannot set diagnostic parameter 'DiagSessionType'");
          break;
        }
      }

      if (0 >= DiagSendReqAndWaitForResp("CVADAS_0001_00000000_000", __req, __resp, __res, -1, -1, -1, -1, -1, EnumResult_pos, EnumServiceDetails_onfail, EnumSendingMode_physical, EnumSuppressPosResBit_asconfigured, EnumVerdictOnInvalidValues_fail))
        break;
    }

    __res = DiagErrCodeTestStep(__res, "Can't retrieve last response for request! No check possible.") < 0;
    if(__res)
    {
	  __bVerdict = __eVerdictFail;
      break;
    }
    {
      __res = DiagInterpretAs(__resp, "DSC_PR");
      if(__res != 0)
      {
        __bVerdict = __eVerdictFail;
        DiagErrCodeTestStep(__res, "Can't interpret response as diagnostic primitive 'DSC_PR'.");
        break;
      }
      else
      {
        TestStepPass( "Received primitive can be interpreted as diagnostic primitive 'DSC_PR'.");
      }
    }
  }
  while(0);


  // Response, check & read aspect
  {
    __res = 1;
    __tableHandle = ReportTableHead5Columns(__cCheckCaption, __cTSym, __cTOp, __cRefVal, __cActual, __cRes);
    {
      double __nDiagValue;
      DiagGetParameterErrorHandled(__resp, "DiagSessionType", __nDiagValue);
      __csr = CheckSignalMatch(__nDiagValue, 03, "==") == 1;
      snprintf(__cArray, 8192, "%s", "Diagnostic parameter \'DiagSessionType\'");
      snprintf(__cArray2, 8192, "%s", __cArray);
      snprintf(__cArray3, 8192, "%s", "");
      ReportTableRow(__tableHandle, 0, __cArray2, "==", 03, __cArray3, __oneOfFlag, __bSetInCheckAlignment);
      ReportCell(__tableHandle, __nDiagValue);
      ReportCellResult(__tableHandle, __csr, __ePassFail);
    
      __res = __res && __csr;
    
    }
    ReportTableEndVerdict(__tableHandle, __cEvaluateResponse, __res);
	__bVerdict = __bVerdict && __res;
  }
  if (__bVerdict == __eVerdictFail)
    TestReportWriteDiagObjectList();
}
  
void __diagService4h42sqi_53(DiagRequest * __req, DiagResponse * __resp )
{
  stack long __tableHandle;
  long __res, __paramLen, __bytePos;

   __bVerdict = __eVerdictPass;

  do {
    TestReportResetDiagObjectList();
    DiagSetReportDetailLevel("CVADAS_0001_00000000_000", EnumServiceDetails_onfail);
    // Request aspect
    {
      {
        {
          byte __bArray[1] = { 0x00 };
          __bArrayCtr = elCount(__bArray);
          __bDiagValueArrayCtr = __CopyBytes(__bArray, __bArrayCtr, __bDiagValueArray);
        }
      
        __res = DiagSetParameterErrorHandled(__req, "HighLevel_NVM_Block_ID", __bDiagValueArray, __bDiagValueArrayCtr);
        if(__res < 0)
        {
          __bVerdict = __eVerdictFail;
          DiagErrCodeTestStep(__res, "Cannot set diagnostic parameter 'HighLevel_NVM_Block_ID'");
          break;
        }
      }

      if (0 >= DiagSendReqAndWaitForResp("CVADAS_0001_00000000_000", __req, __resp, __res, -1, -1, -1, -1, -1, EnumResult_pos, EnumServiceDetails_onfail, EnumSendingMode_physical, EnumSuppressPosResBit_asconfigured, EnumVerdictOnInvalidValues_fail))
        break;
    }

    __res = DiagErrCodeTestStep(__res, "Can't retrieve last response for request! No check possible.") < 0;
    if(__res)
    {
	  __bVerdict = __eVerdictFail;
      break;
    }
    {
      __res = DiagInterpretAs(__resp, "WDBI_PR");
      if(__res != 0)
      {
        __bVerdict = __eVerdictFail;
        DiagErrCodeTestStep(__res, "Can't interpret response as diagnostic primitive 'WDBI_PR'.");
        break;
      }
      else
      {
        TestStepPass( "Received primitive can be interpreted as diagnostic primitive 'WDBI_PR'.");
      }
    }
  }
  while(0);


  if (__bVerdict == __eVerdictFail)
    TestReportWriteDiagObjectList();
}

void Tt4h42sqi_Tet_TtInit()
{
  stack long __tableHandle;
}

void Tt4h42sqi_Tet_Tc0()
{
  CreateTTEIFFunction("Tt4h42sqi_Tc0", __eTcDef, __eLocal);  
  AddIFParameterTestCaseAttribute("TC_ID", "");
  AddIFParameterTestCaseAttribute("Test Case ID", "");
  CallInterfaceFunction("Enter Extended Diag Session", __cEmpty , __cEmpty );
}
testcase Tt4h42sqi_Tc0()
{
  stack long __tableHandle;
  SetBreakOnFail(0);

  TestCommandBegin(__eDiagService, __cDiagService, "", "0");
  {
    if (DiagIsFunctionalGroup("CVADAS_0001_00000000_000"))
    {
      DiagResponse * __resp;
      DiagRequest CVADAS_0001_00000000_000.Extended_Diagnostic_Session_Start __req;
      __diagService4h42sqi_54(__req, __resp);
    }
    else
    {
      DiagResponse CVADAS_0001_00000000_000.* __resp;
      DiagRequest CVADAS_0001_00000000_000.Extended_Diagnostic_Session_Start __req;
      __diagService4h42sqi_54(__req, __resp);
    }
  }
  TestCommandEnd();


}

  
void __diagService4h42sqi_54(DiagRequest * __req, DiagResponse * __resp )
{
  stack long __tableHandle;
  long __res, __paramLen, __bytePos;

   __bVerdict = __eVerdictPass;

  do {
    TestReportResetDiagObjectList();
    DiagSetReportDetailLevel("CVADAS_0001_00000000_000", EnumServiceDetails_onfail);
    // Request aspect
    {
      {
        __res = DiagSetParameterErrorHandled(__req, "DiagSessionType", 03);
        if(__res < 0)
        {
          __bVerdict = __eVerdictFail;
          DiagErrCodeTestStep(__res, "Cannot set diagnostic parameter 'DiagSessionType'");
          break;
        }
      }

      if (0 >= DiagSendReqAndWaitForResp("CVADAS_0001_00000000_000", __req, __resp, __res, -1, -1, -1, -1, -1, EnumResult_pos, EnumServiceDetails_onfail, EnumSendingMode_physical, EnumSuppressPosResBit_asconfigured, EnumVerdictOnInvalidValues_fail))
        break;
    }

    __res = DiagErrCodeTestStep(__res, "Can't retrieve last response for request! No check possible.") < 0;
    if(__res)
    {
	  __bVerdict = __eVerdictFail;
      break;
    }
    {
      __res = DiagInterpretAs(__resp, "DSC_PR");
      if(__res != 0)
      {
        __bVerdict = __eVerdictFail;
        DiagErrCodeTestStep(__res, "Can't interpret response as diagnostic primitive 'DSC_PR'.");
        break;
      }
      else
      {
        TestStepPass( "Received primitive can be interpreted as diagnostic primitive 'DSC_PR'.");
      }
    }
  }
  while(0);


  // Response, check & read aspect
  {
    __res = 1;
    __tableHandle = ReportTableHead5Columns(__cCheckCaption, __cTSym, __cTOp, __cRefVal, __cActual, __cRes);
    {
      double __nDiagValue;
      DiagGetParameterErrorHandled(__resp, "DiagSessionType", __nDiagValue);
      __csr = CheckSignalMatch(__nDiagValue, 03, "==") == 1;
      snprintf(__cArray, 8192, "%s", "Diagnostic parameter \'DiagSessionType\'");
      snprintf(__cArray2, 8192, "%s", __cArray);
      snprintf(__cArray3, 8192, "%s", "");
      ReportTableRow(__tableHandle, 0, __cArray2, "==", 03, __cArray3, __oneOfFlag, __bSetInCheckAlignment);
      ReportCell(__tableHandle, __nDiagValue);
      ReportCellResult(__tableHandle, __csr, __ePassFail);
    
      __res = __res && __csr;
    
    }
    ReportTableEndVerdict(__tableHandle, __cEvaluateResponse, __res);
	__bVerdict = __bVerdict && __res;
  }
  if (__bVerdict == __eVerdictFail)
    TestReportWriteDiagObjectList();
}

void Tt4h42sqi_Tet_CaplTcCall0()
{
  stack long __tableHandle;
  CreateCaplIFFunction("Send_Proxi", __eTcDef);
  AddIFParameterTestCaseAttribute("TC_ID", "");
  AddIFParameterTestCaseAttribute("Test Case ID", "");
  AddIFParameterChar(syspar::`VehicleProxy1);
  CallInterfaceFunction(__cEmpty , "", __cEmpty );
}

void Tt4h42sqi_Tet_Tc1()
{
  CreateTTEIFFunction("Tt4h42sqi_Tc1", __eTcDef, __eLocal);  
  AddIFParameterTestCaseAttribute("TC_ID", "");
  AddIFParameterTestCaseAttribute("Test Case ID", "");
  CallInterfaceFunction("Set to Surround View Camera", __cEmpty , __cEmpty );
}
testcase Tt4h42sqi_Tc1()
{
  stack long __tableHandle;
  SetBreakOnFail(1);

  TestPreparationBegin();
  {
  }
  TestPreparationEnd();

  TestCommandBegin(__eSet, __cSet, "", "0");
  {
    __tableHandle = ReportTableHead3Columns(__cSetCaption , __cTSym, __cTOp, __cAssigned); 
    {
      $`FDCAN2::dbNode::`SGW::`TELEMATIC_FD_14::`TGW_CAMERA_DISP_STAT.phys = 4;
      snprintf(__cArray, 8192, "%s", "TGW_CAMERA_DISP_STAT");
      snprintf(__cArray2, 8192, "%s '%s'", __cCANSignal, __cArray);
      snprintf(__cArray3, 8192, "%s", "");
      
      ReportSetLValueOrSignalNotOnline(getSignalTime(`FDCAN2::dbNode::`SGW::`TELEMATIC_FD_14::`TGW_CAMERA_DISP_STAT), __cArray2, __cArray4, 8192);
      ReportTableRow(__tableHandle, 0, __cArray4, __cAOp, 4, __cArray3, __oneOfFlag, __bSetInCheckAlignment);
      
  
    }
    {
      $`FDCAN2::dbNode::`SGW::`TELEMATIC_FD_5::`CameraDisplaySts2.phys = 0;
      snprintf(__cArray, 8192, "%s", "CameraDisplaySts2");
      snprintf(__cArray2, 8192, "%s '%s'", __cCANSignal, __cArray);
      snprintf(__cArray3, 8192, "%s", "Default");
      
      ReportSetLValueOrSignalNotOnline(getSignalTime(`FDCAN2::dbNode::`SGW::`TELEMATIC_FD_5::`CameraDisplaySts2), __cArray2, __cArray4, 8192);
      ReportTableRow(__tableHandle, 0, __cArray4, __cAOp, 0, __cArray3, __oneOfFlag, __bSetInCheckAlignment);
      
  
    }
    ReportTableEndTestStep(__tableHandle, "1");
  }
  TestCommandEnd();


  TestCommandBegin(__eWait, __cWait, "", "1");
  {
    Wait("1", (1000 * 1000000LL), 1000000, "");
  }
  TestCommandEnd();

  TestCommandBegin(__eCheck, __cCheck, "", "2");
  {
    __bVerdict = __eVerdictPass;
    __tableHandle = ReportTableHead5Columns(__cCheckCaption, __cTSym, __cTOp, __cRefVal, __cActual, __cRes);
    {
      {
        int __res1,__res2;
        __res1 = CheckSignalMatch(`FDCAN2::dbNode::`SGW::`TELEMATIC_FD_14::`TGW_CAMERA_DISP_STAT, 0, __cGreaterEqualThan) == 1;
        __res2 = CheckSignalMatch(`FDCAN2::dbNode::`SGW::`TELEMATIC_FD_14::`TGW_CAMERA_DISP_STAT, 4, __cLessEqualThan) == 1;
        __csr = __res1 && __res2;
        snprintf(__cArray, 8192, "%s", "TGW_CAMERA_DISP_STAT");
        snprintf(__cArray2, 8192, "%s '%s'", __cCANSignal, __cArray);
        snprintf(__cArray3, 8192, "%s", "");
        snprintf(__cArray4, 8192, "%s", "");
        snprintf(__cArray5, 8192, "%s", __cArray3);
        snprintf(__cArray6, 8192, "%s", __cArray4);
        ReportRange(0, 4, __cArray5, __cArray6, __cArray7, 8192);
        ReportTableRow(__tableHandle, 0, __cArray2, __cRange, __cArray7, __cEmpty, __oneOfFlag, __bSetInCheckAlignment);
        ReportLValueOrSignalNotOnline(`FDCAN2::dbNode::`SGW::`TELEMATIC_FD_14::`TGW_CAMERA_DISP_STAT, __cArray8, 8192);
        ReportCell(__tableHandle, __cArray8);
        ReportCellResult(__tableHandle, __csr, __ePassFail);
      }
  
      __bVerdict = __bVerdict && __csr;
    }
    ReportTableEndVerdict(__tableHandle, "1", __bVerdict);
  }
  TestCommandEnd();


  TestCommandBegin(__eWait, __cWait, "", "3");
  {
    Wait("1", (3000 * 1000000LL), 1000000, "");
  }
  TestCommandEnd();

}

void Tt4h42sqi_Tet_Tc2()
{
  CreateTTEIFFunction("Tt4h42sqi_Tc2", __eTcDef, __eLocal);  
  AddIFParameterTestCaseAttribute("TC_ID", "");
  AddIFParameterTestCaseAttribute("Test Case ID", "");
  CallInterfaceFunction("Default View", __cEmpty , __cEmpty );
}
testcase Tt4h42sqi_Tc2()
{
  stack long __tableHandle;
  SetBreakOnFail(1);

  TestCommandBegin(__eSet, __cSet, "", "0");
  {
    __tableHandle = ReportTableHead3Columns(__cSetCaption , __cTSym, __cTOp, __cAssigned); 
    {
      $`FDCAN2::dbNode::`SGW::`TELEMATIC_FD_5::`CameraDisplaySts2.phys = 2;
      snprintf(__cArray, 8192, "%s", "CameraDisplaySts2");
      snprintf(__cArray2, 8192, "%s '%s'", __cCANSignal, __cArray);
      snprintf(__cArray3, 8192, "%s", "");
      
      ReportSetLValueOrSignalNotOnline(getSignalTime(`FDCAN2::dbNode::`SGW::`TELEMATIC_FD_5::`CameraDisplaySts2), __cArray2, __cArray4, 8192);
      ReportTableRow(__tableHandle, 0, __cArray4, __cAOp, 2, __cArray3, __oneOfFlag, __bSetInCheckAlignment);
      
  
    }
    ReportTableEndTestStep(__tableHandle, "1");
  }
  TestCommandEnd();


  TestCommandBegin(__eWait, __cWait, "", "1");
  {
    Wait("1", (1000 * 1000000LL), 1000000, "");
  }
  TestCommandEnd();

  TestCommandBegin(__eSet, __cSet, "", "2");
  {
    __tableHandle = ReportTableHead3Columns(__cSetCaption , __cTSym, __cTOp, __cAssigned); 
    {
      $`FDCAN2::dbNode::`SGW::`TELEMATIC_FD_5::`CameraDisplaySts2.phys = 0;
      snprintf(__cArray, 8192, "%s", "CameraDisplaySts2");
      snprintf(__cArray2, 8192, "%s '%s'", __cCANSignal, __cArray);
      snprintf(__cArray3, 8192, "%s", "");
      
      ReportSetLValueOrSignalNotOnline(getSignalTime(`FDCAN2::dbNode::`SGW::`TELEMATIC_FD_5::`CameraDisplaySts2), __cArray2, __cArray4, 8192);
      ReportTableRow(__tableHandle, 0, __cArray4, __cAOp, 0, __cArray3, __oneOfFlag, __bSetInCheckAlignment);
      
  
    }
    ReportTableEndTestStep(__tableHandle, "1");
  }
  TestCommandEnd();


  TestCommandBegin(__eWait, __cWait, "", "3");
  {
    Wait("1", (1000 * 1000000LL), 1000000, "");
  }
  TestCommandEnd();

  TestCommandBegin(__eCheck, __cCheck, "", "4");
  {
    __bVerdict = __eVerdictPass;
    __tableHandle = ReportTableHead5Columns(__cCheckCaption, __cTSym, __cTOp, __cRefVal, __cActual, __cRes);
    {
      {
        int __res1,__res2;
        __res1 = CheckSignalMatch(`FDCAN2::dbNode::`CVADAS::`CVPAM_FD_Info::`DisplayView2, 1, __cGreaterEqualThan) == 1;
        __res2 = CheckSignalMatch(`FDCAN2::dbNode::`CVADAS::`CVPAM_FD_Info::`DisplayView2, 15, __cLessEqualThan) == 1;
        __csr = __res1 && __res2;
        snprintf(__cArray, 8192, "%s", "DisplayView2");
        snprintf(__cArray2, 8192, "%s '%s'", __cCANSignal, __cArray);
        snprintf(__cArray3, 8192, "%s", "");
        snprintf(__cArray4, 8192, "%s", "");
        snprintf(__cArray5, 8192, "%s", __cArray3);
        snprintf(__cArray6, 8192, "%s", __cArray4);
        ReportRange(1, 15, __cArray5, __cArray6, __cArray7, 8192);
        ReportTableRow(__tableHandle, 0, __cArray2, __cRange, __cArray7, __cEmpty, __oneOfFlag, __bSetInCheckAlignment);
        ReportLValueOrSignalNotOnline(`FDCAN2::dbNode::`CVADAS::`CVPAM_FD_Info::`DisplayView2, __cArray8, 8192);
        ReportCell(__tableHandle, __cArray8);
        ReportCellResult(__tableHandle, __csr, __ePassFail);
      }
  
      __bVerdict = __bVerdict && __csr;
    }
    ReportTableEndVerdict(__tableHandle, "1", __bVerdict);
  }
  TestCommandEnd();


}

void Tt4h42sqi_Tet_Tc3()
{
  CreateTTEIFFunction("Tt4h42sqi_Tc3", __eTcDef, __eLocal);  
  AddIFParameterTestCaseAttribute("TC_ID", "");
  AddIFParameterTestCaseAttribute("Test Case ID", "");
  CallInterfaceFunction("View 1: FVTV_RVTV", __cEmpty , __cEmpty );
}
testcase Tt4h42sqi_Tc3()
{
  stack long __tableHandle;
  SetBreakOnFail(1);

  TestCommandBegin(__eSet, __cSet, "", "0");
  {
    __tableHandle = ReportTableHead3Columns(__cSetCaption , __cTSym, __cTOp, __cAssigned); 
    {
      $`FDCAN2::dbNode::`SGW::`TELEMATIC_FD_5::`CameraDisplaySts2.phys = 1;
      snprintf(__cArray, 8192, "%s", "CameraDisplaySts2");
      snprintf(__cArray2, 8192, "%s '%s'", __cCANSignal, __cArray);
      snprintf(__cArray3, 8192, "%s", "");
      
      ReportSetLValueOrSignalNotOnline(getSignalTime(`FDCAN2::dbNode::`SGW::`TELEMATIC_FD_5::`CameraDisplaySts2), __cArray2, __cArray4, 8192);
      ReportTableRow(__tableHandle, 0, __cArray4, __cAOp, 1, __cArray3, __oneOfFlag, __bSetInCheckAlignment);
      
  
    }
    ReportTableEndTestStep(__tableHandle, "1");
  }
  TestCommandEnd();


  TestCommandBegin(__eWait, __cWait, "", "1");
  {
    Wait("1", (1000 * 1000000LL), 1000000, "");
  }
  TestCommandEnd();

  TestCommandBegin(__eCheck, __cCheck, "", "2");
  {
    __bVerdict = __eVerdictPass;
    __tableHandle = ReportTableHead5Columns(__cCheckCaption, __cTSym, __cTOp, __cRefVal, __cActual, __cRes);
    {
      {
        int __res1,__res2;
        __res1 = CheckSignalMatch(`FDCAN2::dbNode::`CVADAS::`CVPAM_FD_Info::`DisplayView2, 1, __cGreaterEqualThan) == 1;
        __res2 = CheckSignalMatch(`FDCAN2::dbNode::`CVADAS::`CVPAM_FD_Info::`DisplayView2, 15, __cLessEqualThan) == 1;
        __csr = __res1 && __res2;
        snprintf(__cArray, 8192, "%s", "DisplayView2");
        snprintf(__cArray2, 8192, "%s '%s'", __cCANSignal, __cArray);
        snprintf(__cArray3, 8192, "%s", "");
        snprintf(__cArray4, 8192, "%s", "");
        snprintf(__cArray5, 8192, "%s", __cArray3);
        snprintf(__cArray6, 8192, "%s", __cArray4);
        ReportRange(1, 15, __cArray5, __cArray6, __cArray7, 8192);
        ReportTableRow(__tableHandle, 0, __cArray2, __cRange, __cArray7, __cEmpty, __oneOfFlag, __bSetInCheckAlignment);
        ReportLValueOrSignalNotOnline(`FDCAN2::dbNode::`CVADAS::`CVPAM_FD_Info::`DisplayView2, __cArray8, 8192);
        ReportCell(__tableHandle, __cArray8);
        ReportCellResult(__tableHandle, __csr, __ePassFail);
      }
  
      __bVerdict = __bVerdict && __csr;
    }
    ReportTableEndVerdict(__tableHandle, "1", __bVerdict);
  }
  TestCommandEnd();


}

void Tt4h42sqi_Tet_Tc4()
{
  CreateTTEIFFunction("Tt4h42sqi_Tc4", __eTcDef, __eLocal);  
  AddIFParameterTestCaseAttribute("TC_ID", "");
  AddIFParameterTestCaseAttribute("Test Case ID", "");
  CallInterfaceFunction("View 2: BackupRearView", __cEmpty , __cEmpty );
}
testcase Tt4h42sqi_Tc4()
{
  stack long __tableHandle;
  SetBreakOnFail(1);

  TestCommandBegin(__eSet, __cSet, "", "0");
  {
    __tableHandle = ReportTableHead3Columns(__cSetCaption , __cTSym, __cTOp, __cAssigned); 
    {
      $`FDCAN2::dbNode::`SGW::`TELEMATIC_FD_5::`CameraDisplaySts2.phys = 2;
      snprintf(__cArray, 8192, "%s", "CameraDisplaySts2");
      snprintf(__cArray2, 8192, "%s '%s'", __cCANSignal, __cArray);
      snprintf(__cArray3, 8192, "%s", "");
      
      ReportSetLValueOrSignalNotOnline(getSignalTime(`FDCAN2::dbNode::`SGW::`TELEMATIC_FD_5::`CameraDisplaySts2), __cArray2, __cArray4, 8192);
      ReportTableRow(__tableHandle, 0, __cArray4, __cAOp, 2, __cArray3, __oneOfFlag, __bSetInCheckAlignment);
      
  
    }
    ReportTableEndTestStep(__tableHandle, "1");
  }
  TestCommandEnd();


  TestCommandBegin(__eWait, __cWait, "", "1");
  {
    Wait("1", (1000 * 1000000LL), 1000000, "");
  }
  TestCommandEnd();

  TestCommandBegin(__eCheck, __cCheck, "", "2");
  {
    __bVerdict = __eVerdictPass;
    __tableHandle = ReportTableHead5Columns(__cCheckCaption, __cTSym, __cTOp, __cRefVal, __cActual, __cRes);
    {
      {
        int __res1,__res2;
        __res1 = CheckSignalMatch(`FDCAN2::dbNode::`CVADAS::`CVPAM_FD_Info::`DisplayView2, 1, __cGreaterEqualThan) == 1;
        __res2 = CheckSignalMatch(`FDCAN2::dbNode::`CVADAS::`CVPAM_FD_Info::`DisplayView2, 15, __cLessEqualThan) == 1;
        __csr = __res1 && __res2;
        snprintf(__cArray, 8192, "%s", "DisplayView2");
        snprintf(__cArray2, 8192, "%s '%s'", __cCANSignal, __cArray);
        snprintf(__cArray3, 8192, "%s", "");
        snprintf(__cArray4, 8192, "%s", "");
        snprintf(__cArray5, 8192, "%s", __cArray3);
        snprintf(__cArray6, 8192, "%s", __cArray4);
        ReportRange(1, 15, __cArray5, __cArray6, __cArray7, 8192);
        ReportTableRow(__tableHandle, 0, __cArray2, __cRange, __cArray7, __cEmpty, __oneOfFlag, __bSetInCheckAlignment);
        ReportLValueOrSignalNotOnline(`FDCAN2::dbNode::`CVADAS::`CVPAM_FD_Info::`DisplayView2, __cArray8, 8192);
        ReportCell(__tableHandle, __cArray8);
        ReportCellResult(__tableHandle, __csr, __ePassFail);
      }
  
      __bVerdict = __bVerdict && __csr;
    }
    ReportTableEndVerdict(__tableHandle, "1", __bVerdict);
  }
  TestCommandEnd();


}

void Tt4h42sqi_Tet_Tc5()
{
  CreateTTEIFFunction("Tt4h42sqi_Tc5", __eTcDef, __eLocal);  
  AddIFParameterTestCaseAttribute("TC_ID", "");
  AddIFParameterTestCaseAttribute("Test Case ID", "");
  CallInterfaceFunction("View 3: Forward Facing Camera", __cEmpty , __cEmpty );
}
testcase Tt4h42sqi_Tc5()
{
  stack long __tableHandle;
  SetBreakOnFail(1);

  TestCommandBegin(__eSet, __cSet, "", "0");
  {
    __tableHandle = ReportTableHead3Columns(__cSetCaption , __cTSym, __cTOp, __cAssigned); 
    {
      $`FDCAN2::dbNode::`SGW::`TELEMATIC_FD_5::`CameraDisplaySts2.phys = 3;
      snprintf(__cArray, 8192, "%s", "CameraDisplaySts2");
      snprintf(__cArray2, 8192, "%s '%s'", __cCANSignal, __cArray);
      snprintf(__cArray3, 8192, "%s", "");
      
      ReportSetLValueOrSignalNotOnline(getSignalTime(`FDCAN2::dbNode::`SGW::`TELEMATIC_FD_5::`CameraDisplaySts2), __cArray2, __cArray4, 8192);
      ReportTableRow(__tableHandle, 0, __cArray4, __cAOp, 3, __cArray3, __oneOfFlag, __bSetInCheckAlignment);
      
  
    }
    ReportTableEndTestStep(__tableHandle, "1");
  }
  TestCommandEnd();


  TestCommandBegin(__eWait, __cWait, "", "1");
  {
    Wait("1", (1000 * 1000000LL), 1000000, "");
  }
  TestCommandEnd();

  TestCommandBegin(__eCheck, __cCheck, "", "2");
  {
    __bVerdict = __eVerdictPass;
    __tableHandle = ReportTableHead5Columns(__cCheckCaption, __cTSym, __cTOp, __cRefVal, __cActual, __cRes);
    {
      {
        int __res1,__res2;
        __res1 = CheckSignalMatch(`FDCAN2::dbNode::`CVADAS::`CVPAM_FD_Info::`DisplayView2, 1, __cGreaterEqualThan) == 1;
        __res2 = CheckSignalMatch(`FDCAN2::dbNode::`CVADAS::`CVPAM_FD_Info::`DisplayView2, 15, __cLessEqualThan) == 1;
        __csr = __res1 && __res2;
        snprintf(__cArray, 8192, "%s", "DisplayView2");
        snprintf(__cArray2, 8192, "%s '%s'", __cCANSignal, __cArray);
        snprintf(__cArray3, 8192, "%s", "");
        snprintf(__cArray4, 8192, "%s", "");
        snprintf(__cArray5, 8192, "%s", __cArray3);
        snprintf(__cArray6, 8192, "%s", __cArray4);
        ReportRange(1, 15, __cArray5, __cArray6, __cArray7, 8192);
        ReportTableRow(__tableHandle, 0, __cArray2, __cRange, __cArray7, __cEmpty, __oneOfFlag, __bSetInCheckAlignment);
        ReportLValueOrSignalNotOnline(`FDCAN2::dbNode::`CVADAS::`CVPAM_FD_Info::`DisplayView2, __cArray8, 8192);
        ReportCell(__tableHandle, __cArray8);
        ReportCellResult(__tableHandle, __csr, __ePassFail);
      }
  
      __bVerdict = __bVerdict && __csr;
    }
    ReportTableEndVerdict(__tableHandle, "1", __bVerdict);
  }
  TestCommandEnd();


}

void Tt4h42sqi_Tet_Tc6()
{
  CreateTTEIFFunction("Tt4h42sqi_Tc6", __eTcDef, __eLocal);  
  AddIFParameterTestCaseAttribute("TC_ID", "");
  AddIFParameterTestCaseAttribute("Test Case ID", "");
  CallInterfaceFunction("View 5: Trailer Reverse Guidance", __cEmpty , __cEmpty );
}
testcase Tt4h42sqi_Tc6()
{
  stack long __tableHandle;
  SetBreakOnFail(1);

  TestCommandBegin(__eSet, __cSet, "", "0");
  {
    __tableHandle = ReportTableHead3Columns(__cSetCaption , __cTSym, __cTOp, __cAssigned); 
    {
      $`FDCAN2::dbNode::`SGW::`TELEMATIC_FD_5::`CameraDisplaySts2.phys = 5;
      snprintf(__cArray, 8192, "%s", "CameraDisplaySts2");
      snprintf(__cArray2, 8192, "%s '%s'", __cCANSignal, __cArray);
      snprintf(__cArray3, 8192, "%s", "");
      
      ReportSetLValueOrSignalNotOnline(getSignalTime(`FDCAN2::dbNode::`SGW::`TELEMATIC_FD_5::`CameraDisplaySts2), __cArray2, __cArray4, 8192);
      ReportTableRow(__tableHandle, 0, __cArray4, __cAOp, 5, __cArray3, __oneOfFlag, __bSetInCheckAlignment);
      
  
    }
    ReportTableEndTestStep(__tableHandle, "1");
  }
  TestCommandEnd();


  TestCommandBegin(__eWait, __cWait, "", "1");
  {
    Wait("1", (1000 * 1000000LL), 1000000, "");
  }
  TestCommandEnd();

  TestCommandBegin(__eCheck, __cCheck, "", "2");
  {
    __bVerdict = __eVerdictPass;
    __tableHandle = ReportTableHead5Columns(__cCheckCaption, __cTSym, __cTOp, __cRefVal, __cActual, __cRes);
    {
      {
        int __res1,__res2;
        __res1 = CheckSignalMatch(`FDCAN2::dbNode::`CVADAS::`CVPAM_FD_Info::`DisplayView2, 1, __cGreaterEqualThan) == 1;
        __res2 = CheckSignalMatch(`FDCAN2::dbNode::`CVADAS::`CVPAM_FD_Info::`DisplayView2, 15, __cLessEqualThan) == 1;
        __csr = __res1 && __res2;
        snprintf(__cArray, 8192, "%s", "DisplayView2");
        snprintf(__cArray2, 8192, "%s '%s'", __cCANSignal, __cArray);
        snprintf(__cArray3, 8192, "%s", "");
        snprintf(__cArray4, 8192, "%s", "");
        snprintf(__cArray5, 8192, "%s", __cArray3);
        snprintf(__cArray6, 8192, "%s", __cArray4);
        ReportRange(1, 15, __cArray5, __cArray6, __cArray7, 8192);
        ReportTableRow(__tableHandle, 0, __cArray2, __cRange, __cArray7, __cEmpty, __oneOfFlag, __bSetInCheckAlignment);
        ReportLValueOrSignalNotOnline(`FDCAN2::dbNode::`CVADAS::`CVPAM_FD_Info::`DisplayView2, __cArray8, 8192);
        ReportCell(__tableHandle, __cArray8);
        ReportCellResult(__tableHandle, __csr, __ePassFail);
      }
  
      __bVerdict = __bVerdict && __csr;
    }
    ReportTableEndVerdict(__tableHandle, "1", __bVerdict);
  }
  TestCommandEnd();


}

void Tt4h42sqi_Tet_Tc7()
{
  CreateTTEIFFunction("Tt4h42sqi_Tc7", __eTcDef, __eLocal);  
  AddIFParameterTestCaseAttribute("TC_ID", "");
  AddIFParameterTestCaseAttribute("Test Case ID", "");
  CallInterfaceFunction("View 6: Trailer Left View", __cEmpty , __cEmpty );
}
testcase Tt4h42sqi_Tc7()
{
  stack long __tableHandle;
  SetBreakOnFail(1);

  TestCommandBegin(__eSet, __cSet, "", "0");
  {
    __tableHandle = ReportTableHead3Columns(__cSetCaption , __cTSym, __cTOp, __cAssigned); 
    {
      $`FDCAN2::dbNode::`SGW::`TELEMATIC_FD_5::`CameraDisplaySts2.phys = 6;
      snprintf(__cArray, 8192, "%s", "CameraDisplaySts2");
      snprintf(__cArray2, 8192, "%s '%s'", __cCANSignal, __cArray);
      snprintf(__cArray3, 8192, "%s", "");
      
      ReportSetLValueOrSignalNotOnline(getSignalTime(`FDCAN2::dbNode::`SGW::`TELEMATIC_FD_5::`CameraDisplaySts2), __cArray2, __cArray4, 8192);
      ReportTableRow(__tableHandle, 0, __cArray4, __cAOp, 6, __cArray3, __oneOfFlag, __bSetInCheckAlignment);
      
  
    }
    ReportTableEndTestStep(__tableHandle, "1");
  }
  TestCommandEnd();


  TestCommandBegin(__eWait, __cWait, "", "1");
  {
    Wait("1", (1000 * 1000000LL), 1000000, "");
  }
  TestCommandEnd();

  TestCommandBegin(__eCheck, __cCheck, "", "2");
  {
    __bVerdict = __eVerdictPass;
    __tableHandle = ReportTableHead5Columns(__cCheckCaption, __cTSym, __cTOp, __cRefVal, __cActual, __cRes);
    {
      {
        int __res1,__res2;
        __res1 = CheckSignalMatch(`FDCAN2::dbNode::`CVADAS::`CVPAM_FD_Info::`DisplayView2, 1, __cGreaterEqualThan) == 1;
        __res2 = CheckSignalMatch(`FDCAN2::dbNode::`CVADAS::`CVPAM_FD_Info::`DisplayView2, 15, __cLessEqualThan) == 1;
        __csr = __res1 && __res2;
        snprintf(__cArray, 8192, "%s", "DisplayView2");
        snprintf(__cArray2, 8192, "%s '%s'", __cCANSignal, __cArray);
        snprintf(__cArray3, 8192, "%s", "");
        snprintf(__cArray4, 8192, "%s", "");
        snprintf(__cArray5, 8192, "%s", __cArray3);
        snprintf(__cArray6, 8192, "%s", __cArray4);
        ReportRange(1, 15, __cArray5, __cArray6, __cArray7, 8192);
        ReportTableRow(__tableHandle, 0, __cArray2, __cRange, __cArray7, __cEmpty, __oneOfFlag, __bSetInCheckAlignment);
        ReportLValueOrSignalNotOnline(`FDCAN2::dbNode::`CVADAS::`CVPAM_FD_Info::`DisplayView2, __cArray8, 8192);
        ReportCell(__tableHandle, __cArray8);
        ReportCellResult(__tableHandle, __csr, __ePassFail);
      }
  
      __bVerdict = __bVerdict && __csr;
    }
    ReportTableEndVerdict(__tableHandle, "1", __bVerdict);
  }
  TestCommandEnd();


}

void Tt4h42sqi_Tet_Tc8()
{
  CreateTTEIFFunction("Tt4h42sqi_Tc8", __eTcDef, __eLocal);  
  AddIFParameterTestCaseAttribute("TC_ID", "");
  AddIFParameterTestCaseAttribute("Test Case ID", "");
  CallInterfaceFunction("View 7: Trailer Right View", __cEmpty , __cEmpty );
}
testcase Tt4h42sqi_Tc8()
{
  stack long __tableHandle;
  SetBreakOnFail(1);

  TestCommandBegin(__eSet, __cSet, "", "0");
  {
    __tableHandle = ReportTableHead3Columns(__cSetCaption , __cTSym, __cTOp, __cAssigned); 
    {
      $`FDCAN2::dbNode::`SGW::`TELEMATIC_FD_5::`CameraDisplaySts2.phys = 7;
      snprintf(__cArray, 8192, "%s", "CameraDisplaySts2");
      snprintf(__cArray2, 8192, "%s '%s'", __cCANSignal, __cArray);
      snprintf(__cArray3, 8192, "%s", "");
      
      ReportSetLValueOrSignalNotOnline(getSignalTime(`FDCAN2::dbNode::`SGW::`TELEMATIC_FD_5::`CameraDisplaySts2), __cArray2, __cArray4, 8192);
      ReportTableRow(__tableHandle, 0, __cArray4, __cAOp, 7, __cArray3, __oneOfFlag, __bSetInCheckAlignment);
      
  
    }
    ReportTableEndTestStep(__tableHandle, "1");
  }
  TestCommandEnd();


  TestCommandBegin(__eWait, __cWait, "", "1");
  {
    Wait("1", (1000 * 1000000LL), 1000000, "");
  }
  TestCommandEnd();

  TestCommandBegin(__eCheck, __cCheck, "", "2");
  {
    __bVerdict = __eVerdictPass;
    __tableHandle = ReportTableHead5Columns(__cCheckCaption, __cTSym, __cTOp, __cRefVal, __cActual, __cRes);
    {
      {
        int __res1,__res2;
        __res1 = CheckSignalMatch(`FDCAN2::dbNode::`CVADAS::`CVPAM_FD_Info::`DisplayView2, 1, __cGreaterEqualThan) == 1;
        __res2 = CheckSignalMatch(`FDCAN2::dbNode::`CVADAS::`CVPAM_FD_Info::`DisplayView2, 15, __cLessEqualThan) == 1;
        __csr = __res1 && __res2;
        snprintf(__cArray, 8192, "%s", "DisplayView2");
        snprintf(__cArray2, 8192, "%s '%s'", __cCANSignal, __cArray);
        snprintf(__cArray3, 8192, "%s", "");
        snprintf(__cArray4, 8192, "%s", "");
        snprintf(__cArray5, 8192, "%s", __cArray3);
        snprintf(__cArray6, 8192, "%s", __cArray4);
        ReportRange(1, 15, __cArray5, __cArray6, __cArray7, 8192);
        ReportTableRow(__tableHandle, 0, __cArray2, __cRange, __cArray7, __cEmpty, __oneOfFlag, __bSetInCheckAlignment);
        ReportLValueOrSignalNotOnline(`FDCAN2::dbNode::`CVADAS::`CVPAM_FD_Info::`DisplayView2, __cArray8, 8192);
        ReportCell(__tableHandle, __cArray8);
        ReportCellResult(__tableHandle, __csr, __ePassFail);
      }
  
      __bVerdict = __bVerdict && __csr;
    }
    ReportTableEndVerdict(__tableHandle, "1", __bVerdict);
  }
  TestCommandEnd();


}

void Tt4h42sqi_Tet_Tc9()
{
  CreateTTEIFFunction("Tt4h42sqi_Tc9", __eTcDef, __eLocal);  
  AddIFParameterTestCaseAttribute("TC_ID", "");
  AddIFParameterTestCaseAttribute("Test Case ID", "");
  CallInterfaceFunction("View 8: Blind Spot Left View", __cEmpty , __cEmpty );
}
testcase Tt4h42sqi_Tc9()
{
  stack long __tableHandle;
  SetBreakOnFail(1);

  TestCommandBegin(__eSet, __cSet, "", "0");
  {
    __tableHandle = ReportTableHead3Columns(__cSetCaption , __cTSym, __cTOp, __cAssigned); 
    {
      $`FDCAN2::dbNode::`SGW::`TELEMATIC_FD_5::`CameraDisplaySts2.phys = 8;
      snprintf(__cArray, 8192, "%s", "CameraDisplaySts2");
      snprintf(__cArray2, 8192, "%s '%s'", __cCANSignal, __cArray);
      snprintf(__cArray3, 8192, "%s", "");
      
      ReportSetLValueOrSignalNotOnline(getSignalTime(`FDCAN2::dbNode::`SGW::`TELEMATIC_FD_5::`CameraDisplaySts2), __cArray2, __cArray4, 8192);
      ReportTableRow(__tableHandle, 0, __cArray4, __cAOp, 8, __cArray3, __oneOfFlag, __bSetInCheckAlignment);
      
  
    }
    ReportTableEndTestStep(__tableHandle, "1");
  }
  TestCommandEnd();


  TestCommandBegin(__eWait, __cWait, "", "1");
  {
    Wait("1", (1000 * 1000000LL), 1000000, "");
  }
  TestCommandEnd();

}

void Tt4h42sqi_Tet_Tc10()
{
  CreateTTEIFFunction("Tt4h42sqi_Tc10", __eTcDef, __eLocal);  
  AddIFParameterTestCaseAttribute("TC_ID", "");
  AddIFParameterTestCaseAttribute("Test Case ID", "");
  CallInterfaceFunction("View 9: Blind Spot Right View", __cEmpty , __cEmpty );
}
testcase Tt4h42sqi_Tc10()
{
  stack long __tableHandle;
  SetBreakOnFail(1);

  TestCommandBegin(__eSet, __cSet, "", "0");
  {
    __tableHandle = ReportTableHead3Columns(__cSetCaption , __cTSym, __cTOp, __cAssigned); 
    {
      $`FDCAN2::dbNode::`SGW::`TELEMATIC_FD_5::`CameraDisplaySts2.phys = 9;
      snprintf(__cArray, 8192, "%s", "CameraDisplaySts2");
      snprintf(__cArray2, 8192, "%s '%s'", __cCANSignal, __cArray);
      snprintf(__cArray3, 8192, "%s", "");
      
      ReportSetLValueOrSignalNotOnline(getSignalTime(`FDCAN2::dbNode::`SGW::`TELEMATIC_FD_5::`CameraDisplaySts2), __cArray2, __cArray4, 8192);
      ReportTableRow(__tableHandle, 0, __cArray4, __cAOp, 9, __cArray3, __oneOfFlag, __bSetInCheckAlignment);
      
  
    }
    ReportTableEndTestStep(__tableHandle, "1");
  }
  TestCommandEnd();


  TestCommandBegin(__eWait, __cWait, "", "1");
  {
    Wait("1", (1000 * 1000000LL), 1000000, "");
  }
  TestCommandEnd();

}

void Tt4h42sqi_Tet_Tc11()
{
  CreateTTEIFFunction("Tt4h42sqi_Tc11", __eTcDef, __eLocal);  
  AddIFParameterTestCaseAttribute("TC_ID", "");
  AddIFParameterTestCaseAttribute("Test Case ID", "");
  CallInterfaceFunction("View 11: FVTV", __cEmpty , __cEmpty );
}
testcase Tt4h42sqi_Tc11()
{
  stack long __tableHandle;
  SetBreakOnFail(1);

  TestCommandBegin(__eSet, __cSet, "", "0");
  {
    __tableHandle = ReportTableHead3Columns(__cSetCaption , __cTSym, __cTOp, __cAssigned); 
    {
      $`FDCAN2::dbNode::`SGW::`TELEMATIC_FD_5::`CameraDisplaySts2.phys = 11;
      snprintf(__cArray, 8192, "%s", "CameraDisplaySts2");
      snprintf(__cArray2, 8192, "%s '%s'", __cCANSignal, __cArray);
      snprintf(__cArray3, 8192, "%s", "");
      
      ReportSetLValueOrSignalNotOnline(getSignalTime(`FDCAN2::dbNode::`SGW::`TELEMATIC_FD_5::`CameraDisplaySts2), __cArray2, __cArray4, 8192);
      ReportTableRow(__tableHandle, 0, __cArray4, __cAOp, 11, __cArray3, __oneOfFlag, __bSetInCheckAlignment);
      
  
    }
    ReportTableEndTestStep(__tableHandle, "1");
  }
  TestCommandEnd();


  TestCommandBegin(__eWait, __cWait, "", "1");
  {
    Wait("1", (1000 * 1000000LL), 1000000, "");
  }
  TestCommandEnd();

  TestCommandBegin(__eCheck, __cCheck, "", "2");
  {
    __bVerdict = __eVerdictPass;
    __tableHandle = ReportTableHead5Columns(__cCheckCaption, __cTSym, __cTOp, __cRefVal, __cActual, __cRes);
    {
      {
        int __res1,__res2;
        __res1 = CheckSignalMatch(`FDCAN2::dbNode::`CVADAS::`CVPAM_FD_Info::`DisplayView2, 1, __cGreaterEqualThan) == 1;
        __res2 = CheckSignalMatch(`FDCAN2::dbNode::`CVADAS::`CVPAM_FD_Info::`DisplayView2, 15, __cLessEqualThan) == 1;
        __csr = __res1 && __res2;
        snprintf(__cArray, 8192, "%s", "DisplayView2");
        snprintf(__cArray2, 8192, "%s '%s'", __cCANSignal, __cArray);
        snprintf(__cArray3, 8192, "%s", "");
        snprintf(__cArray4, 8192, "%s", "");
        snprintf(__cArray5, 8192, "%s", __cArray3);
        snprintf(__cArray6, 8192, "%s", __cArray4);
        ReportRange(1, 15, __cArray5, __cArray6, __cArray7, 8192);
        ReportTableRow(__tableHandle, 0, __cArray2, __cRange, __cArray7, __cEmpty, __oneOfFlag, __bSetInCheckAlignment);
        ReportLValueOrSignalNotOnline(`FDCAN2::dbNode::`CVADAS::`CVPAM_FD_Info::`DisplayView2, __cArray8, 8192);
        ReportCell(__tableHandle, __cArray8);
        ReportCellResult(__tableHandle, __csr, __ePassFail);
      }
  
      __bVerdict = __bVerdict && __csr;
    }
    ReportTableEndVerdict(__tableHandle, "1", __bVerdict);
  }
  TestCommandEnd();


}

void Tt4h42sqi_Tet_Tc12()
{
  CreateTTEIFFunction("Tt4h42sqi_Tc12", __eTcDef, __eLocal);  
  AddIFParameterTestCaseAttribute("TC_ID", "");
  AddIFParameterTestCaseAttribute("Test Case ID", "");
  CallInterfaceFunction("View 12: RVTV", __cEmpty , __cEmpty );
}
testcase Tt4h42sqi_Tc12()
{
  stack long __tableHandle;
  SetBreakOnFail(1);

  TestCommandBegin(__eSet, __cSet, "", "0");
  {
    __tableHandle = ReportTableHead3Columns(__cSetCaption , __cTSym, __cTOp, __cAssigned); 
    {
      $`FDCAN2::dbNode::`SGW::`TELEMATIC_FD_5::`CameraDisplaySts2.phys = 12;
      snprintf(__cArray, 8192, "%s", "CameraDisplaySts2");
      snprintf(__cArray2, 8192, "%s '%s'", __cCANSignal, __cArray);
      snprintf(__cArray3, 8192, "%s", "");
      
      ReportSetLValueOrSignalNotOnline(getSignalTime(`FDCAN2::dbNode::`SGW::`TELEMATIC_FD_5::`CameraDisplaySts2), __cArray2, __cArray4, 8192);
      ReportTableRow(__tableHandle, 0, __cArray4, __cAOp, 12, __cArray3, __oneOfFlag, __bSetInCheckAlignment);
      
  
    }
    ReportTableEndTestStep(__tableHandle, "1");
  }
  TestCommandEnd();


  TestCommandBegin(__eWait, __cWait, "", "1");
  {
    Wait("1", (1000 * 1000000LL), 1000000, "");
  }
  TestCommandEnd();

  TestCommandBegin(__eCheck, __cCheck, "", "2");
  {
    __bVerdict = __eVerdictPass;
    __tableHandle = ReportTableHead5Columns(__cCheckCaption, __cTSym, __cTOp, __cRefVal, __cActual, __cRes);
    {
      {
        int __res1,__res2;
        __res1 = CheckSignalMatch(`FDCAN2::dbNode::`CVADAS::`CVPAM_FD_Info::`DisplayView2, 1, __cGreaterEqualThan) == 1;
        __res2 = CheckSignalMatch(`FDCAN2::dbNode::`CVADAS::`CVPAM_FD_Info::`DisplayView2, 15, __cLessEqualThan) == 1;
        __csr = __res1 && __res2;
        snprintf(__cArray, 8192, "%s", "DisplayView2");
        snprintf(__cArray2, 8192, "%s '%s'", __cCANSignal, __cArray);
        snprintf(__cArray3, 8192, "%s", "");
        snprintf(__cArray4, 8192, "%s", "");
        snprintf(__cArray5, 8192, "%s", __cArray3);
        snprintf(__cArray6, 8192, "%s", __cArray4);
        ReportRange(1, 15, __cArray5, __cArray6, __cArray7, 8192);
        ReportTableRow(__tableHandle, 0, __cArray2, __cRange, __cArray7, __cEmpty, __oneOfFlag, __bSetInCheckAlignment);
        ReportLValueOrSignalNotOnline(`FDCAN2::dbNode::`CVADAS::`CVPAM_FD_Info::`DisplayView2, __cArray8, 8192);
        ReportCell(__tableHandle, __cArray8);
        ReportCellResult(__tableHandle, __csr, __ePassFail);
      }
  
      __bVerdict = __bVerdict && __csr;
    }
    ReportTableEndVerdict(__tableHandle, "1", __bVerdict);
  }
  TestCommandEnd();


}

void Tt4h42sqi_Tet_Tc13()
{
  CreateTTEIFFunction("Tt4h42sqi_Tc13", __eTcDef, __eLocal);  
  AddIFParameterTestCaseAttribute("TC_ID", "");
  AddIFParameterTestCaseAttribute("Test Case ID", "");
  CallInterfaceFunction("View 13: FrontCrossPathView", __cEmpty , __cEmpty );
}
testcase Tt4h42sqi_Tc13()
{
  stack long __tableHandle;
  SetBreakOnFail(1);

  TestCommandBegin(__eSet, __cSet, "", "0");
  {
    __tableHandle = ReportTableHead3Columns(__cSetCaption , __cTSym, __cTOp, __cAssigned); 
    {
      $`FDCAN2::dbNode::`SGW::`TELEMATIC_FD_5::`CameraDisplaySts2.phys = 13;
      snprintf(__cArray, 8192, "%s", "CameraDisplaySts2");
      snprintf(__cArray2, 8192, "%s '%s'", __cCANSignal, __cArray);
      snprintf(__cArray3, 8192, "%s", "");
      
      ReportSetLValueOrSignalNotOnline(getSignalTime(`FDCAN2::dbNode::`SGW::`TELEMATIC_FD_5::`CameraDisplaySts2), __cArray2, __cArray4, 8192);
      ReportTableRow(__tableHandle, 0, __cArray4, __cAOp, 13, __cArray3, __oneOfFlag, __bSetInCheckAlignment);
      
  
    }
    ReportTableEndTestStep(__tableHandle, "1");
  }
  TestCommandEnd();


  TestCommandBegin(__eWait, __cWait, "", "1");
  {
    Wait("1", (1000 * 1000000LL), 1000000, "");
  }
  TestCommandEnd();

  TestCommandBegin(__eCheck, __cCheck, "", "2");
  {
    __bVerdict = __eVerdictPass;
    __tableHandle = ReportTableHead5Columns(__cCheckCaption, __cTSym, __cTOp, __cRefVal, __cActual, __cRes);
    {
      {
        int __res1,__res2;
        __res1 = CheckSignalMatch(`FDCAN2::dbNode::`CVADAS::`CVPAM_FD_Info::`DisplayView2, 1, __cGreaterEqualThan) == 1;
        __res2 = CheckSignalMatch(`FDCAN2::dbNode::`CVADAS::`CVPAM_FD_Info::`DisplayView2, 15, __cLessEqualThan) == 1;
        __csr = __res1 && __res2;
        snprintf(__cArray, 8192, "%s", "DisplayView2");
        snprintf(__cArray2, 8192, "%s '%s'", __cCANSignal, __cArray);
        snprintf(__cArray3, 8192, "%s", "");
        snprintf(__cArray4, 8192, "%s", "");
        snprintf(__cArray5, 8192, "%s", __cArray3);
        snprintf(__cArray6, 8192, "%s", __cArray4);
        ReportRange(1, 15, __cArray5, __cArray6, __cArray7, 8192);
        ReportTableRow(__tableHandle, 0, __cArray2, __cRange, __cArray7, __cEmpty, __oneOfFlag, __bSetInCheckAlignment);
        ReportLValueOrSignalNotOnline(`FDCAN2::dbNode::`CVADAS::`CVPAM_FD_Info::`DisplayView2, __cArray8, 8192);
        ReportCell(__tableHandle, __cArray8);
        ReportCellResult(__tableHandle, __csr, __ePassFail);
      }
  
      __bVerdict = __bVerdict && __csr;
    }
    ReportTableEndVerdict(__tableHandle, "1", __bVerdict);
  }
  TestCommandEnd();


}

void Tt4h42sqi_Tet_Tc14()
{
  CreateTTEIFFunction("Tt4h42sqi_Tc14", __eTcDef, __eLocal);  
  AddIFParameterTestCaseAttribute("TC_ID", "");
  AddIFParameterTestCaseAttribute("Test Case ID", "");
  CallInterfaceFunction("View 14: RearCrossPathView", __cEmpty , __cEmpty );
}
testcase Tt4h42sqi_Tc14()
{
  stack long __tableHandle;
  SetBreakOnFail(1);

  TestCommandBegin(__eSet, __cSet, "", "0");
  {
    __tableHandle = ReportTableHead3Columns(__cSetCaption , __cTSym, __cTOp, __cAssigned); 
    {
      $`FDCAN2::dbNode::`SGW::`TELEMATIC_FD_5::`CameraDisplaySts2.phys = 14;
      snprintf(__cArray, 8192, "%s", "CameraDisplaySts2");
      snprintf(__cArray2, 8192, "%s '%s'", __cCANSignal, __cArray);
      snprintf(__cArray3, 8192, "%s", "");
      
      ReportSetLValueOrSignalNotOnline(getSignalTime(`FDCAN2::dbNode::`SGW::`TELEMATIC_FD_5::`CameraDisplaySts2), __cArray2, __cArray4, 8192);
      ReportTableRow(__tableHandle, 0, __cArray4, __cAOp, 14, __cArray3, __oneOfFlag, __bSetInCheckAlignment);
      
  
    }
    ReportTableEndTestStep(__tableHandle, "1");
  }
  TestCommandEnd();


  TestCommandBegin(__eWait, __cWait, "", "1");
  {
    Wait("1", (1000 * 1000000LL), 1000000, "");
  }
  TestCommandEnd();

  TestCommandBegin(__eCheck, __cCheck, "", "2");
  {
    __bVerdict = __eVerdictPass;
    __tableHandle = ReportTableHead5Columns(__cCheckCaption, __cTSym, __cTOp, __cRefVal, __cActual, __cRes);
    {
      {
        int __res1,__res2;
        __res1 = CheckSignalMatch(`FDCAN2::dbNode::`CVADAS::`CVPAM_FD_Info::`DisplayView2, 1, __cGreaterEqualThan) == 1;
        __res2 = CheckSignalMatch(`FDCAN2::dbNode::`CVADAS::`CVPAM_FD_Info::`DisplayView2, 15, __cLessEqualThan) == 1;
        __csr = __res1 && __res2;
        snprintf(__cArray, 8192, "%s", "DisplayView2");
        snprintf(__cArray2, 8192, "%s '%s'", __cCANSignal, __cArray);
        snprintf(__cArray3, 8192, "%s", "");
        snprintf(__cArray4, 8192, "%s", "");
        snprintf(__cArray5, 8192, "%s", __cArray3);
        snprintf(__cArray6, 8192, "%s", __cArray4);
        ReportRange(1, 15, __cArray5, __cArray6, __cArray7, 8192);
        ReportTableRow(__tableHandle, 0, __cArray2, __cRange, __cArray7, __cEmpty, __oneOfFlag, __bSetInCheckAlignment);
        ReportLValueOrSignalNotOnline(`FDCAN2::dbNode::`CVADAS::`CVPAM_FD_Info::`DisplayView2, __cArray8, 8192);
        ReportCell(__tableHandle, __cArray8);
        ReportCellResult(__tableHandle, __csr, __ePassFail);
      }
  
      __bVerdict = __bVerdict && __csr;
    }
    ReportTableEndVerdict(__tableHandle, "1", __bVerdict);
  }
  TestCommandEnd();


}

void Tt4h42sqi_Tet_CaplTcCall1()
{
  stack long __tableHandle;
  CreateCaplIFFunction("Send_Proxi", __eTcDef);
  AddIFParameterTestCaseAttribute("TC_ID", "");
  AddIFParameterTestCaseAttribute("Test Case ID", "");
  AddIFParameterChar(syspar::`VehicleProxy2);
  CallInterfaceFunction(__cEmpty , "", __cEmpty );
}

void Tt4h42sqi_Tet_Tc15()
{
  CreateTTEIFFunction("Tt4h42sqi_Tc15", __eTcDef, __eLocal);  
  AddIFParameterTestCaseAttribute("TC_ID", "");
  AddIFParameterTestCaseAttribute("Test Case ID", "");
  CallInterfaceFunction("Set to Surround View Camera", __cEmpty , __cEmpty );
}
testcase Tt4h42sqi_Tc15()
{
  stack long __tableHandle;
  SetBreakOnFail(1);

  TestPreparationBegin();
  {
  }
  TestPreparationEnd();

  TestCommandBegin(__eSet, __cSet, "", "0");
  {
    __tableHandle = ReportTableHead3Columns(__cSetCaption , __cTSym, __cTOp, __cAssigned); 
    {
      $`FDCAN2::dbNode::`SGW::`TELEMATIC_FD_14::`TGW_CAMERA_DISP_STAT.phys = 4;
      snprintf(__cArray, 8192, "%s", "TGW_CAMERA_DISP_STAT");
      snprintf(__cArray2, 8192, "%s '%s'", __cCANSignal, __cArray);
      snprintf(__cArray3, 8192, "%s", "");
      
      ReportSetLValueOrSignalNotOnline(getSignalTime(`FDCAN2::dbNode::`SGW::`TELEMATIC_FD_14::`TGW_CAMERA_DISP_STAT), __cArray2, __cArray4, 8192);
      ReportTableRow(__tableHandle, 0, __cArray4, __cAOp, 4, __cArray3, __oneOfFlag, __bSetInCheckAlignment);
      
  
    }
    {
      $`FDCAN2::dbNode::`SGW::`TELEMATIC_FD_5::`CameraDisplaySts2.phys = 0;
      snprintf(__cArray, 8192, "%s", "CameraDisplaySts2");
      snprintf(__cArray2, 8192, "%s '%s'", __cCANSignal, __cArray);
      snprintf(__cArray3, 8192, "%s", "Default");
      
      ReportSetLValueOrSignalNotOnline(getSignalTime(`FDCAN2::dbNode::`SGW::`TELEMATIC_FD_5::`CameraDisplaySts2), __cArray2, __cArray4, 8192);
      ReportTableRow(__tableHandle, 0, __cArray4, __cAOp, 0, __cArray3, __oneOfFlag, __bSetInCheckAlignment);
      
  
    }
    ReportTableEndTestStep(__tableHandle, "1");
  }
  TestCommandEnd();


  TestCommandBegin(__eWait, __cWait, "", "1");
  {
    Wait("1", (1000 * 1000000LL), 1000000, "");
  }
  TestCommandEnd();

  TestCommandBegin(__eCheck, __cCheck, "", "2");
  {
    __bVerdict = __eVerdictPass;
    __tableHandle = ReportTableHead5Columns(__cCheckCaption, __cTSym, __cTOp, __cRefVal, __cActual, __cRes);
    {
      {
        int __res1,__res2;
        __res1 = CheckSignalMatch(`FDCAN2::dbNode::`SGW::`TELEMATIC_FD_14::`TGW_CAMERA_DISP_STAT, 0, __cGreaterEqualThan) == 1;
        __res2 = CheckSignalMatch(`FDCAN2::dbNode::`SGW::`TELEMATIC_FD_14::`TGW_CAMERA_DISP_STAT, 4, __cLessEqualThan) == 1;
        __csr = __res1 && __res2;
        snprintf(__cArray, 8192, "%s", "TGW_CAMERA_DISP_STAT");
        snprintf(__cArray2, 8192, "%s '%s'", __cCANSignal, __cArray);
        snprintf(__cArray3, 8192, "%s", "");
        snprintf(__cArray4, 8192, "%s", "");
        snprintf(__cArray5, 8192, "%s", __cArray3);
        snprintf(__cArray6, 8192, "%s", __cArray4);
        ReportRange(0, 4, __cArray5, __cArray6, __cArray7, 8192);
        ReportTableRow(__tableHandle, 0, __cArray2, __cRange, __cArray7, __cEmpty, __oneOfFlag, __bSetInCheckAlignment);
        ReportLValueOrSignalNotOnline(`FDCAN2::dbNode::`SGW::`TELEMATIC_FD_14::`TGW_CAMERA_DISP_STAT, __cArray8, 8192);
        ReportCell(__tableHandle, __cArray8);
        ReportCellResult(__tableHandle, __csr, __ePassFail);
      }
  
      __bVerdict = __bVerdict && __csr;
    }
    ReportTableEndVerdict(__tableHandle, "1", __bVerdict);
  }
  TestCommandEnd();


  TestCommandBegin(__eWait, __cWait, "", "3");
  {
    Wait("1", (3000 * 1000000LL), 1000000, "");
  }
  TestCommandEnd();

}

void Tt4h42sqi_Tet_Tc16()
{
  CreateTTEIFFunction("Tt4h42sqi_Tc16", __eTcDef, __eLocal);  
  AddIFParameterTestCaseAttribute("TC_ID", "");
  AddIFParameterTestCaseAttribute("Test Case ID", "");
  CallInterfaceFunction("Default View", __cEmpty , __cEmpty );
}
testcase Tt4h42sqi_Tc16()
{
  stack long __tableHandle;
  SetBreakOnFail(1);

  TestCommandBegin(__eSet, __cSet, "", "0");
  {
    __tableHandle = ReportTableHead3Columns(__cSetCaption , __cTSym, __cTOp, __cAssigned); 
    {
      $`FDCAN2::dbNode::`SGW::`TELEMATIC_FD_5::`CameraDisplaySts2.phys = 2;
      snprintf(__cArray, 8192, "%s", "CameraDisplaySts2");
      snprintf(__cArray2, 8192, "%s '%s'", __cCANSignal, __cArray);
      snprintf(__cArray3, 8192, "%s", "");
      
      ReportSetLValueOrSignalNotOnline(getSignalTime(`FDCAN2::dbNode::`SGW::`TELEMATIC_FD_5::`CameraDisplaySts2), __cArray2, __cArray4, 8192);
      ReportTableRow(__tableHandle, 0, __cArray4, __cAOp, 2, __cArray3, __oneOfFlag, __bSetInCheckAlignment);
      
  
    }
    ReportTableEndTestStep(__tableHandle, "1");
  }
  TestCommandEnd();


  TestCommandBegin(__eWait, __cWait, "", "1");
  {
    Wait("1", (1000 * 1000000LL), 1000000, "");
  }
  TestCommandEnd();

  TestCommandBegin(__eSet, __cSet, "", "2");
  {
    __tableHandle = ReportTableHead3Columns(__cSetCaption , __cTSym, __cTOp, __cAssigned); 
    {
      $`FDCAN2::dbNode::`SGW::`TELEMATIC_FD_5::`CameraDisplaySts2.phys = 0;
      snprintf(__cArray, 8192, "%s", "CameraDisplaySts2");
      snprintf(__cArray2, 8192, "%s '%s'", __cCANSignal, __cArray);
      snprintf(__cArray3, 8192, "%s", "");
      
      ReportSetLValueOrSignalNotOnline(getSignalTime(`FDCAN2::dbNode::`SGW::`TELEMATIC_FD_5::`CameraDisplaySts2), __cArray2, __cArray4, 8192);
      ReportTableRow(__tableHandle, 0, __cArray4, __cAOp, 0, __cArray3, __oneOfFlag, __bSetInCheckAlignment);
      
  
    }
    ReportTableEndTestStep(__tableHandle, "1");
  }
  TestCommandEnd();


  TestCommandBegin(__eWait, __cWait, "", "3");
  {
    Wait("1", (1000 * 1000000LL), 1000000, "");
  }
  TestCommandEnd();

  TestCommandBegin(__eCheck, __cCheck, "", "4");
  {
    __bVerdict = __eVerdictPass;
    __tableHandle = ReportTableHead5Columns(__cCheckCaption, __cTSym, __cTOp, __cRefVal, __cActual, __cRes);
    {
      {
        int __res1,__res2;
        __res1 = CheckSignalMatch(`FDCAN2::dbNode::`CVADAS::`CVPAM_FD_Info::`DisplayView2, 1, __cGreaterEqualThan) == 1;
        __res2 = CheckSignalMatch(`FDCAN2::dbNode::`CVADAS::`CVPAM_FD_Info::`DisplayView2, 15, __cLessEqualThan) == 1;
        __csr = __res1 && __res2;
        snprintf(__cArray, 8192, "%s", "DisplayView2");
        snprintf(__cArray2, 8192, "%s '%s'", __cCANSignal, __cArray);
        snprintf(__cArray3, 8192, "%s", "");
        snprintf(__cArray4, 8192, "%s", "");
        snprintf(__cArray5, 8192, "%s", __cArray3);
        snprintf(__cArray6, 8192, "%s", __cArray4);
        ReportRange(1, 15, __cArray5, __cArray6, __cArray7, 8192);
        ReportTableRow(__tableHandle, 0, __cArray2, __cRange, __cArray7, __cEmpty, __oneOfFlag, __bSetInCheckAlignment);
        ReportLValueOrSignalNotOnline(`FDCAN2::dbNode::`CVADAS::`CVPAM_FD_Info::`DisplayView2, __cArray8, 8192);
        ReportCell(__tableHandle, __cArray8);
        ReportCellResult(__tableHandle, __csr, __ePassFail);
      }
  
      __bVerdict = __bVerdict && __csr;
    }
    ReportTableEndVerdict(__tableHandle, "1", __bVerdict);
  }
  TestCommandEnd();


}

void Tt4h42sqi_Tet_Tc17()
{
  CreateTTEIFFunction("Tt4h42sqi_Tc17", __eTcDef, __eLocal);  
  AddIFParameterTestCaseAttribute("TC_ID", "");
  AddIFParameterTestCaseAttribute("Test Case ID", "");
  CallInterfaceFunction("View 1: FVTV_RVTV", __cEmpty , __cEmpty );
}
testcase Tt4h42sqi_Tc17()
{
  stack long __tableHandle;
  SetBreakOnFail(1);

  TestCommandBegin(__eSet, __cSet, "", "0");
  {
    __tableHandle = ReportTableHead3Columns(__cSetCaption , __cTSym, __cTOp, __cAssigned); 
    {
      $`FDCAN2::dbNode::`SGW::`TELEMATIC_FD_5::`CameraDisplaySts2.phys = 1;
      snprintf(__cArray, 8192, "%s", "CameraDisplaySts2");
      snprintf(__cArray2, 8192, "%s '%s'", __cCANSignal, __cArray);
      snprintf(__cArray3, 8192, "%s", "");
      
      ReportSetLValueOrSignalNotOnline(getSignalTime(`FDCAN2::dbNode::`SGW::`TELEMATIC_FD_5::`CameraDisplaySts2), __cArray2, __cArray4, 8192);
      ReportTableRow(__tableHandle, 0, __cArray4, __cAOp, 1, __cArray3, __oneOfFlag, __bSetInCheckAlignment);
      
  
    }
    ReportTableEndTestStep(__tableHandle, "1");
  }
  TestCommandEnd();


  TestCommandBegin(__eWait, __cWait, "", "1");
  {
    Wait("1", (1000 * 1000000LL), 1000000, "");
  }
  TestCommandEnd();

  TestCommandBegin(__eCheck, __cCheck, "", "2");
  {
    __bVerdict = __eVerdictPass;
    __tableHandle = ReportTableHead5Columns(__cCheckCaption, __cTSym, __cTOp, __cRefVal, __cActual, __cRes);
    {
      {
        int __res1,__res2;
        __res1 = CheckSignalMatch(`FDCAN2::dbNode::`CVADAS::`CVPAM_FD_Info::`DisplayView2, 1, __cGreaterEqualThan) == 1;
        __res2 = CheckSignalMatch(`FDCAN2::dbNode::`CVADAS::`CVPAM_FD_Info::`DisplayView2, 15, __cLessEqualThan) == 1;
        __csr = __res1 && __res2;
        snprintf(__cArray, 8192, "%s", "DisplayView2");
        snprintf(__cArray2, 8192, "%s '%s'", __cCANSignal, __cArray);
        snprintf(__cArray3, 8192, "%s", "");
        snprintf(__cArray4, 8192, "%s", "");
        snprintf(__cArray5, 8192, "%s", __cArray3);
        snprintf(__cArray6, 8192, "%s", __cArray4);
        ReportRange(1, 15, __cArray5, __cArray6, __cArray7, 8192);
        ReportTableRow(__tableHandle, 0, __cArray2, __cRange, __cArray7, __cEmpty, __oneOfFlag, __bSetInCheckAlignment);
        ReportLValueOrSignalNotOnline(`FDCAN2::dbNode::`CVADAS::`CVPAM_FD_Info::`DisplayView2, __cArray8, 8192);
        ReportCell(__tableHandle, __cArray8);
        ReportCellResult(__tableHandle, __csr, __ePassFail);
      }
  
      __bVerdict = __bVerdict && __csr;
    }
    ReportTableEndVerdict(__tableHandle, "1", __bVerdict);
  }
  TestCommandEnd();


}

void Tt4h42sqi_Tet_Tc18()
{
  CreateTTEIFFunction("Tt4h42sqi_Tc18", __eTcDef, __eLocal);  
  AddIFParameterTestCaseAttribute("TC_ID", "");
  AddIFParameterTestCaseAttribute("Test Case ID", "");
  CallInterfaceFunction("View 2: BackupRearView", __cEmpty , __cEmpty );
}
testcase Tt4h42sqi_Tc18()
{
  stack long __tableHandle;
  SetBreakOnFail(1);

  TestCommandBegin(__eSet, __cSet, "", "0");
  {
    __tableHandle = ReportTableHead3Columns(__cSetCaption , __cTSym, __cTOp, __cAssigned); 
    {
      $`FDCAN2::dbNode::`SGW::`TELEMATIC_FD_5::`CameraDisplaySts2.phys = 2;
      snprintf(__cArray, 8192, "%s", "CameraDisplaySts2");
      snprintf(__cArray2, 8192, "%s '%s'", __cCANSignal, __cArray);
      snprintf(__cArray3, 8192, "%s", "");
      
      ReportSetLValueOrSignalNotOnline(getSignalTime(`FDCAN2::dbNode::`SGW::`TELEMATIC_FD_5::`CameraDisplaySts2), __cArray2, __cArray4, 8192);
      ReportTableRow(__tableHandle, 0, __cArray4, __cAOp, 2, __cArray3, __oneOfFlag, __bSetInCheckAlignment);
      
  
    }
    ReportTableEndTestStep(__tableHandle, "1");
  }
  TestCommandEnd();


  TestCommandBegin(__eWait, __cWait, "", "1");
  {
    Wait("1", (1000 * 1000000LL), 1000000, "");
  }
  TestCommandEnd();

  TestCommandBegin(__eCheck, __cCheck, "", "2");
  {
    __bVerdict = __eVerdictPass;
    __tableHandle = ReportTableHead5Columns(__cCheckCaption, __cTSym, __cTOp, __cRefVal, __cActual, __cRes);
    {
      {
        int __res1,__res2;
        __res1 = CheckSignalMatch(`FDCAN2::dbNode::`CVADAS::`CVPAM_FD_Info::`DisplayView2, 1, __cGreaterEqualThan) == 1;
        __res2 = CheckSignalMatch(`FDCAN2::dbNode::`CVADAS::`CVPAM_FD_Info::`DisplayView2, 15, __cLessEqualThan) == 1;
        __csr = __res1 && __res2;
        snprintf(__cArray, 8192, "%s", "DisplayView2");
        snprintf(__cArray2, 8192, "%s '%s'", __cCANSignal, __cArray);
        snprintf(__cArray3, 8192, "%s", "");
        snprintf(__cArray4, 8192, "%s", "");
        snprintf(__cArray5, 8192, "%s", __cArray3);
        snprintf(__cArray6, 8192, "%s", __cArray4);
        ReportRange(1, 15, __cArray5, __cArray6, __cArray7, 8192);
        ReportTableRow(__tableHandle, 0, __cArray2, __cRange, __cArray7, __cEmpty, __oneOfFlag, __bSetInCheckAlignment);
        ReportLValueOrSignalNotOnline(`FDCAN2::dbNode::`CVADAS::`CVPAM_FD_Info::`DisplayView2, __cArray8, 8192);
        ReportCell(__tableHandle, __cArray8);
        ReportCellResult(__tableHandle, __csr, __ePassFail);
      }
  
      __bVerdict = __bVerdict && __csr;
    }
    ReportTableEndVerdict(__tableHandle, "1", __bVerdict);
  }
  TestCommandEnd();


}

void Tt4h42sqi_Tet_Tc19()
{
  CreateTTEIFFunction("Tt4h42sqi_Tc19", __eTcDef, __eLocal);  
  AddIFParameterTestCaseAttribute("TC_ID", "");
  AddIFParameterTestCaseAttribute("Test Case ID", "");
  CallInterfaceFunction("View 3: Forward Facing Camera", __cEmpty , __cEmpty );
}
testcase Tt4h42sqi_Tc19()
{
  stack long __tableHandle;
  SetBreakOnFail(1);

  TestCommandBegin(__eSet, __cSet, "", "0");
  {
    __tableHandle = ReportTableHead3Columns(__cSetCaption , __cTSym, __cTOp, __cAssigned); 
    {
      $`FDCAN2::dbNode::`SGW::`TELEMATIC_FD_5::`CameraDisplaySts2.phys = 3;
      snprintf(__cArray, 8192, "%s", "CameraDisplaySts2");
      snprintf(__cArray2, 8192, "%s '%s'", __cCANSignal, __cArray);
      snprintf(__cArray3, 8192, "%s", "");
      
      ReportSetLValueOrSignalNotOnline(getSignalTime(`FDCAN2::dbNode::`SGW::`TELEMATIC_FD_5::`CameraDisplaySts2), __cArray2, __cArray4, 8192);
      ReportTableRow(__tableHandle, 0, __cArray4, __cAOp, 3, __cArray3, __oneOfFlag, __bSetInCheckAlignment);
      
  
    }
    ReportTableEndTestStep(__tableHandle, "1");
  }
  TestCommandEnd();


  TestCommandBegin(__eWait, __cWait, "", "1");
  {
    Wait("1", (1000 * 1000000LL), 1000000, "");
  }
  TestCommandEnd();

  TestCommandBegin(__eCheck, __cCheck, "", "2");
  {
    __bVerdict = __eVerdictPass;
    __tableHandle = ReportTableHead5Columns(__cCheckCaption, __cTSym, __cTOp, __cRefVal, __cActual, __cRes);
    {
      {
        int __res1,__res2;
        __res1 = CheckSignalMatch(`FDCAN2::dbNode::`CVADAS::`CVPAM_FD_Info::`DisplayView2, 1, __cGreaterEqualThan) == 1;
        __res2 = CheckSignalMatch(`FDCAN2::dbNode::`CVADAS::`CVPAM_FD_Info::`DisplayView2, 15, __cLessEqualThan) == 1;
        __csr = __res1 && __res2;
        snprintf(__cArray, 8192, "%s", "DisplayView2");
        snprintf(__cArray2, 8192, "%s '%s'", __cCANSignal, __cArray);
        snprintf(__cArray3, 8192, "%s", "");
        snprintf(__cArray4, 8192, "%s", "");
        snprintf(__cArray5, 8192, "%s", __cArray3);
        snprintf(__cArray6, 8192, "%s", __cArray4);
        ReportRange(1, 15, __cArray5, __cArray6, __cArray7, 8192);
        ReportTableRow(__tableHandle, 0, __cArray2, __cRange, __cArray7, __cEmpty, __oneOfFlag, __bSetInCheckAlignment);
        ReportLValueOrSignalNotOnline(`FDCAN2::dbNode::`CVADAS::`CVPAM_FD_Info::`DisplayView2, __cArray8, 8192);
        ReportCell(__tableHandle, __cArray8);
        ReportCellResult(__tableHandle, __csr, __ePassFail);
      }
  
      __bVerdict = __bVerdict && __csr;
    }
    ReportTableEndVerdict(__tableHandle, "1", __bVerdict);
  }
  TestCommandEnd();


}

void Tt4h42sqi_Tet_Tc20()
{
  CreateTTEIFFunction("Tt4h42sqi_Tc20", __eTcDef, __eLocal);  
  AddIFParameterTestCaseAttribute("TC_ID", "");
  AddIFParameterTestCaseAttribute("Test Case ID", "");
  CallInterfaceFunction("View 5: Trailer Reverse Guidance", __cEmpty , __cEmpty );
}
testcase Tt4h42sqi_Tc20()
{
  stack long __tableHandle;
  SetBreakOnFail(1);

  TestCommandBegin(__eSet, __cSet, "", "0");
  {
    __tableHandle = ReportTableHead3Columns(__cSetCaption , __cTSym, __cTOp, __cAssigned); 
    {
      $`FDCAN2::dbNode::`SGW::`TELEMATIC_FD_5::`CameraDisplaySts2.phys = 5;
      snprintf(__cArray, 8192, "%s", "CameraDisplaySts2");
      snprintf(__cArray2, 8192, "%s '%s'", __cCANSignal, __cArray);
      snprintf(__cArray3, 8192, "%s", "");
      
      ReportSetLValueOrSignalNotOnline(getSignalTime(`FDCAN2::dbNode::`SGW::`TELEMATIC_FD_5::`CameraDisplaySts2), __cArray2, __cArray4, 8192);
      ReportTableRow(__tableHandle, 0, __cArray4, __cAOp, 5, __cArray3, __oneOfFlag, __bSetInCheckAlignment);
      
  
    }
    ReportTableEndTestStep(__tableHandle, "1");
  }
  TestCommandEnd();


  TestCommandBegin(__eWait, __cWait, "", "1");
  {
    Wait("1", (1000 * 1000000LL), 1000000, "");
  }
  TestCommandEnd();

  TestCommandBegin(__eCheck, __cCheck, "", "2");
  {
    __bVerdict = __eVerdictPass;
    __tableHandle = ReportTableHead5Columns(__cCheckCaption, __cTSym, __cTOp, __cRefVal, __cActual, __cRes);
    {
      {
        int __res1,__res2;
        __res1 = CheckSignalMatch(`FDCAN2::dbNode::`CVADAS::`CVPAM_FD_Info::`DisplayView2, 1, __cGreaterEqualThan) == 1;
        __res2 = CheckSignalMatch(`FDCAN2::dbNode::`CVADAS::`CVPAM_FD_Info::`DisplayView2, 15, __cLessEqualThan) == 1;
        __csr = __res1 && __res2;
        snprintf(__cArray, 8192, "%s", "DisplayView2");
        snprintf(__cArray2, 8192, "%s '%s'", __cCANSignal, __cArray);
        snprintf(__cArray3, 8192, "%s", "");
        snprintf(__cArray4, 8192, "%s", "");
        snprintf(__cArray5, 8192, "%s", __cArray3);
        snprintf(__cArray6, 8192, "%s", __cArray4);
        ReportRange(1, 15, __cArray5, __cArray6, __cArray7, 8192);
        ReportTableRow(__tableHandle, 0, __cArray2, __cRange, __cArray7, __cEmpty, __oneOfFlag, __bSetInCheckAlignment);
        ReportLValueOrSignalNotOnline(`FDCAN2::dbNode::`CVADAS::`CVPAM_FD_Info::`DisplayView2, __cArray8, 8192);
        ReportCell(__tableHandle, __cArray8);
        ReportCellResult(__tableHandle, __csr, __ePassFail);
      }
  
      __bVerdict = __bVerdict && __csr;
    }
    ReportTableEndVerdict(__tableHandle, "1", __bVerdict);
  }
  TestCommandEnd();


}

void Tt4h42sqi_Tet_Tc21()
{
  CreateTTEIFFunction("Tt4h42sqi_Tc21", __eTcDef, __eLocal);  
  AddIFParameterTestCaseAttribute("TC_ID", "");
  AddIFParameterTestCaseAttribute("Test Case ID", "");
  CallInterfaceFunction("View 6: Trailer Left View", __cEmpty , __cEmpty );
}
testcase Tt4h42sqi_Tc21()
{
  stack long __tableHandle;
  SetBreakOnFail(1);

  TestCommandBegin(__eSet, __cSet, "", "0");
  {
    __tableHandle = ReportTableHead3Columns(__cSetCaption , __cTSym, __cTOp, __cAssigned); 
    {
      $`FDCAN2::dbNode::`SGW::`TELEMATIC_FD_5::`CameraDisplaySts2.phys = 6;
      snprintf(__cArray, 8192, "%s", "CameraDisplaySts2");
      snprintf(__cArray2, 8192, "%s '%s'", __cCANSignal, __cArray);
      snprintf(__cArray3, 8192, "%s", "");
      
      ReportSetLValueOrSignalNotOnline(getSignalTime(`FDCAN2::dbNode::`SGW::`TELEMATIC_FD_5::`CameraDisplaySts2), __cArray2, __cArray4, 8192);
      ReportTableRow(__tableHandle, 0, __cArray4, __cAOp, 6, __cArray3, __oneOfFlag, __bSetInCheckAlignment);
      
  
    }
    ReportTableEndTestStep(__tableHandle, "1");
  }
  TestCommandEnd();


  TestCommandBegin(__eWait, __cWait, "", "1");
  {
    Wait("1", (1000 * 1000000LL), 1000000, "");
  }
  TestCommandEnd();

  TestCommandBegin(__eCheck, __cCheck, "", "2");
  {
    __bVerdict = __eVerdictPass;
    __tableHandle = ReportTableHead5Columns(__cCheckCaption, __cTSym, __cTOp, __cRefVal, __cActual, __cRes);
    {
      {
        int __res1,__res2;
        __res1 = CheckSignalMatch(`FDCAN2::dbNode::`CVADAS::`CVPAM_FD_Info::`DisplayView2, 1, __cGreaterEqualThan) == 1;
        __res2 = CheckSignalMatch(`FDCAN2::dbNode::`CVADAS::`CVPAM_FD_Info::`DisplayView2, 15, __cLessEqualThan) == 1;
        __csr = __res1 && __res2;
        snprintf(__cArray, 8192, "%s", "DisplayView2");
        snprintf(__cArray2, 8192, "%s '%s'", __cCANSignal, __cArray);
        snprintf(__cArray3, 8192, "%s", "");
        snprintf(__cArray4, 8192, "%s", "");
        snprintf(__cArray5, 8192, "%s", __cArray3);
        snprintf(__cArray6, 8192, "%s", __cArray4);
        ReportRange(1, 15, __cArray5, __cArray6, __cArray7, 8192);
        ReportTableRow(__tableHandle, 0, __cArray2, __cRange, __cArray7, __cEmpty, __oneOfFlag, __bSetInCheckAlignment);
        ReportLValueOrSignalNotOnline(`FDCAN2::dbNode::`CVADAS::`CVPAM_FD_Info::`DisplayView2, __cArray8, 8192);
        ReportCell(__tableHandle, __cArray8);
        ReportCellResult(__tableHandle, __csr, __ePassFail);
      }
  
      __bVerdict = __bVerdict && __csr;
    }
    ReportTableEndVerdict(__tableHandle, "1", __bVerdict);
  }
  TestCommandEnd();


}

void Tt4h42sqi_Tet_Tc22()
{
  CreateTTEIFFunction("Tt4h42sqi_Tc22", __eTcDef, __eLocal);  
  AddIFParameterTestCaseAttribute("TC_ID", "");
  AddIFParameterTestCaseAttribute("Test Case ID", "");
  CallInterfaceFunction("View 7: Trailer Right View", __cEmpty , __cEmpty );
}
testcase Tt4h42sqi_Tc22()
{
  stack long __tableHandle;
  SetBreakOnFail(1);

  TestCommandBegin(__eSet, __cSet, "", "0");
  {
    __tableHandle = ReportTableHead3Columns(__cSetCaption , __cTSym, __cTOp, __cAssigned); 
    {
      $`FDCAN2::dbNode::`SGW::`TELEMATIC_FD_5::`CameraDisplaySts2.phys = 7;
      snprintf(__cArray, 8192, "%s", "CameraDisplaySts2");
      snprintf(__cArray2, 8192, "%s '%s'", __cCANSignal, __cArray);
      snprintf(__cArray3, 8192, "%s", "");
      
      ReportSetLValueOrSignalNotOnline(getSignalTime(`FDCAN2::dbNode::`SGW::`TELEMATIC_FD_5::`CameraDisplaySts2), __cArray2, __cArray4, 8192);
      ReportTableRow(__tableHandle, 0, __cArray4, __cAOp, 7, __cArray3, __oneOfFlag, __bSetInCheckAlignment);
      
  
    }
    ReportTableEndTestStep(__tableHandle, "1");
  }
  TestCommandEnd();


  TestCommandBegin(__eWait, __cWait, "", "1");
  {
    Wait("1", (1000 * 1000000LL), 1000000, "");
  }
  TestCommandEnd();

  TestCommandBegin(__eCheck, __cCheck, "", "2");
  {
    __bVerdict = __eVerdictPass;
    __tableHandle = ReportTableHead5Columns(__cCheckCaption, __cTSym, __cTOp, __cRefVal, __cActual, __cRes);
    {
      {
        int __res1,__res2;
        __res1 = CheckSignalMatch(`FDCAN2::dbNode::`CVADAS::`CVPAM_FD_Info::`DisplayView2, 1, __cGreaterEqualThan) == 1;
        __res2 = CheckSignalMatch(`FDCAN2::dbNode::`CVADAS::`CVPAM_FD_Info::`DisplayView2, 15, __cLessEqualThan) == 1;
        __csr = __res1 && __res2;
        snprintf(__cArray, 8192, "%s", "DisplayView2");
        snprintf(__cArray2, 8192, "%s '%s'", __cCANSignal, __cArray);
        snprintf(__cArray3, 8192, "%s", "");
        snprintf(__cArray4, 8192, "%s", "");
        snprintf(__cArray5, 8192, "%s", __cArray3);
        snprintf(__cArray6, 8192, "%s", __cArray4);
        ReportRange(1, 15, __cArray5, __cArray6, __cArray7, 8192);
        ReportTableRow(__tableHandle, 0, __cArray2, __cRange, __cArray7, __cEmpty, __oneOfFlag, __bSetInCheckAlignment);
        ReportLValueOrSignalNotOnline(`FDCAN2::dbNode::`CVADAS::`CVPAM_FD_Info::`DisplayView2, __cArray8, 8192);
        ReportCell(__tableHandle, __cArray8);
        ReportCellResult(__tableHandle, __csr, __ePassFail);
      }
  
      __bVerdict = __bVerdict && __csr;
    }
    ReportTableEndVerdict(__tableHandle, "1", __bVerdict);
  }
  TestCommandEnd();


}

void Tt4h42sqi_Tet_Tc23()
{
  CreateTTEIFFunction("Tt4h42sqi_Tc23", __eTcDef, __eLocal);  
  AddIFParameterTestCaseAttribute("TC_ID", "");
  AddIFParameterTestCaseAttribute("Test Case ID", "");
  CallInterfaceFunction("View 8: Blind Spot Left View", __cEmpty , __cEmpty );
}
testcase Tt4h42sqi_Tc23()
{
  stack long __tableHandle;
  SetBreakOnFail(1);

  TestCommandBegin(__eSet, __cSet, "", "0");
  {
    __tableHandle = ReportTableHead3Columns(__cSetCaption , __cTSym, __cTOp, __cAssigned); 
    {
      $`FDCAN2::dbNode::`SGW::`TELEMATIC_FD_5::`CameraDisplaySts2.phys = 8;
      snprintf(__cArray, 8192, "%s", "CameraDisplaySts2");
      snprintf(__cArray2, 8192, "%s '%s'", __cCANSignal, __cArray);
      snprintf(__cArray3, 8192, "%s", "");
      
      ReportSetLValueOrSignalNotOnline(getSignalTime(`FDCAN2::dbNode::`SGW::`TELEMATIC_FD_5::`CameraDisplaySts2), __cArray2, __cArray4, 8192);
      ReportTableRow(__tableHandle, 0, __cArray4, __cAOp, 8, __cArray3, __oneOfFlag, __bSetInCheckAlignment);
      
  
    }
    ReportTableEndTestStep(__tableHandle, "1");
  }
  TestCommandEnd();


  TestCommandBegin(__eWait, __cWait, "", "1");
  {
    Wait("1", (1000 * 1000000LL), 1000000, "");
  }
  TestCommandEnd();

  TestCommandBegin(__eCheck, __cCheck, "", "2");
  {
    __bVerdict = __eVerdictPass;
    __tableHandle = ReportTableHead5Columns(__cCheckCaption, __cTSym, __cTOp, __cRefVal, __cActual, __cRes);
    {
      {
        int __res1,__res2;
        __res1 = CheckSignalMatch(`FDCAN2::dbNode::`CVADAS::`CVPAM_FD_Info::`DisplayView2, 2, __cGreaterEqualThan) == 1;
        __res2 = CheckSignalMatch(`FDCAN2::dbNode::`CVADAS::`CVPAM_FD_Info::`DisplayView2, 10, __cLessEqualThan) == 1;
        __csr = __res1 && __res2;
        snprintf(__cArray, 8192, "%s", "DisplayView2");
        snprintf(__cArray2, 8192, "%s '%s'", __cCANSignal, __cArray);
        snprintf(__cArray3, 8192, "%s", "");
        snprintf(__cArray4, 8192, "%s", "");
        snprintf(__cArray5, 8192, "%s", __cArray3);
        snprintf(__cArray6, 8192, "%s", __cArray4);
        ReportRange(2, 10, __cArray5, __cArray6, __cArray7, 8192);
        ReportTableRow(__tableHandle, 0, __cArray2, __cRange, __cArray7, __cEmpty, __oneOfFlag, __bSetInCheckAlignment);
        ReportLValueOrSignalNotOnline(`FDCAN2::dbNode::`CVADAS::`CVPAM_FD_Info::`DisplayView2, __cArray8, 8192);
        ReportCell(__tableHandle, __cArray8);
        ReportCellResult(__tableHandle, __csr, __ePassFail);
      }
  
      __bVerdict = __bVerdict && __csr;
    }
    ReportTableEndVerdict(__tableHandle, "1", __bVerdict);
  }
  TestCommandEnd();


}

void Tt4h42sqi_Tet_Tc24()
{
  CreateTTEIFFunction("Tt4h42sqi_Tc24", __eTcDef, __eLocal);  
  AddIFParameterTestCaseAttribute("TC_ID", "");
  AddIFParameterTestCaseAttribute("Test Case ID", "");
  CallInterfaceFunction("View 9: Blind Spot Right View", __cEmpty , __cEmpty );
}
testcase Tt4h42sqi_Tc24()
{
  stack long __tableHandle;
  SetBreakOnFail(1);

  TestCommandBegin(__eSet, __cSet, "", "0");
  {
    __tableHandle = ReportTableHead3Columns(__cSetCaption , __cTSym, __cTOp, __cAssigned); 
    {
      $`FDCAN2::dbNode::`SGW::`TELEMATIC_FD_5::`CameraDisplaySts2.phys = 9;
      snprintf(__cArray, 8192, "%s", "CameraDisplaySts2");
      snprintf(__cArray2, 8192, "%s '%s'", __cCANSignal, __cArray);
      snprintf(__cArray3, 8192, "%s", "");
      
      ReportSetLValueOrSignalNotOnline(getSignalTime(`FDCAN2::dbNode::`SGW::`TELEMATIC_FD_5::`CameraDisplaySts2), __cArray2, __cArray4, 8192);
      ReportTableRow(__tableHandle, 0, __cArray4, __cAOp, 9, __cArray3, __oneOfFlag, __bSetInCheckAlignment);
      
  
    }
    ReportTableEndTestStep(__tableHandle, "1");
  }
  TestCommandEnd();


  TestCommandBegin(__eWait, __cWait, "", "1");
  {
    Wait("1", (1000 * 1000000LL), 1000000, "");
  }
  TestCommandEnd();

  TestCommandBegin(__eCheck, __cCheck, "", "2");
  {
    __bVerdict = __eVerdictPass;
    __tableHandle = ReportTableHead5Columns(__cCheckCaption, __cTSym, __cTOp, __cRefVal, __cActual, __cRes);
    {
      {
        int __res1,__res2;
        __res1 = CheckSignalMatch(`FDCAN2::dbNode::`CVADAS::`CVPAM_FD_Info::`DisplayView2, 2, __cGreaterEqualThan) == 1;
        __res2 = CheckSignalMatch(`FDCAN2::dbNode::`CVADAS::`CVPAM_FD_Info::`DisplayView2, 15, __cLessEqualThan) == 1;
        __csr = __res1 && __res2;
        snprintf(__cArray, 8192, "%s", "DisplayView2");
        snprintf(__cArray2, 8192, "%s '%s'", __cCANSignal, __cArray);
        snprintf(__cArray3, 8192, "%s", "");
        snprintf(__cArray4, 8192, "%s", "");
        snprintf(__cArray5, 8192, "%s", __cArray3);
        snprintf(__cArray6, 8192, "%s", __cArray4);
        ReportRange(2, 15, __cArray5, __cArray6, __cArray7, 8192);
        ReportTableRow(__tableHandle, 0, __cArray2, __cRange, __cArray7, __cEmpty, __oneOfFlag, __bSetInCheckAlignment);
        ReportLValueOrSignalNotOnline(`FDCAN2::dbNode::`CVADAS::`CVPAM_FD_Info::`DisplayView2, __cArray8, 8192);
        ReportCell(__tableHandle, __cArray8);
        ReportCellResult(__tableHandle, __csr, __ePassFail);
      }
  
      __bVerdict = __bVerdict && __csr;
    }
    ReportTableEndVerdict(__tableHandle, "1", __bVerdict);
  }
  TestCommandEnd();


}

void Tt4h42sqi_Tet_Tc25()
{
  CreateTTEIFFunction("Tt4h42sqi_Tc25", __eTcDef, __eLocal);  
  AddIFParameterTestCaseAttribute("TC_ID", "");
  AddIFParameterTestCaseAttribute("Test Case ID", "");
  CallInterfaceFunction("View 11: FVTV", __cEmpty , __cEmpty );
}
testcase Tt4h42sqi_Tc25()
{
  stack long __tableHandle;
  SetBreakOnFail(1);

  TestCommandBegin(__eSet, __cSet, "", "0");
  {
    __tableHandle = ReportTableHead3Columns(__cSetCaption , __cTSym, __cTOp, __cAssigned); 
    {
      $`FDCAN2::dbNode::`SGW::`TELEMATIC_FD_5::`CameraDisplaySts2.phys = 11;
      snprintf(__cArray, 8192, "%s", "CameraDisplaySts2");
      snprintf(__cArray2, 8192, "%s '%s'", __cCANSignal, __cArray);
      snprintf(__cArray3, 8192, "%s", "");
      
      ReportSetLValueOrSignalNotOnline(getSignalTime(`FDCAN2::dbNode::`SGW::`TELEMATIC_FD_5::`CameraDisplaySts2), __cArray2, __cArray4, 8192);
      ReportTableRow(__tableHandle, 0, __cArray4, __cAOp, 11, __cArray3, __oneOfFlag, __bSetInCheckAlignment);
      
  
    }
    ReportTableEndTestStep(__tableHandle, "1");
  }
  TestCommandEnd();


  TestCommandBegin(__eWait, __cWait, "", "1");
  {
    Wait("1", (1000 * 1000000LL), 1000000, "");
  }
  TestCommandEnd();

  TestCommandBegin(__eCheck, __cCheck, "", "2");
  {
    __bVerdict = __eVerdictPass;
    __tableHandle = ReportTableHead5Columns(__cCheckCaption, __cTSym, __cTOp, __cRefVal, __cActual, __cRes);
    {
      {
        int __res1,__res2;
        __res1 = CheckSignalMatch(`FDCAN2::dbNode::`CVADAS::`CVPAM_FD_Info::`DisplayView2, 1, __cGreaterEqualThan) == 1;
        __res2 = CheckSignalMatch(`FDCAN2::dbNode::`CVADAS::`CVPAM_FD_Info::`DisplayView2, 15, __cLessEqualThan) == 1;
        __csr = __res1 && __res2;
        snprintf(__cArray, 8192, "%s", "DisplayView2");
        snprintf(__cArray2, 8192, "%s '%s'", __cCANSignal, __cArray);
        snprintf(__cArray3, 8192, "%s", "");
        snprintf(__cArray4, 8192, "%s", "");
        snprintf(__cArray5, 8192, "%s", __cArray3);
        snprintf(__cArray6, 8192, "%s", __cArray4);
        ReportRange(1, 15, __cArray5, __cArray6, __cArray7, 8192);
        ReportTableRow(__tableHandle, 0, __cArray2, __cRange, __cArray7, __cEmpty, __oneOfFlag, __bSetInCheckAlignment);
        ReportLValueOrSignalNotOnline(`FDCAN2::dbNode::`CVADAS::`CVPAM_FD_Info::`DisplayView2, __cArray8, 8192);
        ReportCell(__tableHandle, __cArray8);
        ReportCellResult(__tableHandle, __csr, __ePassFail);
      }
  
      __bVerdict = __bVerdict && __csr;
    }
    ReportTableEndVerdict(__tableHandle, "1", __bVerdict);
  }
  TestCommandEnd();


}

void Tt4h42sqi_Tet_Tc26()
{
  CreateTTEIFFunction("Tt4h42sqi_Tc26", __eTcDef, __eLocal);  
  AddIFParameterTestCaseAttribute("TC_ID", "");
  AddIFParameterTestCaseAttribute("Test Case ID", "");
  CallInterfaceFunction("View 12: RVTV", __cEmpty , __cEmpty );
}
testcase Tt4h42sqi_Tc26()
{
  stack long __tableHandle;
  SetBreakOnFail(1);

  TestCommandBegin(__eSet, __cSet, "", "0");
  {
    __tableHandle = ReportTableHead3Columns(__cSetCaption , __cTSym, __cTOp, __cAssigned); 
    {
      $`FDCAN2::dbNode::`SGW::`TELEMATIC_FD_5::`CameraDisplaySts2.phys = 12;
      snprintf(__cArray, 8192, "%s", "CameraDisplaySts2");
      snprintf(__cArray2, 8192, "%s '%s'", __cCANSignal, __cArray);
      snprintf(__cArray3, 8192, "%s", "");
      
      ReportSetLValueOrSignalNotOnline(getSignalTime(`FDCAN2::dbNode::`SGW::`TELEMATIC_FD_5::`CameraDisplaySts2), __cArray2, __cArray4, 8192);
      ReportTableRow(__tableHandle, 0, __cArray4, __cAOp, 12, __cArray3, __oneOfFlag, __bSetInCheckAlignment);
      
  
    }
    ReportTableEndTestStep(__tableHandle, "1");
  }
  TestCommandEnd();


  TestCommandBegin(__eWait, __cWait, "", "1");
  {
    Wait("1", (1000 * 1000000LL), 1000000, "");
  }
  TestCommandEnd();

  TestCommandBegin(__eCheck, __cCheck, "", "2");
  {
    __bVerdict = __eVerdictPass;
    __tableHandle = ReportTableHead5Columns(__cCheckCaption, __cTSym, __cTOp, __cRefVal, __cActual, __cRes);
    {
      {
        int __res1,__res2;
        __res1 = CheckSignalMatch(`FDCAN2::dbNode::`CVADAS::`CVPAM_FD_Info::`DisplayView2, 1, __cGreaterEqualThan) == 1;
        __res2 = CheckSignalMatch(`FDCAN2::dbNode::`CVADAS::`CVPAM_FD_Info::`DisplayView2, 15, __cLessEqualThan) == 1;
        __csr = __res1 && __res2;
        snprintf(__cArray, 8192, "%s", "DisplayView2");
        snprintf(__cArray2, 8192, "%s '%s'", __cCANSignal, __cArray);
        snprintf(__cArray3, 8192, "%s", "");
        snprintf(__cArray4, 8192, "%s", "");
        snprintf(__cArray5, 8192, "%s", __cArray3);
        snprintf(__cArray6, 8192, "%s", __cArray4);
        ReportRange(1, 15, __cArray5, __cArray6, __cArray7, 8192);
        ReportTableRow(__tableHandle, 0, __cArray2, __cRange, __cArray7, __cEmpty, __oneOfFlag, __bSetInCheckAlignment);
        ReportLValueOrSignalNotOnline(`FDCAN2::dbNode::`CVADAS::`CVPAM_FD_Info::`DisplayView2, __cArray8, 8192);
        ReportCell(__tableHandle, __cArray8);
        ReportCellResult(__tableHandle, __csr, __ePassFail);
      }
  
      __bVerdict = __bVerdict && __csr;
    }
    ReportTableEndVerdict(__tableHandle, "1", __bVerdict);
  }
  TestCommandEnd();


}

void Tt4h42sqi_Tet_Tc27()
{
  CreateTTEIFFunction("Tt4h42sqi_Tc27", __eTcDef, __eLocal);  
  AddIFParameterTestCaseAttribute("TC_ID", "");
  AddIFParameterTestCaseAttribute("Test Case ID", "");
  CallInterfaceFunction("View 13: FrontCrossPathView", __cEmpty , __cEmpty );
}
testcase Tt4h42sqi_Tc27()
{
  stack long __tableHandle;
  SetBreakOnFail(1);

  TestCommandBegin(__eSet, __cSet, "", "0");
  {
    __tableHandle = ReportTableHead3Columns(__cSetCaption , __cTSym, __cTOp, __cAssigned); 
    {
      $`FDCAN2::dbNode::`SGW::`TELEMATIC_FD_5::`CameraDisplaySts2.phys = 13;
      snprintf(__cArray, 8192, "%s", "CameraDisplaySts2");
      snprintf(__cArray2, 8192, "%s '%s'", __cCANSignal, __cArray);
      snprintf(__cArray3, 8192, "%s", "");
      
      ReportSetLValueOrSignalNotOnline(getSignalTime(`FDCAN2::dbNode::`SGW::`TELEMATIC_FD_5::`CameraDisplaySts2), __cArray2, __cArray4, 8192);
      ReportTableRow(__tableHandle, 0, __cArray4, __cAOp, 13, __cArray3, __oneOfFlag, __bSetInCheckAlignment);
      
  
    }
    ReportTableEndTestStep(__tableHandle, "1");
  }
  TestCommandEnd();


  TestCommandBegin(__eWait, __cWait, "", "1");
  {
    Wait("1", (1000 * 1000000LL), 1000000, "");
  }
  TestCommandEnd();

  TestCommandBegin(__eCheck, __cCheck, "", "2");
  {
    __bVerdict = __eVerdictPass;
    __tableHandle = ReportTableHead5Columns(__cCheckCaption, __cTSym, __cTOp, __cRefVal, __cActual, __cRes);
    {
      {
        int __res1,__res2;
        __res1 = CheckSignalMatch(`FDCAN2::dbNode::`CVADAS::`CVPAM_FD_Info::`DisplayView2, 1, __cGreaterEqualThan) == 1;
        __res2 = CheckSignalMatch(`FDCAN2::dbNode::`CVADAS::`CVPAM_FD_Info::`DisplayView2, 15, __cLessEqualThan) == 1;
        __csr = __res1 && __res2;
        snprintf(__cArray, 8192, "%s", "DisplayView2");
        snprintf(__cArray2, 8192, "%s '%s'", __cCANSignal, __cArray);
        snprintf(__cArray3, 8192, "%s", "");
        snprintf(__cArray4, 8192, "%s", "");
        snprintf(__cArray5, 8192, "%s", __cArray3);
        snprintf(__cArray6, 8192, "%s", __cArray4);
        ReportRange(1, 15, __cArray5, __cArray6, __cArray7, 8192);
        ReportTableRow(__tableHandle, 0, __cArray2, __cRange, __cArray7, __cEmpty, __oneOfFlag, __bSetInCheckAlignment);
        ReportLValueOrSignalNotOnline(`FDCAN2::dbNode::`CVADAS::`CVPAM_FD_Info::`DisplayView2, __cArray8, 8192);
        ReportCell(__tableHandle, __cArray8);
        ReportCellResult(__tableHandle, __csr, __ePassFail);
      }
  
      __bVerdict = __bVerdict && __csr;
    }
    ReportTableEndVerdict(__tableHandle, "1", __bVerdict);
  }
  TestCommandEnd();


}

void Tt4h42sqi_Tet_Tc28()
{
  CreateTTEIFFunction("Tt4h42sqi_Tc28", __eTcDef, __eLocal);  
  AddIFParameterTestCaseAttribute("TC_ID", "");
  AddIFParameterTestCaseAttribute("Test Case ID", "");
  CallInterfaceFunction("View 14: RearCrossPathView", __cEmpty , __cEmpty );
}
testcase Tt4h42sqi_Tc28()
{
  stack long __tableHandle;
  SetBreakOnFail(1);

  TestCommandBegin(__eSet, __cSet, "", "0");
  {
    __tableHandle = ReportTableHead3Columns(__cSetCaption , __cTSym, __cTOp, __cAssigned); 
    {
      $`FDCAN2::dbNode::`SGW::`TELEMATIC_FD_5::`CameraDisplaySts2.phys = 14;
      snprintf(__cArray, 8192, "%s", "CameraDisplaySts2");
      snprintf(__cArray2, 8192, "%s '%s'", __cCANSignal, __cArray);
      snprintf(__cArray3, 8192, "%s", "");
      
      ReportSetLValueOrSignalNotOnline(getSignalTime(`FDCAN2::dbNode::`SGW::`TELEMATIC_FD_5::`CameraDisplaySts2), __cArray2, __cArray4, 8192);
      ReportTableRow(__tableHandle, 0, __cArray4, __cAOp, 14, __cArray3, __oneOfFlag, __bSetInCheckAlignment);
      
  
    }
    ReportTableEndTestStep(__tableHandle, "1");
  }
  TestCommandEnd();


  TestCommandBegin(__eWait, __cWait, "", "1");
  {
    Wait("1", (1000 * 1000000LL), 1000000, "");
  }
  TestCommandEnd();

  TestCommandBegin(__eCheck, __cCheck, "", "2");
  {
    __bVerdict = __eVerdictPass;
    __tableHandle = ReportTableHead5Columns(__cCheckCaption, __cTSym, __cTOp, __cRefVal, __cActual, __cRes);
    {
      {
        int __res1,__res2;
        __res1 = CheckSignalMatch(`FDCAN2::dbNode::`CVADAS::`CVPAM_FD_Info::`DisplayView2, 1, __cGreaterEqualThan) == 1;
        __res2 = CheckSignalMatch(`FDCAN2::dbNode::`CVADAS::`CVPAM_FD_Info::`DisplayView2, 15, __cLessEqualThan) == 1;
        __csr = __res1 && __res2;
        snprintf(__cArray, 8192, "%s", "DisplayView2");
        snprintf(__cArray2, 8192, "%s '%s'", __cCANSignal, __cArray);
        snprintf(__cArray3, 8192, "%s", "");
        snprintf(__cArray4, 8192, "%s", "");
        snprintf(__cArray5, 8192, "%s", __cArray3);
        snprintf(__cArray6, 8192, "%s", __cArray4);
        ReportRange(1, 15, __cArray5, __cArray6, __cArray7, 8192);
        ReportTableRow(__tableHandle, 0, __cArray2, __cRange, __cArray7, __cEmpty, __oneOfFlag, __bSetInCheckAlignment);
        ReportLValueOrSignalNotOnline(`FDCAN2::dbNode::`CVADAS::`CVPAM_FD_Info::`DisplayView2, __cArray8, 8192);
        ReportCell(__tableHandle, __cArray8);
        ReportCellResult(__tableHandle, __csr, __ePassFail);
      }
  
      __bVerdict = __bVerdict && __csr;
    }
    ReportTableEndVerdict(__tableHandle, "1", __bVerdict);
  }
  TestCommandEnd();


}

void Tt4h42sqi_Tet_CaplTcCall2()
{
  stack long __tableHandle;
  CreateCaplIFFunction("Send_Proxi", __eTcDef);
  AddIFParameterTestCaseAttribute("TC_ID", "");
  AddIFParameterTestCaseAttribute("Test Case ID", "");
  AddIFParameterChar(syspar::`VehicleProxy3);
  CallInterfaceFunction(__cEmpty , "", __cEmpty );
}

void Tt4h42sqi_Tet_Tc29()
{
  CreateTTEIFFunction("Tt4h42sqi_Tc29", __eTcDef, __eLocal);  
  AddIFParameterTestCaseAttribute("TC_ID", "");
  AddIFParameterTestCaseAttribute("Test Case ID", "");
  CallInterfaceFunction("Set to Surround View Camera", __cEmpty , __cEmpty );
}
testcase Tt4h42sqi_Tc29()
{
  stack long __tableHandle;
  SetBreakOnFail(1);

  TestPreparationBegin();
  {
  }
  TestPreparationEnd();

  TestCommandBegin(__eSet, __cSet, "", "0");
  {
    __tableHandle = ReportTableHead3Columns(__cSetCaption , __cTSym, __cTOp, __cAssigned); 
    {
      $`FDCAN2::dbNode::`SGW::`TELEMATIC_FD_14::`TGW_CAMERA_DISP_STAT.phys = 4;
      snprintf(__cArray, 8192, "%s", "TGW_CAMERA_DISP_STAT");
      snprintf(__cArray2, 8192, "%s '%s'", __cCANSignal, __cArray);
      snprintf(__cArray3, 8192, "%s", "");
      
      ReportSetLValueOrSignalNotOnline(getSignalTime(`FDCAN2::dbNode::`SGW::`TELEMATIC_FD_14::`TGW_CAMERA_DISP_STAT), __cArray2, __cArray4, 8192);
      ReportTableRow(__tableHandle, 0, __cArray4, __cAOp, 4, __cArray3, __oneOfFlag, __bSetInCheckAlignment);
      
  
    }
    {
      $`FDCAN2::dbNode::`SGW::`TELEMATIC_FD_5::`CameraDisplaySts2.phys = 0;
      snprintf(__cArray, 8192, "%s", "CameraDisplaySts2");
      snprintf(__cArray2, 8192, "%s '%s'", __cCANSignal, __cArray);
      snprintf(__cArray3, 8192, "%s", "Default");
      
      ReportSetLValueOrSignalNotOnline(getSignalTime(`FDCAN2::dbNode::`SGW::`TELEMATIC_FD_5::`CameraDisplaySts2), __cArray2, __cArray4, 8192);
      ReportTableRow(__tableHandle, 0, __cArray4, __cAOp, 0, __cArray3, __oneOfFlag, __bSetInCheckAlignment);
      
  
    }
    ReportTableEndTestStep(__tableHandle, "1");
  }
  TestCommandEnd();


  TestCommandBegin(__eWait, __cWait, "", "1");
  {
    Wait("1", (1000 * 1000000LL), 1000000, "");
  }
  TestCommandEnd();

  TestCommandBegin(__eCheck, __cCheck, "", "2");
  {
    __bVerdict = __eVerdictPass;
    __tableHandle = ReportTableHead5Columns(__cCheckCaption, __cTSym, __cTOp, __cRefVal, __cActual, __cRes);
    {
      {
        int __res1,__res2;
        __res1 = CheckSignalMatch(`FDCAN2::dbNode::`SGW::`TELEMATIC_FD_14::`TGW_CAMERA_DISP_STAT, 0, __cGreaterEqualThan) == 1;
        __res2 = CheckSignalMatch(`FDCAN2::dbNode::`SGW::`TELEMATIC_FD_14::`TGW_CAMERA_DISP_STAT, 4, __cLessEqualThan) == 1;
        __csr = __res1 && __res2;
        snprintf(__cArray, 8192, "%s", "TGW_CAMERA_DISP_STAT");
        snprintf(__cArray2, 8192, "%s '%s'", __cCANSignal, __cArray);
        snprintf(__cArray3, 8192, "%s", "");
        snprintf(__cArray4, 8192, "%s", "");
        snprintf(__cArray5, 8192, "%s", __cArray3);
        snprintf(__cArray6, 8192, "%s", __cArray4);
        ReportRange(0, 4, __cArray5, __cArray6, __cArray7, 8192);
        ReportTableRow(__tableHandle, 0, __cArray2, __cRange, __cArray7, __cEmpty, __oneOfFlag, __bSetInCheckAlignment);
        ReportLValueOrSignalNotOnline(`FDCAN2::dbNode::`SGW::`TELEMATIC_FD_14::`TGW_CAMERA_DISP_STAT, __cArray8, 8192);
        ReportCell(__tableHandle, __cArray8);
        ReportCellResult(__tableHandle, __csr, __ePassFail);
      }
  
      __bVerdict = __bVerdict && __csr;
    }
    ReportTableEndVerdict(__tableHandle, "1", __bVerdict);
  }
  TestCommandEnd();


  TestCommandBegin(__eWait, __cWait, "", "3");
  {
    Wait("1", (3000 * 1000000LL), 1000000, "");
  }
  TestCommandEnd();

}

void Tt4h42sqi_Tet_Tc30()
{
  CreateTTEIFFunction("Tt4h42sqi_Tc30", __eTcDef, __eLocal);  
  AddIFParameterTestCaseAttribute("TC_ID", "");
  AddIFParameterTestCaseAttribute("Test Case ID", "");
  CallInterfaceFunction("Default View", __cEmpty , __cEmpty );
}
testcase Tt4h42sqi_Tc30()
{
  stack long __tableHandle;
  SetBreakOnFail(1);

  TestCommandBegin(__eSet, __cSet, "", "0");
  {
    __tableHandle = ReportTableHead3Columns(__cSetCaption , __cTSym, __cTOp, __cAssigned); 
    {
      $`FDCAN2::dbNode::`SGW::`TELEMATIC_FD_5::`CameraDisplaySts2.phys = 2;
      snprintf(__cArray, 8192, "%s", "CameraDisplaySts2");
      snprintf(__cArray2, 8192, "%s '%s'", __cCANSignal, __cArray);
      snprintf(__cArray3, 8192, "%s", "");
      
      ReportSetLValueOrSignalNotOnline(getSignalTime(`FDCAN2::dbNode::`SGW::`TELEMATIC_FD_5::`CameraDisplaySts2), __cArray2, __cArray4, 8192);
      ReportTableRow(__tableHandle, 0, __cArray4, __cAOp, 2, __cArray3, __oneOfFlag, __bSetInCheckAlignment);
      
  
    }
    ReportTableEndTestStep(__tableHandle, "1");
  }
  TestCommandEnd();


  TestCommandBegin(__eWait, __cWait, "", "1");
  {
    Wait("1", (1000 * 1000000LL), 1000000, "");
  }
  TestCommandEnd();

  TestCommandBegin(__eSet, __cSet, "", "2");
  {
    __tableHandle = ReportTableHead3Columns(__cSetCaption , __cTSym, __cTOp, __cAssigned); 
    {
      $`FDCAN2::dbNode::`SGW::`TELEMATIC_FD_5::`CameraDisplaySts2.phys = 0;
      snprintf(__cArray, 8192, "%s", "CameraDisplaySts2");
      snprintf(__cArray2, 8192, "%s '%s'", __cCANSignal, __cArray);
      snprintf(__cArray3, 8192, "%s", "");
      
      ReportSetLValueOrSignalNotOnline(getSignalTime(`FDCAN2::dbNode::`SGW::`TELEMATIC_FD_5::`CameraDisplaySts2), __cArray2, __cArray4, 8192);
      ReportTableRow(__tableHandle, 0, __cArray4, __cAOp, 0, __cArray3, __oneOfFlag, __bSetInCheckAlignment);
      
  
    }
    ReportTableEndTestStep(__tableHandle, "1");
  }
  TestCommandEnd();


  TestCommandBegin(__eWait, __cWait, "", "3");
  {
    Wait("1", (1000 * 1000000LL), 1000000, "");
  }
  TestCommandEnd();

  TestCommandBegin(__eCheck, __cCheck, "", "4");
  {
    __bVerdict = __eVerdictPass;
    __tableHandle = ReportTableHead5Columns(__cCheckCaption, __cTSym, __cTOp, __cRefVal, __cActual, __cRes);
    {
      {
        int __res1,__res2;
        __res1 = CheckSignalMatch(`FDCAN2::dbNode::`CVADAS::`CVPAM_FD_Info::`DisplayView2, 1, __cGreaterEqualThan) == 1;
        __res2 = CheckSignalMatch(`FDCAN2::dbNode::`CVADAS::`CVPAM_FD_Info::`DisplayView2, 15, __cLessEqualThan) == 1;
        __csr = __res1 && __res2;
        snprintf(__cArray, 8192, "%s", "DisplayView2");
        snprintf(__cArray2, 8192, "%s '%s'", __cCANSignal, __cArray);
        snprintf(__cArray3, 8192, "%s", "");
        snprintf(__cArray4, 8192, "%s", "");
        snprintf(__cArray5, 8192, "%s", __cArray3);
        snprintf(__cArray6, 8192, "%s", __cArray4);
        ReportRange(1, 15, __cArray5, __cArray6, __cArray7, 8192);
        ReportTableRow(__tableHandle, 0, __cArray2, __cRange, __cArray7, __cEmpty, __oneOfFlag, __bSetInCheckAlignment);
        ReportLValueOrSignalNotOnline(`FDCAN2::dbNode::`CVADAS::`CVPAM_FD_Info::`DisplayView2, __cArray8, 8192);
        ReportCell(__tableHandle, __cArray8);
        ReportCellResult(__tableHandle, __csr, __ePassFail);
      }
  
      __bVerdict = __bVerdict && __csr;
    }
    ReportTableEndVerdict(__tableHandle, "1", __bVerdict);
  }
  TestCommandEnd();


}

void Tt4h42sqi_Tet_Tc31()
{
  CreateTTEIFFunction("Tt4h42sqi_Tc31", __eTcDef, __eLocal);  
  AddIFParameterTestCaseAttribute("TC_ID", "");
  AddIFParameterTestCaseAttribute("Test Case ID", "");
  CallInterfaceFunction("View 1: FVTV_RVTV", __cEmpty , __cEmpty );
}
testcase Tt4h42sqi_Tc31()
{
  stack long __tableHandle;
  SetBreakOnFail(1);

  TestCommandBegin(__eSet, __cSet, "", "0");
  {
    __tableHandle = ReportTableHead3Columns(__cSetCaption , __cTSym, __cTOp, __cAssigned); 
    {
      $`FDCAN2::dbNode::`SGW::`TELEMATIC_FD_5::`CameraDisplaySts2.phys = 1;
      snprintf(__cArray, 8192, "%s", "CameraDisplaySts2");
      snprintf(__cArray2, 8192, "%s '%s'", __cCANSignal, __cArray);
      snprintf(__cArray3, 8192, "%s", "");
      
      ReportSetLValueOrSignalNotOnline(getSignalTime(`FDCAN2::dbNode::`SGW::`TELEMATIC_FD_5::`CameraDisplaySts2), __cArray2, __cArray4, 8192);
      ReportTableRow(__tableHandle, 0, __cArray4, __cAOp, 1, __cArray3, __oneOfFlag, __bSetInCheckAlignment);
      
  
    }
    ReportTableEndTestStep(__tableHandle, "1");
  }
  TestCommandEnd();


  TestCommandBegin(__eWait, __cWait, "", "1");
  {
    Wait("1", (1000 * 1000000LL), 1000000, "");
  }
  TestCommandEnd();

  TestCommandBegin(__eCheck, __cCheck, "", "2");
  {
    __bVerdict = __eVerdictPass;
    __tableHandle = ReportTableHead5Columns(__cCheckCaption, __cTSym, __cTOp, __cRefVal, __cActual, __cRes);
    {
      {
        int __res1,__res2;
        __res1 = CheckSignalMatch(`FDCAN2::dbNode::`CVADAS::`CVPAM_FD_Info::`DisplayView2, 1, __cGreaterEqualThan) == 1;
        __res2 = CheckSignalMatch(`FDCAN2::dbNode::`CVADAS::`CVPAM_FD_Info::`DisplayView2, 15, __cLessEqualThan) == 1;
        __csr = __res1 && __res2;
        snprintf(__cArray, 8192, "%s", "DisplayView2");
        snprintf(__cArray2, 8192, "%s '%s'", __cCANSignal, __cArray);
        snprintf(__cArray3, 8192, "%s", "");
        snprintf(__cArray4, 8192, "%s", "");
        snprintf(__cArray5, 8192, "%s", __cArray3);
        snprintf(__cArray6, 8192, "%s", __cArray4);
        ReportRange(1, 15, __cArray5, __cArray6, __cArray7, 8192);
        ReportTableRow(__tableHandle, 0, __cArray2, __cRange, __cArray7, __cEmpty, __oneOfFlag, __bSetInCheckAlignment);
        ReportLValueOrSignalNotOnline(`FDCAN2::dbNode::`CVADAS::`CVPAM_FD_Info::`DisplayView2, __cArray8, 8192);
        ReportCell(__tableHandle, __cArray8);
        ReportCellResult(__tableHandle, __csr, __ePassFail);
      }
  
      __bVerdict = __bVerdict && __csr;
    }
    ReportTableEndVerdict(__tableHandle, "1", __bVerdict);
  }
  TestCommandEnd();


}

void Tt4h42sqi_Tet_Tc32()
{
  CreateTTEIFFunction("Tt4h42sqi_Tc32", __eTcDef, __eLocal);  
  AddIFParameterTestCaseAttribute("TC_ID", "");
  AddIFParameterTestCaseAttribute("Test Case ID", "");
  CallInterfaceFunction("View 2: BackupRearView", __cEmpty , __cEmpty );
}
testcase Tt4h42sqi_Tc32()
{
  stack long __tableHandle;
  SetBreakOnFail(1);

  TestCommandBegin(__eSet, __cSet, "", "0");
  {
    __tableHandle = ReportTableHead3Columns(__cSetCaption , __cTSym, __cTOp, __cAssigned); 
    {
      $`FDCAN2::dbNode::`SGW::`TELEMATIC_FD_5::`CameraDisplaySts2.phys = 2;
      snprintf(__cArray, 8192, "%s", "CameraDisplaySts2");
      snprintf(__cArray2, 8192, "%s '%s'", __cCANSignal, __cArray);
      snprintf(__cArray3, 8192, "%s", "");
      
      ReportSetLValueOrSignalNotOnline(getSignalTime(`FDCAN2::dbNode::`SGW::`TELEMATIC_FD_5::`CameraDisplaySts2), __cArray2, __cArray4, 8192);
      ReportTableRow(__tableHandle, 0, __cArray4, __cAOp, 2, __cArray3, __oneOfFlag, __bSetInCheckAlignment);
      
  
    }
    ReportTableEndTestStep(__tableHandle, "1");
  }
  TestCommandEnd();


  TestCommandBegin(__eWait, __cWait, "", "1");
  {
    Wait("1", (1000 * 1000000LL), 1000000, "");
  }
  TestCommandEnd();

  TestCommandBegin(__eCheck, __cCheck, "", "2");
  {
    __bVerdict = __eVerdictPass;
    __tableHandle = ReportTableHead5Columns(__cCheckCaption, __cTSym, __cTOp, __cRefVal, __cActual, __cRes);
    {
      {
        int __res1,__res2;
        __res1 = CheckSignalMatch(`FDCAN2::dbNode::`CVADAS::`CVPAM_FD_Info::`DisplayView2, 1, __cGreaterEqualThan) == 1;
        __res2 = CheckSignalMatch(`FDCAN2::dbNode::`CVADAS::`CVPAM_FD_Info::`DisplayView2, 15, __cLessEqualThan) == 1;
        __csr = __res1 && __res2;
        snprintf(__cArray, 8192, "%s", "DisplayView2");
        snprintf(__cArray2, 8192, "%s '%s'", __cCANSignal, __cArray);
        snprintf(__cArray3, 8192, "%s", "");
        snprintf(__cArray4, 8192, "%s", "");
        snprintf(__cArray5, 8192, "%s", __cArray3);
        snprintf(__cArray6, 8192, "%s", __cArray4);
        ReportRange(1, 15, __cArray5, __cArray6, __cArray7, 8192);
        ReportTableRow(__tableHandle, 0, __cArray2, __cRange, __cArray7, __cEmpty, __oneOfFlag, __bSetInCheckAlignment);
        ReportLValueOrSignalNotOnline(`FDCAN2::dbNode::`CVADAS::`CVPAM_FD_Info::`DisplayView2, __cArray8, 8192);
        ReportCell(__tableHandle, __cArray8);
        ReportCellResult(__tableHandle, __csr, __ePassFail);
      }
  
      __bVerdict = __bVerdict && __csr;
    }
    ReportTableEndVerdict(__tableHandle, "1", __bVerdict);
  }
  TestCommandEnd();


}

void Tt4h42sqi_Tet_Tc33()
{
  CreateTTEIFFunction("Tt4h42sqi_Tc33", __eTcDef, __eLocal);  
  AddIFParameterTestCaseAttribute("TC_ID", "");
  AddIFParameterTestCaseAttribute("Test Case ID", "");
  CallInterfaceFunction("View 3: Forward Facing Camera", __cEmpty , __cEmpty );
}
testcase Tt4h42sqi_Tc33()
{
  stack long __tableHandle;
  SetBreakOnFail(1);

  TestCommandBegin(__eSet, __cSet, "", "0");
  {
    __tableHandle = ReportTableHead3Columns(__cSetCaption , __cTSym, __cTOp, __cAssigned); 
    {
      $`FDCAN2::dbNode::`SGW::`TELEMATIC_FD_5::`CameraDisplaySts2.phys = 3;
      snprintf(__cArray, 8192, "%s", "CameraDisplaySts2");
      snprintf(__cArray2, 8192, "%s '%s'", __cCANSignal, __cArray);
      snprintf(__cArray3, 8192, "%s", "");
      
      ReportSetLValueOrSignalNotOnline(getSignalTime(`FDCAN2::dbNode::`SGW::`TELEMATIC_FD_5::`CameraDisplaySts2), __cArray2, __cArray4, 8192);
      ReportTableRow(__tableHandle, 0, __cArray4, __cAOp, 3, __cArray3, __oneOfFlag, __bSetInCheckAlignment);
      
  
    }
    ReportTableEndTestStep(__tableHandle, "1");
  }
  TestCommandEnd();


  TestCommandBegin(__eWait, __cWait, "", "1");
  {
    Wait("1", (1000 * 1000000LL), 1000000, "");
  }
  TestCommandEnd();

  TestCommandBegin(__eCheck, __cCheck, "", "2");
  {
    __bVerdict = __eVerdictPass;
    __tableHandle = ReportTableHead5Columns(__cCheckCaption, __cTSym, __cTOp, __cRefVal, __cActual, __cRes);
    {
      {
        int __res1,__res2;
        __res1 = CheckSignalMatch(`FDCAN2::dbNode::`CVADAS::`CVPAM_FD_Info::`DisplayView2, 1, __cGreaterEqualThan) == 1;
        __res2 = CheckSignalMatch(`FDCAN2::dbNode::`CVADAS::`CVPAM_FD_Info::`DisplayView2, 15, __cLessEqualThan) == 1;
        __csr = __res1 && __res2;
        snprintf(__cArray, 8192, "%s", "DisplayView2");
        snprintf(__cArray2, 8192, "%s '%s'", __cCANSignal, __cArray);
        snprintf(__cArray3, 8192, "%s", "");
        snprintf(__cArray4, 8192, "%s", "");
        snprintf(__cArray5, 8192, "%s", __cArray3);
        snprintf(__cArray6, 8192, "%s", __cArray4);
        ReportRange(1, 15, __cArray5, __cArray6, __cArray7, 8192);
        ReportTableRow(__tableHandle, 0, __cArray2, __cRange, __cArray7, __cEmpty, __oneOfFlag, __bSetInCheckAlignment);
        ReportLValueOrSignalNotOnline(`FDCAN2::dbNode::`CVADAS::`CVPAM_FD_Info::`DisplayView2, __cArray8, 8192);
        ReportCell(__tableHandle, __cArray8);
        ReportCellResult(__tableHandle, __csr, __ePassFail);
      }
  
      __bVerdict = __bVerdict && __csr;
    }
    ReportTableEndVerdict(__tableHandle, "1", __bVerdict);
  }
  TestCommandEnd();


}

void Tt4h42sqi_Tet_Tc34()
{
  CreateTTEIFFunction("Tt4h42sqi_Tc34", __eTcDef, __eLocal);  
  AddIFParameterTestCaseAttribute("TC_ID", "");
  AddIFParameterTestCaseAttribute("Test Case ID", "");
  CallInterfaceFunction("View 5: Trailer Reverse Guidance", __cEmpty , __cEmpty );
}
testcase Tt4h42sqi_Tc34()
{
  stack long __tableHandle;
  SetBreakOnFail(1);

  TestCommandBegin(__eSet, __cSet, "", "0");
  {
    __tableHandle = ReportTableHead3Columns(__cSetCaption , __cTSym, __cTOp, __cAssigned); 
    {
      $`FDCAN2::dbNode::`SGW::`TELEMATIC_FD_5::`CameraDisplaySts2.phys = 5;
      snprintf(__cArray, 8192, "%s", "CameraDisplaySts2");
      snprintf(__cArray2, 8192, "%s '%s'", __cCANSignal, __cArray);
      snprintf(__cArray3, 8192, "%s", "");
      
      ReportSetLValueOrSignalNotOnline(getSignalTime(`FDCAN2::dbNode::`SGW::`TELEMATIC_FD_5::`CameraDisplaySts2), __cArray2, __cArray4, 8192);
      ReportTableRow(__tableHandle, 0, __cArray4, __cAOp, 5, __cArray3, __oneOfFlag, __bSetInCheckAlignment);
      
  
    }
    ReportTableEndTestStep(__tableHandle, "1");
  }
  TestCommandEnd();


  TestCommandBegin(__eWait, __cWait, "", "1");
  {
    Wait("1", (1000 * 1000000LL), 1000000, "");
  }
  TestCommandEnd();

  TestCommandBegin(__eCheck, __cCheck, "", "2");
  {
    __bVerdict = __eVerdictPass;
    __tableHandle = ReportTableHead5Columns(__cCheckCaption, __cTSym, __cTOp, __cRefVal, __cActual, __cRes);
    {
      {
        int __res1,__res2;
        __res1 = CheckSignalMatch(`FDCAN2::dbNode::`CVADAS::`CVPAM_FD_Info::`DisplayView2, 1, __cGreaterEqualThan) == 1;
        __res2 = CheckSignalMatch(`FDCAN2::dbNode::`CVADAS::`CVPAM_FD_Info::`DisplayView2, 15, __cLessEqualThan) == 1;
        __csr = __res1 && __res2;
        snprintf(__cArray, 8192, "%s", "DisplayView2");
        snprintf(__cArray2, 8192, "%s '%s'", __cCANSignal, __cArray);
        snprintf(__cArray3, 8192, "%s", "");
        snprintf(__cArray4, 8192, "%s", "");
        snprintf(__cArray5, 8192, "%s", __cArray3);
        snprintf(__cArray6, 8192, "%s", __cArray4);
        ReportRange(1, 15, __cArray5, __cArray6, __cArray7, 8192);
        ReportTableRow(__tableHandle, 0, __cArray2, __cRange, __cArray7, __cEmpty, __oneOfFlag, __bSetInCheckAlignment);
        ReportLValueOrSignalNotOnline(`FDCAN2::dbNode::`CVADAS::`CVPAM_FD_Info::`DisplayView2, __cArray8, 8192);
        ReportCell(__tableHandle, __cArray8);
        ReportCellResult(__tableHandle, __csr, __ePassFail);
      }
  
      __bVerdict = __bVerdict && __csr;
    }
    ReportTableEndVerdict(__tableHandle, "1", __bVerdict);
  }
  TestCommandEnd();


}

void Tt4h42sqi_Tet_Tc35()
{
  CreateTTEIFFunction("Tt4h42sqi_Tc35", __eTcDef, __eLocal);  
  AddIFParameterTestCaseAttribute("TC_ID", "");
  AddIFParameterTestCaseAttribute("Test Case ID", "");
  CallInterfaceFunction("View 6: Trailer Left View", __cEmpty , __cEmpty );
}
testcase Tt4h42sqi_Tc35()
{
  stack long __tableHandle;
  SetBreakOnFail(1);

  TestCommandBegin(__eSet, __cSet, "", "0");
  {
    __tableHandle = ReportTableHead3Columns(__cSetCaption , __cTSym, __cTOp, __cAssigned); 
    {
      $`FDCAN2::dbNode::`SGW::`TELEMATIC_FD_5::`CameraDisplaySts2.phys = 6;
      snprintf(__cArray, 8192, "%s", "CameraDisplaySts2");
      snprintf(__cArray2, 8192, "%s '%s'", __cCANSignal, __cArray);
      snprintf(__cArray3, 8192, "%s", "");
      
      ReportSetLValueOrSignalNotOnline(getSignalTime(`FDCAN2::dbNode::`SGW::`TELEMATIC_FD_5::`CameraDisplaySts2), __cArray2, __cArray4, 8192);
      ReportTableRow(__tableHandle, 0, __cArray4, __cAOp, 6, __cArray3, __oneOfFlag, __bSetInCheckAlignment);
      
  
    }
    ReportTableEndTestStep(__tableHandle, "1");
  }
  TestCommandEnd();


  TestCommandBegin(__eWait, __cWait, "", "1");
  {
    Wait("1", (1000 * 1000000LL), 1000000, "");
  }
  TestCommandEnd();

  TestCommandBegin(__eCheck, __cCheck, "", "2");
  {
    __bVerdict = __eVerdictPass;
    __tableHandle = ReportTableHead5Columns(__cCheckCaption, __cTSym, __cTOp, __cRefVal, __cActual, __cRes);
    {
      {
        int __res1,__res2;
        __res1 = CheckSignalMatch(`FDCAN2::dbNode::`CVADAS::`CVPAM_FD_Info::`DisplayView2, 1, __cGreaterEqualThan) == 1;
        __res2 = CheckSignalMatch(`FDCAN2::dbNode::`CVADAS::`CVPAM_FD_Info::`DisplayView2, 15, __cLessEqualThan) == 1;
        __csr = __res1 && __res2;
        snprintf(__cArray, 8192, "%s", "DisplayView2");
        snprintf(__cArray2, 8192, "%s '%s'", __cCANSignal, __cArray);
        snprintf(__cArray3, 8192, "%s", "");
        snprintf(__cArray4, 8192, "%s", "");
        snprintf(__cArray5, 8192, "%s", __cArray3);
        snprintf(__cArray6, 8192, "%s", __cArray4);
        ReportRange(1, 15, __cArray5, __cArray6, __cArray7, 8192);
        ReportTableRow(__tableHandle, 0, __cArray2, __cRange, __cArray7, __cEmpty, __oneOfFlag, __bSetInCheckAlignment);
        ReportLValueOrSignalNotOnline(`FDCAN2::dbNode::`CVADAS::`CVPAM_FD_Info::`DisplayView2, __cArray8, 8192);
        ReportCell(__tableHandle, __cArray8);
        ReportCellResult(__tableHandle, __csr, __ePassFail);
      }
  
      __bVerdict = __bVerdict && __csr;
    }
    ReportTableEndVerdict(__tableHandle, "1", __bVerdict);
  }
  TestCommandEnd();


}

void Tt4h42sqi_Tet_Tc36()
{
  CreateTTEIFFunction("Tt4h42sqi_Tc36", __eTcDef, __eLocal);  
  AddIFParameterTestCaseAttribute("TC_ID", "");
  AddIFParameterTestCaseAttribute("Test Case ID", "");
  CallInterfaceFunction("View 7: Trailer Right View", __cEmpty , __cEmpty );
}
testcase Tt4h42sqi_Tc36()
{
  stack long __tableHandle;
  SetBreakOnFail(1);

  TestCommandBegin(__eSet, __cSet, "", "0");
  {
    __tableHandle = ReportTableHead3Columns(__cSetCaption , __cTSym, __cTOp, __cAssigned); 
    {
      $`FDCAN2::dbNode::`SGW::`TELEMATIC_FD_5::`CameraDisplaySts2.phys = 7;
      snprintf(__cArray, 8192, "%s", "CameraDisplaySts2");
      snprintf(__cArray2, 8192, "%s '%s'", __cCANSignal, __cArray);
      snprintf(__cArray3, 8192, "%s", "");
      
      ReportSetLValueOrSignalNotOnline(getSignalTime(`FDCAN2::dbNode::`SGW::`TELEMATIC_FD_5::`CameraDisplaySts2), __cArray2, __cArray4, 8192);
      ReportTableRow(__tableHandle, 0, __cArray4, __cAOp, 7, __cArray3, __oneOfFlag, __bSetInCheckAlignment);
      
  
    }
    ReportTableEndTestStep(__tableHandle, "1");
  }
  TestCommandEnd();


  TestCommandBegin(__eWait, __cWait, "", "1");
  {
    Wait("1", (1000 * 1000000LL), 1000000, "");
  }
  TestCommandEnd();

  TestCommandBegin(__eCheck, __cCheck, "", "2");
  {
    __bVerdict = __eVerdictPass;
    __tableHandle = ReportTableHead5Columns(__cCheckCaption, __cTSym, __cTOp, __cRefVal, __cActual, __cRes);
    {
      {
        int __res1,__res2;
        __res1 = CheckSignalMatch(`FDCAN2::dbNode::`CVADAS::`CVPAM_FD_Info::`DisplayView2, 1, __cGreaterEqualThan) == 1;
        __res2 = CheckSignalMatch(`FDCAN2::dbNode::`CVADAS::`CVPAM_FD_Info::`DisplayView2, 15, __cLessEqualThan) == 1;
        __csr = __res1 && __res2;
        snprintf(__cArray, 8192, "%s", "DisplayView2");
        snprintf(__cArray2, 8192, "%s '%s'", __cCANSignal, __cArray);
        snprintf(__cArray3, 8192, "%s", "");
        snprintf(__cArray4, 8192, "%s", "");
        snprintf(__cArray5, 8192, "%s", __cArray3);
        snprintf(__cArray6, 8192, "%s", __cArray4);
        ReportRange(1, 15, __cArray5, __cArray6, __cArray7, 8192);
        ReportTableRow(__tableHandle, 0, __cArray2, __cRange, __cArray7, __cEmpty, __oneOfFlag, __bSetInCheckAlignment);
        ReportLValueOrSignalNotOnline(`FDCAN2::dbNode::`CVADAS::`CVPAM_FD_Info::`DisplayView2, __cArray8, 8192);
        ReportCell(__tableHandle, __cArray8);
        ReportCellResult(__tableHandle, __csr, __ePassFail);
      }
  
      __bVerdict = __bVerdict && __csr;
    }
    ReportTableEndVerdict(__tableHandle, "1", __bVerdict);
  }
  TestCommandEnd();


}

void Tt4h42sqi_Tet_Tc37()
{
  CreateTTEIFFunction("Tt4h42sqi_Tc37", __eTcDef, __eLocal);  
  AddIFParameterTestCaseAttribute("TC_ID", "");
  AddIFParameterTestCaseAttribute("Test Case ID", "");
  CallInterfaceFunction("View 8: Blind Spot Left View", __cEmpty , __cEmpty );
}
testcase Tt4h42sqi_Tc37()
{
  stack long __tableHandle;
  SetBreakOnFail(1);

  TestCommandBegin(__eSet, __cSet, "", "0");
  {
    __tableHandle = ReportTableHead3Columns(__cSetCaption , __cTSym, __cTOp, __cAssigned); 
    {
      $`FDCAN2::dbNode::`SGW::`TELEMATIC_FD_5::`CameraDisplaySts2.phys = 8;
      snprintf(__cArray, 8192, "%s", "CameraDisplaySts2");
      snprintf(__cArray2, 8192, "%s '%s'", __cCANSignal, __cArray);
      snprintf(__cArray3, 8192, "%s", "");
      
      ReportSetLValueOrSignalNotOnline(getSignalTime(`FDCAN2::dbNode::`SGW::`TELEMATIC_FD_5::`CameraDisplaySts2), __cArray2, __cArray4, 8192);
      ReportTableRow(__tableHandle, 0, __cArray4, __cAOp, 8, __cArray3, __oneOfFlag, __bSetInCheckAlignment);
      
  
    }
    ReportTableEndTestStep(__tableHandle, "1");
  }
  TestCommandEnd();


  TestCommandBegin(__eWait, __cWait, "", "1");
  {
    Wait("1", (1000 * 1000000LL), 1000000, "");
  }
  TestCommandEnd();

  TestCommandBegin(__eCheck, __cCheck, "", "2");
  {
    __bVerdict = __eVerdictPass;
    __tableHandle = ReportTableHead5Columns(__cCheckCaption, __cTSym, __cTOp, __cRefVal, __cActual, __cRes);
    {
      {
        int __res1,__res2;
        __res1 = CheckSignalMatch(`FDCAN2::dbNode::`CVADAS::`CVPAM_FD_Info::`DisplayView2, 2, __cGreaterEqualThan) == 1;
        __res2 = CheckSignalMatch(`FDCAN2::dbNode::`CVADAS::`CVPAM_FD_Info::`DisplayView2, 10, __cLessEqualThan) == 1;
        __csr = __res1 && __res2;
        snprintf(__cArray, 8192, "%s", "DisplayView2");
        snprintf(__cArray2, 8192, "%s '%s'", __cCANSignal, __cArray);
        snprintf(__cArray3, 8192, "%s", "");
        snprintf(__cArray4, 8192, "%s", "");
        snprintf(__cArray5, 8192, "%s", __cArray3);
        snprintf(__cArray6, 8192, "%s", __cArray4);
        ReportRange(2, 10, __cArray5, __cArray6, __cArray7, 8192);
        ReportTableRow(__tableHandle, 0, __cArray2, __cRange, __cArray7, __cEmpty, __oneOfFlag, __bSetInCheckAlignment);
        ReportLValueOrSignalNotOnline(`FDCAN2::dbNode::`CVADAS::`CVPAM_FD_Info::`DisplayView2, __cArray8, 8192);
        ReportCell(__tableHandle, __cArray8);
        ReportCellResult(__tableHandle, __csr, __ePassFail);
      }
  
      __bVerdict = __bVerdict && __csr;
    }
    ReportTableEndVerdict(__tableHandle, "1", __bVerdict);
  }
  TestCommandEnd();


}

void Tt4h42sqi_Tet_Tc38()
{
  CreateTTEIFFunction("Tt4h42sqi_Tc38", __eTcDef, __eLocal);  
  AddIFParameterTestCaseAttribute("TC_ID", "");
  AddIFParameterTestCaseAttribute("Test Case ID", "");
  CallInterfaceFunction("View 9: Blind Spot Right View", __cEmpty , __cEmpty );
}
testcase Tt4h42sqi_Tc38()
{
  stack long __tableHandle;
  SetBreakOnFail(1);

  TestCommandBegin(__eSet, __cSet, "", "0");
  {
    __tableHandle = ReportTableHead3Columns(__cSetCaption , __cTSym, __cTOp, __cAssigned); 
    {
      $`FDCAN2::dbNode::`SGW::`TELEMATIC_FD_5::`CameraDisplaySts2.phys = 9;
      snprintf(__cArray, 8192, "%s", "CameraDisplaySts2");
      snprintf(__cArray2, 8192, "%s '%s'", __cCANSignal, __cArray);
      snprintf(__cArray3, 8192, "%s", "");
      
      ReportSetLValueOrSignalNotOnline(getSignalTime(`FDCAN2::dbNode::`SGW::`TELEMATIC_FD_5::`CameraDisplaySts2), __cArray2, __cArray4, 8192);
      ReportTableRow(__tableHandle, 0, __cArray4, __cAOp, 9, __cArray3, __oneOfFlag, __bSetInCheckAlignment);
      
  
    }
    ReportTableEndTestStep(__tableHandle, "1");
  }
  TestCommandEnd();


  TestCommandBegin(__eWait, __cWait, "", "1");
  {
    Wait("1", (1000 * 1000000LL), 1000000, "");
  }
  TestCommandEnd();

  TestCommandBegin(__eCheck, __cCheck, "", "2");
  {
    __bVerdict = __eVerdictPass;
    __tableHandle = ReportTableHead5Columns(__cCheckCaption, __cTSym, __cTOp, __cRefVal, __cActual, __cRes);
    {
      {
        int __res1,__res2;
        __res1 = CheckSignalMatch(`FDCAN2::dbNode::`CVADAS::`CVPAM_FD_Info::`DisplayView2, 2, __cGreaterEqualThan) == 1;
        __res2 = CheckSignalMatch(`FDCAN2::dbNode::`CVADAS::`CVPAM_FD_Info::`DisplayView2, 15, __cLessEqualThan) == 1;
        __csr = __res1 && __res2;
        snprintf(__cArray, 8192, "%s", "DisplayView2");
        snprintf(__cArray2, 8192, "%s '%s'", __cCANSignal, __cArray);
        snprintf(__cArray3, 8192, "%s", "");
        snprintf(__cArray4, 8192, "%s", "");
        snprintf(__cArray5, 8192, "%s", __cArray3);
        snprintf(__cArray6, 8192, "%s", __cArray4);
        ReportRange(2, 15, __cArray5, __cArray6, __cArray7, 8192);
        ReportTableRow(__tableHandle, 0, __cArray2, __cRange, __cArray7, __cEmpty, __oneOfFlag, __bSetInCheckAlignment);
        ReportLValueOrSignalNotOnline(`FDCAN2::dbNode::`CVADAS::`CVPAM_FD_Info::`DisplayView2, __cArray8, 8192);
        ReportCell(__tableHandle, __cArray8);
        ReportCellResult(__tableHandle, __csr, __ePassFail);
      }
  
      __bVerdict = __bVerdict && __csr;
    }
    ReportTableEndVerdict(__tableHandle, "1", __bVerdict);
  }
  TestCommandEnd();


}

void Tt4h42sqi_Tet_Tc39()
{
  CreateTTEIFFunction("Tt4h42sqi_Tc39", __eTcDef, __eLocal);  
  AddIFParameterTestCaseAttribute("TC_ID", "");
  AddIFParameterTestCaseAttribute("Test Case ID", "");
  CallInterfaceFunction("View 11: FVTV", __cEmpty , __cEmpty );
}
testcase Tt4h42sqi_Tc39()
{
  stack long __tableHandle;
  SetBreakOnFail(1);

  TestCommandBegin(__eSet, __cSet, "", "0");
  {
    __tableHandle = ReportTableHead3Columns(__cSetCaption , __cTSym, __cTOp, __cAssigned); 
    {
      $`FDCAN2::dbNode::`SGW::`TELEMATIC_FD_5::`CameraDisplaySts2.phys = 11;
      snprintf(__cArray, 8192, "%s", "CameraDisplaySts2");
      snprintf(__cArray2, 8192, "%s '%s'", __cCANSignal, __cArray);
      snprintf(__cArray3, 8192, "%s", "");
      
      ReportSetLValueOrSignalNotOnline(getSignalTime(`FDCAN2::dbNode::`SGW::`TELEMATIC_FD_5::`CameraDisplaySts2), __cArray2, __cArray4, 8192);
      ReportTableRow(__tableHandle, 0, __cArray4, __cAOp, 11, __cArray3, __oneOfFlag, __bSetInCheckAlignment);
      
  
    }
    ReportTableEndTestStep(__tableHandle, "1");
  }
  TestCommandEnd();


  TestCommandBegin(__eWait, __cWait, "", "1");
  {
    Wait("1", (1000 * 1000000LL), 1000000, "");
  }
  TestCommandEnd();

  TestCommandBegin(__eCheck, __cCheck, "", "2");
  {
    __bVerdict = __eVerdictPass;
    __tableHandle = ReportTableHead5Columns(__cCheckCaption, __cTSym, __cTOp, __cRefVal, __cActual, __cRes);
    {
      {
        int __res1,__res2;
        __res1 = CheckSignalMatch(`FDCAN2::dbNode::`CVADAS::`CVPAM_FD_Info::`DisplayView2, 1, __cGreaterEqualThan) == 1;
        __res2 = CheckSignalMatch(`FDCAN2::dbNode::`CVADAS::`CVPAM_FD_Info::`DisplayView2, 15, __cLessEqualThan) == 1;
        __csr = __res1 && __res2;
        snprintf(__cArray, 8192, "%s", "DisplayView2");
        snprintf(__cArray2, 8192, "%s '%s'", __cCANSignal, __cArray);
        snprintf(__cArray3, 8192, "%s", "");
        snprintf(__cArray4, 8192, "%s", "");
        snprintf(__cArray5, 8192, "%s", __cArray3);
        snprintf(__cArray6, 8192, "%s", __cArray4);
        ReportRange(1, 15, __cArray5, __cArray6, __cArray7, 8192);
        ReportTableRow(__tableHandle, 0, __cArray2, __cRange, __cArray7, __cEmpty, __oneOfFlag, __bSetInCheckAlignment);
        ReportLValueOrSignalNotOnline(`FDCAN2::dbNode::`CVADAS::`CVPAM_FD_Info::`DisplayView2, __cArray8, 8192);
        ReportCell(__tableHandle, __cArray8);
        ReportCellResult(__tableHandle, __csr, __ePassFail);
      }
  
      __bVerdict = __bVerdict && __csr;
    }
    ReportTableEndVerdict(__tableHandle, "1", __bVerdict);
  }
  TestCommandEnd();


}

void Tt4h42sqi_Tet_Tc40()
{
  CreateTTEIFFunction("Tt4h42sqi_Tc40", __eTcDef, __eLocal);  
  AddIFParameterTestCaseAttribute("TC_ID", "");
  AddIFParameterTestCaseAttribute("Test Case ID", "");
  CallInterfaceFunction("View 12: RVTV", __cEmpty , __cEmpty );
}
testcase Tt4h42sqi_Tc40()
{
  stack long __tableHandle;
  SetBreakOnFail(1);

  TestCommandBegin(__eSet, __cSet, "", "0");
  {
    __tableHandle = ReportTableHead3Columns(__cSetCaption , __cTSym, __cTOp, __cAssigned); 
    {
      $`FDCAN2::dbNode::`SGW::`TELEMATIC_FD_5::`CameraDisplaySts2.phys = 12;
      snprintf(__cArray, 8192, "%s", "CameraDisplaySts2");
      snprintf(__cArray2, 8192, "%s '%s'", __cCANSignal, __cArray);
      snprintf(__cArray3, 8192, "%s", "");
      
      ReportSetLValueOrSignalNotOnline(getSignalTime(`FDCAN2::dbNode::`SGW::`TELEMATIC_FD_5::`CameraDisplaySts2), __cArray2, __cArray4, 8192);
      ReportTableRow(__tableHandle, 0, __cArray4, __cAOp, 12, __cArray3, __oneOfFlag, __bSetInCheckAlignment);
      
  
    }
    ReportTableEndTestStep(__tableHandle, "1");
  }
  TestCommandEnd();


  TestCommandBegin(__eWait, __cWait, "", "1");
  {
    Wait("1", (1000 * 1000000LL), 1000000, "");
  }
  TestCommandEnd();

  TestCommandBegin(__eCheck, __cCheck, "", "2");
  {
    __bVerdict = __eVerdictPass;
    __tableHandle = ReportTableHead5Columns(__cCheckCaption, __cTSym, __cTOp, __cRefVal, __cActual, __cRes);
    {
      {
        int __res1,__res2;
        __res1 = CheckSignalMatch(`FDCAN2::dbNode::`CVADAS::`CVPAM_FD_Info::`DisplayView2, 1, __cGreaterEqualThan) == 1;
        __res2 = CheckSignalMatch(`FDCAN2::dbNode::`CVADAS::`CVPAM_FD_Info::`DisplayView2, 15, __cLessEqualThan) == 1;
        __csr = __res1 && __res2;
        snprintf(__cArray, 8192, "%s", "DisplayView2");
        snprintf(__cArray2, 8192, "%s '%s'", __cCANSignal, __cArray);
        snprintf(__cArray3, 8192, "%s", "");
        snprintf(__cArray4, 8192, "%s", "");
        snprintf(__cArray5, 8192, "%s", __cArray3);
        snprintf(__cArray6, 8192, "%s", __cArray4);
        ReportRange(1, 15, __cArray5, __cArray6, __cArray7, 8192);
        ReportTableRow(__tableHandle, 0, __cArray2, __cRange, __cArray7, __cEmpty, __oneOfFlag, __bSetInCheckAlignment);
        ReportLValueOrSignalNotOnline(`FDCAN2::dbNode::`CVADAS::`CVPAM_FD_Info::`DisplayView2, __cArray8, 8192);
        ReportCell(__tableHandle, __cArray8);
        ReportCellResult(__tableHandle, __csr, __ePassFail);
      }
  
      __bVerdict = __bVerdict && __csr;
    }
    ReportTableEndVerdict(__tableHandle, "1", __bVerdict);
  }
  TestCommandEnd();


}

void Tt4h42sqi_Tet_Tc41()
{
  CreateTTEIFFunction("Tt4h42sqi_Tc41", __eTcDef, __eLocal);  
  AddIFParameterTestCaseAttribute("TC_ID", "");
  AddIFParameterTestCaseAttribute("Test Case ID", "");
  CallInterfaceFunction("View 13: FrontCrossPathView", __cEmpty , __cEmpty );
}
testcase Tt4h42sqi_Tc41()
{
  stack long __tableHandle;
  SetBreakOnFail(1);

  TestCommandBegin(__eSet, __cSet, "", "0");
  {
    __tableHandle = ReportTableHead3Columns(__cSetCaption , __cTSym, __cTOp, __cAssigned); 
    {
      $`FDCAN2::dbNode::`SGW::`TELEMATIC_FD_5::`CameraDisplaySts2.phys = 13;
      snprintf(__cArray, 8192, "%s", "CameraDisplaySts2");
      snprintf(__cArray2, 8192, "%s '%s'", __cCANSignal, __cArray);
      snprintf(__cArray3, 8192, "%s", "");
      
      ReportSetLValueOrSignalNotOnline(getSignalTime(`FDCAN2::dbNode::`SGW::`TELEMATIC_FD_5::`CameraDisplaySts2), __cArray2, __cArray4, 8192);
      ReportTableRow(__tableHandle, 0, __cArray4, __cAOp, 13, __cArray3, __oneOfFlag, __bSetInCheckAlignment);
      
  
    }
    ReportTableEndTestStep(__tableHandle, "1");
  }
  TestCommandEnd();


  TestCommandBegin(__eWait, __cWait, "", "1");
  {
    Wait("1", (1000 * 1000000LL), 1000000, "");
  }
  TestCommandEnd();

  TestCommandBegin(__eCheck, __cCheck, "", "2");
  {
    __bVerdict = __eVerdictPass;
    __tableHandle = ReportTableHead5Columns(__cCheckCaption, __cTSym, __cTOp, __cRefVal, __cActual, __cRes);
    {
      {
        int __res1,__res2;
        __res1 = CheckSignalMatch(`FDCAN2::dbNode::`CVADAS::`CVPAM_FD_Info::`DisplayView2, 1, __cGreaterEqualThan) == 1;
        __res2 = CheckSignalMatch(`FDCAN2::dbNode::`CVADAS::`CVPAM_FD_Info::`DisplayView2, 15, __cLessEqualThan) == 1;
        __csr = __res1 && __res2;
        snprintf(__cArray, 8192, "%s", "DisplayView2");
        snprintf(__cArray2, 8192, "%s '%s'", __cCANSignal, __cArray);
        snprintf(__cArray3, 8192, "%s", "");
        snprintf(__cArray4, 8192, "%s", "");
        snprintf(__cArray5, 8192, "%s", __cArray3);
        snprintf(__cArray6, 8192, "%s", __cArray4);
        ReportRange(1, 15, __cArray5, __cArray6, __cArray7, 8192);
        ReportTableRow(__tableHandle, 0, __cArray2, __cRange, __cArray7, __cEmpty, __oneOfFlag, __bSetInCheckAlignment);
        ReportLValueOrSignalNotOnline(`FDCAN2::dbNode::`CVADAS::`CVPAM_FD_Info::`DisplayView2, __cArray8, 8192);
        ReportCell(__tableHandle, __cArray8);
        ReportCellResult(__tableHandle, __csr, __ePassFail);
      }
  
      __bVerdict = __bVerdict && __csr;
    }
    ReportTableEndVerdict(__tableHandle, "1", __bVerdict);
  }
  TestCommandEnd();


}

void Tt4h42sqi_Tet_Tc42()
{
  CreateTTEIFFunction("Tt4h42sqi_Tc42", __eTcDef, __eLocal);  
  AddIFParameterTestCaseAttribute("TC_ID", "");
  AddIFParameterTestCaseAttribute("Test Case ID", "");
  CallInterfaceFunction("View 14: RearCrossPathView", __cEmpty , __cEmpty );
}
testcase Tt4h42sqi_Tc42()
{
  stack long __tableHandle;
  SetBreakOnFail(1);

  TestCommandBegin(__eSet, __cSet, "", "0");
  {
    __tableHandle = ReportTableHead3Columns(__cSetCaption , __cTSym, __cTOp, __cAssigned); 
    {
      $`FDCAN2::dbNode::`SGW::`TELEMATIC_FD_5::`CameraDisplaySts2.phys = 14;
      snprintf(__cArray, 8192, "%s", "CameraDisplaySts2");
      snprintf(__cArray2, 8192, "%s '%s'", __cCANSignal, __cArray);
      snprintf(__cArray3, 8192, "%s", "");
      
      ReportSetLValueOrSignalNotOnline(getSignalTime(`FDCAN2::dbNode::`SGW::`TELEMATIC_FD_5::`CameraDisplaySts2), __cArray2, __cArray4, 8192);
      ReportTableRow(__tableHandle, 0, __cArray4, __cAOp, 14, __cArray3, __oneOfFlag, __bSetInCheckAlignment);
      
  
    }
    ReportTableEndTestStep(__tableHandle, "1");
  }
  TestCommandEnd();


  TestCommandBegin(__eWait, __cWait, "", "1");
  {
    Wait("1", (1000 * 1000000LL), 1000000, "");
  }
  TestCommandEnd();

  TestCommandBegin(__eCheck, __cCheck, "", "2");
  {
    __bVerdict = __eVerdictPass;
    __tableHandle = ReportTableHead5Columns(__cCheckCaption, __cTSym, __cTOp, __cRefVal, __cActual, __cRes);
    {
      {
        int __res1,__res2;
        __res1 = CheckSignalMatch(`FDCAN2::dbNode::`CVADAS::`CVPAM_FD_Info::`DisplayView2, 1, __cGreaterEqualThan) == 1;
        __res2 = CheckSignalMatch(`FDCAN2::dbNode::`CVADAS::`CVPAM_FD_Info::`DisplayView2, 15, __cLessEqualThan) == 1;
        __csr = __res1 && __res2;
        snprintf(__cArray, 8192, "%s", "DisplayView2");
        snprintf(__cArray2, 8192, "%s '%s'", __cCANSignal, __cArray);
        snprintf(__cArray3, 8192, "%s", "");
        snprintf(__cArray4, 8192, "%s", "");
        snprintf(__cArray5, 8192, "%s", __cArray3);
        snprintf(__cArray6, 8192, "%s", __cArray4);
        ReportRange(1, 15, __cArray5, __cArray6, __cArray7, 8192);
        ReportTableRow(__tableHandle, 0, __cArray2, __cRange, __cArray7, __cEmpty, __oneOfFlag, __bSetInCheckAlignment);
        ReportLValueOrSignalNotOnline(`FDCAN2::dbNode::`CVADAS::`CVPAM_FD_Info::`DisplayView2, __cArray8, 8192);
        ReportCell(__tableHandle, __cArray8);
        ReportCellResult(__tableHandle, __csr, __ePassFail);
      }
  
      __bVerdict = __bVerdict && __csr;
    }
    ReportTableEndVerdict(__tableHandle, "1", __bVerdict);
  }
  TestCommandEnd();


}

void Tt4h42sqi_Tet_CaplTcCall3()
{
  stack long __tableHandle;
  CreateCaplIFFunction("Send_Proxi", __eTcDef);
  AddIFParameterTestCaseAttribute("TC_ID", "");
  AddIFParameterTestCaseAttribute("Test Case ID", "");
  AddIFParameterChar(syspar::`VehicleProxy4);
  CallInterfaceFunction(__cEmpty , "", __cEmpty );
}

void Tt4h42sqi_Tet_Tc43()
{
  CreateTTEIFFunction("Tt4h42sqi_Tc43", __eTcDef, __eLocal);  
  AddIFParameterTestCaseAttribute("TC_ID", "");
  AddIFParameterTestCaseAttribute("Test Case ID", "");
  CallInterfaceFunction("Set to Surround View Camera", __cEmpty , __cEmpty );
}
testcase Tt4h42sqi_Tc43()
{
  stack long __tableHandle;
  SetBreakOnFail(1);

  TestPreparationBegin();
  {
  }
  TestPreparationEnd();

  TestCommandBegin(__eSet, __cSet, "", "0");
  {
    __tableHandle = ReportTableHead3Columns(__cSetCaption , __cTSym, __cTOp, __cAssigned); 
    {
      $`FDCAN2::dbNode::`SGW::`TELEMATIC_FD_14::`TGW_CAMERA_DISP_STAT.phys = 4;
      snprintf(__cArray, 8192, "%s", "TGW_CAMERA_DISP_STAT");
      snprintf(__cArray2, 8192, "%s '%s'", __cCANSignal, __cArray);
      snprintf(__cArray3, 8192, "%s", "");
      
      ReportSetLValueOrSignalNotOnline(getSignalTime(`FDCAN2::dbNode::`SGW::`TELEMATIC_FD_14::`TGW_CAMERA_DISP_STAT), __cArray2, __cArray4, 8192);
      ReportTableRow(__tableHandle, 0, __cArray4, __cAOp, 4, __cArray3, __oneOfFlag, __bSetInCheckAlignment);
      
  
    }
    {
      $`FDCAN2::dbNode::`SGW::`TELEMATIC_FD_5::`CameraDisplaySts2.phys = 0;
      snprintf(__cArray, 8192, "%s", "CameraDisplaySts2");
      snprintf(__cArray2, 8192, "%s '%s'", __cCANSignal, __cArray);
      snprintf(__cArray3, 8192, "%s", "Default");
      
      ReportSetLValueOrSignalNotOnline(getSignalTime(`FDCAN2::dbNode::`SGW::`TELEMATIC_FD_5::`CameraDisplaySts2), __cArray2, __cArray4, 8192);
      ReportTableRow(__tableHandle, 0, __cArray4, __cAOp, 0, __cArray3, __oneOfFlag, __bSetInCheckAlignment);
      
  
    }
    ReportTableEndTestStep(__tableHandle, "1");
  }
  TestCommandEnd();


  TestCommandBegin(__eWait, __cWait, "", "1");
  {
    Wait("1", (1000 * 1000000LL), 1000000, "");
  }
  TestCommandEnd();

  TestCommandBegin(__eCheck, __cCheck, "", "2");
  {
    __bVerdict = __eVerdictPass;
    __tableHandle = ReportTableHead5Columns(__cCheckCaption, __cTSym, __cTOp, __cRefVal, __cActual, __cRes);
    {
      {
        int __res1,__res2;
        __res1 = CheckSignalMatch(`FDCAN2::dbNode::`SGW::`TELEMATIC_FD_14::`TGW_CAMERA_DISP_STAT, 0, __cGreaterEqualThan) == 1;
        __res2 = CheckSignalMatch(`FDCAN2::dbNode::`SGW::`TELEMATIC_FD_14::`TGW_CAMERA_DISP_STAT, 4, __cLessEqualThan) == 1;
        __csr = __res1 && __res2;
        snprintf(__cArray, 8192, "%s", "TGW_CAMERA_DISP_STAT");
        snprintf(__cArray2, 8192, "%s '%s'", __cCANSignal, __cArray);
        snprintf(__cArray3, 8192, "%s", "");
        snprintf(__cArray4, 8192, "%s", "");
        snprintf(__cArray5, 8192, "%s", __cArray3);
        snprintf(__cArray6, 8192, "%s", __cArray4);
        ReportRange(0, 4, __cArray5, __cArray6, __cArray7, 8192);
        ReportTableRow(__tableHandle, 0, __cArray2, __cRange, __cArray7, __cEmpty, __oneOfFlag, __bSetInCheckAlignment);
        ReportLValueOrSignalNotOnline(`FDCAN2::dbNode::`SGW::`TELEMATIC_FD_14::`TGW_CAMERA_DISP_STAT, __cArray8, 8192);
        ReportCell(__tableHandle, __cArray8);
        ReportCellResult(__tableHandle, __csr, __ePassFail);
      }
  
      __bVerdict = __bVerdict && __csr;
    }
    ReportTableEndVerdict(__tableHandle, "1", __bVerdict);
  }
  TestCommandEnd();


  TestCommandBegin(__eWait, __cWait, "", "3");
  {
    Wait("1", (3000 * 1000000LL), 1000000, "");
  }
  TestCommandEnd();

}

void Tt4h42sqi_Tet_Tc44()
{
  CreateTTEIFFunction("Tt4h42sqi_Tc44", __eTcDef, __eLocal);  
  AddIFParameterTestCaseAttribute("TC_ID", "");
  AddIFParameterTestCaseAttribute("Test Case ID", "");
  CallInterfaceFunction("Default View", __cEmpty , __cEmpty );
}
testcase Tt4h42sqi_Tc44()
{
  stack long __tableHandle;
  SetBreakOnFail(1);

  TestCommandBegin(__eSet, __cSet, "", "0");
  {
    __tableHandle = ReportTableHead3Columns(__cSetCaption , __cTSym, __cTOp, __cAssigned); 
    {
      $`FDCAN2::dbNode::`SGW::`TELEMATIC_FD_5::`CameraDisplaySts2.phys = 2;
      snprintf(__cArray, 8192, "%s", "CameraDisplaySts2");
      snprintf(__cArray2, 8192, "%s '%s'", __cCANSignal, __cArray);
      snprintf(__cArray3, 8192, "%s", "");
      
      ReportSetLValueOrSignalNotOnline(getSignalTime(`FDCAN2::dbNode::`SGW::`TELEMATIC_FD_5::`CameraDisplaySts2), __cArray2, __cArray4, 8192);
      ReportTableRow(__tableHandle, 0, __cArray4, __cAOp, 2, __cArray3, __oneOfFlag, __bSetInCheckAlignment);
      
  
    }
    ReportTableEndTestStep(__tableHandle, "1");
  }
  TestCommandEnd();


  TestCommandBegin(__eWait, __cWait, "", "1");
  {
    Wait("1", (1000 * 1000000LL), 1000000, "");
  }
  TestCommandEnd();

  TestCommandBegin(__eSet, __cSet, "", "2");
  {
    __tableHandle = ReportTableHead3Columns(__cSetCaption , __cTSym, __cTOp, __cAssigned); 
    {
      $`FDCAN2::dbNode::`SGW::`TELEMATIC_FD_5::`CameraDisplaySts2.phys = 0;
      snprintf(__cArray, 8192, "%s", "CameraDisplaySts2");
      snprintf(__cArray2, 8192, "%s '%s'", __cCANSignal, __cArray);
      snprintf(__cArray3, 8192, "%s", "");
      
      ReportSetLValueOrSignalNotOnline(getSignalTime(`FDCAN2::dbNode::`SGW::`TELEMATIC_FD_5::`CameraDisplaySts2), __cArray2, __cArray4, 8192);
      ReportTableRow(__tableHandle, 0, __cArray4, __cAOp, 0, __cArray3, __oneOfFlag, __bSetInCheckAlignment);
      
  
    }
    ReportTableEndTestStep(__tableHandle, "1");
  }
  TestCommandEnd();


  TestCommandBegin(__eWait, __cWait, "", "3");
  {
    Wait("1", (1000 * 1000000LL), 1000000, "");
  }
  TestCommandEnd();

  TestCommandBegin(__eCheck, __cCheck, "", "4");
  {
    __bVerdict = __eVerdictPass;
    __tableHandle = ReportTableHead5Columns(__cCheckCaption, __cTSym, __cTOp, __cRefVal, __cActual, __cRes);
    {
      {
        int __res1,__res2;
        __res1 = CheckSignalMatch(`FDCAN2::dbNode::`CVADAS::`CVPAM_FD_Info::`DisplayView2, 1, __cGreaterEqualThan) == 1;
        __res2 = CheckSignalMatch(`FDCAN2::dbNode::`CVADAS::`CVPAM_FD_Info::`DisplayView2, 15, __cLessEqualThan) == 1;
        __csr = __res1 && __res2;
        snprintf(__cArray, 8192, "%s", "DisplayView2");
        snprintf(__cArray2, 8192, "%s '%s'", __cCANSignal, __cArray);
        snprintf(__cArray3, 8192, "%s", "");
        snprintf(__cArray4, 8192, "%s", "");
        snprintf(__cArray5, 8192, "%s", __cArray3);
        snprintf(__cArray6, 8192, "%s", __cArray4);
        ReportRange(1, 15, __cArray5, __cArray6, __cArray7, 8192);
        ReportTableRow(__tableHandle, 0, __cArray2, __cRange, __cArray7, __cEmpty, __oneOfFlag, __bSetInCheckAlignment);
        ReportLValueOrSignalNotOnline(`FDCAN2::dbNode::`CVADAS::`CVPAM_FD_Info::`DisplayView2, __cArray8, 8192);
        ReportCell(__tableHandle, __cArray8);
        ReportCellResult(__tableHandle, __csr, __ePassFail);
      }
  
      __bVerdict = __bVerdict && __csr;
    }
    ReportTableEndVerdict(__tableHandle, "1", __bVerdict);
  }
  TestCommandEnd();


}

void Tt4h42sqi_Tet_Tc45()
{
  CreateTTEIFFunction("Tt4h42sqi_Tc45", __eTcDef, __eLocal);  
  AddIFParameterTestCaseAttribute("TC_ID", "");
  AddIFParameterTestCaseAttribute("Test Case ID", "");
  CallInterfaceFunction("View 1: FVTV_RVTV", __cEmpty , __cEmpty );
}
testcase Tt4h42sqi_Tc45()
{
  stack long __tableHandle;
  SetBreakOnFail(1);

  TestCommandBegin(__eSet, __cSet, "", "0");
  {
    __tableHandle = ReportTableHead3Columns(__cSetCaption , __cTSym, __cTOp, __cAssigned); 
    {
      $`FDCAN2::dbNode::`SGW::`TELEMATIC_FD_5::`CameraDisplaySts2.phys = 1;
      snprintf(__cArray, 8192, "%s", "CameraDisplaySts2");
      snprintf(__cArray2, 8192, "%s '%s'", __cCANSignal, __cArray);
      snprintf(__cArray3, 8192, "%s", "");
      
      ReportSetLValueOrSignalNotOnline(getSignalTime(`FDCAN2::dbNode::`SGW::`TELEMATIC_FD_5::`CameraDisplaySts2), __cArray2, __cArray4, 8192);
      ReportTableRow(__tableHandle, 0, __cArray4, __cAOp, 1, __cArray3, __oneOfFlag, __bSetInCheckAlignment);
      
  
    }
    ReportTableEndTestStep(__tableHandle, "1");
  }
  TestCommandEnd();


  TestCommandBegin(__eWait, __cWait, "", "1");
  {
    Wait("1", (1000 * 1000000LL), 1000000, "");
  }
  TestCommandEnd();

  TestCommandBegin(__eCheck, __cCheck, "", "2");
  {
    __bVerdict = __eVerdictPass;
    __tableHandle = ReportTableHead5Columns(__cCheckCaption, __cTSym, __cTOp, __cRefVal, __cActual, __cRes);
    {
      {
        int __res1,__res2;
        __res1 = CheckSignalMatch(`FDCAN2::dbNode::`CVADAS::`CVPAM_FD_Info::`DisplayView2, 1, __cGreaterEqualThan) == 1;
        __res2 = CheckSignalMatch(`FDCAN2::dbNode::`CVADAS::`CVPAM_FD_Info::`DisplayView2, 15, __cLessEqualThan) == 1;
        __csr = __res1 && __res2;
        snprintf(__cArray, 8192, "%s", "DisplayView2");
        snprintf(__cArray2, 8192, "%s '%s'", __cCANSignal, __cArray);
        snprintf(__cArray3, 8192, "%s", "");
        snprintf(__cArray4, 8192, "%s", "");
        snprintf(__cArray5, 8192, "%s", __cArray3);
        snprintf(__cArray6, 8192, "%s", __cArray4);
        ReportRange(1, 15, __cArray5, __cArray6, __cArray7, 8192);
        ReportTableRow(__tableHandle, 0, __cArray2, __cRange, __cArray7, __cEmpty, __oneOfFlag, __bSetInCheckAlignment);
        ReportLValueOrSignalNotOnline(`FDCAN2::dbNode::`CVADAS::`CVPAM_FD_Info::`DisplayView2, __cArray8, 8192);
        ReportCell(__tableHandle, __cArray8);
        ReportCellResult(__tableHandle, __csr, __ePassFail);
      }
  
      __bVerdict = __bVerdict && __csr;
    }
    ReportTableEndVerdict(__tableHandle, "1", __bVerdict);
  }
  TestCommandEnd();


  {
    CreateTTEIFFunction("Tt4h42sqi_CaptureImage", __eFct, __eLocal);
    CallInterfaceFunction(__cEmpty, __cEmpty, "6684ffe3-1b9d-493e-a7be-53a7c51a24bb");
  }


}

void Tt4h42sqi_Tet_Tc46()
{
  CreateTTEIFFunction("Tt4h42sqi_Tc46", __eTcDef, __eLocal);  
  AddIFParameterTestCaseAttribute("TC_ID", "");
  AddIFParameterTestCaseAttribute("Test Case ID", "");
  CallInterfaceFunction("View 2: BackupRearView", __cEmpty , __cEmpty );
}
testcase Tt4h42sqi_Tc46()
{
  stack long __tableHandle;
  SetBreakOnFail(1);

  TestCommandBegin(__eSet, __cSet, "", "0");
  {
    __tableHandle = ReportTableHead3Columns(__cSetCaption , __cTSym, __cTOp, __cAssigned); 
    {
      $`FDCAN2::dbNode::`SGW::`TELEMATIC_FD_5::`CameraDisplaySts2.phys = 2;
      snprintf(__cArray, 8192, "%s", "CameraDisplaySts2");
      snprintf(__cArray2, 8192, "%s '%s'", __cCANSignal, __cArray);
      snprintf(__cArray3, 8192, "%s", "");
      
      ReportSetLValueOrSignalNotOnline(getSignalTime(`FDCAN2::dbNode::`SGW::`TELEMATIC_FD_5::`CameraDisplaySts2), __cArray2, __cArray4, 8192);
      ReportTableRow(__tableHandle, 0, __cArray4, __cAOp, 2, __cArray3, __oneOfFlag, __bSetInCheckAlignment);
      
  
    }
    ReportTableEndTestStep(__tableHandle, "1");
  }
  TestCommandEnd();


  TestCommandBegin(__eWait, __cWait, "", "1");
  {
    Wait("1", (1000 * 1000000LL), 1000000, "");
  }
  TestCommandEnd();

  TestCommandBegin(__eCheck, __cCheck, "", "2");
  {
    __bVerdict = __eVerdictPass;
    __tableHandle = ReportTableHead5Columns(__cCheckCaption, __cTSym, __cTOp, __cRefVal, __cActual, __cRes);
    {
      {
        int __res1,__res2;
        __res1 = CheckSignalMatch(`FDCAN2::dbNode::`CVADAS::`CVPAM_FD_Info::`DisplayView2, 1, __cGreaterEqualThan) == 1;
        __res2 = CheckSignalMatch(`FDCAN2::dbNode::`CVADAS::`CVPAM_FD_Info::`DisplayView2, 15, __cLessEqualThan) == 1;
        __csr = __res1 && __res2;
        snprintf(__cArray, 8192, "%s", "DisplayView2");
        snprintf(__cArray2, 8192, "%s '%s'", __cCANSignal, __cArray);
        snprintf(__cArray3, 8192, "%s", "");
        snprintf(__cArray4, 8192, "%s", "");
        snprintf(__cArray5, 8192, "%s", __cArray3);
        snprintf(__cArray6, 8192, "%s", __cArray4);
        ReportRange(1, 15, __cArray5, __cArray6, __cArray7, 8192);
        ReportTableRow(__tableHandle, 0, __cArray2, __cRange, __cArray7, __cEmpty, __oneOfFlag, __bSetInCheckAlignment);
        ReportLValueOrSignalNotOnline(`FDCAN2::dbNode::`CVADAS::`CVPAM_FD_Info::`DisplayView2, __cArray8, 8192);
        ReportCell(__tableHandle, __cArray8);
        ReportCellResult(__tableHandle, __csr, __ePassFail);
      }
  
      __bVerdict = __bVerdict && __csr;
    }
    ReportTableEndVerdict(__tableHandle, "1", __bVerdict);
  }
  TestCommandEnd();


  {
    CreateTTEIFFunction("Tt4h42sqi_CaptureImage", __eFct, __eLocal);
    CallInterfaceFunction(__cEmpty, __cEmpty, "6684ffe3-1b9d-493e-a7be-53a7c51a24bb");
  }


}

void Tt4h42sqi_Tet_Tc47()
{
  CreateTTEIFFunction("Tt4h42sqi_Tc47", __eTcDef, __eLocal);  
  AddIFParameterTestCaseAttribute("TC_ID", "");
  AddIFParameterTestCaseAttribute("Test Case ID", "");
  CallInterfaceFunction("View 3: Forward Facing Camera", __cEmpty , __cEmpty );
}
testcase Tt4h42sqi_Tc47()
{
  stack long __tableHandle;
  SetBreakOnFail(1);

  TestCommandBegin(__eSet, __cSet, "", "0");
  {
    __tableHandle = ReportTableHead3Columns(__cSetCaption , __cTSym, __cTOp, __cAssigned); 
    {
      $`FDCAN2::dbNode::`SGW::`TELEMATIC_FD_5::`CameraDisplaySts2.phys = 3;
      snprintf(__cArray, 8192, "%s", "CameraDisplaySts2");
      snprintf(__cArray2, 8192, "%s '%s'", __cCANSignal, __cArray);
      snprintf(__cArray3, 8192, "%s", "");
      
      ReportSetLValueOrSignalNotOnline(getSignalTime(`FDCAN2::dbNode::`SGW::`TELEMATIC_FD_5::`CameraDisplaySts2), __cArray2, __cArray4, 8192);
      ReportTableRow(__tableHandle, 0, __cArray4, __cAOp, 3, __cArray3, __oneOfFlag, __bSetInCheckAlignment);
      
  
    }
    ReportTableEndTestStep(__tableHandle, "1");
  }
  TestCommandEnd();


  TestCommandBegin(__eWait, __cWait, "", "1");
  {
    Wait("1", (1000 * 1000000LL), 1000000, "");
  }
  TestCommandEnd();

  TestCommandBegin(__eCheck, __cCheck, "", "2");
  {
    __bVerdict = __eVerdictPass;
    __tableHandle = ReportTableHead5Columns(__cCheckCaption, __cTSym, __cTOp, __cRefVal, __cActual, __cRes);
    {
      {
        int __res1,__res2;
        __res1 = CheckSignalMatch(`FDCAN2::dbNode::`CVADAS::`CVPAM_FD_Info::`DisplayView2, 1, __cGreaterEqualThan) == 1;
        __res2 = CheckSignalMatch(`FDCAN2::dbNode::`CVADAS::`CVPAM_FD_Info::`DisplayView2, 15, __cLessEqualThan) == 1;
        __csr = __res1 && __res2;
        snprintf(__cArray, 8192, "%s", "DisplayView2");
        snprintf(__cArray2, 8192, "%s '%s'", __cCANSignal, __cArray);
        snprintf(__cArray3, 8192, "%s", "");
        snprintf(__cArray4, 8192, "%s", "");
        snprintf(__cArray5, 8192, "%s", __cArray3);
        snprintf(__cArray6, 8192, "%s", __cArray4);
        ReportRange(1, 15, __cArray5, __cArray6, __cArray7, 8192);
        ReportTableRow(__tableHandle, 0, __cArray2, __cRange, __cArray7, __cEmpty, __oneOfFlag, __bSetInCheckAlignment);
        ReportLValueOrSignalNotOnline(`FDCAN2::dbNode::`CVADAS::`CVPAM_FD_Info::`DisplayView2, __cArray8, 8192);
        ReportCell(__tableHandle, __cArray8);
        ReportCellResult(__tableHandle, __csr, __ePassFail);
      }
  
      __bVerdict = __bVerdict && __csr;
    }
    ReportTableEndVerdict(__tableHandle, "1", __bVerdict);
  }
  TestCommandEnd();


}

void Tt4h42sqi_Tet_Tc48()
{
  CreateTTEIFFunction("Tt4h42sqi_Tc48", __eTcDef, __eLocal);  
  AddIFParameterTestCaseAttribute("TC_ID", "");
  AddIFParameterTestCaseAttribute("Test Case ID", "");
  CallInterfaceFunction("View 5: Trailer Reverse Guidance", __cEmpty , __cEmpty );
}
testcase Tt4h42sqi_Tc48()
{
  stack long __tableHandle;
  SetBreakOnFail(1);

  TestCommandBegin(__eSet, __cSet, "", "0");
  {
    __tableHandle = ReportTableHead3Columns(__cSetCaption , __cTSym, __cTOp, __cAssigned); 
    {
      $`FDCAN2::dbNode::`SGW::`TELEMATIC_FD_5::`CameraDisplaySts2.phys = 5;
      snprintf(__cArray, 8192, "%s", "CameraDisplaySts2");
      snprintf(__cArray2, 8192, "%s '%s'", __cCANSignal, __cArray);
      snprintf(__cArray3, 8192, "%s", "");
      
      ReportSetLValueOrSignalNotOnline(getSignalTime(`FDCAN2::dbNode::`SGW::`TELEMATIC_FD_5::`CameraDisplaySts2), __cArray2, __cArray4, 8192);
      ReportTableRow(__tableHandle, 0, __cArray4, __cAOp, 5, __cArray3, __oneOfFlag, __bSetInCheckAlignment);
      
  
    }
    ReportTableEndTestStep(__tableHandle, "1");
  }
  TestCommandEnd();


  TestCommandBegin(__eWait, __cWait, "", "1");
  {
    Wait("1", (1000 * 1000000LL), 1000000, "");
  }
  TestCommandEnd();

  TestCommandBegin(__eCheck, __cCheck, "", "2");
  {
    __bVerdict = __eVerdictPass;
    __tableHandle = ReportTableHead5Columns(__cCheckCaption, __cTSym, __cTOp, __cRefVal, __cActual, __cRes);
    {
      {
        int __res1,__res2;
        __res1 = CheckSignalMatch(`FDCAN2::dbNode::`CVADAS::`CVPAM_FD_Info::`DisplayView2, 1, __cGreaterEqualThan) == 1;
        __res2 = CheckSignalMatch(`FDCAN2::dbNode::`CVADAS::`CVPAM_FD_Info::`DisplayView2, 15, __cLessEqualThan) == 1;
        __csr = __res1 && __res2;
        snprintf(__cArray, 8192, "%s", "DisplayView2");
        snprintf(__cArray2, 8192, "%s '%s'", __cCANSignal, __cArray);
        snprintf(__cArray3, 8192, "%s", "");
        snprintf(__cArray4, 8192, "%s", "");
        snprintf(__cArray5, 8192, "%s", __cArray3);
        snprintf(__cArray6, 8192, "%s", __cArray4);
        ReportRange(1, 15, __cArray5, __cArray6, __cArray7, 8192);
        ReportTableRow(__tableHandle, 0, __cArray2, __cRange, __cArray7, __cEmpty, __oneOfFlag, __bSetInCheckAlignment);
        ReportLValueOrSignalNotOnline(`FDCAN2::dbNode::`CVADAS::`CVPAM_FD_Info::`DisplayView2, __cArray8, 8192);
        ReportCell(__tableHandle, __cArray8);
        ReportCellResult(__tableHandle, __csr, __ePassFail);
      }
  
      __bVerdict = __bVerdict && __csr;
    }
    ReportTableEndVerdict(__tableHandle, "1", __bVerdict);
  }
  TestCommandEnd();


}

void Tt4h42sqi_Tet_Tc49()
{
  CreateTTEIFFunction("Tt4h42sqi_Tc49", __eTcDef, __eLocal);  
  AddIFParameterTestCaseAttribute("TC_ID", "");
  AddIFParameterTestCaseAttribute("Test Case ID", "");
  CallInterfaceFunction("View 6: Trailer Left View", __cEmpty , __cEmpty );
}
testcase Tt4h42sqi_Tc49()
{
  stack long __tableHandle;
  SetBreakOnFail(1);

  TestCommandBegin(__eSet, __cSet, "", "0");
  {
    __tableHandle = ReportTableHead3Columns(__cSetCaption , __cTSym, __cTOp, __cAssigned); 
    {
      $`FDCAN2::dbNode::`SGW::`TELEMATIC_FD_5::`CameraDisplaySts2.phys = 6;
      snprintf(__cArray, 8192, "%s", "CameraDisplaySts2");
      snprintf(__cArray2, 8192, "%s '%s'", __cCANSignal, __cArray);
      snprintf(__cArray3, 8192, "%s", "");
      
      ReportSetLValueOrSignalNotOnline(getSignalTime(`FDCAN2::dbNode::`SGW::`TELEMATIC_FD_5::`CameraDisplaySts2), __cArray2, __cArray4, 8192);
      ReportTableRow(__tableHandle, 0, __cArray4, __cAOp, 6, __cArray3, __oneOfFlag, __bSetInCheckAlignment);
      
  
    }
    ReportTableEndTestStep(__tableHandle, "1");
  }
  TestCommandEnd();


  TestCommandBegin(__eWait, __cWait, "", "1");
  {
    Wait("1", (1000 * 1000000LL), 1000000, "");
  }
  TestCommandEnd();

  TestCommandBegin(__eCheck, __cCheck, "", "2");
  {
    __bVerdict = __eVerdictPass;
    __tableHandle = ReportTableHead5Columns(__cCheckCaption, __cTSym, __cTOp, __cRefVal, __cActual, __cRes);
    {
      {
        int __res1,__res2;
        __res1 = CheckSignalMatch(`FDCAN2::dbNode::`CVADAS::`CVPAM_FD_Info::`DisplayView2, 1, __cGreaterEqualThan) == 1;
        __res2 = CheckSignalMatch(`FDCAN2::dbNode::`CVADAS::`CVPAM_FD_Info::`DisplayView2, 15, __cLessEqualThan) == 1;
        __csr = __res1 && __res2;
        snprintf(__cArray, 8192, "%s", "DisplayView2");
        snprintf(__cArray2, 8192, "%s '%s'", __cCANSignal, __cArray);
        snprintf(__cArray3, 8192, "%s", "");
        snprintf(__cArray4, 8192, "%s", "");
        snprintf(__cArray5, 8192, "%s", __cArray3);
        snprintf(__cArray6, 8192, "%s", __cArray4);
        ReportRange(1, 15, __cArray5, __cArray6, __cArray7, 8192);
        ReportTableRow(__tableHandle, 0, __cArray2, __cRange, __cArray7, __cEmpty, __oneOfFlag, __bSetInCheckAlignment);
        ReportLValueOrSignalNotOnline(`FDCAN2::dbNode::`CVADAS::`CVPAM_FD_Info::`DisplayView2, __cArray8, 8192);
        ReportCell(__tableHandle, __cArray8);
        ReportCellResult(__tableHandle, __csr, __ePassFail);
      }
  
      __bVerdict = __bVerdict && __csr;
    }
    ReportTableEndVerdict(__tableHandle, "1", __bVerdict);
  }
  TestCommandEnd();


}

void Tt4h42sqi_Tet_Tc50()
{
  CreateTTEIFFunction("Tt4h42sqi_Tc50", __eTcDef, __eLocal);  
  AddIFParameterTestCaseAttribute("TC_ID", "");
  AddIFParameterTestCaseAttribute("Test Case ID", "");
  CallInterfaceFunction("View 7: Trailer Right View", __cEmpty , __cEmpty );
}
testcase Tt4h42sqi_Tc50()
{
  stack long __tableHandle;
  SetBreakOnFail(1);

  TestCommandBegin(__eSet, __cSet, "", "0");
  {
    __tableHandle = ReportTableHead3Columns(__cSetCaption , __cTSym, __cTOp, __cAssigned); 
    {
      $`FDCAN2::dbNode::`SGW::`TELEMATIC_FD_5::`CameraDisplaySts2.phys = 7;
      snprintf(__cArray, 8192, "%s", "CameraDisplaySts2");
      snprintf(__cArray2, 8192, "%s '%s'", __cCANSignal, __cArray);
      snprintf(__cArray3, 8192, "%s", "");
      
      ReportSetLValueOrSignalNotOnline(getSignalTime(`FDCAN2::dbNode::`SGW::`TELEMATIC_FD_5::`CameraDisplaySts2), __cArray2, __cArray4, 8192);
      ReportTableRow(__tableHandle, 0, __cArray4, __cAOp, 7, __cArray3, __oneOfFlag, __bSetInCheckAlignment);
      
  
    }
    ReportTableEndTestStep(__tableHandle, "1");
  }
  TestCommandEnd();


  TestCommandBegin(__eWait, __cWait, "", "1");
  {
    Wait("1", (1000 * 1000000LL), 1000000, "");
  }
  TestCommandEnd();

  TestCommandBegin(__eCheck, __cCheck, "", "2");
  {
    __bVerdict = __eVerdictPass;
    __tableHandle = ReportTableHead5Columns(__cCheckCaption, __cTSym, __cTOp, __cRefVal, __cActual, __cRes);
    {
      {
        int __res1,__res2;
        __res1 = CheckSignalMatch(`FDCAN2::dbNode::`CVADAS::`CVPAM_FD_Info::`DisplayView2, 1, __cGreaterEqualThan) == 1;
        __res2 = CheckSignalMatch(`FDCAN2::dbNode::`CVADAS::`CVPAM_FD_Info::`DisplayView2, 15, __cLessEqualThan) == 1;
        __csr = __res1 && __res2;
        snprintf(__cArray, 8192, "%s", "DisplayView2");
        snprintf(__cArray2, 8192, "%s '%s'", __cCANSignal, __cArray);
        snprintf(__cArray3, 8192, "%s", "");
        snprintf(__cArray4, 8192, "%s", "");
        snprintf(__cArray5, 8192, "%s", __cArray3);
        snprintf(__cArray6, 8192, "%s", __cArray4);
        ReportRange(1, 15, __cArray5, __cArray6, __cArray7, 8192);
        ReportTableRow(__tableHandle, 0, __cArray2, __cRange, __cArray7, __cEmpty, __oneOfFlag, __bSetInCheckAlignment);
        ReportLValueOrSignalNotOnline(`FDCAN2::dbNode::`CVADAS::`CVPAM_FD_Info::`DisplayView2, __cArray8, 8192);
        ReportCell(__tableHandle, __cArray8);
        ReportCellResult(__tableHandle, __csr, __ePassFail);
      }
  
      __bVerdict = __bVerdict && __csr;
    }
    ReportTableEndVerdict(__tableHandle, "1", __bVerdict);
  }
  TestCommandEnd();


}

void Tt4h42sqi_Tet_Tc51()
{
  CreateTTEIFFunction("Tt4h42sqi_Tc51", __eTcDef, __eLocal);  
  AddIFParameterTestCaseAttribute("TC_ID", "");
  AddIFParameterTestCaseAttribute("Test Case ID", "");
  CallInterfaceFunction("View 8: Blind Spot Left View", __cEmpty , __cEmpty );
}
testcase Tt4h42sqi_Tc51()
{
  stack long __tableHandle;
  SetBreakOnFail(1);

  TestCommandBegin(__eSet, __cSet, "", "0");
  {
    __tableHandle = ReportTableHead3Columns(__cSetCaption , __cTSym, __cTOp, __cAssigned); 
    {
      $`FDCAN2::dbNode::`SGW::`TELEMATIC_FD_5::`CameraDisplaySts2.phys = 8;
      snprintf(__cArray, 8192, "%s", "CameraDisplaySts2");
      snprintf(__cArray2, 8192, "%s '%s'", __cCANSignal, __cArray);
      snprintf(__cArray3, 8192, "%s", "");
      
      ReportSetLValueOrSignalNotOnline(getSignalTime(`FDCAN2::dbNode::`SGW::`TELEMATIC_FD_5::`CameraDisplaySts2), __cArray2, __cArray4, 8192);
      ReportTableRow(__tableHandle, 0, __cArray4, __cAOp, 8, __cArray3, __oneOfFlag, __bSetInCheckAlignment);
      
  
    }
    ReportTableEndTestStep(__tableHandle, "1");
  }
  TestCommandEnd();


  TestCommandBegin(__eWait, __cWait, "", "1");
  {
    Wait("1", (1000 * 1000000LL), 1000000, "");
  }
  TestCommandEnd();

  TestCommandBegin(__eCheck, __cCheck, "", "2");
  {
    __bVerdict = __eVerdictPass;
    __tableHandle = ReportTableHead5Columns(__cCheckCaption, __cTSym, __cTOp, __cRefVal, __cActual, __cRes);
    {
      {
        int __res1,__res2;
        __res1 = CheckSignalMatch(`FDCAN2::dbNode::`CVADAS::`CVPAM_FD_Info::`DisplayView2, 2, __cGreaterEqualThan) == 1;
        __res2 = CheckSignalMatch(`FDCAN2::dbNode::`CVADAS::`CVPAM_FD_Info::`DisplayView2, 10, __cLessEqualThan) == 1;
        __csr = __res1 && __res2;
        snprintf(__cArray, 8192, "%s", "DisplayView2");
        snprintf(__cArray2, 8192, "%s '%s'", __cCANSignal, __cArray);
        snprintf(__cArray3, 8192, "%s", "");
        snprintf(__cArray4, 8192, "%s", "");
        snprintf(__cArray5, 8192, "%s", __cArray3);
        snprintf(__cArray6, 8192, "%s", __cArray4);
        ReportRange(2, 10, __cArray5, __cArray6, __cArray7, 8192);
        ReportTableRow(__tableHandle, 0, __cArray2, __cRange, __cArray7, __cEmpty, __oneOfFlag, __bSetInCheckAlignment);
        ReportLValueOrSignalNotOnline(`FDCAN2::dbNode::`CVADAS::`CVPAM_FD_Info::`DisplayView2, __cArray8, 8192);
        ReportCell(__tableHandle, __cArray8);
        ReportCellResult(__tableHandle, __csr, __ePassFail);
      }
  
      __bVerdict = __bVerdict && __csr;
    }
    ReportTableEndVerdict(__tableHandle, "1", __bVerdict);
  }
  TestCommandEnd();


}

void Tt4h42sqi_Tet_Tc52()
{
  CreateTTEIFFunction("Tt4h42sqi_Tc52", __eTcDef, __eLocal);  
  AddIFParameterTestCaseAttribute("TC_ID", "");
  AddIFParameterTestCaseAttribute("Test Case ID", "");
  CallInterfaceFunction("View 9: Blind Spot Right View", __cEmpty , __cEmpty );
}
testcase Tt4h42sqi_Tc52()
{
  stack long __tableHandle;
  SetBreakOnFail(1);

  TestCommandBegin(__eSet, __cSet, "", "0");
  {
    __tableHandle = ReportTableHead3Columns(__cSetCaption , __cTSym, __cTOp, __cAssigned); 
    {
      $`FDCAN2::dbNode::`SGW::`TELEMATIC_FD_5::`CameraDisplaySts2.phys = 9;
      snprintf(__cArray, 8192, "%s", "CameraDisplaySts2");
      snprintf(__cArray2, 8192, "%s '%s'", __cCANSignal, __cArray);
      snprintf(__cArray3, 8192, "%s", "");
      
      ReportSetLValueOrSignalNotOnline(getSignalTime(`FDCAN2::dbNode::`SGW::`TELEMATIC_FD_5::`CameraDisplaySts2), __cArray2, __cArray4, 8192);
      ReportTableRow(__tableHandle, 0, __cArray4, __cAOp, 9, __cArray3, __oneOfFlag, __bSetInCheckAlignment);
      
  
    }
    ReportTableEndTestStep(__tableHandle, "1");
  }
  TestCommandEnd();


  TestCommandBegin(__eWait, __cWait, "", "1");
  {
    Wait("1", (1000 * 1000000LL), 1000000, "");
  }
  TestCommandEnd();

  TestCommandBegin(__eCheck, __cCheck, "", "2");
  {
    __bVerdict = __eVerdictPass;
    __tableHandle = ReportTableHead5Columns(__cCheckCaption, __cTSym, __cTOp, __cRefVal, __cActual, __cRes);
    {
      {
        int __res1,__res2;
        __res1 = CheckSignalMatch(`FDCAN2::dbNode::`CVADAS::`CVPAM_FD_Info::`DisplayView2, 2, __cGreaterEqualThan) == 1;
        __res2 = CheckSignalMatch(`FDCAN2::dbNode::`CVADAS::`CVPAM_FD_Info::`DisplayView2, 15, __cLessEqualThan) == 1;
        __csr = __res1 && __res2;
        snprintf(__cArray, 8192, "%s", "DisplayView2");
        snprintf(__cArray2, 8192, "%s '%s'", __cCANSignal, __cArray);
        snprintf(__cArray3, 8192, "%s", "");
        snprintf(__cArray4, 8192, "%s", "");
        snprintf(__cArray5, 8192, "%s", __cArray3);
        snprintf(__cArray6, 8192, "%s", __cArray4);
        ReportRange(2, 15, __cArray5, __cArray6, __cArray7, 8192);
        ReportTableRow(__tableHandle, 0, __cArray2, __cRange, __cArray7, __cEmpty, __oneOfFlag, __bSetInCheckAlignment);
        ReportLValueOrSignalNotOnline(`FDCAN2::dbNode::`CVADAS::`CVPAM_FD_Info::`DisplayView2, __cArray8, 8192);
        ReportCell(__tableHandle, __cArray8);
        ReportCellResult(__tableHandle, __csr, __ePassFail);
      }
  
      __bVerdict = __bVerdict && __csr;
    }
    ReportTableEndVerdict(__tableHandle, "1", __bVerdict);
  }
  TestCommandEnd();


}

void Tt4h42sqi_Tet_Tc53()
{
  CreateTTEIFFunction("Tt4h42sqi_Tc53", __eTcDef, __eLocal);  
  AddIFParameterTestCaseAttribute("TC_ID", "");
  AddIFParameterTestCaseAttribute("Test Case ID", "");
  CallInterfaceFunction("View 11: FVTV", __cEmpty , __cEmpty );
}
testcase Tt4h42sqi_Tc53()
{
  stack long __tableHandle;
  SetBreakOnFail(1);

  TestCommandBegin(__eSet, __cSet, "", "0");
  {
    __tableHandle = ReportTableHead3Columns(__cSetCaption , __cTSym, __cTOp, __cAssigned); 
    {
      $`FDCAN2::dbNode::`SGW::`TELEMATIC_FD_5::`CameraDisplaySts2.phys = 11;
      snprintf(__cArray, 8192, "%s", "CameraDisplaySts2");
      snprintf(__cArray2, 8192, "%s '%s'", __cCANSignal, __cArray);
      snprintf(__cArray3, 8192, "%s", "");
      
      ReportSetLValueOrSignalNotOnline(getSignalTime(`FDCAN2::dbNode::`SGW::`TELEMATIC_FD_5::`CameraDisplaySts2), __cArray2, __cArray4, 8192);
      ReportTableRow(__tableHandle, 0, __cArray4, __cAOp, 11, __cArray3, __oneOfFlag, __bSetInCheckAlignment);
      
  
    }
    ReportTableEndTestStep(__tableHandle, "1");
  }
  TestCommandEnd();


  TestCommandBegin(__eWait, __cWait, "", "1");
  {
    Wait("1", (1000 * 1000000LL), 1000000, "");
  }
  TestCommandEnd();

  TestCommandBegin(__eCheck, __cCheck, "", "2");
  {
    __bVerdict = __eVerdictPass;
    __tableHandle = ReportTableHead5Columns(__cCheckCaption, __cTSym, __cTOp, __cRefVal, __cActual, __cRes);
    {
      {
        int __res1,__res2;
        __res1 = CheckSignalMatch(`FDCAN2::dbNode::`CVADAS::`CVPAM_FD_Info::`DisplayView2, 1, __cGreaterEqualThan) == 1;
        __res2 = CheckSignalMatch(`FDCAN2::dbNode::`CVADAS::`CVPAM_FD_Info::`DisplayView2, 15, __cLessEqualThan) == 1;
        __csr = __res1 && __res2;
        snprintf(__cArray, 8192, "%s", "DisplayView2");
        snprintf(__cArray2, 8192, "%s '%s'", __cCANSignal, __cArray);
        snprintf(__cArray3, 8192, "%s", "");
        snprintf(__cArray4, 8192, "%s", "");
        snprintf(__cArray5, 8192, "%s", __cArray3);
        snprintf(__cArray6, 8192, "%s", __cArray4);
        ReportRange(1, 15, __cArray5, __cArray6, __cArray7, 8192);
        ReportTableRow(__tableHandle, 0, __cArray2, __cRange, __cArray7, __cEmpty, __oneOfFlag, __bSetInCheckAlignment);
        ReportLValueOrSignalNotOnline(`FDCAN2::dbNode::`CVADAS::`CVPAM_FD_Info::`DisplayView2, __cArray8, 8192);
        ReportCell(__tableHandle, __cArray8);
        ReportCellResult(__tableHandle, __csr, __ePassFail);
      }
  
      __bVerdict = __bVerdict && __csr;
    }
    ReportTableEndVerdict(__tableHandle, "1", __bVerdict);
  }
  TestCommandEnd();


}

void Tt4h42sqi_Tet_Tc54()
{
  CreateTTEIFFunction("Tt4h42sqi_Tc54", __eTcDef, __eLocal);  
  AddIFParameterTestCaseAttribute("TC_ID", "");
  AddIFParameterTestCaseAttribute("Test Case ID", "");
  CallInterfaceFunction("View 12: RVTV", __cEmpty , __cEmpty );
}
testcase Tt4h42sqi_Tc54()
{
  stack long __tableHandle;
  SetBreakOnFail(1);

  TestCommandBegin(__eSet, __cSet, "", "0");
  {
    __tableHandle = ReportTableHead3Columns(__cSetCaption , __cTSym, __cTOp, __cAssigned); 
    {
      $`FDCAN2::dbNode::`SGW::`TELEMATIC_FD_5::`CameraDisplaySts2.phys = 12;
      snprintf(__cArray, 8192, "%s", "CameraDisplaySts2");
      snprintf(__cArray2, 8192, "%s '%s'", __cCANSignal, __cArray);
      snprintf(__cArray3, 8192, "%s", "");
      
      ReportSetLValueOrSignalNotOnline(getSignalTime(`FDCAN2::dbNode::`SGW::`TELEMATIC_FD_5::`CameraDisplaySts2), __cArray2, __cArray4, 8192);
      ReportTableRow(__tableHandle, 0, __cArray4, __cAOp, 12, __cArray3, __oneOfFlag, __bSetInCheckAlignment);
      
  
    }
    ReportTableEndTestStep(__tableHandle, "1");
  }
  TestCommandEnd();


  TestCommandBegin(__eWait, __cWait, "", "1");
  {
    Wait("1", (1000 * 1000000LL), 1000000, "");
  }
  TestCommandEnd();

  TestCommandBegin(__eCheck, __cCheck, "", "2");
  {
    __bVerdict = __eVerdictPass;
    __tableHandle = ReportTableHead5Columns(__cCheckCaption, __cTSym, __cTOp, __cRefVal, __cActual, __cRes);
    {
      {
        int __res1,__res2;
        __res1 = CheckSignalMatch(`FDCAN2::dbNode::`CVADAS::`CVPAM_FD_Info::`DisplayView2, 1, __cGreaterEqualThan) == 1;
        __res2 = CheckSignalMatch(`FDCAN2::dbNode::`CVADAS::`CVPAM_FD_Info::`DisplayView2, 15, __cLessEqualThan) == 1;
        __csr = __res1 && __res2;
        snprintf(__cArray, 8192, "%s", "DisplayView2");
        snprintf(__cArray2, 8192, "%s '%s'", __cCANSignal, __cArray);
        snprintf(__cArray3, 8192, "%s", "");
        snprintf(__cArray4, 8192, "%s", "");
        snprintf(__cArray5, 8192, "%s", __cArray3);
        snprintf(__cArray6, 8192, "%s", __cArray4);
        ReportRange(1, 15, __cArray5, __cArray6, __cArray7, 8192);
        ReportTableRow(__tableHandle, 0, __cArray2, __cRange, __cArray7, __cEmpty, __oneOfFlag, __bSetInCheckAlignment);
        ReportLValueOrSignalNotOnline(`FDCAN2::dbNode::`CVADAS::`CVPAM_FD_Info::`DisplayView2, __cArray8, 8192);
        ReportCell(__tableHandle, __cArray8);
        ReportCellResult(__tableHandle, __csr, __ePassFail);
      }
  
      __bVerdict = __bVerdict && __csr;
    }
    ReportTableEndVerdict(__tableHandle, "1", __bVerdict);
  }
  TestCommandEnd();


}

void Tt4h42sqi_Tet_Tc55()
{
  CreateTTEIFFunction("Tt4h42sqi_Tc55", __eTcDef, __eLocal);  
  AddIFParameterTestCaseAttribute("TC_ID", "");
  AddIFParameterTestCaseAttribute("Test Case ID", "");
  CallInterfaceFunction("View 13: FrontCrossPathView", __cEmpty , __cEmpty );
}
testcase Tt4h42sqi_Tc55()
{
  stack long __tableHandle;
  SetBreakOnFail(1);

  TestCommandBegin(__eSet, __cSet, "", "0");
  {
    __tableHandle = ReportTableHead3Columns(__cSetCaption , __cTSym, __cTOp, __cAssigned); 
    {
      $`FDCAN2::dbNode::`SGW::`TELEMATIC_FD_5::`CameraDisplaySts2.phys = 13;
      snprintf(__cArray, 8192, "%s", "CameraDisplaySts2");
      snprintf(__cArray2, 8192, "%s '%s'", __cCANSignal, __cArray);
      snprintf(__cArray3, 8192, "%s", "");
      
      ReportSetLValueOrSignalNotOnline(getSignalTime(`FDCAN2::dbNode::`SGW::`TELEMATIC_FD_5::`CameraDisplaySts2), __cArray2, __cArray4, 8192);
      ReportTableRow(__tableHandle, 0, __cArray4, __cAOp, 13, __cArray3, __oneOfFlag, __bSetInCheckAlignment);
      
  
    }
    ReportTableEndTestStep(__tableHandle, "1");
  }
  TestCommandEnd();


  TestCommandBegin(__eWait, __cWait, "", "1");
  {
    Wait("1", (1000 * 1000000LL), 1000000, "");
  }
  TestCommandEnd();

  TestCommandBegin(__eCheck, __cCheck, "", "2");
  {
    __bVerdict = __eVerdictPass;
    __tableHandle = ReportTableHead5Columns(__cCheckCaption, __cTSym, __cTOp, __cRefVal, __cActual, __cRes);
    {
      {
        int __res1,__res2;
        __res1 = CheckSignalMatch(`FDCAN2::dbNode::`CVADAS::`CVPAM_FD_Info::`DisplayView2, 1, __cGreaterEqualThan) == 1;
        __res2 = CheckSignalMatch(`FDCAN2::dbNode::`CVADAS::`CVPAM_FD_Info::`DisplayView2, 15, __cLessEqualThan) == 1;
        __csr = __res1 && __res2;
        snprintf(__cArray, 8192, "%s", "DisplayView2");
        snprintf(__cArray2, 8192, "%s '%s'", __cCANSignal, __cArray);
        snprintf(__cArray3, 8192, "%s", "");
        snprintf(__cArray4, 8192, "%s", "");
        snprintf(__cArray5, 8192, "%s", __cArray3);
        snprintf(__cArray6, 8192, "%s", __cArray4);
        ReportRange(1, 15, __cArray5, __cArray6, __cArray7, 8192);
        ReportTableRow(__tableHandle, 0, __cArray2, __cRange, __cArray7, __cEmpty, __oneOfFlag, __bSetInCheckAlignment);
        ReportLValueOrSignalNotOnline(`FDCAN2::dbNode::`CVADAS::`CVPAM_FD_Info::`DisplayView2, __cArray8, 8192);
        ReportCell(__tableHandle, __cArray8);
        ReportCellResult(__tableHandle, __csr, __ePassFail);
      }
  
      __bVerdict = __bVerdict && __csr;
    }
    ReportTableEndVerdict(__tableHandle, "1", __bVerdict);
  }
  TestCommandEnd();


}

void Tt4h42sqi_Tet_Tc56()
{
  CreateTTEIFFunction("Tt4h42sqi_Tc56", __eTcDef, __eLocal);  
  AddIFParameterTestCaseAttribute("TC_ID", "");
  AddIFParameterTestCaseAttribute("Test Case ID", "");
  CallInterfaceFunction("View 14: RearCrossPathView", __cEmpty , __cEmpty );
}
testcase Tt4h42sqi_Tc56()
{
  stack long __tableHandle;
  SetBreakOnFail(1);

  TestCommandBegin(__eSet, __cSet, "", "0");
  {
    __tableHandle = ReportTableHead3Columns(__cSetCaption , __cTSym, __cTOp, __cAssigned); 
    {
      $`FDCAN2::dbNode::`SGW::`TELEMATIC_FD_5::`CameraDisplaySts2.phys = 14;
      snprintf(__cArray, 8192, "%s", "CameraDisplaySts2");
      snprintf(__cArray2, 8192, "%s '%s'", __cCANSignal, __cArray);
      snprintf(__cArray3, 8192, "%s", "");
      
      ReportSetLValueOrSignalNotOnline(getSignalTime(`FDCAN2::dbNode::`SGW::`TELEMATIC_FD_5::`CameraDisplaySts2), __cArray2, __cArray4, 8192);
      ReportTableRow(__tableHandle, 0, __cArray4, __cAOp, 14, __cArray3, __oneOfFlag, __bSetInCheckAlignment);
      
  
    }
    ReportTableEndTestStep(__tableHandle, "1");
  }
  TestCommandEnd();


  TestCommandBegin(__eWait, __cWait, "", "1");
  {
    Wait("1", (1000 * 1000000LL), 1000000, "");
  }
  TestCommandEnd();

  TestCommandBegin(__eCheck, __cCheck, "", "2");
  {
    __bVerdict = __eVerdictPass;
    __tableHandle = ReportTableHead5Columns(__cCheckCaption, __cTSym, __cTOp, __cRefVal, __cActual, __cRes);
    {
      {
        int __res1,__res2;
        __res1 = CheckSignalMatch(`FDCAN2::dbNode::`CVADAS::`CVPAM_FD_Info::`DisplayView2, 1, __cGreaterEqualThan) == 1;
        __res2 = CheckSignalMatch(`FDCAN2::dbNode::`CVADAS::`CVPAM_FD_Info::`DisplayView2, 15, __cLessEqualThan) == 1;
        __csr = __res1 && __res2;
        snprintf(__cArray, 8192, "%s", "DisplayView2");
        snprintf(__cArray2, 8192, "%s '%s'", __cCANSignal, __cArray);
        snprintf(__cArray3, 8192, "%s", "");
        snprintf(__cArray4, 8192, "%s", "");
        snprintf(__cArray5, 8192, "%s", __cArray3);
        snprintf(__cArray6, 8192, "%s", __cArray4);
        ReportRange(1, 15, __cArray5, __cArray6, __cArray7, 8192);
        ReportTableRow(__tableHandle, 0, __cArray2, __cRange, __cArray7, __cEmpty, __oneOfFlag, __bSetInCheckAlignment);
        ReportLValueOrSignalNotOnline(`FDCAN2::dbNode::`CVADAS::`CVPAM_FD_Info::`DisplayView2, __cArray8, 8192);
        ReportCell(__tableHandle, __cArray8);
        ReportCellResult(__tableHandle, __csr, __ePassFail);
      }
  
      __bVerdict = __bVerdict && __csr;
    }
    ReportTableEndVerdict(__tableHandle, "1", __bVerdict);
  }
  TestCommandEnd();


}

void Tt4h42sqi_Tet_CaplTcCall4()
{
  stack long __tableHandle;
  CreateCaplIFFunction("Send_Proxi", __eTcDef);
  AddIFParameterTestCaseAttribute("TC_ID", "");
  AddIFParameterTestCaseAttribute("Test Case ID", "");
  AddIFParameterChar(syspar::`VehicleProxy5);
  CallInterfaceFunction(__cEmpty , "", __cEmpty );
}

void Tt4h42sqi_Tet_Tc57()
{
  CreateTTEIFFunction("Tt4h42sqi_Tc57", __eTcDef, __eLocal);  
  AddIFParameterTestCaseAttribute("TC_ID", "");
  AddIFParameterTestCaseAttribute("Test Case ID", "");
  CallInterfaceFunction("Set to Surround View Camera", __cEmpty , __cEmpty );
}
testcase Tt4h42sqi_Tc57()
{
  stack long __tableHandle;
  SetBreakOnFail(1);

  TestPreparationBegin();
  {
  }
  TestPreparationEnd();

  TestCommandBegin(__eSet, __cSet, "", "0");
  {
    __tableHandle = ReportTableHead3Columns(__cSetCaption , __cTSym, __cTOp, __cAssigned); 
    {
      $`FDCAN2::dbNode::`SGW::`TELEMATIC_FD_14::`TGW_CAMERA_DISP_STAT.phys = 4;
      snprintf(__cArray, 8192, "%s", "TGW_CAMERA_DISP_STAT");
      snprintf(__cArray2, 8192, "%s '%s'", __cCANSignal, __cArray);
      snprintf(__cArray3, 8192, "%s", "");
      
      ReportSetLValueOrSignalNotOnline(getSignalTime(`FDCAN2::dbNode::`SGW::`TELEMATIC_FD_14::`TGW_CAMERA_DISP_STAT), __cArray2, __cArray4, 8192);
      ReportTableRow(__tableHandle, 0, __cArray4, __cAOp, 4, __cArray3, __oneOfFlag, __bSetInCheckAlignment);
      
  
    }
    {
      $`FDCAN2::dbNode::`SGW::`TELEMATIC_FD_5::`CameraDisplaySts2.phys = 0;
      snprintf(__cArray, 8192, "%s", "CameraDisplaySts2");
      snprintf(__cArray2, 8192, "%s '%s'", __cCANSignal, __cArray);
      snprintf(__cArray3, 8192, "%s", "Default");
      
      ReportSetLValueOrSignalNotOnline(getSignalTime(`FDCAN2::dbNode::`SGW::`TELEMATIC_FD_5::`CameraDisplaySts2), __cArray2, __cArray4, 8192);
      ReportTableRow(__tableHandle, 0, __cArray4, __cAOp, 0, __cArray3, __oneOfFlag, __bSetInCheckAlignment);
      
  
    }
    ReportTableEndTestStep(__tableHandle, "1");
  }
  TestCommandEnd();


  TestCommandBegin(__eWait, __cWait, "", "1");
  {
    Wait("1", (1000 * 1000000LL), 1000000, "");
  }
  TestCommandEnd();

  TestCommandBegin(__eCheck, __cCheck, "", "2");
  {
    __bVerdict = __eVerdictPass;
    __tableHandle = ReportTableHead5Columns(__cCheckCaption, __cTSym, __cTOp, __cRefVal, __cActual, __cRes);
    {
      {
        int __res1,__res2;
        __res1 = CheckSignalMatch(`FDCAN2::dbNode::`SGW::`TELEMATIC_FD_14::`TGW_CAMERA_DISP_STAT, 0, __cGreaterEqualThan) == 1;
        __res2 = CheckSignalMatch(`FDCAN2::dbNode::`SGW::`TELEMATIC_FD_14::`TGW_CAMERA_DISP_STAT, 4, __cLessEqualThan) == 1;
        __csr = __res1 && __res2;
        snprintf(__cArray, 8192, "%s", "TGW_CAMERA_DISP_STAT");
        snprintf(__cArray2, 8192, "%s '%s'", __cCANSignal, __cArray);
        snprintf(__cArray3, 8192, "%s", "");
        snprintf(__cArray4, 8192, "%s", "");
        snprintf(__cArray5, 8192, "%s", __cArray3);
        snprintf(__cArray6, 8192, "%s", __cArray4);
        ReportRange(0, 4, __cArray5, __cArray6, __cArray7, 8192);
        ReportTableRow(__tableHandle, 0, __cArray2, __cRange, __cArray7, __cEmpty, __oneOfFlag, __bSetInCheckAlignment);
        ReportLValueOrSignalNotOnline(`FDCAN2::dbNode::`SGW::`TELEMATIC_FD_14::`TGW_CAMERA_DISP_STAT, __cArray8, 8192);
        ReportCell(__tableHandle, __cArray8);
        ReportCellResult(__tableHandle, __csr, __ePassFail);
      }
  
      __bVerdict = __bVerdict && __csr;
    }
    ReportTableEndVerdict(__tableHandle, "1", __bVerdict);
  }
  TestCommandEnd();


  TestCommandBegin(__eWait, __cWait, "", "3");
  {
    Wait("1", (3000 * 1000000LL), 1000000, "");
  }
  TestCommandEnd();

}

void Tt4h42sqi_Tet_Tc58()
{
  CreateTTEIFFunction("Tt4h42sqi_Tc58", __eTcDef, __eLocal);  
  AddIFParameterTestCaseAttribute("TC_ID", "");
  AddIFParameterTestCaseAttribute("Test Case ID", "");
  CallInterfaceFunction("Default View", __cEmpty , __cEmpty );
}
testcase Tt4h42sqi_Tc58()
{
  stack long __tableHandle;
  SetBreakOnFail(1);

  TestCommandBegin(__eSet, __cSet, "", "0");
  {
    __tableHandle = ReportTableHead3Columns(__cSetCaption , __cTSym, __cTOp, __cAssigned); 
    {
      $`FDCAN2::dbNode::`SGW::`TELEMATIC_FD_5::`CameraDisplaySts2.phys = 2;
      snprintf(__cArray, 8192, "%s", "CameraDisplaySts2");
      snprintf(__cArray2, 8192, "%s '%s'", __cCANSignal, __cArray);
      snprintf(__cArray3, 8192, "%s", "");
      
      ReportSetLValueOrSignalNotOnline(getSignalTime(`FDCAN2::dbNode::`SGW::`TELEMATIC_FD_5::`CameraDisplaySts2), __cArray2, __cArray4, 8192);
      ReportTableRow(__tableHandle, 0, __cArray4, __cAOp, 2, __cArray3, __oneOfFlag, __bSetInCheckAlignment);
      
  
    }
    ReportTableEndTestStep(__tableHandle, "1");
  }
  TestCommandEnd();


  TestCommandBegin(__eWait, __cWait, "", "1");
  {
    Wait("1", (1000 * 1000000LL), 1000000, "");
  }
  TestCommandEnd();

  TestCommandBegin(__eSet, __cSet, "", "2");
  {
    __tableHandle = ReportTableHead3Columns(__cSetCaption , __cTSym, __cTOp, __cAssigned); 
    {
      $`FDCAN2::dbNode::`SGW::`TELEMATIC_FD_5::`CameraDisplaySts2.phys = 0;
      snprintf(__cArray, 8192, "%s", "CameraDisplaySts2");
      snprintf(__cArray2, 8192, "%s '%s'", __cCANSignal, __cArray);
      snprintf(__cArray3, 8192, "%s", "");
      
      ReportSetLValueOrSignalNotOnline(getSignalTime(`FDCAN2::dbNode::`SGW::`TELEMATIC_FD_5::`CameraDisplaySts2), __cArray2, __cArray4, 8192);
      ReportTableRow(__tableHandle, 0, __cArray4, __cAOp, 0, __cArray3, __oneOfFlag, __bSetInCheckAlignment);
      
  
    }
    ReportTableEndTestStep(__tableHandle, "1");
  }
  TestCommandEnd();


  TestCommandBegin(__eWait, __cWait, "", "3");
  {
    Wait("1", (1000 * 1000000LL), 1000000, "");
  }
  TestCommandEnd();

  TestCommandBegin(__eCheck, __cCheck, "", "4");
  {
    __bVerdict = __eVerdictPass;
    __tableHandle = ReportTableHead5Columns(__cCheckCaption, __cTSym, __cTOp, __cRefVal, __cActual, __cRes);
    {
      {
        int __res1,__res2;
        __res1 = CheckSignalMatch(`FDCAN2::dbNode::`CVADAS::`CVPAM_FD_Info::`DisplayView2, 1, __cGreaterEqualThan) == 1;
        __res2 = CheckSignalMatch(`FDCAN2::dbNode::`CVADAS::`CVPAM_FD_Info::`DisplayView2, 15, __cLessEqualThan) == 1;
        __csr = __res1 && __res2;
        snprintf(__cArray, 8192, "%s", "DisplayView2");
        snprintf(__cArray2, 8192, "%s '%s'", __cCANSignal, __cArray);
        snprintf(__cArray3, 8192, "%s", "");
        snprintf(__cArray4, 8192, "%s", "");
        snprintf(__cArray5, 8192, "%s", __cArray3);
        snprintf(__cArray6, 8192, "%s", __cArray4);
        ReportRange(1, 15, __cArray5, __cArray6, __cArray7, 8192);
        ReportTableRow(__tableHandle, 0, __cArray2, __cRange, __cArray7, __cEmpty, __oneOfFlag, __bSetInCheckAlignment);
        ReportLValueOrSignalNotOnline(`FDCAN2::dbNode::`CVADAS::`CVPAM_FD_Info::`DisplayView2, __cArray8, 8192);
        ReportCell(__tableHandle, __cArray8);
        ReportCellResult(__tableHandle, __csr, __ePassFail);
      }
  
      __bVerdict = __bVerdict && __csr;
    }
    ReportTableEndVerdict(__tableHandle, "1", __bVerdict);
  }
  TestCommandEnd();


}

void Tt4h42sqi_Tet_Tc59()
{
  CreateTTEIFFunction("Tt4h42sqi_Tc59", __eTcDef, __eLocal);  
  AddIFParameterTestCaseAttribute("TC_ID", "");
  AddIFParameterTestCaseAttribute("Test Case ID", "");
  CallInterfaceFunction("View 1: FVTV_RVTV", __cEmpty , __cEmpty );
}
testcase Tt4h42sqi_Tc59()
{
  stack long __tableHandle;
  SetBreakOnFail(1);

  TestCommandBegin(__eSet, __cSet, "", "0");
  {
    __tableHandle = ReportTableHead3Columns(__cSetCaption , __cTSym, __cTOp, __cAssigned); 
    {
      $`FDCAN2::dbNode::`SGW::`TELEMATIC_FD_5::`CameraDisplaySts2.phys = 1;
      snprintf(__cArray, 8192, "%s", "CameraDisplaySts2");
      snprintf(__cArray2, 8192, "%s '%s'", __cCANSignal, __cArray);
      snprintf(__cArray3, 8192, "%s", "");
      
      ReportSetLValueOrSignalNotOnline(getSignalTime(`FDCAN2::dbNode::`SGW::`TELEMATIC_FD_5::`CameraDisplaySts2), __cArray2, __cArray4, 8192);
      ReportTableRow(__tableHandle, 0, __cArray4, __cAOp, 1, __cArray3, __oneOfFlag, __bSetInCheckAlignment);
      
  
    }
    ReportTableEndTestStep(__tableHandle, "1");
  }
  TestCommandEnd();


  TestCommandBegin(__eWait, __cWait, "", "1");
  {
    Wait("1", (1000 * 1000000LL), 1000000, "");
  }
  TestCommandEnd();

  TestCommandBegin(__eCheck, __cCheck, "", "2");
  {
    __bVerdict = __eVerdictPass;
    __tableHandle = ReportTableHead5Columns(__cCheckCaption, __cTSym, __cTOp, __cRefVal, __cActual, __cRes);
    {
      {
        int __res1,__res2;
        __res1 = CheckSignalMatch(`FDCAN2::dbNode::`CVADAS::`CVPAM_FD_Info::`DisplayView2, 1, __cGreaterEqualThan) == 1;
        __res2 = CheckSignalMatch(`FDCAN2::dbNode::`CVADAS::`CVPAM_FD_Info::`DisplayView2, 15, __cLessEqualThan) == 1;
        __csr = __res1 && __res2;
        snprintf(__cArray, 8192, "%s", "DisplayView2");
        snprintf(__cArray2, 8192, "%s '%s'", __cCANSignal, __cArray);
        snprintf(__cArray3, 8192, "%s", "");
        snprintf(__cArray4, 8192, "%s", "");
        snprintf(__cArray5, 8192, "%s", __cArray3);
        snprintf(__cArray6, 8192, "%s", __cArray4);
        ReportRange(1, 15, __cArray5, __cArray6, __cArray7, 8192);
        ReportTableRow(__tableHandle, 0, __cArray2, __cRange, __cArray7, __cEmpty, __oneOfFlag, __bSetInCheckAlignment);
        ReportLValueOrSignalNotOnline(`FDCAN2::dbNode::`CVADAS::`CVPAM_FD_Info::`DisplayView2, __cArray8, 8192);
        ReportCell(__tableHandle, __cArray8);
        ReportCellResult(__tableHandle, __csr, __ePassFail);
      }
  
      __bVerdict = __bVerdict && __csr;
    }
    ReportTableEndVerdict(__tableHandle, "1", __bVerdict);
  }
  TestCommandEnd();


}

void Tt4h42sqi_Tet_Tc60()
{
  CreateTTEIFFunction("Tt4h42sqi_Tc60", __eTcDef, __eLocal);  
  AddIFParameterTestCaseAttribute("TC_ID", "");
  AddIFParameterTestCaseAttribute("Test Case ID", "");
  CallInterfaceFunction("View 2: BackupRearView", __cEmpty , __cEmpty );
}
testcase Tt4h42sqi_Tc60()
{
  stack long __tableHandle;
  SetBreakOnFail(1);

  TestCommandBegin(__eSet, __cSet, "", "0");
  {
    __tableHandle = ReportTableHead3Columns(__cSetCaption , __cTSym, __cTOp, __cAssigned); 
    {
      $`FDCAN2::dbNode::`SGW::`TELEMATIC_FD_5::`CameraDisplaySts2.phys = 2;
      snprintf(__cArray, 8192, "%s", "CameraDisplaySts2");
      snprintf(__cArray2, 8192, "%s '%s'", __cCANSignal, __cArray);
      snprintf(__cArray3, 8192, "%s", "");
      
      ReportSetLValueOrSignalNotOnline(getSignalTime(`FDCAN2::dbNode::`SGW::`TELEMATIC_FD_5::`CameraDisplaySts2), __cArray2, __cArray4, 8192);
      ReportTableRow(__tableHandle, 0, __cArray4, __cAOp, 2, __cArray3, __oneOfFlag, __bSetInCheckAlignment);
      
  
    }
    ReportTableEndTestStep(__tableHandle, "1");
  }
  TestCommandEnd();


  TestCommandBegin(__eWait, __cWait, "", "1");
  {
    Wait("1", (1000 * 1000000LL), 1000000, "");
  }
  TestCommandEnd();

  TestCommandBegin(__eCheck, __cCheck, "", "2");
  {
    __bVerdict = __eVerdictPass;
    __tableHandle = ReportTableHead5Columns(__cCheckCaption, __cTSym, __cTOp, __cRefVal, __cActual, __cRes);
    {
      {
        int __res1,__res2;
        __res1 = CheckSignalMatch(`FDCAN2::dbNode::`CVADAS::`CVPAM_FD_Info::`DisplayView2, 1, __cGreaterEqualThan) == 1;
        __res2 = CheckSignalMatch(`FDCAN2::dbNode::`CVADAS::`CVPAM_FD_Info::`DisplayView2, 15, __cLessEqualThan) == 1;
        __csr = __res1 && __res2;
        snprintf(__cArray, 8192, "%s", "DisplayView2");
        snprintf(__cArray2, 8192, "%s '%s'", __cCANSignal, __cArray);
        snprintf(__cArray3, 8192, "%s", "");
        snprintf(__cArray4, 8192, "%s", "");
        snprintf(__cArray5, 8192, "%s", __cArray3);
        snprintf(__cArray6, 8192, "%s", __cArray4);
        ReportRange(1, 15, __cArray5, __cArray6, __cArray7, 8192);
        ReportTableRow(__tableHandle, 0, __cArray2, __cRange, __cArray7, __cEmpty, __oneOfFlag, __bSetInCheckAlignment);
        ReportLValueOrSignalNotOnline(`FDCAN2::dbNode::`CVADAS::`CVPAM_FD_Info::`DisplayView2, __cArray8, 8192);
        ReportCell(__tableHandle, __cArray8);
        ReportCellResult(__tableHandle, __csr, __ePassFail);
      }
  
      __bVerdict = __bVerdict && __csr;
    }
    ReportTableEndVerdict(__tableHandle, "1", __bVerdict);
  }
  TestCommandEnd();


}

void Tt4h42sqi_Tet_Tc61()
{
  CreateTTEIFFunction("Tt4h42sqi_Tc61", __eTcDef, __eLocal);  
  AddIFParameterTestCaseAttribute("TC_ID", "");
  AddIFParameterTestCaseAttribute("Test Case ID", "");
  CallInterfaceFunction("View 3: Forward Facing Camera", __cEmpty , __cEmpty );
}
testcase Tt4h42sqi_Tc61()
{
  stack long __tableHandle;
  SetBreakOnFail(1);

  TestCommandBegin(__eSet, __cSet, "", "0");
  {
    __tableHandle = ReportTableHead3Columns(__cSetCaption , __cTSym, __cTOp, __cAssigned); 
    {
      $`FDCAN2::dbNode::`SGW::`TELEMATIC_FD_5::`CameraDisplaySts2.phys = 3;
      snprintf(__cArray, 8192, "%s", "CameraDisplaySts2");
      snprintf(__cArray2, 8192, "%s '%s'", __cCANSignal, __cArray);
      snprintf(__cArray3, 8192, "%s", "");
      
      ReportSetLValueOrSignalNotOnline(getSignalTime(`FDCAN2::dbNode::`SGW::`TELEMATIC_FD_5::`CameraDisplaySts2), __cArray2, __cArray4, 8192);
      ReportTableRow(__tableHandle, 0, __cArray4, __cAOp, 3, __cArray3, __oneOfFlag, __bSetInCheckAlignment);
      
  
    }
    ReportTableEndTestStep(__tableHandle, "1");
  }
  TestCommandEnd();


  TestCommandBegin(__eWait, __cWait, "", "1");
  {
    Wait("1", (1000 * 1000000LL), 1000000, "");
  }
  TestCommandEnd();

  TestCommandBegin(__eCheck, __cCheck, "", "2");
  {
    __bVerdict = __eVerdictPass;
    __tableHandle = ReportTableHead5Columns(__cCheckCaption, __cTSym, __cTOp, __cRefVal, __cActual, __cRes);
    {
      {
        int __res1,__res2;
        __res1 = CheckSignalMatch(`FDCAN2::dbNode::`CVADAS::`CVPAM_FD_Info::`DisplayView2, 1, __cGreaterEqualThan) == 1;
        __res2 = CheckSignalMatch(`FDCAN2::dbNode::`CVADAS::`CVPAM_FD_Info::`DisplayView2, 15, __cLessEqualThan) == 1;
        __csr = __res1 && __res2;
        snprintf(__cArray, 8192, "%s", "DisplayView2");
        snprintf(__cArray2, 8192, "%s '%s'", __cCANSignal, __cArray);
        snprintf(__cArray3, 8192, "%s", "");
        snprintf(__cArray4, 8192, "%s", "");
        snprintf(__cArray5, 8192, "%s", __cArray3);
        snprintf(__cArray6, 8192, "%s", __cArray4);
        ReportRange(1, 15, __cArray5, __cArray6, __cArray7, 8192);
        ReportTableRow(__tableHandle, 0, __cArray2, __cRange, __cArray7, __cEmpty, __oneOfFlag, __bSetInCheckAlignment);
        ReportLValueOrSignalNotOnline(`FDCAN2::dbNode::`CVADAS::`CVPAM_FD_Info::`DisplayView2, __cArray8, 8192);
        ReportCell(__tableHandle, __cArray8);
        ReportCellResult(__tableHandle, __csr, __ePassFail);
      }
  
      __bVerdict = __bVerdict && __csr;
    }
    ReportTableEndVerdict(__tableHandle, "1", __bVerdict);
  }
  TestCommandEnd();


}

void Tt4h42sqi_Tet_Tc62()
{
  CreateTTEIFFunction("Tt4h42sqi_Tc62", __eTcDef, __eLocal);  
  AddIFParameterTestCaseAttribute("TC_ID", "");
  AddIFParameterTestCaseAttribute("Test Case ID", "");
  CallInterfaceFunction("View 5: Trailer Reverse Guidance", __cEmpty , __cEmpty );
}
testcase Tt4h42sqi_Tc62()
{
  stack long __tableHandle;
  SetBreakOnFail(1);

  TestCommandBegin(__eSet, __cSet, "", "0");
  {
    __tableHandle = ReportTableHead3Columns(__cSetCaption , __cTSym, __cTOp, __cAssigned); 
    {
      $`FDCAN2::dbNode::`SGW::`TELEMATIC_FD_5::`CameraDisplaySts2.phys = 5;
      snprintf(__cArray, 8192, "%s", "CameraDisplaySts2");
      snprintf(__cArray2, 8192, "%s '%s'", __cCANSignal, __cArray);
      snprintf(__cArray3, 8192, "%s", "");
      
      ReportSetLValueOrSignalNotOnline(getSignalTime(`FDCAN2::dbNode::`SGW::`TELEMATIC_FD_5::`CameraDisplaySts2), __cArray2, __cArray4, 8192);
      ReportTableRow(__tableHandle, 0, __cArray4, __cAOp, 5, __cArray3, __oneOfFlag, __bSetInCheckAlignment);
      
  
    }
    ReportTableEndTestStep(__tableHandle, "1");
  }
  TestCommandEnd();


  TestCommandBegin(__eWait, __cWait, "", "1");
  {
    Wait("1", (1000 * 1000000LL), 1000000, "");
  }
  TestCommandEnd();

  TestCommandBegin(__eCheck, __cCheck, "", "2");
  {
    __bVerdict = __eVerdictPass;
    __tableHandle = ReportTableHead5Columns(__cCheckCaption, __cTSym, __cTOp, __cRefVal, __cActual, __cRes);
    {
      {
        int __res1,__res2;
        __res1 = CheckSignalMatch(`FDCAN2::dbNode::`CVADAS::`CVPAM_FD_Info::`DisplayView2, 1, __cGreaterEqualThan) == 1;
        __res2 = CheckSignalMatch(`FDCAN2::dbNode::`CVADAS::`CVPAM_FD_Info::`DisplayView2, 15, __cLessEqualThan) == 1;
        __csr = __res1 && __res2;
        snprintf(__cArray, 8192, "%s", "DisplayView2");
        snprintf(__cArray2, 8192, "%s '%s'", __cCANSignal, __cArray);
        snprintf(__cArray3, 8192, "%s", "");
        snprintf(__cArray4, 8192, "%s", "");
        snprintf(__cArray5, 8192, "%s", __cArray3);
        snprintf(__cArray6, 8192, "%s", __cArray4);
        ReportRange(1, 15, __cArray5, __cArray6, __cArray7, 8192);
        ReportTableRow(__tableHandle, 0, __cArray2, __cRange, __cArray7, __cEmpty, __oneOfFlag, __bSetInCheckAlignment);
        ReportLValueOrSignalNotOnline(`FDCAN2::dbNode::`CVADAS::`CVPAM_FD_Info::`DisplayView2, __cArray8, 8192);
        ReportCell(__tableHandle, __cArray8);
        ReportCellResult(__tableHandle, __csr, __ePassFail);
      }
  
      __bVerdict = __bVerdict && __csr;
    }
    ReportTableEndVerdict(__tableHandle, "1", __bVerdict);
  }
  TestCommandEnd();


}

void Tt4h42sqi_Tet_Tc63()
{
  CreateTTEIFFunction("Tt4h42sqi_Tc63", __eTcDef, __eLocal);  
  AddIFParameterTestCaseAttribute("TC_ID", "");
  AddIFParameterTestCaseAttribute("Test Case ID", "");
  CallInterfaceFunction("View 6: Trailer Left View", __cEmpty , __cEmpty );
}
testcase Tt4h42sqi_Tc63()
{
  stack long __tableHandle;
  SetBreakOnFail(1);

  TestCommandBegin(__eSet, __cSet, "", "0");
  {
    __tableHandle = ReportTableHead3Columns(__cSetCaption , __cTSym, __cTOp, __cAssigned); 
    {
      $`FDCAN2::dbNode::`SGW::`TELEMATIC_FD_5::`CameraDisplaySts2.phys = 6;
      snprintf(__cArray, 8192, "%s", "CameraDisplaySts2");
      snprintf(__cArray2, 8192, "%s '%s'", __cCANSignal, __cArray);
      snprintf(__cArray3, 8192, "%s", "");
      
      ReportSetLValueOrSignalNotOnline(getSignalTime(`FDCAN2::dbNode::`SGW::`TELEMATIC_FD_5::`CameraDisplaySts2), __cArray2, __cArray4, 8192);
      ReportTableRow(__tableHandle, 0, __cArray4, __cAOp, 6, __cArray3, __oneOfFlag, __bSetInCheckAlignment);
      
  
    }
    ReportTableEndTestStep(__tableHandle, "1");
  }
  TestCommandEnd();


  TestCommandBegin(__eWait, __cWait, "", "1");
  {
    Wait("1", (1000 * 1000000LL), 1000000, "");
  }
  TestCommandEnd();

  TestCommandBegin(__eCheck, __cCheck, "", "2");
  {
    __bVerdict = __eVerdictPass;
    __tableHandle = ReportTableHead5Columns(__cCheckCaption, __cTSym, __cTOp, __cRefVal, __cActual, __cRes);
    {
      {
        int __res1,__res2;
        __res1 = CheckSignalMatch(`FDCAN2::dbNode::`CVADAS::`CVPAM_FD_Info::`DisplayView2, 1, __cGreaterEqualThan) == 1;
        __res2 = CheckSignalMatch(`FDCAN2::dbNode::`CVADAS::`CVPAM_FD_Info::`DisplayView2, 15, __cLessEqualThan) == 1;
        __csr = __res1 && __res2;
        snprintf(__cArray, 8192, "%s", "DisplayView2");
        snprintf(__cArray2, 8192, "%s '%s'", __cCANSignal, __cArray);
        snprintf(__cArray3, 8192, "%s", "");
        snprintf(__cArray4, 8192, "%s", "");
        snprintf(__cArray5, 8192, "%s", __cArray3);
        snprintf(__cArray6, 8192, "%s", __cArray4);
        ReportRange(1, 15, __cArray5, __cArray6, __cArray7, 8192);
        ReportTableRow(__tableHandle, 0, __cArray2, __cRange, __cArray7, __cEmpty, __oneOfFlag, __bSetInCheckAlignment);
        ReportLValueOrSignalNotOnline(`FDCAN2::dbNode::`CVADAS::`CVPAM_FD_Info::`DisplayView2, __cArray8, 8192);
        ReportCell(__tableHandle, __cArray8);
        ReportCellResult(__tableHandle, __csr, __ePassFail);
      }
  
      __bVerdict = __bVerdict && __csr;
    }
    ReportTableEndVerdict(__tableHandle, "1", __bVerdict);
  }
  TestCommandEnd();


}

void Tt4h42sqi_Tet_Tc64()
{
  CreateTTEIFFunction("Tt4h42sqi_Tc64", __eTcDef, __eLocal);  
  AddIFParameterTestCaseAttribute("TC_ID", "");
  AddIFParameterTestCaseAttribute("Test Case ID", "");
  CallInterfaceFunction("View 7: Trailer Right View", __cEmpty , __cEmpty );
}
testcase Tt4h42sqi_Tc64()
{
  stack long __tableHandle;
  SetBreakOnFail(1);

  TestCommandBegin(__eSet, __cSet, "", "0");
  {
    __tableHandle = ReportTableHead3Columns(__cSetCaption , __cTSym, __cTOp, __cAssigned); 
    {
      $`FDCAN2::dbNode::`SGW::`TELEMATIC_FD_5::`CameraDisplaySts2.phys = 7;
      snprintf(__cArray, 8192, "%s", "CameraDisplaySts2");
      snprintf(__cArray2, 8192, "%s '%s'", __cCANSignal, __cArray);
      snprintf(__cArray3, 8192, "%s", "");
      
      ReportSetLValueOrSignalNotOnline(getSignalTime(`FDCAN2::dbNode::`SGW::`TELEMATIC_FD_5::`CameraDisplaySts2), __cArray2, __cArray4, 8192);
      ReportTableRow(__tableHandle, 0, __cArray4, __cAOp, 7, __cArray3, __oneOfFlag, __bSetInCheckAlignment);
      
  
    }
    ReportTableEndTestStep(__tableHandle, "1");
  }
  TestCommandEnd();


  TestCommandBegin(__eWait, __cWait, "", "1");
  {
    Wait("1", (1000 * 1000000LL), 1000000, "");
  }
  TestCommandEnd();

  TestCommandBegin(__eCheck, __cCheck, "", "2");
  {
    __bVerdict = __eVerdictPass;
    __tableHandle = ReportTableHead5Columns(__cCheckCaption, __cTSym, __cTOp, __cRefVal, __cActual, __cRes);
    {
      {
        int __res1,__res2;
        __res1 = CheckSignalMatch(`FDCAN2::dbNode::`CVADAS::`CVPAM_FD_Info::`DisplayView2, 1, __cGreaterEqualThan) == 1;
        __res2 = CheckSignalMatch(`FDCAN2::dbNode::`CVADAS::`CVPAM_FD_Info::`DisplayView2, 15, __cLessEqualThan) == 1;
        __csr = __res1 && __res2;
        snprintf(__cArray, 8192, "%s", "DisplayView2");
        snprintf(__cArray2, 8192, "%s '%s'", __cCANSignal, __cArray);
        snprintf(__cArray3, 8192, "%s", "");
        snprintf(__cArray4, 8192, "%s", "");
        snprintf(__cArray5, 8192, "%s", __cArray3);
        snprintf(__cArray6, 8192, "%s", __cArray4);
        ReportRange(1, 15, __cArray5, __cArray6, __cArray7, 8192);
        ReportTableRow(__tableHandle, 0, __cArray2, __cRange, __cArray7, __cEmpty, __oneOfFlag, __bSetInCheckAlignment);
        ReportLValueOrSignalNotOnline(`FDCAN2::dbNode::`CVADAS::`CVPAM_FD_Info::`DisplayView2, __cArray8, 8192);
        ReportCell(__tableHandle, __cArray8);
        ReportCellResult(__tableHandle, __csr, __ePassFail);
      }
  
      __bVerdict = __bVerdict && __csr;
    }
    ReportTableEndVerdict(__tableHandle, "1", __bVerdict);
  }
  TestCommandEnd();


}

void Tt4h42sqi_Tet_Tc65()
{
  CreateTTEIFFunction("Tt4h42sqi_Tc65", __eTcDef, __eLocal);  
  AddIFParameterTestCaseAttribute("TC_ID", "");
  AddIFParameterTestCaseAttribute("Test Case ID", "");
  CallInterfaceFunction("View 8: Blind Spot Left View", __cEmpty , __cEmpty );
}
testcase Tt4h42sqi_Tc65()
{
  stack long __tableHandle;
  SetBreakOnFail(1);

  TestCommandBegin(__eSet, __cSet, "", "0");
  {
    __tableHandle = ReportTableHead3Columns(__cSetCaption , __cTSym, __cTOp, __cAssigned); 
    {
      $`FDCAN2::dbNode::`SGW::`TELEMATIC_FD_5::`CameraDisplaySts2.phys = 8;
      snprintf(__cArray, 8192, "%s", "CameraDisplaySts2");
      snprintf(__cArray2, 8192, "%s '%s'", __cCANSignal, __cArray);
      snprintf(__cArray3, 8192, "%s", "");
      
      ReportSetLValueOrSignalNotOnline(getSignalTime(`FDCAN2::dbNode::`SGW::`TELEMATIC_FD_5::`CameraDisplaySts2), __cArray2, __cArray4, 8192);
      ReportTableRow(__tableHandle, 0, __cArray4, __cAOp, 8, __cArray3, __oneOfFlag, __bSetInCheckAlignment);
      
  
    }
    ReportTableEndTestStep(__tableHandle, "1");
  }
  TestCommandEnd();


  TestCommandBegin(__eWait, __cWait, "", "1");
  {
    Wait("1", (1000 * 1000000LL), 1000000, "");
  }
  TestCommandEnd();

  TestCommandBegin(__eCheck, __cCheck, "", "2");
  {
    __bVerdict = __eVerdictPass;
    __tableHandle = ReportTableHead5Columns(__cCheckCaption, __cTSym, __cTOp, __cRefVal, __cActual, __cRes);
    {
      {
        int __res1,__res2;
        __res1 = CheckSignalMatch(`FDCAN2::dbNode::`CVADAS::`CVPAM_FD_Info::`DisplayView2, 2, __cGreaterEqualThan) == 1;
        __res2 = CheckSignalMatch(`FDCAN2::dbNode::`CVADAS::`CVPAM_FD_Info::`DisplayView2, 10, __cLessEqualThan) == 1;
        __csr = __res1 && __res2;
        snprintf(__cArray, 8192, "%s", "DisplayView2");
        snprintf(__cArray2, 8192, "%s '%s'", __cCANSignal, __cArray);
        snprintf(__cArray3, 8192, "%s", "");
        snprintf(__cArray4, 8192, "%s", "");
        snprintf(__cArray5, 8192, "%s", __cArray3);
        snprintf(__cArray6, 8192, "%s", __cArray4);
        ReportRange(2, 10, __cArray5, __cArray6, __cArray7, 8192);
        ReportTableRow(__tableHandle, 0, __cArray2, __cRange, __cArray7, __cEmpty, __oneOfFlag, __bSetInCheckAlignment);
        ReportLValueOrSignalNotOnline(`FDCAN2::dbNode::`CVADAS::`CVPAM_FD_Info::`DisplayView2, __cArray8, 8192);
        ReportCell(__tableHandle, __cArray8);
        ReportCellResult(__tableHandle, __csr, __ePassFail);
      }
  
      __bVerdict = __bVerdict && __csr;
    }
    ReportTableEndVerdict(__tableHandle, "1", __bVerdict);
  }
  TestCommandEnd();


}

void Tt4h42sqi_Tet_Tc66()
{
  CreateTTEIFFunction("Tt4h42sqi_Tc66", __eTcDef, __eLocal);  
  AddIFParameterTestCaseAttribute("TC_ID", "");
  AddIFParameterTestCaseAttribute("Test Case ID", "");
  CallInterfaceFunction("View 9: Blind Spot Right View", __cEmpty , __cEmpty );
}
testcase Tt4h42sqi_Tc66()
{
  stack long __tableHandle;
  SetBreakOnFail(1);

  TestCommandBegin(__eSet, __cSet, "", "0");
  {
    __tableHandle = ReportTableHead3Columns(__cSetCaption , __cTSym, __cTOp, __cAssigned); 
    {
      $`FDCAN2::dbNode::`SGW::`TELEMATIC_FD_5::`CameraDisplaySts2.phys = 9;
      snprintf(__cArray, 8192, "%s", "CameraDisplaySts2");
      snprintf(__cArray2, 8192, "%s '%s'", __cCANSignal, __cArray);
      snprintf(__cArray3, 8192, "%s", "");
      
      ReportSetLValueOrSignalNotOnline(getSignalTime(`FDCAN2::dbNode::`SGW::`TELEMATIC_FD_5::`CameraDisplaySts2), __cArray2, __cArray4, 8192);
      ReportTableRow(__tableHandle, 0, __cArray4, __cAOp, 9, __cArray3, __oneOfFlag, __bSetInCheckAlignment);
      
  
    }
    ReportTableEndTestStep(__tableHandle, "1");
  }
  TestCommandEnd();


  TestCommandBegin(__eWait, __cWait, "", "1");
  {
    Wait("1", (1000 * 1000000LL), 1000000, "");
  }
  TestCommandEnd();

  TestCommandBegin(__eCheck, __cCheck, "", "2");
  {
    __bVerdict = __eVerdictPass;
    __tableHandle = ReportTableHead5Columns(__cCheckCaption, __cTSym, __cTOp, __cRefVal, __cActual, __cRes);
    {
      {
        int __res1,__res2;
        __res1 = CheckSignalMatch(`FDCAN2::dbNode::`CVADAS::`CVPAM_FD_Info::`DisplayView2, 2, __cGreaterEqualThan) == 1;
        __res2 = CheckSignalMatch(`FDCAN2::dbNode::`CVADAS::`CVPAM_FD_Info::`DisplayView2, 15, __cLessEqualThan) == 1;
        __csr = __res1 && __res2;
        snprintf(__cArray, 8192, "%s", "DisplayView2");
        snprintf(__cArray2, 8192, "%s '%s'", __cCANSignal, __cArray);
        snprintf(__cArray3, 8192, "%s", "");
        snprintf(__cArray4, 8192, "%s", "");
        snprintf(__cArray5, 8192, "%s", __cArray3);
        snprintf(__cArray6, 8192, "%s", __cArray4);
        ReportRange(2, 15, __cArray5, __cArray6, __cArray7, 8192);
        ReportTableRow(__tableHandle, 0, __cArray2, __cRange, __cArray7, __cEmpty, __oneOfFlag, __bSetInCheckAlignment);
        ReportLValueOrSignalNotOnline(`FDCAN2::dbNode::`CVADAS::`CVPAM_FD_Info::`DisplayView2, __cArray8, 8192);
        ReportCell(__tableHandle, __cArray8);
        ReportCellResult(__tableHandle, __csr, __ePassFail);
      }
  
      __bVerdict = __bVerdict && __csr;
    }
    ReportTableEndVerdict(__tableHandle, "1", __bVerdict);
  }
  TestCommandEnd();


}

void Tt4h42sqi_Tet_Tc67()
{
  CreateTTEIFFunction("Tt4h42sqi_Tc67", __eTcDef, __eLocal);  
  AddIFParameterTestCaseAttribute("TC_ID", "");
  AddIFParameterTestCaseAttribute("Test Case ID", "");
  CallInterfaceFunction("View 11: FVTV", __cEmpty , __cEmpty );
}
testcase Tt4h42sqi_Tc67()
{
  stack long __tableHandle;
  SetBreakOnFail(1);

  TestCommandBegin(__eSet, __cSet, "", "0");
  {
    __tableHandle = ReportTableHead3Columns(__cSetCaption , __cTSym, __cTOp, __cAssigned); 
    {
      $`FDCAN2::dbNode::`SGW::`TELEMATIC_FD_5::`CameraDisplaySts2.phys = 11;
      snprintf(__cArray, 8192, "%s", "CameraDisplaySts2");
      snprintf(__cArray2, 8192, "%s '%s'", __cCANSignal, __cArray);
      snprintf(__cArray3, 8192, "%s", "");
      
      ReportSetLValueOrSignalNotOnline(getSignalTime(`FDCAN2::dbNode::`SGW::`TELEMATIC_FD_5::`CameraDisplaySts2), __cArray2, __cArray4, 8192);
      ReportTableRow(__tableHandle, 0, __cArray4, __cAOp, 11, __cArray3, __oneOfFlag, __bSetInCheckAlignment);
      
  
    }
    ReportTableEndTestStep(__tableHandle, "1");
  }
  TestCommandEnd();


  TestCommandBegin(__eWait, __cWait, "", "1");
  {
    Wait("1", (1000 * 1000000LL), 1000000, "");
  }
  TestCommandEnd();

  TestCommandBegin(__eCheck, __cCheck, "", "2");
  {
    __bVerdict = __eVerdictPass;
    __tableHandle = ReportTableHead5Columns(__cCheckCaption, __cTSym, __cTOp, __cRefVal, __cActual, __cRes);
    {
      {
        int __res1,__res2;
        __res1 = CheckSignalMatch(`FDCAN2::dbNode::`CVADAS::`CVPAM_FD_Info::`DisplayView2, 1, __cGreaterEqualThan) == 1;
        __res2 = CheckSignalMatch(`FDCAN2::dbNode::`CVADAS::`CVPAM_FD_Info::`DisplayView2, 15, __cLessEqualThan) == 1;
        __csr = __res1 && __res2;
        snprintf(__cArray, 8192, "%s", "DisplayView2");
        snprintf(__cArray2, 8192, "%s '%s'", __cCANSignal, __cArray);
        snprintf(__cArray3, 8192, "%s", "");
        snprintf(__cArray4, 8192, "%s", "");
        snprintf(__cArray5, 8192, "%s", __cArray3);
        snprintf(__cArray6, 8192, "%s", __cArray4);
        ReportRange(1, 15, __cArray5, __cArray6, __cArray7, 8192);
        ReportTableRow(__tableHandle, 0, __cArray2, __cRange, __cArray7, __cEmpty, __oneOfFlag, __bSetInCheckAlignment);
        ReportLValueOrSignalNotOnline(`FDCAN2::dbNode::`CVADAS::`CVPAM_FD_Info::`DisplayView2, __cArray8, 8192);
        ReportCell(__tableHandle, __cArray8);
        ReportCellResult(__tableHandle, __csr, __ePassFail);
      }
  
      __bVerdict = __bVerdict && __csr;
    }
    ReportTableEndVerdict(__tableHandle, "1", __bVerdict);
  }
  TestCommandEnd();


}

void Tt4h42sqi_Tet_Tc68()
{
  CreateTTEIFFunction("Tt4h42sqi_Tc68", __eTcDef, __eLocal);  
  AddIFParameterTestCaseAttribute("TC_ID", "");
  AddIFParameterTestCaseAttribute("Test Case ID", "");
  CallInterfaceFunction("View 12: RVTV", __cEmpty , __cEmpty );
}
testcase Tt4h42sqi_Tc68()
{
  stack long __tableHandle;
  SetBreakOnFail(1);

  TestCommandBegin(__eSet, __cSet, "", "0");
  {
    __tableHandle = ReportTableHead3Columns(__cSetCaption , __cTSym, __cTOp, __cAssigned); 
    {
      $`FDCAN2::dbNode::`SGW::`TELEMATIC_FD_5::`CameraDisplaySts2.phys = 12;
      snprintf(__cArray, 8192, "%s", "CameraDisplaySts2");
      snprintf(__cArray2, 8192, "%s '%s'", __cCANSignal, __cArray);
      snprintf(__cArray3, 8192, "%s", "");
      
      ReportSetLValueOrSignalNotOnline(getSignalTime(`FDCAN2::dbNode::`SGW::`TELEMATIC_FD_5::`CameraDisplaySts2), __cArray2, __cArray4, 8192);
      ReportTableRow(__tableHandle, 0, __cArray4, __cAOp, 12, __cArray3, __oneOfFlag, __bSetInCheckAlignment);
      
  
    }
    ReportTableEndTestStep(__tableHandle, "1");
  }
  TestCommandEnd();


  TestCommandBegin(__eWait, __cWait, "", "1");
  {
    Wait("1", (1000 * 1000000LL), 1000000, "");
  }
  TestCommandEnd();

  TestCommandBegin(__eCheck, __cCheck, "", "2");
  {
    __bVerdict = __eVerdictPass;
    __tableHandle = ReportTableHead5Columns(__cCheckCaption, __cTSym, __cTOp, __cRefVal, __cActual, __cRes);
    {
      {
        int __res1,__res2;
        __res1 = CheckSignalMatch(`FDCAN2::dbNode::`CVADAS::`CVPAM_FD_Info::`DisplayView2, 1, __cGreaterEqualThan) == 1;
        __res2 = CheckSignalMatch(`FDCAN2::dbNode::`CVADAS::`CVPAM_FD_Info::`DisplayView2, 15, __cLessEqualThan) == 1;
        __csr = __res1 && __res2;
        snprintf(__cArray, 8192, "%s", "DisplayView2");
        snprintf(__cArray2, 8192, "%s '%s'", __cCANSignal, __cArray);
        snprintf(__cArray3, 8192, "%s", "");
        snprintf(__cArray4, 8192, "%s", "");
        snprintf(__cArray5, 8192, "%s", __cArray3);
        snprintf(__cArray6, 8192, "%s", __cArray4);
        ReportRange(1, 15, __cArray5, __cArray6, __cArray7, 8192);
        ReportTableRow(__tableHandle, 0, __cArray2, __cRange, __cArray7, __cEmpty, __oneOfFlag, __bSetInCheckAlignment);
        ReportLValueOrSignalNotOnline(`FDCAN2::dbNode::`CVADAS::`CVPAM_FD_Info::`DisplayView2, __cArray8, 8192);
        ReportCell(__tableHandle, __cArray8);
        ReportCellResult(__tableHandle, __csr, __ePassFail);
      }
  
      __bVerdict = __bVerdict && __csr;
    }
    ReportTableEndVerdict(__tableHandle, "1", __bVerdict);
  }
  TestCommandEnd();


}

void Tt4h42sqi_Tet_Tc69()
{
  CreateTTEIFFunction("Tt4h42sqi_Tc69", __eTcDef, __eLocal);  
  AddIFParameterTestCaseAttribute("TC_ID", "");
  AddIFParameterTestCaseAttribute("Test Case ID", "");
  CallInterfaceFunction("View 13: FrontCrossPathView", __cEmpty , __cEmpty );
}
testcase Tt4h42sqi_Tc69()
{
  stack long __tableHandle;
  SetBreakOnFail(1);

  TestCommandBegin(__eSet, __cSet, "", "0");
  {
    __tableHandle = ReportTableHead3Columns(__cSetCaption , __cTSym, __cTOp, __cAssigned); 
    {
      $`FDCAN2::dbNode::`SGW::`TELEMATIC_FD_5::`CameraDisplaySts2.phys = 13;
      snprintf(__cArray, 8192, "%s", "CameraDisplaySts2");
      snprintf(__cArray2, 8192, "%s '%s'", __cCANSignal, __cArray);
      snprintf(__cArray3, 8192, "%s", "");
      
      ReportSetLValueOrSignalNotOnline(getSignalTime(`FDCAN2::dbNode::`SGW::`TELEMATIC_FD_5::`CameraDisplaySts2), __cArray2, __cArray4, 8192);
      ReportTableRow(__tableHandle, 0, __cArray4, __cAOp, 13, __cArray3, __oneOfFlag, __bSetInCheckAlignment);
      
  
    }
    ReportTableEndTestStep(__tableHandle, "1");
  }
  TestCommandEnd();


  TestCommandBegin(__eWait, __cWait, "", "1");
  {
    Wait("1", (1000 * 1000000LL), 1000000, "");
  }
  TestCommandEnd();

  TestCommandBegin(__eCheck, __cCheck, "", "2");
  {
    __bVerdict = __eVerdictPass;
    __tableHandle = ReportTableHead5Columns(__cCheckCaption, __cTSym, __cTOp, __cRefVal, __cActual, __cRes);
    {
      {
        int __res1,__res2;
        __res1 = CheckSignalMatch(`FDCAN2::dbNode::`CVADAS::`CVPAM_FD_Info::`DisplayView2, 1, __cGreaterEqualThan) == 1;
        __res2 = CheckSignalMatch(`FDCAN2::dbNode::`CVADAS::`CVPAM_FD_Info::`DisplayView2, 15, __cLessEqualThan) == 1;
        __csr = __res1 && __res2;
        snprintf(__cArray, 8192, "%s", "DisplayView2");
        snprintf(__cArray2, 8192, "%s '%s'", __cCANSignal, __cArray);
        snprintf(__cArray3, 8192, "%s", "");
        snprintf(__cArray4, 8192, "%s", "");
        snprintf(__cArray5, 8192, "%s", __cArray3);
        snprintf(__cArray6, 8192, "%s", __cArray4);
        ReportRange(1, 15, __cArray5, __cArray6, __cArray7, 8192);
        ReportTableRow(__tableHandle, 0, __cArray2, __cRange, __cArray7, __cEmpty, __oneOfFlag, __bSetInCheckAlignment);
        ReportLValueOrSignalNotOnline(`FDCAN2::dbNode::`CVADAS::`CVPAM_FD_Info::`DisplayView2, __cArray8, 8192);
        ReportCell(__tableHandle, __cArray8);
        ReportCellResult(__tableHandle, __csr, __ePassFail);
      }
  
      __bVerdict = __bVerdict && __csr;
    }
    ReportTableEndVerdict(__tableHandle, "1", __bVerdict);
  }
  TestCommandEnd();


}

void Tt4h42sqi_Tet_Tc70()
{
  CreateTTEIFFunction("Tt4h42sqi_Tc70", __eTcDef, __eLocal);  
  AddIFParameterTestCaseAttribute("TC_ID", "");
  AddIFParameterTestCaseAttribute("Test Case ID", "");
  CallInterfaceFunction("View 14: RearCrossPathView", __cEmpty , __cEmpty );
}
testcase Tt4h42sqi_Tc70()
{
  stack long __tableHandle;
  SetBreakOnFail(1);

  TestCommandBegin(__eSet, __cSet, "", "0");
  {
    __tableHandle = ReportTableHead3Columns(__cSetCaption , __cTSym, __cTOp, __cAssigned); 
    {
      $`FDCAN2::dbNode::`SGW::`TELEMATIC_FD_5::`CameraDisplaySts2.phys = 14;
      snprintf(__cArray, 8192, "%s", "CameraDisplaySts2");
      snprintf(__cArray2, 8192, "%s '%s'", __cCANSignal, __cArray);
      snprintf(__cArray3, 8192, "%s", "");
      
      ReportSetLValueOrSignalNotOnline(getSignalTime(`FDCAN2::dbNode::`SGW::`TELEMATIC_FD_5::`CameraDisplaySts2), __cArray2, __cArray4, 8192);
      ReportTableRow(__tableHandle, 0, __cArray4, __cAOp, 14, __cArray3, __oneOfFlag, __bSetInCheckAlignment);
      
  
    }
    ReportTableEndTestStep(__tableHandle, "1");
  }
  TestCommandEnd();


  TestCommandBegin(__eWait, __cWait, "", "1");
  {
    Wait("1", (1000 * 1000000LL), 1000000, "");
  }
  TestCommandEnd();

  TestCommandBegin(__eCheck, __cCheck, "", "2");
  {
    __bVerdict = __eVerdictPass;
    __tableHandle = ReportTableHead5Columns(__cCheckCaption, __cTSym, __cTOp, __cRefVal, __cActual, __cRes);
    {
      {
        int __res1,__res2;
        __res1 = CheckSignalMatch(`FDCAN2::dbNode::`CVADAS::`CVPAM_FD_Info::`DisplayView2, 1, __cGreaterEqualThan) == 1;
        __res2 = CheckSignalMatch(`FDCAN2::dbNode::`CVADAS::`CVPAM_FD_Info::`DisplayView2, 15, __cLessEqualThan) == 1;
        __csr = __res1 && __res2;
        snprintf(__cArray, 8192, "%s", "DisplayView2");
        snprintf(__cArray2, 8192, "%s '%s'", __cCANSignal, __cArray);
        snprintf(__cArray3, 8192, "%s", "");
        snprintf(__cArray4, 8192, "%s", "");
        snprintf(__cArray5, 8192, "%s", __cArray3);
        snprintf(__cArray6, 8192, "%s", __cArray4);
        ReportRange(1, 15, __cArray5, __cArray6, __cArray7, 8192);
        ReportTableRow(__tableHandle, 0, __cArray2, __cRange, __cArray7, __cEmpty, __oneOfFlag, __bSetInCheckAlignment);
        ReportLValueOrSignalNotOnline(`FDCAN2::dbNode::`CVADAS::`CVPAM_FD_Info::`DisplayView2, __cArray8, 8192);
        ReportCell(__tableHandle, __cArray8);
        ReportCellResult(__tableHandle, __csr, __ePassFail);
      }
  
      __bVerdict = __bVerdict && __csr;
    }
    ReportTableEndVerdict(__tableHandle, "1", __bVerdict);
  }
  TestCommandEnd();


}

void Tt4h42sqi_Tet_CaplTcCall5()
{
  stack long __tableHandle;
  CreateCaplIFFunction("Send_Proxi", __eTcDef);
  AddIFParameterTestCaseAttribute("TC_ID", "");
  AddIFParameterTestCaseAttribute("Test Case ID", "");
  AddIFParameterChar(syspar::`HD_Proxy_6);
  CallInterfaceFunction(__cEmpty , "", __cEmpty );
}

void Tt4h42sqi_Tet_Tc71()
{
  CreateTTEIFFunction("Tt4h42sqi_Tc71", __eTcDef, __eLocal);  
  AddIFParameterTestCaseAttribute("TC_ID", "");
  AddIFParameterTestCaseAttribute("Test Case ID", "");
  CallInterfaceFunction("Set to Surround View Camera", __cEmpty , __cEmpty );
}
testcase Tt4h42sqi_Tc71()
{
  stack long __tableHandle;
  SetBreakOnFail(1);

  TestPreparationBegin();
  {
  }
  TestPreparationEnd();

  TestCommandBegin(__eSet, __cSet, "", "0");
  {
    __tableHandle = ReportTableHead3Columns(__cSetCaption , __cTSym, __cTOp, __cAssigned); 
    {
      $`FDCAN2::dbNode::`SGW::`TELEMATIC_FD_14::`TGW_CAMERA_DISP_STAT.phys = 4;
      snprintf(__cArray, 8192, "%s", "TGW_CAMERA_DISP_STAT");
      snprintf(__cArray2, 8192, "%s '%s'", __cCANSignal, __cArray);
      snprintf(__cArray3, 8192, "%s", "");
      
      ReportSetLValueOrSignalNotOnline(getSignalTime(`FDCAN2::dbNode::`SGW::`TELEMATIC_FD_14::`TGW_CAMERA_DISP_STAT), __cArray2, __cArray4, 8192);
      ReportTableRow(__tableHandle, 0, __cArray4, __cAOp, 4, __cArray3, __oneOfFlag, __bSetInCheckAlignment);
      
  
    }
    {
      $`FDCAN2::dbNode::`SGW::`TELEMATIC_FD_5::`CameraDisplaySts2.phys = 0;
      snprintf(__cArray, 8192, "%s", "CameraDisplaySts2");
      snprintf(__cArray2, 8192, "%s '%s'", __cCANSignal, __cArray);
      snprintf(__cArray3, 8192, "%s", "Default");
      
      ReportSetLValueOrSignalNotOnline(getSignalTime(`FDCAN2::dbNode::`SGW::`TELEMATIC_FD_5::`CameraDisplaySts2), __cArray2, __cArray4, 8192);
      ReportTableRow(__tableHandle, 0, __cArray4, __cAOp, 0, __cArray3, __oneOfFlag, __bSetInCheckAlignment);
      
  
    }
    ReportTableEndTestStep(__tableHandle, "1");
  }
  TestCommandEnd();


  TestCommandBegin(__eWait, __cWait, "", "1");
  {
    Wait("1", (1000 * 1000000LL), 1000000, "");
  }
  TestCommandEnd();

  TestCommandBegin(__eCheck, __cCheck, "", "2");
  {
    __bVerdict = __eVerdictPass;
    __tableHandle = ReportTableHead5Columns(__cCheckCaption, __cTSym, __cTOp, __cRefVal, __cActual, __cRes);
    {
      {
        int __res1,__res2;
        __res1 = CheckSignalMatch(`FDCAN2::dbNode::`SGW::`TELEMATIC_FD_14::`TGW_CAMERA_DISP_STAT, 0, __cGreaterEqualThan) == 1;
        __res2 = CheckSignalMatch(`FDCAN2::dbNode::`SGW::`TELEMATIC_FD_14::`TGW_CAMERA_DISP_STAT, 4, __cLessEqualThan) == 1;
        __csr = __res1 && __res2;
        snprintf(__cArray, 8192, "%s", "TGW_CAMERA_DISP_STAT");
        snprintf(__cArray2, 8192, "%s '%s'", __cCANSignal, __cArray);
        snprintf(__cArray3, 8192, "%s", "");
        snprintf(__cArray4, 8192, "%s", "");
        snprintf(__cArray5, 8192, "%s", __cArray3);
        snprintf(__cArray6, 8192, "%s", __cArray4);
        ReportRange(0, 4, __cArray5, __cArray6, __cArray7, 8192);
        ReportTableRow(__tableHandle, 0, __cArray2, __cRange, __cArray7, __cEmpty, __oneOfFlag, __bSetInCheckAlignment);
        ReportLValueOrSignalNotOnline(`FDCAN2::dbNode::`SGW::`TELEMATIC_FD_14::`TGW_CAMERA_DISP_STAT, __cArray8, 8192);
        ReportCell(__tableHandle, __cArray8);
        ReportCellResult(__tableHandle, __csr, __ePassFail);
      }
  
      __bVerdict = __bVerdict && __csr;
    }
    ReportTableEndVerdict(__tableHandle, "1", __bVerdict);
  }
  TestCommandEnd();


  TestCommandBegin(__eWait, __cWait, "", "3");
  {
    Wait("1", (3000 * 1000000LL), 1000000, "");
  }
  TestCommandEnd();

}

void Tt4h42sqi_Tet_Tc72()
{
  CreateTTEIFFunction("Tt4h42sqi_Tc72", __eTcDef, __eLocal);  
  AddIFParameterTestCaseAttribute("TC_ID", "");
  AddIFParameterTestCaseAttribute("Test Case ID", "");
  CallInterfaceFunction("Default View", __cEmpty , __cEmpty );
}
testcase Tt4h42sqi_Tc72()
{
  stack long __tableHandle;
  SetBreakOnFail(1);

  TestCommandBegin(__eSet, __cSet, "", "0");
  {
    __tableHandle = ReportTableHead3Columns(__cSetCaption , __cTSym, __cTOp, __cAssigned); 
    {
      $`FDCAN2::dbNode::`SGW::`TELEMATIC_FD_5::`CameraDisplaySts2.phys = 2;
      snprintf(__cArray, 8192, "%s", "CameraDisplaySts2");
      snprintf(__cArray2, 8192, "%s '%s'", __cCANSignal, __cArray);
      snprintf(__cArray3, 8192, "%s", "");
      
      ReportSetLValueOrSignalNotOnline(getSignalTime(`FDCAN2::dbNode::`SGW::`TELEMATIC_FD_5::`CameraDisplaySts2), __cArray2, __cArray4, 8192);
      ReportTableRow(__tableHandle, 0, __cArray4, __cAOp, 2, __cArray3, __oneOfFlag, __bSetInCheckAlignment);
      
  
    }
    ReportTableEndTestStep(__tableHandle, "1");
  }
  TestCommandEnd();


  TestCommandBegin(__eWait, __cWait, "", "1");
  {
    Wait("1", (1000 * 1000000LL), 1000000, "");
  }
  TestCommandEnd();

  TestCommandBegin(__eSet, __cSet, "", "2");
  {
    __tableHandle = ReportTableHead3Columns(__cSetCaption , __cTSym, __cTOp, __cAssigned); 
    {
      $`FDCAN2::dbNode::`SGW::`TELEMATIC_FD_5::`CameraDisplaySts2.phys = 0;
      snprintf(__cArray, 8192, "%s", "CameraDisplaySts2");
      snprintf(__cArray2, 8192, "%s '%s'", __cCANSignal, __cArray);
      snprintf(__cArray3, 8192, "%s", "");
      
      ReportSetLValueOrSignalNotOnline(getSignalTime(`FDCAN2::dbNode::`SGW::`TELEMATIC_FD_5::`CameraDisplaySts2), __cArray2, __cArray4, 8192);
      ReportTableRow(__tableHandle, 0, __cArray4, __cAOp, 0, __cArray3, __oneOfFlag, __bSetInCheckAlignment);
      
  
    }
    ReportTableEndTestStep(__tableHandle, "1");
  }
  TestCommandEnd();


  TestCommandBegin(__eWait, __cWait, "", "3");
  {
    Wait("1", (1000 * 1000000LL), 1000000, "");
  }
  TestCommandEnd();

  TestCommandBegin(__eCheck, __cCheck, "", "4");
  {
    __bVerdict = __eVerdictPass;
    __tableHandle = ReportTableHead5Columns(__cCheckCaption, __cTSym, __cTOp, __cRefVal, __cActual, __cRes);
    {
      {
        int __res1,__res2;
        __res1 = CheckSignalMatch(`FDCAN2::dbNode::`CVADAS::`CVPAM_FD_Info::`DisplayView2, 1, __cGreaterEqualThan) == 1;
        __res2 = CheckSignalMatch(`FDCAN2::dbNode::`CVADAS::`CVPAM_FD_Info::`DisplayView2, 15, __cLessEqualThan) == 1;
        __csr = __res1 && __res2;
        snprintf(__cArray, 8192, "%s", "DisplayView2");
        snprintf(__cArray2, 8192, "%s '%s'", __cCANSignal, __cArray);
        snprintf(__cArray3, 8192, "%s", "");
        snprintf(__cArray4, 8192, "%s", "");
        snprintf(__cArray5, 8192, "%s", __cArray3);
        snprintf(__cArray6, 8192, "%s", __cArray4);
        ReportRange(1, 15, __cArray5, __cArray6, __cArray7, 8192);
        ReportTableRow(__tableHandle, 0, __cArray2, __cRange, __cArray7, __cEmpty, __oneOfFlag, __bSetInCheckAlignment);
        ReportLValueOrSignalNotOnline(`FDCAN2::dbNode::`CVADAS::`CVPAM_FD_Info::`DisplayView2, __cArray8, 8192);
        ReportCell(__tableHandle, __cArray8);
        ReportCellResult(__tableHandle, __csr, __ePassFail);
      }
  
      __bVerdict = __bVerdict && __csr;
    }
    ReportTableEndVerdict(__tableHandle, "1", __bVerdict);
  }
  TestCommandEnd();


}

void Tt4h42sqi_Tet_Tc73()
{
  CreateTTEIFFunction("Tt4h42sqi_Tc73", __eTcDef, __eLocal);  
  AddIFParameterTestCaseAttribute("TC_ID", "");
  AddIFParameterTestCaseAttribute("Test Case ID", "");
  CallInterfaceFunction("View 1: FVTV_RVTV", __cEmpty , __cEmpty );
}
testcase Tt4h42sqi_Tc73()
{
  stack long __tableHandle;
  SetBreakOnFail(1);

  TestCommandBegin(__eSet, __cSet, "", "0");
  {
    __tableHandle = ReportTableHead3Columns(__cSetCaption , __cTSym, __cTOp, __cAssigned); 
    {
      $`FDCAN2::dbNode::`SGW::`TELEMATIC_FD_5::`CameraDisplaySts2.phys = 1;
      snprintf(__cArray, 8192, "%s", "CameraDisplaySts2");
      snprintf(__cArray2, 8192, "%s '%s'", __cCANSignal, __cArray);
      snprintf(__cArray3, 8192, "%s", "");
      
      ReportSetLValueOrSignalNotOnline(getSignalTime(`FDCAN2::dbNode::`SGW::`TELEMATIC_FD_5::`CameraDisplaySts2), __cArray2, __cArray4, 8192);
      ReportTableRow(__tableHandle, 0, __cArray4, __cAOp, 1, __cArray3, __oneOfFlag, __bSetInCheckAlignment);
      
  
    }
    ReportTableEndTestStep(__tableHandle, "1");
  }
  TestCommandEnd();


  TestCommandBegin(__eWait, __cWait, "", "1");
  {
    Wait("1", (1000 * 1000000LL), 1000000, "");
  }
  TestCommandEnd();

  TestCommandBegin(__eCheck, __cCheck, "", "2");
  {
    __bVerdict = __eVerdictPass;
    __tableHandle = ReportTableHead5Columns(__cCheckCaption, __cTSym, __cTOp, __cRefVal, __cActual, __cRes);
    {
      {
        int __res1,__res2;
        __res1 = CheckSignalMatch(`FDCAN2::dbNode::`CVADAS::`CVPAM_FD_Info::`DisplayView2, 1, __cGreaterEqualThan) == 1;
        __res2 = CheckSignalMatch(`FDCAN2::dbNode::`CVADAS::`CVPAM_FD_Info::`DisplayView2, 15, __cLessEqualThan) == 1;
        __csr = __res1 && __res2;
        snprintf(__cArray, 8192, "%s", "DisplayView2");
        snprintf(__cArray2, 8192, "%s '%s'", __cCANSignal, __cArray);
        snprintf(__cArray3, 8192, "%s", "");
        snprintf(__cArray4, 8192, "%s", "");
        snprintf(__cArray5, 8192, "%s", __cArray3);
        snprintf(__cArray6, 8192, "%s", __cArray4);
        ReportRange(1, 15, __cArray5, __cArray6, __cArray7, 8192);
        ReportTableRow(__tableHandle, 0, __cArray2, __cRange, __cArray7, __cEmpty, __oneOfFlag, __bSetInCheckAlignment);
        ReportLValueOrSignalNotOnline(`FDCAN2::dbNode::`CVADAS::`CVPAM_FD_Info::`DisplayView2, __cArray8, 8192);
        ReportCell(__tableHandle, __cArray8);
        ReportCellResult(__tableHandle, __csr, __ePassFail);
      }
  
      __bVerdict = __bVerdict && __csr;
    }
    ReportTableEndVerdict(__tableHandle, "1", __bVerdict);
  }
  TestCommandEnd();


}

void Tt4h42sqi_Tet_Tc74()
{
  CreateTTEIFFunction("Tt4h42sqi_Tc74", __eTcDef, __eLocal);  
  AddIFParameterTestCaseAttribute("TC_ID", "");
  AddIFParameterTestCaseAttribute("Test Case ID", "");
  CallInterfaceFunction("View 2: BackupRearView", __cEmpty , __cEmpty );
}
testcase Tt4h42sqi_Tc74()
{
  stack long __tableHandle;
  SetBreakOnFail(1);

  TestCommandBegin(__eSet, __cSet, "", "0");
  {
    __tableHandle = ReportTableHead3Columns(__cSetCaption , __cTSym, __cTOp, __cAssigned); 
    {
      $`FDCAN2::dbNode::`SGW::`TELEMATIC_FD_5::`CameraDisplaySts2.phys = 2;
      snprintf(__cArray, 8192, "%s", "CameraDisplaySts2");
      snprintf(__cArray2, 8192, "%s '%s'", __cCANSignal, __cArray);
      snprintf(__cArray3, 8192, "%s", "");
      
      ReportSetLValueOrSignalNotOnline(getSignalTime(`FDCAN2::dbNode::`SGW::`TELEMATIC_FD_5::`CameraDisplaySts2), __cArray2, __cArray4, 8192);
      ReportTableRow(__tableHandle, 0, __cArray4, __cAOp, 2, __cArray3, __oneOfFlag, __bSetInCheckAlignment);
      
  
    }
    ReportTableEndTestStep(__tableHandle, "1");
  }
  TestCommandEnd();


  TestCommandBegin(__eWait, __cWait, "", "1");
  {
    Wait("1", (1000 * 1000000LL), 1000000, "");
  }
  TestCommandEnd();

  TestCommandBegin(__eCheck, __cCheck, "", "2");
  {
    __bVerdict = __eVerdictPass;
    __tableHandle = ReportTableHead5Columns(__cCheckCaption, __cTSym, __cTOp, __cRefVal, __cActual, __cRes);
    {
      {
        int __res1,__res2;
        __res1 = CheckSignalMatch(`FDCAN2::dbNode::`CVADAS::`CVPAM_FD_Info::`DisplayView2, 1, __cGreaterEqualThan) == 1;
        __res2 = CheckSignalMatch(`FDCAN2::dbNode::`CVADAS::`CVPAM_FD_Info::`DisplayView2, 15, __cLessEqualThan) == 1;
        __csr = __res1 && __res2;
        snprintf(__cArray, 8192, "%s", "DisplayView2");
        snprintf(__cArray2, 8192, "%s '%s'", __cCANSignal, __cArray);
        snprintf(__cArray3, 8192, "%s", "");
        snprintf(__cArray4, 8192, "%s", "");
        snprintf(__cArray5, 8192, "%s", __cArray3);
        snprintf(__cArray6, 8192, "%s", __cArray4);
        ReportRange(1, 15, __cArray5, __cArray6, __cArray7, 8192);
        ReportTableRow(__tableHandle, 0, __cArray2, __cRange, __cArray7, __cEmpty, __oneOfFlag, __bSetInCheckAlignment);
        ReportLValueOrSignalNotOnline(`FDCAN2::dbNode::`CVADAS::`CVPAM_FD_Info::`DisplayView2, __cArray8, 8192);
        ReportCell(__tableHandle, __cArray8);
        ReportCellResult(__tableHandle, __csr, __ePassFail);
      }
  
      __bVerdict = __bVerdict && __csr;
    }
    ReportTableEndVerdict(__tableHandle, "1", __bVerdict);
  }
  TestCommandEnd();


}

void Tt4h42sqi_Tet_Tc75()
{
  CreateTTEIFFunction("Tt4h42sqi_Tc75", __eTcDef, __eLocal);  
  AddIFParameterTestCaseAttribute("TC_ID", "");
  AddIFParameterTestCaseAttribute("Test Case ID", "");
  CallInterfaceFunction("View 3: Forward Facing Camera", __cEmpty , __cEmpty );
}
testcase Tt4h42sqi_Tc75()
{
  stack long __tableHandle;
  SetBreakOnFail(1);

  TestCommandBegin(__eSet, __cSet, "", "0");
  {
    __tableHandle = ReportTableHead3Columns(__cSetCaption , __cTSym, __cTOp, __cAssigned); 
    {
      $`FDCAN2::dbNode::`SGW::`TELEMATIC_FD_5::`CameraDisplaySts2.phys = 3;
      snprintf(__cArray, 8192, "%s", "CameraDisplaySts2");
      snprintf(__cArray2, 8192, "%s '%s'", __cCANSignal, __cArray);
      snprintf(__cArray3, 8192, "%s", "");
      
      ReportSetLValueOrSignalNotOnline(getSignalTime(`FDCAN2::dbNode::`SGW::`TELEMATIC_FD_5::`CameraDisplaySts2), __cArray2, __cArray4, 8192);
      ReportTableRow(__tableHandle, 0, __cArray4, __cAOp, 3, __cArray3, __oneOfFlag, __bSetInCheckAlignment);
      
  
    }
    ReportTableEndTestStep(__tableHandle, "1");
  }
  TestCommandEnd();


  TestCommandBegin(__eWait, __cWait, "", "1");
  {
    Wait("1", (1000 * 1000000LL), 1000000, "");
  }
  TestCommandEnd();

  TestCommandBegin(__eCheck, __cCheck, "", "2");
  {
    __bVerdict = __eVerdictPass;
    __tableHandle = ReportTableHead5Columns(__cCheckCaption, __cTSym, __cTOp, __cRefVal, __cActual, __cRes);
    {
      {
        int __res1,__res2;
        __res1 = CheckSignalMatch(`FDCAN2::dbNode::`CVADAS::`CVPAM_FD_Info::`DisplayView2, 1, __cGreaterEqualThan) == 1;
        __res2 = CheckSignalMatch(`FDCAN2::dbNode::`CVADAS::`CVPAM_FD_Info::`DisplayView2, 15, __cLessEqualThan) == 1;
        __csr = __res1 && __res2;
        snprintf(__cArray, 8192, "%s", "DisplayView2");
        snprintf(__cArray2, 8192, "%s '%s'", __cCANSignal, __cArray);
        snprintf(__cArray3, 8192, "%s", "");
        snprintf(__cArray4, 8192, "%s", "");
        snprintf(__cArray5, 8192, "%s", __cArray3);
        snprintf(__cArray6, 8192, "%s", __cArray4);
        ReportRange(1, 15, __cArray5, __cArray6, __cArray7, 8192);
        ReportTableRow(__tableHandle, 0, __cArray2, __cRange, __cArray7, __cEmpty, __oneOfFlag, __bSetInCheckAlignment);
        ReportLValueOrSignalNotOnline(`FDCAN2::dbNode::`CVADAS::`CVPAM_FD_Info::`DisplayView2, __cArray8, 8192);
        ReportCell(__tableHandle, __cArray8);
        ReportCellResult(__tableHandle, __csr, __ePassFail);
      }
  
      __bVerdict = __bVerdict && __csr;
    }
    ReportTableEndVerdict(__tableHandle, "1", __bVerdict);
  }
  TestCommandEnd();


}

void Tt4h42sqi_Tet_Tc76()
{
  CreateTTEIFFunction("Tt4h42sqi_Tc76", __eTcDef, __eLocal);  
  AddIFParameterTestCaseAttribute("TC_ID", "");
  AddIFParameterTestCaseAttribute("Test Case ID", "");
  CallInterfaceFunction("View 5: Trailer Reverse Guidance", __cEmpty , __cEmpty );
}
testcase Tt4h42sqi_Tc76()
{
  stack long __tableHandle;
  SetBreakOnFail(1);

  TestCommandBegin(__eSet, __cSet, "", "0");
  {
    __tableHandle = ReportTableHead3Columns(__cSetCaption , __cTSym, __cTOp, __cAssigned); 
    {
      $`FDCAN2::dbNode::`SGW::`TELEMATIC_FD_5::`CameraDisplaySts2.phys = 5;
      snprintf(__cArray, 8192, "%s", "CameraDisplaySts2");
      snprintf(__cArray2, 8192, "%s '%s'", __cCANSignal, __cArray);
      snprintf(__cArray3, 8192, "%s", "");
      
      ReportSetLValueOrSignalNotOnline(getSignalTime(`FDCAN2::dbNode::`SGW::`TELEMATIC_FD_5::`CameraDisplaySts2), __cArray2, __cArray4, 8192);
      ReportTableRow(__tableHandle, 0, __cArray4, __cAOp, 5, __cArray3, __oneOfFlag, __bSetInCheckAlignment);
      
  
    }
    ReportTableEndTestStep(__tableHandle, "1");
  }
  TestCommandEnd();


  TestCommandBegin(__eWait, __cWait, "", "1");
  {
    Wait("1", (1000 * 1000000LL), 1000000, "");
  }
  TestCommandEnd();

  TestCommandBegin(__eCheck, __cCheck, "", "2");
  {
    __bVerdict = __eVerdictPass;
    __tableHandle = ReportTableHead5Columns(__cCheckCaption, __cTSym, __cTOp, __cRefVal, __cActual, __cRes);
    {
      {
        int __res1,__res2;
        __res1 = CheckSignalMatch(`FDCAN2::dbNode::`CVADAS::`CVPAM_FD_Info::`DisplayView2, 1, __cGreaterEqualThan) == 1;
        __res2 = CheckSignalMatch(`FDCAN2::dbNode::`CVADAS::`CVPAM_FD_Info::`DisplayView2, 15, __cLessEqualThan) == 1;
        __csr = __res1 && __res2;
        snprintf(__cArray, 8192, "%s", "DisplayView2");
        snprintf(__cArray2, 8192, "%s '%s'", __cCANSignal, __cArray);
        snprintf(__cArray3, 8192, "%s", "");
        snprintf(__cArray4, 8192, "%s", "");
        snprintf(__cArray5, 8192, "%s", __cArray3);
        snprintf(__cArray6, 8192, "%s", __cArray4);
        ReportRange(1, 15, __cArray5, __cArray6, __cArray7, 8192);
        ReportTableRow(__tableHandle, 0, __cArray2, __cRange, __cArray7, __cEmpty, __oneOfFlag, __bSetInCheckAlignment);
        ReportLValueOrSignalNotOnline(`FDCAN2::dbNode::`CVADAS::`CVPAM_FD_Info::`DisplayView2, __cArray8, 8192);
        ReportCell(__tableHandle, __cArray8);
        ReportCellResult(__tableHandle, __csr, __ePassFail);
      }
  
      __bVerdict = __bVerdict && __csr;
    }
    ReportTableEndVerdict(__tableHandle, "1", __bVerdict);
  }
  TestCommandEnd();


}

void Tt4h42sqi_Tet_Tc77()
{
  CreateTTEIFFunction("Tt4h42sqi_Tc77", __eTcDef, __eLocal);  
  AddIFParameterTestCaseAttribute("TC_ID", "");
  AddIFParameterTestCaseAttribute("Test Case ID", "");
  CallInterfaceFunction("View 6: Trailer Left View", __cEmpty , __cEmpty );
}
testcase Tt4h42sqi_Tc77()
{
  stack long __tableHandle;
  SetBreakOnFail(1);

  TestCommandBegin(__eSet, __cSet, "", "0");
  {
    __tableHandle = ReportTableHead3Columns(__cSetCaption , __cTSym, __cTOp, __cAssigned); 
    {
      $`FDCAN2::dbNode::`SGW::`TELEMATIC_FD_5::`CameraDisplaySts2.phys = 6;
      snprintf(__cArray, 8192, "%s", "CameraDisplaySts2");
      snprintf(__cArray2, 8192, "%s '%s'", __cCANSignal, __cArray);
      snprintf(__cArray3, 8192, "%s", "");
      
      ReportSetLValueOrSignalNotOnline(getSignalTime(`FDCAN2::dbNode::`SGW::`TELEMATIC_FD_5::`CameraDisplaySts2), __cArray2, __cArray4, 8192);
      ReportTableRow(__tableHandle, 0, __cArray4, __cAOp, 6, __cArray3, __oneOfFlag, __bSetInCheckAlignment);
      
  
    }
    ReportTableEndTestStep(__tableHandle, "1");
  }
  TestCommandEnd();


  TestCommandBegin(__eWait, __cWait, "", "1");
  {
    Wait("1", (1000 * 1000000LL), 1000000, "");
  }
  TestCommandEnd();

  TestCommandBegin(__eCheck, __cCheck, "", "2");
  {
    __bVerdict = __eVerdictPass;
    __tableHandle = ReportTableHead5Columns(__cCheckCaption, __cTSym, __cTOp, __cRefVal, __cActual, __cRes);
    {
      {
        int __res1,__res2;
        __res1 = CheckSignalMatch(`FDCAN2::dbNode::`CVADAS::`CVPAM_FD_Info::`DisplayView2, 1, __cGreaterEqualThan) == 1;
        __res2 = CheckSignalMatch(`FDCAN2::dbNode::`CVADAS::`CVPAM_FD_Info::`DisplayView2, 15, __cLessEqualThan) == 1;
        __csr = __res1 && __res2;
        snprintf(__cArray, 8192, "%s", "DisplayView2");
        snprintf(__cArray2, 8192, "%s '%s'", __cCANSignal, __cArray);
        snprintf(__cArray3, 8192, "%s", "");
        snprintf(__cArray4, 8192, "%s", "");
        snprintf(__cArray5, 8192, "%s", __cArray3);
        snprintf(__cArray6, 8192, "%s", __cArray4);
        ReportRange(1, 15, __cArray5, __cArray6, __cArray7, 8192);
        ReportTableRow(__tableHandle, 0, __cArray2, __cRange, __cArray7, __cEmpty, __oneOfFlag, __bSetInCheckAlignment);
        ReportLValueOrSignalNotOnline(`FDCAN2::dbNode::`CVADAS::`CVPAM_FD_Info::`DisplayView2, __cArray8, 8192);
        ReportCell(__tableHandle, __cArray8);
        ReportCellResult(__tableHandle, __csr, __ePassFail);
      }
  
      __bVerdict = __bVerdict && __csr;
    }
    ReportTableEndVerdict(__tableHandle, "1", __bVerdict);
  }
  TestCommandEnd();


}

void Tt4h42sqi_Tet_Tc78()
{
  CreateTTEIFFunction("Tt4h42sqi_Tc78", __eTcDef, __eLocal);  
  AddIFParameterTestCaseAttribute("TC_ID", "");
  AddIFParameterTestCaseAttribute("Test Case ID", "");
  CallInterfaceFunction("View 7: Trailer Right View", __cEmpty , __cEmpty );
}
testcase Tt4h42sqi_Tc78()
{
  stack long __tableHandle;
  SetBreakOnFail(1);

  TestCommandBegin(__eSet, __cSet, "", "0");
  {
    __tableHandle = ReportTableHead3Columns(__cSetCaption , __cTSym, __cTOp, __cAssigned); 
    {
      $`FDCAN2::dbNode::`SGW::`TELEMATIC_FD_5::`CameraDisplaySts2.phys = 7;
      snprintf(__cArray, 8192, "%s", "CameraDisplaySts2");
      snprintf(__cArray2, 8192, "%s '%s'", __cCANSignal, __cArray);
      snprintf(__cArray3, 8192, "%s", "");
      
      ReportSetLValueOrSignalNotOnline(getSignalTime(`FDCAN2::dbNode::`SGW::`TELEMATIC_FD_5::`CameraDisplaySts2), __cArray2, __cArray4, 8192);
      ReportTableRow(__tableHandle, 0, __cArray4, __cAOp, 7, __cArray3, __oneOfFlag, __bSetInCheckAlignment);
      
  
    }
    ReportTableEndTestStep(__tableHandle, "1");
  }
  TestCommandEnd();


  TestCommandBegin(__eWait, __cWait, "", "1");
  {
    Wait("1", (1000 * 1000000LL), 1000000, "");
  }
  TestCommandEnd();

  TestCommandBegin(__eCheck, __cCheck, "", "2");
  {
    __bVerdict = __eVerdictPass;
    __tableHandle = ReportTableHead5Columns(__cCheckCaption, __cTSym, __cTOp, __cRefVal, __cActual, __cRes);
    {
      {
        int __res1,__res2;
        __res1 = CheckSignalMatch(`FDCAN2::dbNode::`CVADAS::`CVPAM_FD_Info::`DisplayView2, 1, __cGreaterEqualThan) == 1;
        __res2 = CheckSignalMatch(`FDCAN2::dbNode::`CVADAS::`CVPAM_FD_Info::`DisplayView2, 15, __cLessEqualThan) == 1;
        __csr = __res1 && __res2;
        snprintf(__cArray, 8192, "%s", "DisplayView2");
        snprintf(__cArray2, 8192, "%s '%s'", __cCANSignal, __cArray);
        snprintf(__cArray3, 8192, "%s", "");
        snprintf(__cArray4, 8192, "%s", "");
        snprintf(__cArray5, 8192, "%s", __cArray3);
        snprintf(__cArray6, 8192, "%s", __cArray4);
        ReportRange(1, 15, __cArray5, __cArray6, __cArray7, 8192);
        ReportTableRow(__tableHandle, 0, __cArray2, __cRange, __cArray7, __cEmpty, __oneOfFlag, __bSetInCheckAlignment);
        ReportLValueOrSignalNotOnline(`FDCAN2::dbNode::`CVADAS::`CVPAM_FD_Info::`DisplayView2, __cArray8, 8192);
        ReportCell(__tableHandle, __cArray8);
        ReportCellResult(__tableHandle, __csr, __ePassFail);
      }
  
      __bVerdict = __bVerdict && __csr;
    }
    ReportTableEndVerdict(__tableHandle, "1", __bVerdict);
  }
  TestCommandEnd();


}

void Tt4h42sqi_Tet_Tc79()
{
  CreateTTEIFFunction("Tt4h42sqi_Tc79", __eTcDef, __eLocal);  
  AddIFParameterTestCaseAttribute("TC_ID", "");
  AddIFParameterTestCaseAttribute("Test Case ID", "");
  CallInterfaceFunction("View 8: Blind Spot Left View", __cEmpty , __cEmpty );
}
testcase Tt4h42sqi_Tc79()
{
  stack long __tableHandle;
  SetBreakOnFail(1);

  TestCommandBegin(__eSet, __cSet, "", "0");
  {
    __tableHandle = ReportTableHead3Columns(__cSetCaption , __cTSym, __cTOp, __cAssigned); 
    {
      $`FDCAN2::dbNode::`SGW::`TELEMATIC_FD_5::`CameraDisplaySts2.phys = 8;
      snprintf(__cArray, 8192, "%s", "CameraDisplaySts2");
      snprintf(__cArray2, 8192, "%s '%s'", __cCANSignal, __cArray);
      snprintf(__cArray3, 8192, "%s", "");
      
      ReportSetLValueOrSignalNotOnline(getSignalTime(`FDCAN2::dbNode::`SGW::`TELEMATIC_FD_5::`CameraDisplaySts2), __cArray2, __cArray4, 8192);
      ReportTableRow(__tableHandle, 0, __cArray4, __cAOp, 8, __cArray3, __oneOfFlag, __bSetInCheckAlignment);
      
  
    }
    ReportTableEndTestStep(__tableHandle, "1");
  }
  TestCommandEnd();


  TestCommandBegin(__eWait, __cWait, "", "1");
  {
    Wait("1", (1000 * 1000000LL), 1000000, "");
  }
  TestCommandEnd();

  TestCommandBegin(__eCheck, __cCheck, "", "2");
  {
    __bVerdict = __eVerdictPass;
    __tableHandle = ReportTableHead5Columns(__cCheckCaption, __cTSym, __cTOp, __cRefVal, __cActual, __cRes);
    {
      {
        int __res1,__res2;
        __res1 = CheckSignalMatch(`FDCAN2::dbNode::`CVADAS::`CVPAM_FD_Info::`DisplayView2, 2, __cGreaterEqualThan) == 1;
        __res2 = CheckSignalMatch(`FDCAN2::dbNode::`CVADAS::`CVPAM_FD_Info::`DisplayView2, 10, __cLessEqualThan) == 1;
        __csr = __res1 && __res2;
        snprintf(__cArray, 8192, "%s", "DisplayView2");
        snprintf(__cArray2, 8192, "%s '%s'", __cCANSignal, __cArray);
        snprintf(__cArray3, 8192, "%s", "");
        snprintf(__cArray4, 8192, "%s", "");
        snprintf(__cArray5, 8192, "%s", __cArray3);
        snprintf(__cArray6, 8192, "%s", __cArray4);
        ReportRange(2, 10, __cArray5, __cArray6, __cArray7, 8192);
        ReportTableRow(__tableHandle, 0, __cArray2, __cRange, __cArray7, __cEmpty, __oneOfFlag, __bSetInCheckAlignment);
        ReportLValueOrSignalNotOnline(`FDCAN2::dbNode::`CVADAS::`CVPAM_FD_Info::`DisplayView2, __cArray8, 8192);
        ReportCell(__tableHandle, __cArray8);
        ReportCellResult(__tableHandle, __csr, __ePassFail);
      }
  
      __bVerdict = __bVerdict && __csr;
    }
    ReportTableEndVerdict(__tableHandle, "1", __bVerdict);
  }
  TestCommandEnd();


}

void Tt4h42sqi_Tet_Tc80()
{
  CreateTTEIFFunction("Tt4h42sqi_Tc80", __eTcDef, __eLocal);  
  AddIFParameterTestCaseAttribute("TC_ID", "");
  AddIFParameterTestCaseAttribute("Test Case ID", "");
  CallInterfaceFunction("View 9: Blind Spot Right View", __cEmpty , __cEmpty );
}
testcase Tt4h42sqi_Tc80()
{
  stack long __tableHandle;
  SetBreakOnFail(1);

  TestCommandBegin(__eSet, __cSet, "", "0");
  {
    __tableHandle = ReportTableHead3Columns(__cSetCaption , __cTSym, __cTOp, __cAssigned); 
    {
      $`FDCAN2::dbNode::`SGW::`TELEMATIC_FD_5::`CameraDisplaySts2.phys = 9;
      snprintf(__cArray, 8192, "%s", "CameraDisplaySts2");
      snprintf(__cArray2, 8192, "%s '%s'", __cCANSignal, __cArray);
      snprintf(__cArray3, 8192, "%s", "");
      
      ReportSetLValueOrSignalNotOnline(getSignalTime(`FDCAN2::dbNode::`SGW::`TELEMATIC_FD_5::`CameraDisplaySts2), __cArray2, __cArray4, 8192);
      ReportTableRow(__tableHandle, 0, __cArray4, __cAOp, 9, __cArray3, __oneOfFlag, __bSetInCheckAlignment);
      
  
    }
    ReportTableEndTestStep(__tableHandle, "1");
  }
  TestCommandEnd();


  TestCommandBegin(__eWait, __cWait, "", "1");
  {
    Wait("1", (1000 * 1000000LL), 1000000, "");
  }
  TestCommandEnd();

  TestCommandBegin(__eCheck, __cCheck, "", "2");
  {
    __bVerdict = __eVerdictPass;
    __tableHandle = ReportTableHead5Columns(__cCheckCaption, __cTSym, __cTOp, __cRefVal, __cActual, __cRes);
    {
      {
        int __res1,__res2;
        __res1 = CheckSignalMatch(`FDCAN2::dbNode::`CVADAS::`CVPAM_FD_Info::`DisplayView2, 2, __cGreaterEqualThan) == 1;
        __res2 = CheckSignalMatch(`FDCAN2::dbNode::`CVADAS::`CVPAM_FD_Info::`DisplayView2, 15, __cLessEqualThan) == 1;
        __csr = __res1 && __res2;
        snprintf(__cArray, 8192, "%s", "DisplayView2");
        snprintf(__cArray2, 8192, "%s '%s'", __cCANSignal, __cArray);
        snprintf(__cArray3, 8192, "%s", "");
        snprintf(__cArray4, 8192, "%s", "");
        snprintf(__cArray5, 8192, "%s", __cArray3);
        snprintf(__cArray6, 8192, "%s", __cArray4);
        ReportRange(2, 15, __cArray5, __cArray6, __cArray7, 8192);
        ReportTableRow(__tableHandle, 0, __cArray2, __cRange, __cArray7, __cEmpty, __oneOfFlag, __bSetInCheckAlignment);
        ReportLValueOrSignalNotOnline(`FDCAN2::dbNode::`CVADAS::`CVPAM_FD_Info::`DisplayView2, __cArray8, 8192);
        ReportCell(__tableHandle, __cArray8);
        ReportCellResult(__tableHandle, __csr, __ePassFail);
      }
  
      __bVerdict = __bVerdict && __csr;
    }
    ReportTableEndVerdict(__tableHandle, "1", __bVerdict);
  }
  TestCommandEnd();


}

void Tt4h42sqi_Tet_Tc81()
{
  CreateTTEIFFunction("Tt4h42sqi_Tc81", __eTcDef, __eLocal);  
  AddIFParameterTestCaseAttribute("TC_ID", "");
  AddIFParameterTestCaseAttribute("Test Case ID", "");
  CallInterfaceFunction("View 11: FVTV", __cEmpty , __cEmpty );
}
testcase Tt4h42sqi_Tc81()
{
  stack long __tableHandle;
  SetBreakOnFail(1);

  TestCommandBegin(__eSet, __cSet, "", "0");
  {
    __tableHandle = ReportTableHead3Columns(__cSetCaption , __cTSym, __cTOp, __cAssigned); 
    {
      $`FDCAN2::dbNode::`SGW::`TELEMATIC_FD_5::`CameraDisplaySts2.phys = 11;
      snprintf(__cArray, 8192, "%s", "CameraDisplaySts2");
      snprintf(__cArray2, 8192, "%s '%s'", __cCANSignal, __cArray);
      snprintf(__cArray3, 8192, "%s", "");
      
      ReportSetLValueOrSignalNotOnline(getSignalTime(`FDCAN2::dbNode::`SGW::`TELEMATIC_FD_5::`CameraDisplaySts2), __cArray2, __cArray4, 8192);
      ReportTableRow(__tableHandle, 0, __cArray4, __cAOp, 11, __cArray3, __oneOfFlag, __bSetInCheckAlignment);
      
  
    }
    ReportTableEndTestStep(__tableHandle, "1");
  }
  TestCommandEnd();


  TestCommandBegin(__eWait, __cWait, "", "1");
  {
    Wait("1", (1000 * 1000000LL), 1000000, "");
  }
  TestCommandEnd();

  TestCommandBegin(__eCheck, __cCheck, "", "2");
  {
    __bVerdict = __eVerdictPass;
    __tableHandle = ReportTableHead5Columns(__cCheckCaption, __cTSym, __cTOp, __cRefVal, __cActual, __cRes);
    {
      {
        int __res1,__res2;
        __res1 = CheckSignalMatch(`FDCAN2::dbNode::`CVADAS::`CVPAM_FD_Info::`DisplayView2, 1, __cGreaterEqualThan) == 1;
        __res2 = CheckSignalMatch(`FDCAN2::dbNode::`CVADAS::`CVPAM_FD_Info::`DisplayView2, 15, __cLessEqualThan) == 1;
        __csr = __res1 && __res2;
        snprintf(__cArray, 8192, "%s", "DisplayView2");
        snprintf(__cArray2, 8192, "%s '%s'", __cCANSignal, __cArray);
        snprintf(__cArray3, 8192, "%s", "");
        snprintf(__cArray4, 8192, "%s", "");
        snprintf(__cArray5, 8192, "%s", __cArray3);
        snprintf(__cArray6, 8192, "%s", __cArray4);
        ReportRange(1, 15, __cArray5, __cArray6, __cArray7, 8192);
        ReportTableRow(__tableHandle, 0, __cArray2, __cRange, __cArray7, __cEmpty, __oneOfFlag, __bSetInCheckAlignment);
        ReportLValueOrSignalNotOnline(`FDCAN2::dbNode::`CVADAS::`CVPAM_FD_Info::`DisplayView2, __cArray8, 8192);
        ReportCell(__tableHandle, __cArray8);
        ReportCellResult(__tableHandle, __csr, __ePassFail);
      }
  
      __bVerdict = __bVerdict && __csr;
    }
    ReportTableEndVerdict(__tableHandle, "1", __bVerdict);
  }
  TestCommandEnd();


}

void Tt4h42sqi_Tet_Tc82()
{
  CreateTTEIFFunction("Tt4h42sqi_Tc82", __eTcDef, __eLocal);  
  AddIFParameterTestCaseAttribute("TC_ID", "");
  AddIFParameterTestCaseAttribute("Test Case ID", "");
  CallInterfaceFunction("View 12: RVTV", __cEmpty , __cEmpty );
}
testcase Tt4h42sqi_Tc82()
{
  stack long __tableHandle;
  SetBreakOnFail(1);

  TestCommandBegin(__eSet, __cSet, "", "0");
  {
    __tableHandle = ReportTableHead3Columns(__cSetCaption , __cTSym, __cTOp, __cAssigned); 
    {
      $`FDCAN2::dbNode::`SGW::`TELEMATIC_FD_5::`CameraDisplaySts2.phys = 12;
      snprintf(__cArray, 8192, "%s", "CameraDisplaySts2");
      snprintf(__cArray2, 8192, "%s '%s'", __cCANSignal, __cArray);
      snprintf(__cArray3, 8192, "%s", "");
      
      ReportSetLValueOrSignalNotOnline(getSignalTime(`FDCAN2::dbNode::`SGW::`TELEMATIC_FD_5::`CameraDisplaySts2), __cArray2, __cArray4, 8192);
      ReportTableRow(__tableHandle, 0, __cArray4, __cAOp, 12, __cArray3, __oneOfFlag, __bSetInCheckAlignment);
      
  
    }
    ReportTableEndTestStep(__tableHandle, "1");
  }
  TestCommandEnd();


  TestCommandBegin(__eWait, __cWait, "", "1");
  {
    Wait("1", (1000 * 1000000LL), 1000000, "");
  }
  TestCommandEnd();

  TestCommandBegin(__eCheck, __cCheck, "", "2");
  {
    __bVerdict = __eVerdictPass;
    __tableHandle = ReportTableHead5Columns(__cCheckCaption, __cTSym, __cTOp, __cRefVal, __cActual, __cRes);
    {
      {
        int __res1,__res2;
        __res1 = CheckSignalMatch(`FDCAN2::dbNode::`CVADAS::`CVPAM_FD_Info::`DisplayView2, 1, __cGreaterEqualThan) == 1;
        __res2 = CheckSignalMatch(`FDCAN2::dbNode::`CVADAS::`CVPAM_FD_Info::`DisplayView2, 15, __cLessEqualThan) == 1;
        __csr = __res1 && __res2;
        snprintf(__cArray, 8192, "%s", "DisplayView2");
        snprintf(__cArray2, 8192, "%s '%s'", __cCANSignal, __cArray);
        snprintf(__cArray3, 8192, "%s", "");
        snprintf(__cArray4, 8192, "%s", "");
        snprintf(__cArray5, 8192, "%s", __cArray3);
        snprintf(__cArray6, 8192, "%s", __cArray4);
        ReportRange(1, 15, __cArray5, __cArray6, __cArray7, 8192);
        ReportTableRow(__tableHandle, 0, __cArray2, __cRange, __cArray7, __cEmpty, __oneOfFlag, __bSetInCheckAlignment);
        ReportLValueOrSignalNotOnline(`FDCAN2::dbNode::`CVADAS::`CVPAM_FD_Info::`DisplayView2, __cArray8, 8192);
        ReportCell(__tableHandle, __cArray8);
        ReportCellResult(__tableHandle, __csr, __ePassFail);
      }
  
      __bVerdict = __bVerdict && __csr;
    }
    ReportTableEndVerdict(__tableHandle, "1", __bVerdict);
  }
  TestCommandEnd();


}

void Tt4h42sqi_Tet_Tc83()
{
  CreateTTEIFFunction("Tt4h42sqi_Tc83", __eTcDef, __eLocal);  
  AddIFParameterTestCaseAttribute("TC_ID", "");
  AddIFParameterTestCaseAttribute("Test Case ID", "");
  CallInterfaceFunction("View 13: FrontCrossPathView", __cEmpty , __cEmpty );
}
testcase Tt4h42sqi_Tc83()
{
  stack long __tableHandle;
  SetBreakOnFail(1);

  TestCommandBegin(__eSet, __cSet, "", "0");
  {
    __tableHandle = ReportTableHead3Columns(__cSetCaption , __cTSym, __cTOp, __cAssigned); 
    {
      $`FDCAN2::dbNode::`SGW::`TELEMATIC_FD_5::`CameraDisplaySts2.phys = 13;
      snprintf(__cArray, 8192, "%s", "CameraDisplaySts2");
      snprintf(__cArray2, 8192, "%s '%s'", __cCANSignal, __cArray);
      snprintf(__cArray3, 8192, "%s", "");
      
      ReportSetLValueOrSignalNotOnline(getSignalTime(`FDCAN2::dbNode::`SGW::`TELEMATIC_FD_5::`CameraDisplaySts2), __cArray2, __cArray4, 8192);
      ReportTableRow(__tableHandle, 0, __cArray4, __cAOp, 13, __cArray3, __oneOfFlag, __bSetInCheckAlignment);
      
  
    }
    ReportTableEndTestStep(__tableHandle, "1");
  }
  TestCommandEnd();


  TestCommandBegin(__eWait, __cWait, "", "1");
  {
    Wait("1", (1000 * 1000000LL), 1000000, "");
  }
  TestCommandEnd();

  TestCommandBegin(__eCheck, __cCheck, "", "2");
  {
    __bVerdict = __eVerdictPass;
    __tableHandle = ReportTableHead5Columns(__cCheckCaption, __cTSym, __cTOp, __cRefVal, __cActual, __cRes);
    {
      {
        int __res1,__res2;
        __res1 = CheckSignalMatch(`FDCAN2::dbNode::`CVADAS::`CVPAM_FD_Info::`DisplayView2, 1, __cGreaterEqualThan) == 1;
        __res2 = CheckSignalMatch(`FDCAN2::dbNode::`CVADAS::`CVPAM_FD_Info::`DisplayView2, 15, __cLessEqualThan) == 1;
        __csr = __res1 && __res2;
        snprintf(__cArray, 8192, "%s", "DisplayView2");
        snprintf(__cArray2, 8192, "%s '%s'", __cCANSignal, __cArray);
        snprintf(__cArray3, 8192, "%s", "");
        snprintf(__cArray4, 8192, "%s", "");
        snprintf(__cArray5, 8192, "%s", __cArray3);
        snprintf(__cArray6, 8192, "%s", __cArray4);
        ReportRange(1, 15, __cArray5, __cArray6, __cArray7, 8192);
        ReportTableRow(__tableHandle, 0, __cArray2, __cRange, __cArray7, __cEmpty, __oneOfFlag, __bSetInCheckAlignment);
        ReportLValueOrSignalNotOnline(`FDCAN2::dbNode::`CVADAS::`CVPAM_FD_Info::`DisplayView2, __cArray8, 8192);
        ReportCell(__tableHandle, __cArray8);
        ReportCellResult(__tableHandle, __csr, __ePassFail);
      }
  
      __bVerdict = __bVerdict && __csr;
    }
    ReportTableEndVerdict(__tableHandle, "1", __bVerdict);
  }
  TestCommandEnd();


}

void Tt4h42sqi_Tet_Tc84()
{
  CreateTTEIFFunction("Tt4h42sqi_Tc84", __eTcDef, __eLocal);  
  AddIFParameterTestCaseAttribute("TC_ID", "");
  AddIFParameterTestCaseAttribute("Test Case ID", "");
  CallInterfaceFunction("View 14: RearCrossPathView", __cEmpty , __cEmpty );
}
testcase Tt4h42sqi_Tc84()
{
  stack long __tableHandle;
  SetBreakOnFail(1);

  TestCommandBegin(__eSet, __cSet, "", "0");
  {
    __tableHandle = ReportTableHead3Columns(__cSetCaption , __cTSym, __cTOp, __cAssigned); 
    {
      $`FDCAN2::dbNode::`SGW::`TELEMATIC_FD_5::`CameraDisplaySts2.phys = 14;
      snprintf(__cArray, 8192, "%s", "CameraDisplaySts2");
      snprintf(__cArray2, 8192, "%s '%s'", __cCANSignal, __cArray);
      snprintf(__cArray3, 8192, "%s", "");
      
      ReportSetLValueOrSignalNotOnline(getSignalTime(`FDCAN2::dbNode::`SGW::`TELEMATIC_FD_5::`CameraDisplaySts2), __cArray2, __cArray4, 8192);
      ReportTableRow(__tableHandle, 0, __cArray4, __cAOp, 14, __cArray3, __oneOfFlag, __bSetInCheckAlignment);
      
  
    }
    ReportTableEndTestStep(__tableHandle, "1");
  }
  TestCommandEnd();


  TestCommandBegin(__eWait, __cWait, "", "1");
  {
    Wait("1", (1000 * 1000000LL), 1000000, "");
  }
  TestCommandEnd();

  TestCommandBegin(__eCheck, __cCheck, "", "2");
  {
    __bVerdict = __eVerdictPass;
    __tableHandle = ReportTableHead5Columns(__cCheckCaption, __cTSym, __cTOp, __cRefVal, __cActual, __cRes);
    {
      {
        int __res1,__res2;
        __res1 = CheckSignalMatch(`FDCAN2::dbNode::`CVADAS::`CVPAM_FD_Info::`DisplayView2, 1, __cGreaterEqualThan) == 1;
        __res2 = CheckSignalMatch(`FDCAN2::dbNode::`CVADAS::`CVPAM_FD_Info::`DisplayView2, 15, __cLessEqualThan) == 1;
        __csr = __res1 && __res2;
        snprintf(__cArray, 8192, "%s", "DisplayView2");
        snprintf(__cArray2, 8192, "%s '%s'", __cCANSignal, __cArray);
        snprintf(__cArray3, 8192, "%s", "");
        snprintf(__cArray4, 8192, "%s", "");
        snprintf(__cArray5, 8192, "%s", __cArray3);
        snprintf(__cArray6, 8192, "%s", __cArray4);
        ReportRange(1, 15, __cArray5, __cArray6, __cArray7, 8192);
        ReportTableRow(__tableHandle, 0, __cArray2, __cRange, __cArray7, __cEmpty, __oneOfFlag, __bSetInCheckAlignment);
        ReportLValueOrSignalNotOnline(`FDCAN2::dbNode::`CVADAS::`CVPAM_FD_Info::`DisplayView2, __cArray8, 8192);
        ReportCell(__tableHandle, __cArray8);
        ReportCellResult(__tableHandle, __csr, __ePassFail);
      }
  
      __bVerdict = __bVerdict && __csr;
    }
    ReportTableEndVerdict(__tableHandle, "1", __bVerdict);
  }
  TestCommandEnd();


}

void Tt4h42sqi_Tet_CaplTcCall6()
{
  stack long __tableHandle;
  CreateCaplIFFunction("Send_Proxi", __eTcDef);
  AddIFParameterTestCaseAttribute("TC_ID", "");
  AddIFParameterTestCaseAttribute("Test Case ID", "");
  AddIFParameterChar(syspar::`HD_Proxy_7);
  CallInterfaceFunction(__cEmpty , "", __cEmpty );
}

void Tt4h42sqi_Tet_Tc85()
{
  CreateTTEIFFunction("Tt4h42sqi_Tc85", __eTcDef, __eLocal);  
  AddIFParameterTestCaseAttribute("TC_ID", "");
  AddIFParameterTestCaseAttribute("Test Case ID", "");
  CallInterfaceFunction("Set to Surround View Camera", __cEmpty , __cEmpty );
}
testcase Tt4h42sqi_Tc85()
{
  stack long __tableHandle;
  SetBreakOnFail(1);

  TestPreparationBegin();
  {
  }
  TestPreparationEnd();

  TestCommandBegin(__eSet, __cSet, "", "0");
  {
    __tableHandle = ReportTableHead3Columns(__cSetCaption , __cTSym, __cTOp, __cAssigned); 
    {
      $`FDCAN2::dbNode::`SGW::`TELEMATIC_FD_14::`TGW_CAMERA_DISP_STAT.phys = 4;
      snprintf(__cArray, 8192, "%s", "TGW_CAMERA_DISP_STAT");
      snprintf(__cArray2, 8192, "%s '%s'", __cCANSignal, __cArray);
      snprintf(__cArray3, 8192, "%s", "");
      
      ReportSetLValueOrSignalNotOnline(getSignalTime(`FDCAN2::dbNode::`SGW::`TELEMATIC_FD_14::`TGW_CAMERA_DISP_STAT), __cArray2, __cArray4, 8192);
      ReportTableRow(__tableHandle, 0, __cArray4, __cAOp, 4, __cArray3, __oneOfFlag, __bSetInCheckAlignment);
      
  
    }
    {
      $`FDCAN2::dbNode::`SGW::`TELEMATIC_FD_5::`CameraDisplaySts2.phys = 0;
      snprintf(__cArray, 8192, "%s", "CameraDisplaySts2");
      snprintf(__cArray2, 8192, "%s '%s'", __cCANSignal, __cArray);
      snprintf(__cArray3, 8192, "%s", "Default");
      
      ReportSetLValueOrSignalNotOnline(getSignalTime(`FDCAN2::dbNode::`SGW::`TELEMATIC_FD_5::`CameraDisplaySts2), __cArray2, __cArray4, 8192);
      ReportTableRow(__tableHandle, 0, __cArray4, __cAOp, 0, __cArray3, __oneOfFlag, __bSetInCheckAlignment);
      
  
    }
    ReportTableEndTestStep(__tableHandle, "1");
  }
  TestCommandEnd();


  TestCommandBegin(__eWait, __cWait, "", "1");
  {
    Wait("1", (1000 * 1000000LL), 1000000, "");
  }
  TestCommandEnd();

  TestCommandBegin(__eCheck, __cCheck, "", "2");
  {
    __bVerdict = __eVerdictPass;
    __tableHandle = ReportTableHead5Columns(__cCheckCaption, __cTSym, __cTOp, __cRefVal, __cActual, __cRes);
    {
      {
        int __res1,__res2;
        __res1 = CheckSignalMatch(`FDCAN2::dbNode::`SGW::`TELEMATIC_FD_14::`TGW_CAMERA_DISP_STAT, 0, __cGreaterEqualThan) == 1;
        __res2 = CheckSignalMatch(`FDCAN2::dbNode::`SGW::`TELEMATIC_FD_14::`TGW_CAMERA_DISP_STAT, 4, __cLessEqualThan) == 1;
        __csr = __res1 && __res2;
        snprintf(__cArray, 8192, "%s", "TGW_CAMERA_DISP_STAT");
        snprintf(__cArray2, 8192, "%s '%s'", __cCANSignal, __cArray);
        snprintf(__cArray3, 8192, "%s", "");
        snprintf(__cArray4, 8192, "%s", "");
        snprintf(__cArray5, 8192, "%s", __cArray3);
        snprintf(__cArray6, 8192, "%s", __cArray4);
        ReportRange(0, 4, __cArray5, __cArray6, __cArray7, 8192);
        ReportTableRow(__tableHandle, 0, __cArray2, __cRange, __cArray7, __cEmpty, __oneOfFlag, __bSetInCheckAlignment);
        ReportLValueOrSignalNotOnline(`FDCAN2::dbNode::`SGW::`TELEMATIC_FD_14::`TGW_CAMERA_DISP_STAT, __cArray8, 8192);
        ReportCell(__tableHandle, __cArray8);
        ReportCellResult(__tableHandle, __csr, __ePassFail);
      }
  
      __bVerdict = __bVerdict && __csr;
    }
    ReportTableEndVerdict(__tableHandle, "1", __bVerdict);
  }
  TestCommandEnd();


  TestCommandBegin(__eWait, __cWait, "", "3");
  {
    Wait("1", (3000 * 1000000LL), 1000000, "");
  }
  TestCommandEnd();

}

void Tt4h42sqi_Tet_Tc86()
{
  CreateTTEIFFunction("Tt4h42sqi_Tc86", __eTcDef, __eLocal);  
  AddIFParameterTestCaseAttribute("TC_ID", "");
  AddIFParameterTestCaseAttribute("Test Case ID", "");
  CallInterfaceFunction("Default View", __cEmpty , __cEmpty );
}
testcase Tt4h42sqi_Tc86()
{
  stack long __tableHandle;
  SetBreakOnFail(1);

  TestCommandBegin(__eSet, __cSet, "", "0");
  {
    __tableHandle = ReportTableHead3Columns(__cSetCaption , __cTSym, __cTOp, __cAssigned); 
    {
      $`FDCAN2::dbNode::`SGW::`TELEMATIC_FD_5::`CameraDisplaySts2.phys = 2;
      snprintf(__cArray, 8192, "%s", "CameraDisplaySts2");
      snprintf(__cArray2, 8192, "%s '%s'", __cCANSignal, __cArray);
      snprintf(__cArray3, 8192, "%s", "");
      
      ReportSetLValueOrSignalNotOnline(getSignalTime(`FDCAN2::dbNode::`SGW::`TELEMATIC_FD_5::`CameraDisplaySts2), __cArray2, __cArray4, 8192);
      ReportTableRow(__tableHandle, 0, __cArray4, __cAOp, 2, __cArray3, __oneOfFlag, __bSetInCheckAlignment);
      
  
    }
    ReportTableEndTestStep(__tableHandle, "1");
  }
  TestCommandEnd();


  TestCommandBegin(__eWait, __cWait, "", "1");
  {
    Wait("1", (1000 * 1000000LL), 1000000, "");
  }
  TestCommandEnd();

  TestCommandBegin(__eSet, __cSet, "", "2");
  {
    __tableHandle = ReportTableHead3Columns(__cSetCaption , __cTSym, __cTOp, __cAssigned); 
    {
      $`FDCAN2::dbNode::`SGW::`TELEMATIC_FD_5::`CameraDisplaySts2.phys = 0;
      snprintf(__cArray, 8192, "%s", "CameraDisplaySts2");
      snprintf(__cArray2, 8192, "%s '%s'", __cCANSignal, __cArray);
      snprintf(__cArray3, 8192, "%s", "");
      
      ReportSetLValueOrSignalNotOnline(getSignalTime(`FDCAN2::dbNode::`SGW::`TELEMATIC_FD_5::`CameraDisplaySts2), __cArray2, __cArray4, 8192);
      ReportTableRow(__tableHandle, 0, __cArray4, __cAOp, 0, __cArray3, __oneOfFlag, __bSetInCheckAlignment);
      
  
    }
    ReportTableEndTestStep(__tableHandle, "1");
  }
  TestCommandEnd();


  TestCommandBegin(__eWait, __cWait, "", "3");
  {
    Wait("1", (1000 * 1000000LL), 1000000, "");
  }
  TestCommandEnd();

  TestCommandBegin(__eCheck, __cCheck, "", "4");
  {
    __bVerdict = __eVerdictPass;
    __tableHandle = ReportTableHead5Columns(__cCheckCaption, __cTSym, __cTOp, __cRefVal, __cActual, __cRes);
    {
      {
        int __res1,__res2;
        __res1 = CheckSignalMatch(`FDCAN2::dbNode::`CVADAS::`CVPAM_FD_Info::`DisplayView2, 1, __cGreaterEqualThan) == 1;
        __res2 = CheckSignalMatch(`FDCAN2::dbNode::`CVADAS::`CVPAM_FD_Info::`DisplayView2, 15, __cLessEqualThan) == 1;
        __csr = __res1 && __res2;
        snprintf(__cArray, 8192, "%s", "DisplayView2");
        snprintf(__cArray2, 8192, "%s '%s'", __cCANSignal, __cArray);
        snprintf(__cArray3, 8192, "%s", "");
        snprintf(__cArray4, 8192, "%s", "");
        snprintf(__cArray5, 8192, "%s", __cArray3);
        snprintf(__cArray6, 8192, "%s", __cArray4);
        ReportRange(1, 15, __cArray5, __cArray6, __cArray7, 8192);
        ReportTableRow(__tableHandle, 0, __cArray2, __cRange, __cArray7, __cEmpty, __oneOfFlag, __bSetInCheckAlignment);
        ReportLValueOrSignalNotOnline(`FDCAN2::dbNode::`CVADAS::`CVPAM_FD_Info::`DisplayView2, __cArray8, 8192);
        ReportCell(__tableHandle, __cArray8);
        ReportCellResult(__tableHandle, __csr, __ePassFail);
      }
  
      __bVerdict = __bVerdict && __csr;
    }
    ReportTableEndVerdict(__tableHandle, "1", __bVerdict);
  }
  TestCommandEnd();


}

void Tt4h42sqi_Tet_Tc87()
{
  CreateTTEIFFunction("Tt4h42sqi_Tc87", __eTcDef, __eLocal);  
  AddIFParameterTestCaseAttribute("TC_ID", "");
  AddIFParameterTestCaseAttribute("Test Case ID", "");
  CallInterfaceFunction("View 1: FVTV_RVTV", __cEmpty , __cEmpty );
}
testcase Tt4h42sqi_Tc87()
{
  stack long __tableHandle;
  SetBreakOnFail(1);

  TestCommandBegin(__eSet, __cSet, "", "0");
  {
    __tableHandle = ReportTableHead3Columns(__cSetCaption , __cTSym, __cTOp, __cAssigned); 
    {
      $`FDCAN2::dbNode::`SGW::`TELEMATIC_FD_5::`CameraDisplaySts2.phys = 1;
      snprintf(__cArray, 8192, "%s", "CameraDisplaySts2");
      snprintf(__cArray2, 8192, "%s '%s'", __cCANSignal, __cArray);
      snprintf(__cArray3, 8192, "%s", "");
      
      ReportSetLValueOrSignalNotOnline(getSignalTime(`FDCAN2::dbNode::`SGW::`TELEMATIC_FD_5::`CameraDisplaySts2), __cArray2, __cArray4, 8192);
      ReportTableRow(__tableHandle, 0, __cArray4, __cAOp, 1, __cArray3, __oneOfFlag, __bSetInCheckAlignment);
      
  
    }
    ReportTableEndTestStep(__tableHandle, "1");
  }
  TestCommandEnd();


  TestCommandBegin(__eWait, __cWait, "", "1");
  {
    Wait("1", (1000 * 1000000LL), 1000000, "");
  }
  TestCommandEnd();

  TestCommandBegin(__eCheck, __cCheck, "", "2");
  {
    __bVerdict = __eVerdictPass;
    __tableHandle = ReportTableHead5Columns(__cCheckCaption, __cTSym, __cTOp, __cRefVal, __cActual, __cRes);
    {
      {
        int __res1,__res2;
        __res1 = CheckSignalMatch(`FDCAN2::dbNode::`CVADAS::`CVPAM_FD_Info::`DisplayView2, 1, __cGreaterEqualThan) == 1;
        __res2 = CheckSignalMatch(`FDCAN2::dbNode::`CVADAS::`CVPAM_FD_Info::`DisplayView2, 15, __cLessEqualThan) == 1;
        __csr = __res1 && __res2;
        snprintf(__cArray, 8192, "%s", "DisplayView2");
        snprintf(__cArray2, 8192, "%s '%s'", __cCANSignal, __cArray);
        snprintf(__cArray3, 8192, "%s", "");
        snprintf(__cArray4, 8192, "%s", "");
        snprintf(__cArray5, 8192, "%s", __cArray3);
        snprintf(__cArray6, 8192, "%s", __cArray4);
        ReportRange(1, 15, __cArray5, __cArray6, __cArray7, 8192);
        ReportTableRow(__tableHandle, 0, __cArray2, __cRange, __cArray7, __cEmpty, __oneOfFlag, __bSetInCheckAlignment);
        ReportLValueOrSignalNotOnline(`FDCAN2::dbNode::`CVADAS::`CVPAM_FD_Info::`DisplayView2, __cArray8, 8192);
        ReportCell(__tableHandle, __cArray8);
        ReportCellResult(__tableHandle, __csr, __ePassFail);
      }
  
      __bVerdict = __bVerdict && __csr;
    }
    ReportTableEndVerdict(__tableHandle, "1", __bVerdict);
  }
  TestCommandEnd();


}

void Tt4h42sqi_Tet_Tc88()
{
  CreateTTEIFFunction("Tt4h42sqi_Tc88", __eTcDef, __eLocal);  
  AddIFParameterTestCaseAttribute("TC_ID", "");
  AddIFParameterTestCaseAttribute("Test Case ID", "");
  CallInterfaceFunction("View 2: BackupRearView", __cEmpty , __cEmpty );
}
testcase Tt4h42sqi_Tc88()
{
  stack long __tableHandle;
  SetBreakOnFail(1);

  TestCommandBegin(__eSet, __cSet, "", "0");
  {
    __tableHandle = ReportTableHead3Columns(__cSetCaption , __cTSym, __cTOp, __cAssigned); 
    {
      $`FDCAN2::dbNode::`SGW::`TELEMATIC_FD_5::`CameraDisplaySts2.phys = 2;
      snprintf(__cArray, 8192, "%s", "CameraDisplaySts2");
      snprintf(__cArray2, 8192, "%s '%s'", __cCANSignal, __cArray);
      snprintf(__cArray3, 8192, "%s", "");
      
      ReportSetLValueOrSignalNotOnline(getSignalTime(`FDCAN2::dbNode::`SGW::`TELEMATIC_FD_5::`CameraDisplaySts2), __cArray2, __cArray4, 8192);
      ReportTableRow(__tableHandle, 0, __cArray4, __cAOp, 2, __cArray3, __oneOfFlag, __bSetInCheckAlignment);
      
  
    }
    ReportTableEndTestStep(__tableHandle, "1");
  }
  TestCommandEnd();


  TestCommandBegin(__eWait, __cWait, "", "1");
  {
    Wait("1", (1000 * 1000000LL), 1000000, "");
  }
  TestCommandEnd();

  TestCommandBegin(__eCheck, __cCheck, "", "2");
  {
    __bVerdict = __eVerdictPass;
    __tableHandle = ReportTableHead5Columns(__cCheckCaption, __cTSym, __cTOp, __cRefVal, __cActual, __cRes);
    {
      {
        int __res1,__res2;
        __res1 = CheckSignalMatch(`FDCAN2::dbNode::`CVADAS::`CVPAM_FD_Info::`DisplayView2, 1, __cGreaterEqualThan) == 1;
        __res2 = CheckSignalMatch(`FDCAN2::dbNode::`CVADAS::`CVPAM_FD_Info::`DisplayView2, 15, __cLessEqualThan) == 1;
        __csr = __res1 && __res2;
        snprintf(__cArray, 8192, "%s", "DisplayView2");
        snprintf(__cArray2, 8192, "%s '%s'", __cCANSignal, __cArray);
        snprintf(__cArray3, 8192, "%s", "");
        snprintf(__cArray4, 8192, "%s", "");
        snprintf(__cArray5, 8192, "%s", __cArray3);
        snprintf(__cArray6, 8192, "%s", __cArray4);
        ReportRange(1, 15, __cArray5, __cArray6, __cArray7, 8192);
        ReportTableRow(__tableHandle, 0, __cArray2, __cRange, __cArray7, __cEmpty, __oneOfFlag, __bSetInCheckAlignment);
        ReportLValueOrSignalNotOnline(`FDCAN2::dbNode::`CVADAS::`CVPAM_FD_Info::`DisplayView2, __cArray8, 8192);
        ReportCell(__tableHandle, __cArray8);
        ReportCellResult(__tableHandle, __csr, __ePassFail);
      }
  
      __bVerdict = __bVerdict && __csr;
    }
    ReportTableEndVerdict(__tableHandle, "1", __bVerdict);
  }
  TestCommandEnd();


}

void Tt4h42sqi_Tet_Tc89()
{
  CreateTTEIFFunction("Tt4h42sqi_Tc89", __eTcDef, __eLocal);  
  AddIFParameterTestCaseAttribute("TC_ID", "");
  AddIFParameterTestCaseAttribute("Test Case ID", "");
  CallInterfaceFunction("View 3: Forward Facing Camera", __cEmpty , __cEmpty );
}
testcase Tt4h42sqi_Tc89()
{
  stack long __tableHandle;
  SetBreakOnFail(1);

  TestCommandBegin(__eSet, __cSet, "", "0");
  {
    __tableHandle = ReportTableHead3Columns(__cSetCaption , __cTSym, __cTOp, __cAssigned); 
    {
      $`FDCAN2::dbNode::`SGW::`TELEMATIC_FD_5::`CameraDisplaySts2.phys = 3;
      snprintf(__cArray, 8192, "%s", "CameraDisplaySts2");
      snprintf(__cArray2, 8192, "%s '%s'", __cCANSignal, __cArray);
      snprintf(__cArray3, 8192, "%s", "");
      
      ReportSetLValueOrSignalNotOnline(getSignalTime(`FDCAN2::dbNode::`SGW::`TELEMATIC_FD_5::`CameraDisplaySts2), __cArray2, __cArray4, 8192);
      ReportTableRow(__tableHandle, 0, __cArray4, __cAOp, 3, __cArray3, __oneOfFlag, __bSetInCheckAlignment);
      
  
    }
    ReportTableEndTestStep(__tableHandle, "1");
  }
  TestCommandEnd();


  TestCommandBegin(__eWait, __cWait, "", "1");
  {
    Wait("1", (1000 * 1000000LL), 1000000, "");
  }
  TestCommandEnd();

  TestCommandBegin(__eCheck, __cCheck, "", "2");
  {
    __bVerdict = __eVerdictPass;
    __tableHandle = ReportTableHead5Columns(__cCheckCaption, __cTSym, __cTOp, __cRefVal, __cActual, __cRes);
    {
      {
        int __res1,__res2;
        __res1 = CheckSignalMatch(`FDCAN2::dbNode::`CVADAS::`CVPAM_FD_Info::`DisplayView2, 1, __cGreaterEqualThan) == 1;
        __res2 = CheckSignalMatch(`FDCAN2::dbNode::`CVADAS::`CVPAM_FD_Info::`DisplayView2, 15, __cLessEqualThan) == 1;
        __csr = __res1 && __res2;
        snprintf(__cArray, 8192, "%s", "DisplayView2");
        snprintf(__cArray2, 8192, "%s '%s'", __cCANSignal, __cArray);
        snprintf(__cArray3, 8192, "%s", "");
        snprintf(__cArray4, 8192, "%s", "");
        snprintf(__cArray5, 8192, "%s", __cArray3);
        snprintf(__cArray6, 8192, "%s", __cArray4);
        ReportRange(1, 15, __cArray5, __cArray6, __cArray7, 8192);
        ReportTableRow(__tableHandle, 0, __cArray2, __cRange, __cArray7, __cEmpty, __oneOfFlag, __bSetInCheckAlignment);
        ReportLValueOrSignalNotOnline(`FDCAN2::dbNode::`CVADAS::`CVPAM_FD_Info::`DisplayView2, __cArray8, 8192);
        ReportCell(__tableHandle, __cArray8);
        ReportCellResult(__tableHandle, __csr, __ePassFail);
      }
  
      __bVerdict = __bVerdict && __csr;
    }
    ReportTableEndVerdict(__tableHandle, "1", __bVerdict);
  }
  TestCommandEnd();


}

void Tt4h42sqi_Tet_Tc90()
{
  CreateTTEIFFunction("Tt4h42sqi_Tc90", __eTcDef, __eLocal);  
  AddIFParameterTestCaseAttribute("TC_ID", "");
  AddIFParameterTestCaseAttribute("Test Case ID", "");
  CallInterfaceFunction("View 5: Trailer Reverse Guidance", __cEmpty , __cEmpty );
}
testcase Tt4h42sqi_Tc90()
{
  stack long __tableHandle;
  SetBreakOnFail(1);

  TestCommandBegin(__eSet, __cSet, "", "0");
  {
    __tableHandle = ReportTableHead3Columns(__cSetCaption , __cTSym, __cTOp, __cAssigned); 
    {
      $`FDCAN2::dbNode::`SGW::`TELEMATIC_FD_5::`CameraDisplaySts2.phys = 5;
      snprintf(__cArray, 8192, "%s", "CameraDisplaySts2");
      snprintf(__cArray2, 8192, "%s '%s'", __cCANSignal, __cArray);
      snprintf(__cArray3, 8192, "%s", "");
      
      ReportSetLValueOrSignalNotOnline(getSignalTime(`FDCAN2::dbNode::`SGW::`TELEMATIC_FD_5::`CameraDisplaySts2), __cArray2, __cArray4, 8192);
      ReportTableRow(__tableHandle, 0, __cArray4, __cAOp, 5, __cArray3, __oneOfFlag, __bSetInCheckAlignment);
      
  
    }
    ReportTableEndTestStep(__tableHandle, "1");
  }
  TestCommandEnd();


  TestCommandBegin(__eWait, __cWait, "", "1");
  {
    Wait("1", (1000 * 1000000LL), 1000000, "");
  }
  TestCommandEnd();

  TestCommandBegin(__eCheck, __cCheck, "", "2");
  {
    __bVerdict = __eVerdictPass;
    __tableHandle = ReportTableHead5Columns(__cCheckCaption, __cTSym, __cTOp, __cRefVal, __cActual, __cRes);
    {
      {
        int __res1,__res2;
        __res1 = CheckSignalMatch(`FDCAN2::dbNode::`CVADAS::`CVPAM_FD_Info::`DisplayView2, 1, __cGreaterEqualThan) == 1;
        __res2 = CheckSignalMatch(`FDCAN2::dbNode::`CVADAS::`CVPAM_FD_Info::`DisplayView2, 15, __cLessEqualThan) == 1;
        __csr = __res1 && __res2;
        snprintf(__cArray, 8192, "%s", "DisplayView2");
        snprintf(__cArray2, 8192, "%s '%s'", __cCANSignal, __cArray);
        snprintf(__cArray3, 8192, "%s", "");
        snprintf(__cArray4, 8192, "%s", "");
        snprintf(__cArray5, 8192, "%s", __cArray3);
        snprintf(__cArray6, 8192, "%s", __cArray4);
        ReportRange(1, 15, __cArray5, __cArray6, __cArray7, 8192);
        ReportTableRow(__tableHandle, 0, __cArray2, __cRange, __cArray7, __cEmpty, __oneOfFlag, __bSetInCheckAlignment);
        ReportLValueOrSignalNotOnline(`FDCAN2::dbNode::`CVADAS::`CVPAM_FD_Info::`DisplayView2, __cArray8, 8192);
        ReportCell(__tableHandle, __cArray8);
        ReportCellResult(__tableHandle, __csr, __ePassFail);
      }
  
      __bVerdict = __bVerdict && __csr;
    }
    ReportTableEndVerdict(__tableHandle, "1", __bVerdict);
  }
  TestCommandEnd();


}

void Tt4h42sqi_Tet_Tc91()
{
  CreateTTEIFFunction("Tt4h42sqi_Tc91", __eTcDef, __eLocal);  
  AddIFParameterTestCaseAttribute("TC_ID", "");
  AddIFParameterTestCaseAttribute("Test Case ID", "");
  CallInterfaceFunction("View 6: Trailer Left View", __cEmpty , __cEmpty );
}
testcase Tt4h42sqi_Tc91()
{
  stack long __tableHandle;
  SetBreakOnFail(1);

  TestCommandBegin(__eSet, __cSet, "", "0");
  {
    __tableHandle = ReportTableHead3Columns(__cSetCaption , __cTSym, __cTOp, __cAssigned); 
    {
      $`FDCAN2::dbNode::`SGW::`TELEMATIC_FD_5::`CameraDisplaySts2.phys = 6;
      snprintf(__cArray, 8192, "%s", "CameraDisplaySts2");
      snprintf(__cArray2, 8192, "%s '%s'", __cCANSignal, __cArray);
      snprintf(__cArray3, 8192, "%s", "");
      
      ReportSetLValueOrSignalNotOnline(getSignalTime(`FDCAN2::dbNode::`SGW::`TELEMATIC_FD_5::`CameraDisplaySts2), __cArray2, __cArray4, 8192);
      ReportTableRow(__tableHandle, 0, __cArray4, __cAOp, 6, __cArray3, __oneOfFlag, __bSetInCheckAlignment);
      
  
    }
    ReportTableEndTestStep(__tableHandle, "1");
  }
  TestCommandEnd();


  TestCommandBegin(__eWait, __cWait, "", "1");
  {
    Wait("1", (1000 * 1000000LL), 1000000, "");
  }
  TestCommandEnd();

  TestCommandBegin(__eCheck, __cCheck, "", "2");
  {
    __bVerdict = __eVerdictPass;
    __tableHandle = ReportTableHead5Columns(__cCheckCaption, __cTSym, __cTOp, __cRefVal, __cActual, __cRes);
    {
      {
        int __res1,__res2;
        __res1 = CheckSignalMatch(`FDCAN2::dbNode::`CVADAS::`CVPAM_FD_Info::`DisplayView2, 1, __cGreaterEqualThan) == 1;
        __res2 = CheckSignalMatch(`FDCAN2::dbNode::`CVADAS::`CVPAM_FD_Info::`DisplayView2, 15, __cLessEqualThan) == 1;
        __csr = __res1 && __res2;
        snprintf(__cArray, 8192, "%s", "DisplayView2");
        snprintf(__cArray2, 8192, "%s '%s'", __cCANSignal, __cArray);
        snprintf(__cArray3, 8192, "%s", "");
        snprintf(__cArray4, 8192, "%s", "");
        snprintf(__cArray5, 8192, "%s", __cArray3);
        snprintf(__cArray6, 8192, "%s", __cArray4);
        ReportRange(1, 15, __cArray5, __cArray6, __cArray7, 8192);
        ReportTableRow(__tableHandle, 0, __cArray2, __cRange, __cArray7, __cEmpty, __oneOfFlag, __bSetInCheckAlignment);
        ReportLValueOrSignalNotOnline(`FDCAN2::dbNode::`CVADAS::`CVPAM_FD_Info::`DisplayView2, __cArray8, 8192);
        ReportCell(__tableHandle, __cArray8);
        ReportCellResult(__tableHandle, __csr, __ePassFail);
      }
  
      __bVerdict = __bVerdict && __csr;
    }
    ReportTableEndVerdict(__tableHandle, "1", __bVerdict);
  }
  TestCommandEnd();


}

void Tt4h42sqi_Tet_Tc92()
{
  CreateTTEIFFunction("Tt4h42sqi_Tc92", __eTcDef, __eLocal);  
  AddIFParameterTestCaseAttribute("TC_ID", "");
  AddIFParameterTestCaseAttribute("Test Case ID", "");
  CallInterfaceFunction("View 7: Trailer Right View", __cEmpty , __cEmpty );
}
testcase Tt4h42sqi_Tc92()
{
  stack long __tableHandle;
  SetBreakOnFail(1);

  TestCommandBegin(__eSet, __cSet, "", "0");
  {
    __tableHandle = ReportTableHead3Columns(__cSetCaption , __cTSym, __cTOp, __cAssigned); 
    {
      $`FDCAN2::dbNode::`SGW::`TELEMATIC_FD_5::`CameraDisplaySts2.phys = 7;
      snprintf(__cArray, 8192, "%s", "CameraDisplaySts2");
      snprintf(__cArray2, 8192, "%s '%s'", __cCANSignal, __cArray);
      snprintf(__cArray3, 8192, "%s", "");
      
      ReportSetLValueOrSignalNotOnline(getSignalTime(`FDCAN2::dbNode::`SGW::`TELEMATIC_FD_5::`CameraDisplaySts2), __cArray2, __cArray4, 8192);
      ReportTableRow(__tableHandle, 0, __cArray4, __cAOp, 7, __cArray3, __oneOfFlag, __bSetInCheckAlignment);
      
  
    }
    ReportTableEndTestStep(__tableHandle, "1");
  }
  TestCommandEnd();


  TestCommandBegin(__eWait, __cWait, "", "1");
  {
    Wait("1", (1000 * 1000000LL), 1000000, "");
  }
  TestCommandEnd();

  TestCommandBegin(__eCheck, __cCheck, "", "2");
  {
    __bVerdict = __eVerdictPass;
    __tableHandle = ReportTableHead5Columns(__cCheckCaption, __cTSym, __cTOp, __cRefVal, __cActual, __cRes);
    {
      {
        int __res1,__res2;
        __res1 = CheckSignalMatch(`FDCAN2::dbNode::`CVADAS::`CVPAM_FD_Info::`DisplayView2, 1, __cGreaterEqualThan) == 1;
        __res2 = CheckSignalMatch(`FDCAN2::dbNode::`CVADAS::`CVPAM_FD_Info::`DisplayView2, 15, __cLessEqualThan) == 1;
        __csr = __res1 && __res2;
        snprintf(__cArray, 8192, "%s", "DisplayView2");
        snprintf(__cArray2, 8192, "%s '%s'", __cCANSignal, __cArray);
        snprintf(__cArray3, 8192, "%s", "");
        snprintf(__cArray4, 8192, "%s", "");
        snprintf(__cArray5, 8192, "%s", __cArray3);
        snprintf(__cArray6, 8192, "%s", __cArray4);
        ReportRange(1, 15, __cArray5, __cArray6, __cArray7, 8192);
        ReportTableRow(__tableHandle, 0, __cArray2, __cRange, __cArray7, __cEmpty, __oneOfFlag, __bSetInCheckAlignment);
        ReportLValueOrSignalNotOnline(`FDCAN2::dbNode::`CVADAS::`CVPAM_FD_Info::`DisplayView2, __cArray8, 8192);
        ReportCell(__tableHandle, __cArray8);
        ReportCellResult(__tableHandle, __csr, __ePassFail);
      }
  
      __bVerdict = __bVerdict && __csr;
    }
    ReportTableEndVerdict(__tableHandle, "1", __bVerdict);
  }
  TestCommandEnd();


}

void Tt4h42sqi_Tet_Tc93()
{
  CreateTTEIFFunction("Tt4h42sqi_Tc93", __eTcDef, __eLocal);  
  AddIFParameterTestCaseAttribute("TC_ID", "");
  AddIFParameterTestCaseAttribute("Test Case ID", "");
  CallInterfaceFunction("View 8: Blind Spot Left View", __cEmpty , __cEmpty );
}
testcase Tt4h42sqi_Tc93()
{
  stack long __tableHandle;
  SetBreakOnFail(1);

  TestCommandBegin(__eSet, __cSet, "", "0");
  {
    __tableHandle = ReportTableHead3Columns(__cSetCaption , __cTSym, __cTOp, __cAssigned); 
    {
      $`FDCAN2::dbNode::`SGW::`TELEMATIC_FD_5::`CameraDisplaySts2.phys = 8;
      snprintf(__cArray, 8192, "%s", "CameraDisplaySts2");
      snprintf(__cArray2, 8192, "%s '%s'", __cCANSignal, __cArray);
      snprintf(__cArray3, 8192, "%s", "");
      
      ReportSetLValueOrSignalNotOnline(getSignalTime(`FDCAN2::dbNode::`SGW::`TELEMATIC_FD_5::`CameraDisplaySts2), __cArray2, __cArray4, 8192);
      ReportTableRow(__tableHandle, 0, __cArray4, __cAOp, 8, __cArray3, __oneOfFlag, __bSetInCheckAlignment);
      
  
    }
    ReportTableEndTestStep(__tableHandle, "1");
  }
  TestCommandEnd();


  TestCommandBegin(__eWait, __cWait, "", "1");
  {
    Wait("1", (1000 * 1000000LL), 1000000, "");
  }
  TestCommandEnd();

  TestCommandBegin(__eCheck, __cCheck, "", "2");
  {
    __bVerdict = __eVerdictPass;
    __tableHandle = ReportTableHead5Columns(__cCheckCaption, __cTSym, __cTOp, __cRefVal, __cActual, __cRes);
    {
      {
        int __res1,__res2;
        __res1 = CheckSignalMatch(`FDCAN2::dbNode::`CVADAS::`CVPAM_FD_Info::`DisplayView2, 2, __cGreaterEqualThan) == 1;
        __res2 = CheckSignalMatch(`FDCAN2::dbNode::`CVADAS::`CVPAM_FD_Info::`DisplayView2, 10, __cLessEqualThan) == 1;
        __csr = __res1 && __res2;
        snprintf(__cArray, 8192, "%s", "DisplayView2");
        snprintf(__cArray2, 8192, "%s '%s'", __cCANSignal, __cArray);
        snprintf(__cArray3, 8192, "%s", "");
        snprintf(__cArray4, 8192, "%s", "");
        snprintf(__cArray5, 8192, "%s", __cArray3);
        snprintf(__cArray6, 8192, "%s", __cArray4);
        ReportRange(2, 10, __cArray5, __cArray6, __cArray7, 8192);
        ReportTableRow(__tableHandle, 0, __cArray2, __cRange, __cArray7, __cEmpty, __oneOfFlag, __bSetInCheckAlignment);
        ReportLValueOrSignalNotOnline(`FDCAN2::dbNode::`CVADAS::`CVPAM_FD_Info::`DisplayView2, __cArray8, 8192);
        ReportCell(__tableHandle, __cArray8);
        ReportCellResult(__tableHandle, __csr, __ePassFail);
      }
  
      __bVerdict = __bVerdict && __csr;
    }
    ReportTableEndVerdict(__tableHandle, "1", __bVerdict);
  }
  TestCommandEnd();


}

void Tt4h42sqi_Tet_Tc94()
{
  CreateTTEIFFunction("Tt4h42sqi_Tc94", __eTcDef, __eLocal);  
  AddIFParameterTestCaseAttribute("TC_ID", "");
  AddIFParameterTestCaseAttribute("Test Case ID", "");
  CallInterfaceFunction("View 9: Blind Spot Right View", __cEmpty , __cEmpty );
}
testcase Tt4h42sqi_Tc94()
{
  stack long __tableHandle;
  SetBreakOnFail(1);

  TestCommandBegin(__eSet, __cSet, "", "0");
  {
    __tableHandle = ReportTableHead3Columns(__cSetCaption , __cTSym, __cTOp, __cAssigned); 
    {
      $`FDCAN2::dbNode::`SGW::`TELEMATIC_FD_5::`CameraDisplaySts2.phys = 9;
      snprintf(__cArray, 8192, "%s", "CameraDisplaySts2");
      snprintf(__cArray2, 8192, "%s '%s'", __cCANSignal, __cArray);
      snprintf(__cArray3, 8192, "%s", "");
      
      ReportSetLValueOrSignalNotOnline(getSignalTime(`FDCAN2::dbNode::`SGW::`TELEMATIC_FD_5::`CameraDisplaySts2), __cArray2, __cArray4, 8192);
      ReportTableRow(__tableHandle, 0, __cArray4, __cAOp, 9, __cArray3, __oneOfFlag, __bSetInCheckAlignment);
      
  
    }
    ReportTableEndTestStep(__tableHandle, "1");
  }
  TestCommandEnd();


  TestCommandBegin(__eWait, __cWait, "", "1");
  {
    Wait("1", (1000 * 1000000LL), 1000000, "");
  }
  TestCommandEnd();

  TestCommandBegin(__eCheck, __cCheck, "", "2");
  {
    __bVerdict = __eVerdictPass;
    __tableHandle = ReportTableHead5Columns(__cCheckCaption, __cTSym, __cTOp, __cRefVal, __cActual, __cRes);
    {
      {
        int __res1,__res2;
        __res1 = CheckSignalMatch(`FDCAN2::dbNode::`CVADAS::`CVPAM_FD_Info::`DisplayView2, 2, __cGreaterEqualThan) == 1;
        __res2 = CheckSignalMatch(`FDCAN2::dbNode::`CVADAS::`CVPAM_FD_Info::`DisplayView2, 15, __cLessEqualThan) == 1;
        __csr = __res1 && __res2;
        snprintf(__cArray, 8192, "%s", "DisplayView2");
        snprintf(__cArray2, 8192, "%s '%s'", __cCANSignal, __cArray);
        snprintf(__cArray3, 8192, "%s", "");
        snprintf(__cArray4, 8192, "%s", "");
        snprintf(__cArray5, 8192, "%s", __cArray3);
        snprintf(__cArray6, 8192, "%s", __cArray4);
        ReportRange(2, 15, __cArray5, __cArray6, __cArray7, 8192);
        ReportTableRow(__tableHandle, 0, __cArray2, __cRange, __cArray7, __cEmpty, __oneOfFlag, __bSetInCheckAlignment);
        ReportLValueOrSignalNotOnline(`FDCAN2::dbNode::`CVADAS::`CVPAM_FD_Info::`DisplayView2, __cArray8, 8192);
        ReportCell(__tableHandle, __cArray8);
        ReportCellResult(__tableHandle, __csr, __ePassFail);
      }
  
      __bVerdict = __bVerdict && __csr;
    }
    ReportTableEndVerdict(__tableHandle, "1", __bVerdict);
  }
  TestCommandEnd();


}

void Tt4h42sqi_Tet_Tc95()
{
  CreateTTEIFFunction("Tt4h42sqi_Tc95", __eTcDef, __eLocal);  
  AddIFParameterTestCaseAttribute("TC_ID", "");
  AddIFParameterTestCaseAttribute("Test Case ID", "");
  CallInterfaceFunction("View 11: FVTV", __cEmpty , __cEmpty );
}
testcase Tt4h42sqi_Tc95()
{
  stack long __tableHandle;
  SetBreakOnFail(1);

  TestCommandBegin(__eSet, __cSet, "", "0");
  {
    __tableHandle = ReportTableHead3Columns(__cSetCaption , __cTSym, __cTOp, __cAssigned); 
    {
      $`FDCAN2::dbNode::`SGW::`TELEMATIC_FD_5::`CameraDisplaySts2.phys = 11;
      snprintf(__cArray, 8192, "%s", "CameraDisplaySts2");
      snprintf(__cArray2, 8192, "%s '%s'", __cCANSignal, __cArray);
      snprintf(__cArray3, 8192, "%s", "");
      
      ReportSetLValueOrSignalNotOnline(getSignalTime(`FDCAN2::dbNode::`SGW::`TELEMATIC_FD_5::`CameraDisplaySts2), __cArray2, __cArray4, 8192);
      ReportTableRow(__tableHandle, 0, __cArray4, __cAOp, 11, __cArray3, __oneOfFlag, __bSetInCheckAlignment);
      
  
    }
    ReportTableEndTestStep(__tableHandle, "1");
  }
  TestCommandEnd();


  TestCommandBegin(__eWait, __cWait, "", "1");
  {
    Wait("1", (1000 * 1000000LL), 1000000, "");
  }
  TestCommandEnd();

  TestCommandBegin(__eCheck, __cCheck, "", "2");
  {
    __bVerdict = __eVerdictPass;
    __tableHandle = ReportTableHead5Columns(__cCheckCaption, __cTSym, __cTOp, __cRefVal, __cActual, __cRes);
    {
      {
        int __res1,__res2;
        __res1 = CheckSignalMatch(`FDCAN2::dbNode::`CVADAS::`CVPAM_FD_Info::`DisplayView2, 1, __cGreaterEqualThan) == 1;
        __res2 = CheckSignalMatch(`FDCAN2::dbNode::`CVADAS::`CVPAM_FD_Info::`DisplayView2, 15, __cLessEqualThan) == 1;
        __csr = __res1 && __res2;
        snprintf(__cArray, 8192, "%s", "DisplayView2");
        snprintf(__cArray2, 8192, "%s '%s'", __cCANSignal, __cArray);
        snprintf(__cArray3, 8192, "%s", "");
        snprintf(__cArray4, 8192, "%s", "");
        snprintf(__cArray5, 8192, "%s", __cArray3);
        snprintf(__cArray6, 8192, "%s", __cArray4);
        ReportRange(1, 15, __cArray5, __cArray6, __cArray7, 8192);
        ReportTableRow(__tableHandle, 0, __cArray2, __cRange, __cArray7, __cEmpty, __oneOfFlag, __bSetInCheckAlignment);
        ReportLValueOrSignalNotOnline(`FDCAN2::dbNode::`CVADAS::`CVPAM_FD_Info::`DisplayView2, __cArray8, 8192);
        ReportCell(__tableHandle, __cArray8);
        ReportCellResult(__tableHandle, __csr, __ePassFail);
      }
  
      __bVerdict = __bVerdict && __csr;
    }
    ReportTableEndVerdict(__tableHandle, "1", __bVerdict);
  }
  TestCommandEnd();


}

void Tt4h42sqi_Tet_Tc96()
{
  CreateTTEIFFunction("Tt4h42sqi_Tc96", __eTcDef, __eLocal);  
  AddIFParameterTestCaseAttribute("TC_ID", "");
  AddIFParameterTestCaseAttribute("Test Case ID", "");
  CallInterfaceFunction("View 12: RVTV", __cEmpty , __cEmpty );
}
testcase Tt4h42sqi_Tc96()
{
  stack long __tableHandle;
  SetBreakOnFail(1);

  TestCommandBegin(__eSet, __cSet, "", "0");
  {
    __tableHandle = ReportTableHead3Columns(__cSetCaption , __cTSym, __cTOp, __cAssigned); 
    {
      $`FDCAN2::dbNode::`SGW::`TELEMATIC_FD_5::`CameraDisplaySts2.phys = 12;
      snprintf(__cArray, 8192, "%s", "CameraDisplaySts2");
      snprintf(__cArray2, 8192, "%s '%s'", __cCANSignal, __cArray);
      snprintf(__cArray3, 8192, "%s", "");
      
      ReportSetLValueOrSignalNotOnline(getSignalTime(`FDCAN2::dbNode::`SGW::`TELEMATIC_FD_5::`CameraDisplaySts2), __cArray2, __cArray4, 8192);
      ReportTableRow(__tableHandle, 0, __cArray4, __cAOp, 12, __cArray3, __oneOfFlag, __bSetInCheckAlignment);
      
  
    }
    ReportTableEndTestStep(__tableHandle, "1");
  }
  TestCommandEnd();


  TestCommandBegin(__eWait, __cWait, "", "1");
  {
    Wait("1", (1000 * 1000000LL), 1000000, "");
  }
  TestCommandEnd();

  TestCommandBegin(__eCheck, __cCheck, "", "2");
  {
    __bVerdict = __eVerdictPass;
    __tableHandle = ReportTableHead5Columns(__cCheckCaption, __cTSym, __cTOp, __cRefVal, __cActual, __cRes);
    {
      {
        int __res1,__res2;
        __res1 = CheckSignalMatch(`FDCAN2::dbNode::`CVADAS::`CVPAM_FD_Info::`DisplayView2, 1, __cGreaterEqualThan) == 1;
        __res2 = CheckSignalMatch(`FDCAN2::dbNode::`CVADAS::`CVPAM_FD_Info::`DisplayView2, 15, __cLessEqualThan) == 1;
        __csr = __res1 && __res2;
        snprintf(__cArray, 8192, "%s", "DisplayView2");
        snprintf(__cArray2, 8192, "%s '%s'", __cCANSignal, __cArray);
        snprintf(__cArray3, 8192, "%s", "");
        snprintf(__cArray4, 8192, "%s", "");
        snprintf(__cArray5, 8192, "%s", __cArray3);
        snprintf(__cArray6, 8192, "%s", __cArray4);
        ReportRange(1, 15, __cArray5, __cArray6, __cArray7, 8192);
        ReportTableRow(__tableHandle, 0, __cArray2, __cRange, __cArray7, __cEmpty, __oneOfFlag, __bSetInCheckAlignment);
        ReportLValueOrSignalNotOnline(`FDCAN2::dbNode::`CVADAS::`CVPAM_FD_Info::`DisplayView2, __cArray8, 8192);
        ReportCell(__tableHandle, __cArray8);
        ReportCellResult(__tableHandle, __csr, __ePassFail);
      }
  
      __bVerdict = __bVerdict && __csr;
    }
    ReportTableEndVerdict(__tableHandle, "1", __bVerdict);
  }
  TestCommandEnd();


}

void Tt4h42sqi_Tet_Tc97()
{
  CreateTTEIFFunction("Tt4h42sqi_Tc97", __eTcDef, __eLocal);  
  AddIFParameterTestCaseAttribute("TC_ID", "");
  AddIFParameterTestCaseAttribute("Test Case ID", "");
  CallInterfaceFunction("View 13: FrontCrossPathView", __cEmpty , __cEmpty );
}
testcase Tt4h42sqi_Tc97()
{
  stack long __tableHandle;
  SetBreakOnFail(1);

  TestCommandBegin(__eSet, __cSet, "", "0");
  {
    __tableHandle = ReportTableHead3Columns(__cSetCaption , __cTSym, __cTOp, __cAssigned); 
    {
      $`FDCAN2::dbNode::`SGW::`TELEMATIC_FD_5::`CameraDisplaySts2.phys = 13;
      snprintf(__cArray, 8192, "%s", "CameraDisplaySts2");
      snprintf(__cArray2, 8192, "%s '%s'", __cCANSignal, __cArray);
      snprintf(__cArray3, 8192, "%s", "");
      
      ReportSetLValueOrSignalNotOnline(getSignalTime(`FDCAN2::dbNode::`SGW::`TELEMATIC_FD_5::`CameraDisplaySts2), __cArray2, __cArray4, 8192);
      ReportTableRow(__tableHandle, 0, __cArray4, __cAOp, 13, __cArray3, __oneOfFlag, __bSetInCheckAlignment);
      
  
    }
    ReportTableEndTestStep(__tableHandle, "1");
  }
  TestCommandEnd();


  TestCommandBegin(__eWait, __cWait, "", "1");
  {
    Wait("1", (1000 * 1000000LL), 1000000, "");
  }
  TestCommandEnd();

  TestCommandBegin(__eCheck, __cCheck, "", "2");
  {
    __bVerdict = __eVerdictPass;
    __tableHandle = ReportTableHead5Columns(__cCheckCaption, __cTSym, __cTOp, __cRefVal, __cActual, __cRes);
    {
      {
        int __res1,__res2;
        __res1 = CheckSignalMatch(`FDCAN2::dbNode::`CVADAS::`CVPAM_FD_Info::`DisplayView2, 1, __cGreaterEqualThan) == 1;
        __res2 = CheckSignalMatch(`FDCAN2::dbNode::`CVADAS::`CVPAM_FD_Info::`DisplayView2, 15, __cLessEqualThan) == 1;
        __csr = __res1 && __res2;
        snprintf(__cArray, 8192, "%s", "DisplayView2");
        snprintf(__cArray2, 8192, "%s '%s'", __cCANSignal, __cArray);
        snprintf(__cArray3, 8192, "%s", "");
        snprintf(__cArray4, 8192, "%s", "");
        snprintf(__cArray5, 8192, "%s", __cArray3);
        snprintf(__cArray6, 8192, "%s", __cArray4);
        ReportRange(1, 15, __cArray5, __cArray6, __cArray7, 8192);
        ReportTableRow(__tableHandle, 0, __cArray2, __cRange, __cArray7, __cEmpty, __oneOfFlag, __bSetInCheckAlignment);
        ReportLValueOrSignalNotOnline(`FDCAN2::dbNode::`CVADAS::`CVPAM_FD_Info::`DisplayView2, __cArray8, 8192);
        ReportCell(__tableHandle, __cArray8);
        ReportCellResult(__tableHandle, __csr, __ePassFail);
      }
  
      __bVerdict = __bVerdict && __csr;
    }
    ReportTableEndVerdict(__tableHandle, "1", __bVerdict);
  }
  TestCommandEnd();


}

void Tt4h42sqi_Tet_Tc98()
{
  CreateTTEIFFunction("Tt4h42sqi_Tc98", __eTcDef, __eLocal);  
  AddIFParameterTestCaseAttribute("TC_ID", "");
  AddIFParameterTestCaseAttribute("Test Case ID", "");
  CallInterfaceFunction("View 14: RearCrossPathView", __cEmpty , __cEmpty );
}
testcase Tt4h42sqi_Tc98()
{
  stack long __tableHandle;
  SetBreakOnFail(1);

  TestCommandBegin(__eSet, __cSet, "", "0");
  {
    __tableHandle = ReportTableHead3Columns(__cSetCaption , __cTSym, __cTOp, __cAssigned); 
    {
      $`FDCAN2::dbNode::`SGW::`TELEMATIC_FD_5::`CameraDisplaySts2.phys = 14;
      snprintf(__cArray, 8192, "%s", "CameraDisplaySts2");
      snprintf(__cArray2, 8192, "%s '%s'", __cCANSignal, __cArray);
      snprintf(__cArray3, 8192, "%s", "");
      
      ReportSetLValueOrSignalNotOnline(getSignalTime(`FDCAN2::dbNode::`SGW::`TELEMATIC_FD_5::`CameraDisplaySts2), __cArray2, __cArray4, 8192);
      ReportTableRow(__tableHandle, 0, __cArray4, __cAOp, 14, __cArray3, __oneOfFlag, __bSetInCheckAlignment);
      
  
    }
    ReportTableEndTestStep(__tableHandle, "1");
  }
  TestCommandEnd();


  TestCommandBegin(__eWait, __cWait, "", "1");
  {
    Wait("1", (1000 * 1000000LL), 1000000, "");
  }
  TestCommandEnd();

  TestCommandBegin(__eCheck, __cCheck, "", "2");
  {
    __bVerdict = __eVerdictPass;
    __tableHandle = ReportTableHead5Columns(__cCheckCaption, __cTSym, __cTOp, __cRefVal, __cActual, __cRes);
    {
      {
        int __res1,__res2;
        __res1 = CheckSignalMatch(`FDCAN2::dbNode::`CVADAS::`CVPAM_FD_Info::`DisplayView2, 1, __cGreaterEqualThan) == 1;
        __res2 = CheckSignalMatch(`FDCAN2::dbNode::`CVADAS::`CVPAM_FD_Info::`DisplayView2, 15, __cLessEqualThan) == 1;
        __csr = __res1 && __res2;
        snprintf(__cArray, 8192, "%s", "DisplayView2");
        snprintf(__cArray2, 8192, "%s '%s'", __cCANSignal, __cArray);
        snprintf(__cArray3, 8192, "%s", "");
        snprintf(__cArray4, 8192, "%s", "");
        snprintf(__cArray5, 8192, "%s", __cArray3);
        snprintf(__cArray6, 8192, "%s", __cArray4);
        ReportRange(1, 15, __cArray5, __cArray6, __cArray7, 8192);
        ReportTableRow(__tableHandle, 0, __cArray2, __cRange, __cArray7, __cEmpty, __oneOfFlag, __bSetInCheckAlignment);
        ReportLValueOrSignalNotOnline(`FDCAN2::dbNode::`CVADAS::`CVPAM_FD_Info::`DisplayView2, __cArray8, 8192);
        ReportCell(__tableHandle, __cArray8);
        ReportCellResult(__tableHandle, __csr, __ePassFail);
      }
  
      __bVerdict = __bVerdict && __csr;
    }
    ReportTableEndVerdict(__tableHandle, "1", __bVerdict);
  }
  TestCommandEnd();


}

void Tt4h42sqi_Tet_CaplTcCall7()
{
  stack long __tableHandle;
  CreateCaplIFFunction("Send_Proxi", __eTcDef);
  AddIFParameterTestCaseAttribute("TC_ID", "");
  AddIFParameterTestCaseAttribute("Test Case ID", "");
  AddIFParameterChar(syspar::`HD_Proxy_8);
  CallInterfaceFunction(__cEmpty , "", __cEmpty );
}

void Tt4h42sqi_Tet_Tc99()
{
  CreateTTEIFFunction("Tt4h42sqi_Tc99", __eTcDef, __eLocal);  
  AddIFParameterTestCaseAttribute("TC_ID", "");
  AddIFParameterTestCaseAttribute("Test Case ID", "");
  CallInterfaceFunction("Set to Surround View Camera", __cEmpty , __cEmpty );
}
testcase Tt4h42sqi_Tc99()
{
  stack long __tableHandle;
  SetBreakOnFail(1);

  TestPreparationBegin();
  {
  }
  TestPreparationEnd();

  TestCommandBegin(__eSet, __cSet, "", "0");
  {
    __tableHandle = ReportTableHead3Columns(__cSetCaption , __cTSym, __cTOp, __cAssigned); 
    {
      $`FDCAN2::dbNode::`SGW::`TELEMATIC_FD_14::`TGW_CAMERA_DISP_STAT.phys = 4;
      snprintf(__cArray, 8192, "%s", "TGW_CAMERA_DISP_STAT");
      snprintf(__cArray2, 8192, "%s '%s'", __cCANSignal, __cArray);
      snprintf(__cArray3, 8192, "%s", "");
      
      ReportSetLValueOrSignalNotOnline(getSignalTime(`FDCAN2::dbNode::`SGW::`TELEMATIC_FD_14::`TGW_CAMERA_DISP_STAT), __cArray2, __cArray4, 8192);
      ReportTableRow(__tableHandle, 0, __cArray4, __cAOp, 4, __cArray3, __oneOfFlag, __bSetInCheckAlignment);
      
  
    }
    {
      $`FDCAN2::dbNode::`SGW::`TELEMATIC_FD_5::`CameraDisplaySts2.phys = 0;
      snprintf(__cArray, 8192, "%s", "CameraDisplaySts2");
      snprintf(__cArray2, 8192, "%s '%s'", __cCANSignal, __cArray);
      snprintf(__cArray3, 8192, "%s", "Default");
      
      ReportSetLValueOrSignalNotOnline(getSignalTime(`FDCAN2::dbNode::`SGW::`TELEMATIC_FD_5::`CameraDisplaySts2), __cArray2, __cArray4, 8192);
      ReportTableRow(__tableHandle, 0, __cArray4, __cAOp, 0, __cArray3, __oneOfFlag, __bSetInCheckAlignment);
      
  
    }
    ReportTableEndTestStep(__tableHandle, "1");
  }
  TestCommandEnd();


  TestCommandBegin(__eWait, __cWait, "", "1");
  {
    Wait("1", (1000 * 1000000LL), 1000000, "");
  }
  TestCommandEnd();

  TestCommandBegin(__eCheck, __cCheck, "", "2");
  {
    __bVerdict = __eVerdictPass;
    __tableHandle = ReportTableHead5Columns(__cCheckCaption, __cTSym, __cTOp, __cRefVal, __cActual, __cRes);
    {
      {
        int __res1,__res2;
        __res1 = CheckSignalMatch(`FDCAN2::dbNode::`SGW::`TELEMATIC_FD_14::`TGW_CAMERA_DISP_STAT, 0, __cGreaterEqualThan) == 1;
        __res2 = CheckSignalMatch(`FDCAN2::dbNode::`SGW::`TELEMATIC_FD_14::`TGW_CAMERA_DISP_STAT, 4, __cLessEqualThan) == 1;
        __csr = __res1 && __res2;
        snprintf(__cArray, 8192, "%s", "TGW_CAMERA_DISP_STAT");
        snprintf(__cArray2, 8192, "%s '%s'", __cCANSignal, __cArray);
        snprintf(__cArray3, 8192, "%s", "");
        snprintf(__cArray4, 8192, "%s", "");
        snprintf(__cArray5, 8192, "%s", __cArray3);
        snprintf(__cArray6, 8192, "%s", __cArray4);
        ReportRange(0, 4, __cArray5, __cArray6, __cArray7, 8192);
        ReportTableRow(__tableHandle, 0, __cArray2, __cRange, __cArray7, __cEmpty, __oneOfFlag, __bSetInCheckAlignment);
        ReportLValueOrSignalNotOnline(`FDCAN2::dbNode::`SGW::`TELEMATIC_FD_14::`TGW_CAMERA_DISP_STAT, __cArray8, 8192);
        ReportCell(__tableHandle, __cArray8);
        ReportCellResult(__tableHandle, __csr, __ePassFail);
      }
  
      __bVerdict = __bVerdict && __csr;
    }
    ReportTableEndVerdict(__tableHandle, "1", __bVerdict);
  }
  TestCommandEnd();


  TestCommandBegin(__eWait, __cWait, "", "3");
  {
    Wait("1", (3000 * 1000000LL), 1000000, "");
  }
  TestCommandEnd();

}

void Tt4h42sqi_Tet_Tc100()
{
  CreateTTEIFFunction("Tt4h42sqi_Tc100", __eTcDef, __eLocal);  
  AddIFParameterTestCaseAttribute("TC_ID", "");
  AddIFParameterTestCaseAttribute("Test Case ID", "");
  CallInterfaceFunction("Default View", __cEmpty , __cEmpty );
}
testcase Tt4h42sqi_Tc100()
{
  stack long __tableHandle;
  SetBreakOnFail(1);

  TestCommandBegin(__eSet, __cSet, "", "0");
  {
    __tableHandle = ReportTableHead3Columns(__cSetCaption , __cTSym, __cTOp, __cAssigned); 
    {
      $`FDCAN2::dbNode::`SGW::`TELEMATIC_FD_5::`CameraDisplaySts2.phys = 2;
      snprintf(__cArray, 8192, "%s", "CameraDisplaySts2");
      snprintf(__cArray2, 8192, "%s '%s'", __cCANSignal, __cArray);
      snprintf(__cArray3, 8192, "%s", "");
      
      ReportSetLValueOrSignalNotOnline(getSignalTime(`FDCAN2::dbNode::`SGW::`TELEMATIC_FD_5::`CameraDisplaySts2), __cArray2, __cArray4, 8192);
      ReportTableRow(__tableHandle, 0, __cArray4, __cAOp, 2, __cArray3, __oneOfFlag, __bSetInCheckAlignment);
      
  
    }
    ReportTableEndTestStep(__tableHandle, "1");
  }
  TestCommandEnd();


  TestCommandBegin(__eWait, __cWait, "", "1");
  {
    Wait("1", (1000 * 1000000LL), 1000000, "");
  }
  TestCommandEnd();

  TestCommandBegin(__eSet, __cSet, "", "2");
  {
    __tableHandle = ReportTableHead3Columns(__cSetCaption , __cTSym, __cTOp, __cAssigned); 
    {
      $`FDCAN2::dbNode::`SGW::`TELEMATIC_FD_5::`CameraDisplaySts2.phys = 0;
      snprintf(__cArray, 8192, "%s", "CameraDisplaySts2");
      snprintf(__cArray2, 8192, "%s '%s'", __cCANSignal, __cArray);
      snprintf(__cArray3, 8192, "%s", "");
      
      ReportSetLValueOrSignalNotOnline(getSignalTime(`FDCAN2::dbNode::`SGW::`TELEMATIC_FD_5::`CameraDisplaySts2), __cArray2, __cArray4, 8192);
      ReportTableRow(__tableHandle, 0, __cArray4, __cAOp, 0, __cArray3, __oneOfFlag, __bSetInCheckAlignment);
      
  
    }
    ReportTableEndTestStep(__tableHandle, "1");
  }
  TestCommandEnd();


  TestCommandBegin(__eWait, __cWait, "", "3");
  {
    Wait("1", (1000 * 1000000LL), 1000000, "");
  }
  TestCommandEnd();

  TestCommandBegin(__eCheck, __cCheck, "", "4");
  {
    __bVerdict = __eVerdictPass;
    __tableHandle = ReportTableHead5Columns(__cCheckCaption, __cTSym, __cTOp, __cRefVal, __cActual, __cRes);
    {
      {
        int __res1,__res2;
        __res1 = CheckSignalMatch(`FDCAN2::dbNode::`CVADAS::`CVPAM_FD_Info::`DisplayView2, 1, __cGreaterEqualThan) == 1;
        __res2 = CheckSignalMatch(`FDCAN2::dbNode::`CVADAS::`CVPAM_FD_Info::`DisplayView2, 15, __cLessEqualThan) == 1;
        __csr = __res1 && __res2;
        snprintf(__cArray, 8192, "%s", "DisplayView2");
        snprintf(__cArray2, 8192, "%s '%s'", __cCANSignal, __cArray);
        snprintf(__cArray3, 8192, "%s", "");
        snprintf(__cArray4, 8192, "%s", "");
        snprintf(__cArray5, 8192, "%s", __cArray3);
        snprintf(__cArray6, 8192, "%s", __cArray4);
        ReportRange(1, 15, __cArray5, __cArray6, __cArray7, 8192);
        ReportTableRow(__tableHandle, 0, __cArray2, __cRange, __cArray7, __cEmpty, __oneOfFlag, __bSetInCheckAlignment);
        ReportLValueOrSignalNotOnline(`FDCAN2::dbNode::`CVADAS::`CVPAM_FD_Info::`DisplayView2, __cArray8, 8192);
        ReportCell(__tableHandle, __cArray8);
        ReportCellResult(__tableHandle, __csr, __ePassFail);
      }
  
      __bVerdict = __bVerdict && __csr;
    }
    ReportTableEndVerdict(__tableHandle, "1", __bVerdict);
  }
  TestCommandEnd();


}

void Tt4h42sqi_Tet_Tc101()
{
  CreateTTEIFFunction("Tt4h42sqi_Tc101", __eTcDef, __eLocal);  
  AddIFParameterTestCaseAttribute("TC_ID", "");
  AddIFParameterTestCaseAttribute("Test Case ID", "");
  CallInterfaceFunction("View 1: FVTV_RVTV", __cEmpty , __cEmpty );
}
testcase Tt4h42sqi_Tc101()
{
  stack long __tableHandle;
  SetBreakOnFail(1);

  TestCommandBegin(__eSet, __cSet, "", "0");
  {
    __tableHandle = ReportTableHead3Columns(__cSetCaption , __cTSym, __cTOp, __cAssigned); 
    {
      $`FDCAN2::dbNode::`SGW::`TELEMATIC_FD_5::`CameraDisplaySts2.phys = 1;
      snprintf(__cArray, 8192, "%s", "CameraDisplaySts2");
      snprintf(__cArray2, 8192, "%s '%s'", __cCANSignal, __cArray);
      snprintf(__cArray3, 8192, "%s", "");
      
      ReportSetLValueOrSignalNotOnline(getSignalTime(`FDCAN2::dbNode::`SGW::`TELEMATIC_FD_5::`CameraDisplaySts2), __cArray2, __cArray4, 8192);
      ReportTableRow(__tableHandle, 0, __cArray4, __cAOp, 1, __cArray3, __oneOfFlag, __bSetInCheckAlignment);
      
  
    }
    ReportTableEndTestStep(__tableHandle, "1");
  }
  TestCommandEnd();


  TestCommandBegin(__eWait, __cWait, "", "1");
  {
    Wait("1", (1000 * 1000000LL), 1000000, "");
  }
  TestCommandEnd();

  TestCommandBegin(__eCheck, __cCheck, "", "2");
  {
    __bVerdict = __eVerdictPass;
    __tableHandle = ReportTableHead5Columns(__cCheckCaption, __cTSym, __cTOp, __cRefVal, __cActual, __cRes);
    {
      {
        int __res1,__res2;
        __res1 = CheckSignalMatch(`FDCAN2::dbNode::`CVADAS::`CVPAM_FD_Info::`DisplayView2, 1, __cGreaterEqualThan) == 1;
        __res2 = CheckSignalMatch(`FDCAN2::dbNode::`CVADAS::`CVPAM_FD_Info::`DisplayView2, 15, __cLessEqualThan) == 1;
        __csr = __res1 && __res2;
        snprintf(__cArray, 8192, "%s", "DisplayView2");
        snprintf(__cArray2, 8192, "%s '%s'", __cCANSignal, __cArray);
        snprintf(__cArray3, 8192, "%s", "");
        snprintf(__cArray4, 8192, "%s", "");
        snprintf(__cArray5, 8192, "%s", __cArray3);
        snprintf(__cArray6, 8192, "%s", __cArray4);
        ReportRange(1, 15, __cArray5, __cArray6, __cArray7, 8192);
        ReportTableRow(__tableHandle, 0, __cArray2, __cRange, __cArray7, __cEmpty, __oneOfFlag, __bSetInCheckAlignment);
        ReportLValueOrSignalNotOnline(`FDCAN2::dbNode::`CVADAS::`CVPAM_FD_Info::`DisplayView2, __cArray8, 8192);
        ReportCell(__tableHandle, __cArray8);
        ReportCellResult(__tableHandle, __csr, __ePassFail);
      }
  
      __bVerdict = __bVerdict && __csr;
    }
    ReportTableEndVerdict(__tableHandle, "1", __bVerdict);
  }
  TestCommandEnd();


}

void Tt4h42sqi_Tet_Tc102()
{
  CreateTTEIFFunction("Tt4h42sqi_Tc102", __eTcDef, __eLocal);  
  AddIFParameterTestCaseAttribute("TC_ID", "");
  AddIFParameterTestCaseAttribute("Test Case ID", "");
  CallInterfaceFunction("View 2: BackupRearView", __cEmpty , __cEmpty );
}
testcase Tt4h42sqi_Tc102()
{
  stack long __tableHandle;
  SetBreakOnFail(1);

  TestCommandBegin(__eSet, __cSet, "", "0");
  {
    __tableHandle = ReportTableHead3Columns(__cSetCaption , __cTSym, __cTOp, __cAssigned); 
    {
      $`FDCAN2::dbNode::`SGW::`TELEMATIC_FD_5::`CameraDisplaySts2.phys = 2;
      snprintf(__cArray, 8192, "%s", "CameraDisplaySts2");
      snprintf(__cArray2, 8192, "%s '%s'", __cCANSignal, __cArray);
      snprintf(__cArray3, 8192, "%s", "");
      
      ReportSetLValueOrSignalNotOnline(getSignalTime(`FDCAN2::dbNode::`SGW::`TELEMATIC_FD_5::`CameraDisplaySts2), __cArray2, __cArray4, 8192);
      ReportTableRow(__tableHandle, 0, __cArray4, __cAOp, 2, __cArray3, __oneOfFlag, __bSetInCheckAlignment);
      
  
    }
    ReportTableEndTestStep(__tableHandle, "1");
  }
  TestCommandEnd();


  TestCommandBegin(__eWait, __cWait, "", "1");
  {
    Wait("1", (1000 * 1000000LL), 1000000, "");
  }
  TestCommandEnd();

  TestCommandBegin(__eCheck, __cCheck, "", "2");
  {
    __bVerdict = __eVerdictPass;
    __tableHandle = ReportTableHead5Columns(__cCheckCaption, __cTSym, __cTOp, __cRefVal, __cActual, __cRes);
    {
      {
        int __res1,__res2;
        __res1 = CheckSignalMatch(`FDCAN2::dbNode::`CVADAS::`CVPAM_FD_Info::`DisplayView2, 1, __cGreaterEqualThan) == 1;
        __res2 = CheckSignalMatch(`FDCAN2::dbNode::`CVADAS::`CVPAM_FD_Info::`DisplayView2, 15, __cLessEqualThan) == 1;
        __csr = __res1 && __res2;
        snprintf(__cArray, 8192, "%s", "DisplayView2");
        snprintf(__cArray2, 8192, "%s '%s'", __cCANSignal, __cArray);
        snprintf(__cArray3, 8192, "%s", "");
        snprintf(__cArray4, 8192, "%s", "");
        snprintf(__cArray5, 8192, "%s", __cArray3);
        snprintf(__cArray6, 8192, "%s", __cArray4);
        ReportRange(1, 15, __cArray5, __cArray6, __cArray7, 8192);
        ReportTableRow(__tableHandle, 0, __cArray2, __cRange, __cArray7, __cEmpty, __oneOfFlag, __bSetInCheckAlignment);
        ReportLValueOrSignalNotOnline(`FDCAN2::dbNode::`CVADAS::`CVPAM_FD_Info::`DisplayView2, __cArray8, 8192);
        ReportCell(__tableHandle, __cArray8);
        ReportCellResult(__tableHandle, __csr, __ePassFail);
      }
  
      __bVerdict = __bVerdict && __csr;
    }
    ReportTableEndVerdict(__tableHandle, "1", __bVerdict);
  }
  TestCommandEnd();


}

void Tt4h42sqi_Tet_Tc103()
{
  CreateTTEIFFunction("Tt4h42sqi_Tc103", __eTcDef, __eLocal);  
  AddIFParameterTestCaseAttribute("TC_ID", "");
  AddIFParameterTestCaseAttribute("Test Case ID", "");
  CallInterfaceFunction("View 3: Forward Facing Camera", __cEmpty , __cEmpty );
}
testcase Tt4h42sqi_Tc103()
{
  stack long __tableHandle;
  SetBreakOnFail(1);

  TestCommandBegin(__eSet, __cSet, "", "0");
  {
    __tableHandle = ReportTableHead3Columns(__cSetCaption , __cTSym, __cTOp, __cAssigned); 
    {
      $`FDCAN2::dbNode::`SGW::`TELEMATIC_FD_5::`CameraDisplaySts2.phys = 3;
      snprintf(__cArray, 8192, "%s", "CameraDisplaySts2");
      snprintf(__cArray2, 8192, "%s '%s'", __cCANSignal, __cArray);
      snprintf(__cArray3, 8192, "%s", "");
      
      ReportSetLValueOrSignalNotOnline(getSignalTime(`FDCAN2::dbNode::`SGW::`TELEMATIC_FD_5::`CameraDisplaySts2), __cArray2, __cArray4, 8192);
      ReportTableRow(__tableHandle, 0, __cArray4, __cAOp, 3, __cArray3, __oneOfFlag, __bSetInCheckAlignment);
      
  
    }
    ReportTableEndTestStep(__tableHandle, "1");
  }
  TestCommandEnd();


  TestCommandBegin(__eWait, __cWait, "", "1");
  {
    Wait("1", (1000 * 1000000LL), 1000000, "");
  }
  TestCommandEnd();

  TestCommandBegin(__eCheck, __cCheck, "", "2");
  {
    __bVerdict = __eVerdictPass;
    __tableHandle = ReportTableHead5Columns(__cCheckCaption, __cTSym, __cTOp, __cRefVal, __cActual, __cRes);
    {
      {
        int __res1,__res2;
        __res1 = CheckSignalMatch(`FDCAN2::dbNode::`CVADAS::`CVPAM_FD_Info::`DisplayView2, 1, __cGreaterEqualThan) == 1;
        __res2 = CheckSignalMatch(`FDCAN2::dbNode::`CVADAS::`CVPAM_FD_Info::`DisplayView2, 15, __cLessEqualThan) == 1;
        __csr = __res1 && __res2;
        snprintf(__cArray, 8192, "%s", "DisplayView2");
        snprintf(__cArray2, 8192, "%s '%s'", __cCANSignal, __cArray);
        snprintf(__cArray3, 8192, "%s", "");
        snprintf(__cArray4, 8192, "%s", "");
        snprintf(__cArray5, 8192, "%s", __cArray3);
        snprintf(__cArray6, 8192, "%s", __cArray4);
        ReportRange(1, 15, __cArray5, __cArray6, __cArray7, 8192);
        ReportTableRow(__tableHandle, 0, __cArray2, __cRange, __cArray7, __cEmpty, __oneOfFlag, __bSetInCheckAlignment);
        ReportLValueOrSignalNotOnline(`FDCAN2::dbNode::`CVADAS::`CVPAM_FD_Info::`DisplayView2, __cArray8, 8192);
        ReportCell(__tableHandle, __cArray8);
        ReportCellResult(__tableHandle, __csr, __ePassFail);
      }
  
      __bVerdict = __bVerdict && __csr;
    }
    ReportTableEndVerdict(__tableHandle, "1", __bVerdict);
  }
  TestCommandEnd();


}

void Tt4h42sqi_Tet_Tc104()
{
  CreateTTEIFFunction("Tt4h42sqi_Tc104", __eTcDef, __eLocal);  
  AddIFParameterTestCaseAttribute("TC_ID", "");
  AddIFParameterTestCaseAttribute("Test Case ID", "");
  CallInterfaceFunction("View 5: Trailer Reverse Guidance", __cEmpty , __cEmpty );
}
testcase Tt4h42sqi_Tc104()
{
  stack long __tableHandle;
  SetBreakOnFail(1);

  TestCommandBegin(__eSet, __cSet, "", "0");
  {
    __tableHandle = ReportTableHead3Columns(__cSetCaption , __cTSym, __cTOp, __cAssigned); 
    {
      $`FDCAN2::dbNode::`SGW::`TELEMATIC_FD_5::`CameraDisplaySts2.phys = 5;
      snprintf(__cArray, 8192, "%s", "CameraDisplaySts2");
      snprintf(__cArray2, 8192, "%s '%s'", __cCANSignal, __cArray);
      snprintf(__cArray3, 8192, "%s", "");
      
      ReportSetLValueOrSignalNotOnline(getSignalTime(`FDCAN2::dbNode::`SGW::`TELEMATIC_FD_5::`CameraDisplaySts2), __cArray2, __cArray4, 8192);
      ReportTableRow(__tableHandle, 0, __cArray4, __cAOp, 5, __cArray3, __oneOfFlag, __bSetInCheckAlignment);
      
  
    }
    ReportTableEndTestStep(__tableHandle, "1");
  }
  TestCommandEnd();


  TestCommandBegin(__eWait, __cWait, "", "1");
  {
    Wait("1", (1000 * 1000000LL), 1000000, "");
  }
  TestCommandEnd();

  TestCommandBegin(__eCheck, __cCheck, "", "2");
  {
    __bVerdict = __eVerdictPass;
    __tableHandle = ReportTableHead5Columns(__cCheckCaption, __cTSym, __cTOp, __cRefVal, __cActual, __cRes);
    {
      {
        int __res1,__res2;
        __res1 = CheckSignalMatch(`FDCAN2::dbNode::`CVADAS::`CVPAM_FD_Info::`DisplayView2, 1, __cGreaterEqualThan) == 1;
        __res2 = CheckSignalMatch(`FDCAN2::dbNode::`CVADAS::`CVPAM_FD_Info::`DisplayView2, 15, __cLessEqualThan) == 1;
        __csr = __res1 && __res2;
        snprintf(__cArray, 8192, "%s", "DisplayView2");
        snprintf(__cArray2, 8192, "%s '%s'", __cCANSignal, __cArray);
        snprintf(__cArray3, 8192, "%s", "");
        snprintf(__cArray4, 8192, "%s", "");
        snprintf(__cArray5, 8192, "%s", __cArray3);
        snprintf(__cArray6, 8192, "%s", __cArray4);
        ReportRange(1, 15, __cArray5, __cArray6, __cArray7, 8192);
        ReportTableRow(__tableHandle, 0, __cArray2, __cRange, __cArray7, __cEmpty, __oneOfFlag, __bSetInCheckAlignment);
        ReportLValueOrSignalNotOnline(`FDCAN2::dbNode::`CVADAS::`CVPAM_FD_Info::`DisplayView2, __cArray8, 8192);
        ReportCell(__tableHandle, __cArray8);
        ReportCellResult(__tableHandle, __csr, __ePassFail);
      }
  
      __bVerdict = __bVerdict && __csr;
    }
    ReportTableEndVerdict(__tableHandle, "1", __bVerdict);
  }
  TestCommandEnd();


}

void Tt4h42sqi_Tet_Tc105()
{
  CreateTTEIFFunction("Tt4h42sqi_Tc105", __eTcDef, __eLocal);  
  AddIFParameterTestCaseAttribute("TC_ID", "");
  AddIFParameterTestCaseAttribute("Test Case ID", "");
  CallInterfaceFunction("View 6: Trailer Left View", __cEmpty , __cEmpty );
}
testcase Tt4h42sqi_Tc105()
{
  stack long __tableHandle;
  SetBreakOnFail(1);

  TestCommandBegin(__eSet, __cSet, "", "0");
  {
    __tableHandle = ReportTableHead3Columns(__cSetCaption , __cTSym, __cTOp, __cAssigned); 
    {
      $`FDCAN2::dbNode::`SGW::`TELEMATIC_FD_5::`CameraDisplaySts2.phys = 6;
      snprintf(__cArray, 8192, "%s", "CameraDisplaySts2");
      snprintf(__cArray2, 8192, "%s '%s'", __cCANSignal, __cArray);
      snprintf(__cArray3, 8192, "%s", "");
      
      ReportSetLValueOrSignalNotOnline(getSignalTime(`FDCAN2::dbNode::`SGW::`TELEMATIC_FD_5::`CameraDisplaySts2), __cArray2, __cArray4, 8192);
      ReportTableRow(__tableHandle, 0, __cArray4, __cAOp, 6, __cArray3, __oneOfFlag, __bSetInCheckAlignment);
      
  
    }
    ReportTableEndTestStep(__tableHandle, "1");
  }
  TestCommandEnd();


  TestCommandBegin(__eWait, __cWait, "", "1");
  {
    Wait("1", (1000 * 1000000LL), 1000000, "");
  }
  TestCommandEnd();

  TestCommandBegin(__eCheck, __cCheck, "", "2");
  {
    __bVerdict = __eVerdictPass;
    __tableHandle = ReportTableHead5Columns(__cCheckCaption, __cTSym, __cTOp, __cRefVal, __cActual, __cRes);
    {
      {
        int __res1,__res2;
        __res1 = CheckSignalMatch(`FDCAN2::dbNode::`CVADAS::`CVPAM_FD_Info::`DisplayView2, 1, __cGreaterEqualThan) == 1;
        __res2 = CheckSignalMatch(`FDCAN2::dbNode::`CVADAS::`CVPAM_FD_Info::`DisplayView2, 15, __cLessEqualThan) == 1;
        __csr = __res1 && __res2;
        snprintf(__cArray, 8192, "%s", "DisplayView2");
        snprintf(__cArray2, 8192, "%s '%s'", __cCANSignal, __cArray);
        snprintf(__cArray3, 8192, "%s", "");
        snprintf(__cArray4, 8192, "%s", "");
        snprintf(__cArray5, 8192, "%s", __cArray3);
        snprintf(__cArray6, 8192, "%s", __cArray4);
        ReportRange(1, 15, __cArray5, __cArray6, __cArray7, 8192);
        ReportTableRow(__tableHandle, 0, __cArray2, __cRange, __cArray7, __cEmpty, __oneOfFlag, __bSetInCheckAlignment);
        ReportLValueOrSignalNotOnline(`FDCAN2::dbNode::`CVADAS::`CVPAM_FD_Info::`DisplayView2, __cArray8, 8192);
        ReportCell(__tableHandle, __cArray8);
        ReportCellResult(__tableHandle, __csr, __ePassFail);
      }
  
      __bVerdict = __bVerdict && __csr;
    }
    ReportTableEndVerdict(__tableHandle, "1", __bVerdict);
  }
  TestCommandEnd();


}

void Tt4h42sqi_Tet_Tc106()
{
  CreateTTEIFFunction("Tt4h42sqi_Tc106", __eTcDef, __eLocal);  
  AddIFParameterTestCaseAttribute("TC_ID", "");
  AddIFParameterTestCaseAttribute("Test Case ID", "");
  CallInterfaceFunction("View 7: Trailer Right View", __cEmpty , __cEmpty );
}
testcase Tt4h42sqi_Tc106()
{
  stack long __tableHandle;
  SetBreakOnFail(1);

  TestCommandBegin(__eSet, __cSet, "", "0");
  {
    __tableHandle = ReportTableHead3Columns(__cSetCaption , __cTSym, __cTOp, __cAssigned); 
    {
      $`FDCAN2::dbNode::`SGW::`TELEMATIC_FD_5::`CameraDisplaySts2.phys = 7;
      snprintf(__cArray, 8192, "%s", "CameraDisplaySts2");
      snprintf(__cArray2, 8192, "%s '%s'", __cCANSignal, __cArray);
      snprintf(__cArray3, 8192, "%s", "");
      
      ReportSetLValueOrSignalNotOnline(getSignalTime(`FDCAN2::dbNode::`SGW::`TELEMATIC_FD_5::`CameraDisplaySts2), __cArray2, __cArray4, 8192);
      ReportTableRow(__tableHandle, 0, __cArray4, __cAOp, 7, __cArray3, __oneOfFlag, __bSetInCheckAlignment);
      
  
    }
    ReportTableEndTestStep(__tableHandle, "1");
  }
  TestCommandEnd();


  TestCommandBegin(__eWait, __cWait, "", "1");
  {
    Wait("1", (1000 * 1000000LL), 1000000, "");
  }
  TestCommandEnd();

  TestCommandBegin(__eCheck, __cCheck, "", "2");
  {
    __bVerdict = __eVerdictPass;
    __tableHandle = ReportTableHead5Columns(__cCheckCaption, __cTSym, __cTOp, __cRefVal, __cActual, __cRes);
    {
      {
        int __res1,__res2;
        __res1 = CheckSignalMatch(`FDCAN2::dbNode::`CVADAS::`CVPAM_FD_Info::`DisplayView2, 1, __cGreaterEqualThan) == 1;
        __res2 = CheckSignalMatch(`FDCAN2::dbNode::`CVADAS::`CVPAM_FD_Info::`DisplayView2, 15, __cLessEqualThan) == 1;
        __csr = __res1 && __res2;
        snprintf(__cArray, 8192, "%s", "DisplayView2");
        snprintf(__cArray2, 8192, "%s '%s'", __cCANSignal, __cArray);
        snprintf(__cArray3, 8192, "%s", "");
        snprintf(__cArray4, 8192, "%s", "");
        snprintf(__cArray5, 8192, "%s", __cArray3);
        snprintf(__cArray6, 8192, "%s", __cArray4);
        ReportRange(1, 15, __cArray5, __cArray6, __cArray7, 8192);
        ReportTableRow(__tableHandle, 0, __cArray2, __cRange, __cArray7, __cEmpty, __oneOfFlag, __bSetInCheckAlignment);
        ReportLValueOrSignalNotOnline(`FDCAN2::dbNode::`CVADAS::`CVPAM_FD_Info::`DisplayView2, __cArray8, 8192);
        ReportCell(__tableHandle, __cArray8);
        ReportCellResult(__tableHandle, __csr, __ePassFail);
      }
  
      __bVerdict = __bVerdict && __csr;
    }
    ReportTableEndVerdict(__tableHandle, "1", __bVerdict);
  }
  TestCommandEnd();


}

void Tt4h42sqi_Tet_Tc107()
{
  CreateTTEIFFunction("Tt4h42sqi_Tc107", __eTcDef, __eLocal);  
  AddIFParameterTestCaseAttribute("TC_ID", "");
  AddIFParameterTestCaseAttribute("Test Case ID", "");
  CallInterfaceFunction("View 8: Blind Spot Left View", __cEmpty , __cEmpty );
}
testcase Tt4h42sqi_Tc107()
{
  stack long __tableHandle;
  SetBreakOnFail(1);

  TestCommandBegin(__eSet, __cSet, "", "0");
  {
    __tableHandle = ReportTableHead3Columns(__cSetCaption , __cTSym, __cTOp, __cAssigned); 
    {
      $`FDCAN2::dbNode::`SGW::`TELEMATIC_FD_5::`CameraDisplaySts2.phys = 8;
      snprintf(__cArray, 8192, "%s", "CameraDisplaySts2");
      snprintf(__cArray2, 8192, "%s '%s'", __cCANSignal, __cArray);
      snprintf(__cArray3, 8192, "%s", "");
      
      ReportSetLValueOrSignalNotOnline(getSignalTime(`FDCAN2::dbNode::`SGW::`TELEMATIC_FD_5::`CameraDisplaySts2), __cArray2, __cArray4, 8192);
      ReportTableRow(__tableHandle, 0, __cArray4, __cAOp, 8, __cArray3, __oneOfFlag, __bSetInCheckAlignment);
      
  
    }
    ReportTableEndTestStep(__tableHandle, "1");
  }
  TestCommandEnd();


  TestCommandBegin(__eWait, __cWait, "", "1");
  {
    Wait("1", (1000 * 1000000LL), 1000000, "");
  }
  TestCommandEnd();

  TestCommandBegin(__eCheck, __cCheck, "", "2");
  {
    __bVerdict = __eVerdictPass;
    __tableHandle = ReportTableHead5Columns(__cCheckCaption, __cTSym, __cTOp, __cRefVal, __cActual, __cRes);
    {
      {
        int __res1,__res2;
        __res1 = CheckSignalMatch(`FDCAN2::dbNode::`CVADAS::`CVPAM_FD_Info::`DisplayView2, 2, __cGreaterEqualThan) == 1;
        __res2 = CheckSignalMatch(`FDCAN2::dbNode::`CVADAS::`CVPAM_FD_Info::`DisplayView2, 10, __cLessEqualThan) == 1;
        __csr = __res1 && __res2;
        snprintf(__cArray, 8192, "%s", "DisplayView2");
        snprintf(__cArray2, 8192, "%s '%s'", __cCANSignal, __cArray);
        snprintf(__cArray3, 8192, "%s", "");
        snprintf(__cArray4, 8192, "%s", "");
        snprintf(__cArray5, 8192, "%s", __cArray3);
        snprintf(__cArray6, 8192, "%s", __cArray4);
        ReportRange(2, 10, __cArray5, __cArray6, __cArray7, 8192);
        ReportTableRow(__tableHandle, 0, __cArray2, __cRange, __cArray7, __cEmpty, __oneOfFlag, __bSetInCheckAlignment);
        ReportLValueOrSignalNotOnline(`FDCAN2::dbNode::`CVADAS::`CVPAM_FD_Info::`DisplayView2, __cArray8, 8192);
        ReportCell(__tableHandle, __cArray8);
        ReportCellResult(__tableHandle, __csr, __ePassFail);
      }
  
      __bVerdict = __bVerdict && __csr;
    }
    ReportTableEndVerdict(__tableHandle, "1", __bVerdict);
  }
  TestCommandEnd();


}

void Tt4h42sqi_Tet_Tc108()
{
  CreateTTEIFFunction("Tt4h42sqi_Tc108", __eTcDef, __eLocal);  
  AddIFParameterTestCaseAttribute("TC_ID", "");
  AddIFParameterTestCaseAttribute("Test Case ID", "");
  CallInterfaceFunction("View 9: Blind Spot Right View", __cEmpty , __cEmpty );
}
testcase Tt4h42sqi_Tc108()
{
  stack long __tableHandle;
  SetBreakOnFail(1);

  TestCommandBegin(__eSet, __cSet, "", "0");
  {
    __tableHandle = ReportTableHead3Columns(__cSetCaption , __cTSym, __cTOp, __cAssigned); 
    {
      $`FDCAN2::dbNode::`SGW::`TELEMATIC_FD_5::`CameraDisplaySts2.phys = 9;
      snprintf(__cArray, 8192, "%s", "CameraDisplaySts2");
      snprintf(__cArray2, 8192, "%s '%s'", __cCANSignal, __cArray);
      snprintf(__cArray3, 8192, "%s", "");
      
      ReportSetLValueOrSignalNotOnline(getSignalTime(`FDCAN2::dbNode::`SGW::`TELEMATIC_FD_5::`CameraDisplaySts2), __cArray2, __cArray4, 8192);
      ReportTableRow(__tableHandle, 0, __cArray4, __cAOp, 9, __cArray3, __oneOfFlag, __bSetInCheckAlignment);
      
  
    }
    ReportTableEndTestStep(__tableHandle, "1");
  }
  TestCommandEnd();


  TestCommandBegin(__eWait, __cWait, "", "1");
  {
    Wait("1", (1000 * 1000000LL), 1000000, "");
  }
  TestCommandEnd();

  TestCommandBegin(__eCheck, __cCheck, "", "2");
  {
    __bVerdict = __eVerdictPass;
    __tableHandle = ReportTableHead5Columns(__cCheckCaption, __cTSym, __cTOp, __cRefVal, __cActual, __cRes);
    {
      {
        int __res1,__res2;
        __res1 = CheckSignalMatch(`FDCAN2::dbNode::`CVADAS::`CVPAM_FD_Info::`DisplayView2, 2, __cGreaterEqualThan) == 1;
        __res2 = CheckSignalMatch(`FDCAN2::dbNode::`CVADAS::`CVPAM_FD_Info::`DisplayView2, 15, __cLessEqualThan) == 1;
        __csr = __res1 && __res2;
        snprintf(__cArray, 8192, "%s", "DisplayView2");
        snprintf(__cArray2, 8192, "%s '%s'", __cCANSignal, __cArray);
        snprintf(__cArray3, 8192, "%s", "");
        snprintf(__cArray4, 8192, "%s", "");
        snprintf(__cArray5, 8192, "%s", __cArray3);
        snprintf(__cArray6, 8192, "%s", __cArray4);
        ReportRange(2, 15, __cArray5, __cArray6, __cArray7, 8192);
        ReportTableRow(__tableHandle, 0, __cArray2, __cRange, __cArray7, __cEmpty, __oneOfFlag, __bSetInCheckAlignment);
        ReportLValueOrSignalNotOnline(`FDCAN2::dbNode::`CVADAS::`CVPAM_FD_Info::`DisplayView2, __cArray8, 8192);
        ReportCell(__tableHandle, __cArray8);
        ReportCellResult(__tableHandle, __csr, __ePassFail);
      }
  
      __bVerdict = __bVerdict && __csr;
    }
    ReportTableEndVerdict(__tableHandle, "1", __bVerdict);
  }
  TestCommandEnd();


}

void Tt4h42sqi_Tet_Tc109()
{
  CreateTTEIFFunction("Tt4h42sqi_Tc109", __eTcDef, __eLocal);  
  AddIFParameterTestCaseAttribute("TC_ID", "");
  AddIFParameterTestCaseAttribute("Test Case ID", "");
  CallInterfaceFunction("View 11: FVTV", __cEmpty , __cEmpty );
}
testcase Tt4h42sqi_Tc109()
{
  stack long __tableHandle;
  SetBreakOnFail(1);

  TestCommandBegin(__eSet, __cSet, "", "0");
  {
    __tableHandle = ReportTableHead3Columns(__cSetCaption , __cTSym, __cTOp, __cAssigned); 
    {
      $`FDCAN2::dbNode::`SGW::`TELEMATIC_FD_5::`CameraDisplaySts2.phys = 11;
      snprintf(__cArray, 8192, "%s", "CameraDisplaySts2");
      snprintf(__cArray2, 8192, "%s '%s'", __cCANSignal, __cArray);
      snprintf(__cArray3, 8192, "%s", "");
      
      ReportSetLValueOrSignalNotOnline(getSignalTime(`FDCAN2::dbNode::`SGW::`TELEMATIC_FD_5::`CameraDisplaySts2), __cArray2, __cArray4, 8192);
      ReportTableRow(__tableHandle, 0, __cArray4, __cAOp, 11, __cArray3, __oneOfFlag, __bSetInCheckAlignment);
      
  
    }
    ReportTableEndTestStep(__tableHandle, "1");
  }
  TestCommandEnd();


  TestCommandBegin(__eWait, __cWait, "", "1");
  {
    Wait("1", (1000 * 1000000LL), 1000000, "");
  }
  TestCommandEnd();

  TestCommandBegin(__eCheck, __cCheck, "", "2");
  {
    __bVerdict = __eVerdictPass;
    __tableHandle = ReportTableHead5Columns(__cCheckCaption, __cTSym, __cTOp, __cRefVal, __cActual, __cRes);
    {
      {
        int __res1,__res2;
        __res1 = CheckSignalMatch(`FDCAN2::dbNode::`CVADAS::`CVPAM_FD_Info::`DisplayView2, 1, __cGreaterEqualThan) == 1;
        __res2 = CheckSignalMatch(`FDCAN2::dbNode::`CVADAS::`CVPAM_FD_Info::`DisplayView2, 15, __cLessEqualThan) == 1;
        __csr = __res1 && __res2;
        snprintf(__cArray, 8192, "%s", "DisplayView2");
        snprintf(__cArray2, 8192, "%s '%s'", __cCANSignal, __cArray);
        snprintf(__cArray3, 8192, "%s", "");
        snprintf(__cArray4, 8192, "%s", "");
        snprintf(__cArray5, 8192, "%s", __cArray3);
        snprintf(__cArray6, 8192, "%s", __cArray4);
        ReportRange(1, 15, __cArray5, __cArray6, __cArray7, 8192);
        ReportTableRow(__tableHandle, 0, __cArray2, __cRange, __cArray7, __cEmpty, __oneOfFlag, __bSetInCheckAlignment);
        ReportLValueOrSignalNotOnline(`FDCAN2::dbNode::`CVADAS::`CVPAM_FD_Info::`DisplayView2, __cArray8, 8192);
        ReportCell(__tableHandle, __cArray8);
        ReportCellResult(__tableHandle, __csr, __ePassFail);
      }
  
      __bVerdict = __bVerdict && __csr;
    }
    ReportTableEndVerdict(__tableHandle, "1", __bVerdict);
  }
  TestCommandEnd();


}

void Tt4h42sqi_Tet_Tc110()
{
  CreateTTEIFFunction("Tt4h42sqi_Tc110", __eTcDef, __eLocal);  
  AddIFParameterTestCaseAttribute("TC_ID", "");
  AddIFParameterTestCaseAttribute("Test Case ID", "");
  CallInterfaceFunction("View 12: RVTV", __cEmpty , __cEmpty );
}
testcase Tt4h42sqi_Tc110()
{
  stack long __tableHandle;
  SetBreakOnFail(1);

  TestCommandBegin(__eSet, __cSet, "", "0");
  {
    __tableHandle = ReportTableHead3Columns(__cSetCaption , __cTSym, __cTOp, __cAssigned); 
    {
      $`FDCAN2::dbNode::`SGW::`TELEMATIC_FD_5::`CameraDisplaySts2.phys = 12;
      snprintf(__cArray, 8192, "%s", "CameraDisplaySts2");
      snprintf(__cArray2, 8192, "%s '%s'", __cCANSignal, __cArray);
      snprintf(__cArray3, 8192, "%s", "");
      
      ReportSetLValueOrSignalNotOnline(getSignalTime(`FDCAN2::dbNode::`SGW::`TELEMATIC_FD_5::`CameraDisplaySts2), __cArray2, __cArray4, 8192);
      ReportTableRow(__tableHandle, 0, __cArray4, __cAOp, 12, __cArray3, __oneOfFlag, __bSetInCheckAlignment);
      
  
    }
    ReportTableEndTestStep(__tableHandle, "1");
  }
  TestCommandEnd();


  TestCommandBegin(__eWait, __cWait, "", "1");
  {
    Wait("1", (1000 * 1000000LL), 1000000, "");
  }
  TestCommandEnd();

  TestCommandBegin(__eCheck, __cCheck, "", "2");
  {
    __bVerdict = __eVerdictPass;
    __tableHandle = ReportTableHead5Columns(__cCheckCaption, __cTSym, __cTOp, __cRefVal, __cActual, __cRes);
    {
      {
        int __res1,__res2;
        __res1 = CheckSignalMatch(`FDCAN2::dbNode::`CVADAS::`CVPAM_FD_Info::`DisplayView2, 1, __cGreaterEqualThan) == 1;
        __res2 = CheckSignalMatch(`FDCAN2::dbNode::`CVADAS::`CVPAM_FD_Info::`DisplayView2, 15, __cLessEqualThan) == 1;
        __csr = __res1 && __res2;
        snprintf(__cArray, 8192, "%s", "DisplayView2");
        snprintf(__cArray2, 8192, "%s '%s'", __cCANSignal, __cArray);
        snprintf(__cArray3, 8192, "%s", "");
        snprintf(__cArray4, 8192, "%s", "");
        snprintf(__cArray5, 8192, "%s", __cArray3);
        snprintf(__cArray6, 8192, "%s", __cArray4);
        ReportRange(1, 15, __cArray5, __cArray6, __cArray7, 8192);
        ReportTableRow(__tableHandle, 0, __cArray2, __cRange, __cArray7, __cEmpty, __oneOfFlag, __bSetInCheckAlignment);
        ReportLValueOrSignalNotOnline(`FDCAN2::dbNode::`CVADAS::`CVPAM_FD_Info::`DisplayView2, __cArray8, 8192);
        ReportCell(__tableHandle, __cArray8);
        ReportCellResult(__tableHandle, __csr, __ePassFail);
      }
  
      __bVerdict = __bVerdict && __csr;
    }
    ReportTableEndVerdict(__tableHandle, "1", __bVerdict);
  }
  TestCommandEnd();


}

void Tt4h42sqi_Tet_Tc111()
{
  CreateTTEIFFunction("Tt4h42sqi_Tc111", __eTcDef, __eLocal);  
  AddIFParameterTestCaseAttribute("TC_ID", "");
  AddIFParameterTestCaseAttribute("Test Case ID", "");
  CallInterfaceFunction("View 13: FrontCrossPathView", __cEmpty , __cEmpty );
}
testcase Tt4h42sqi_Tc111()
{
  stack long __tableHandle;
  SetBreakOnFail(1);

  TestCommandBegin(__eSet, __cSet, "", "0");
  {
    __tableHandle = ReportTableHead3Columns(__cSetCaption , __cTSym, __cTOp, __cAssigned); 
    {
      $`FDCAN2::dbNode::`SGW::`TELEMATIC_FD_5::`CameraDisplaySts2.phys = 13;
      snprintf(__cArray, 8192, "%s", "CameraDisplaySts2");
      snprintf(__cArray2, 8192, "%s '%s'", __cCANSignal, __cArray);
      snprintf(__cArray3, 8192, "%s", "");
      
      ReportSetLValueOrSignalNotOnline(getSignalTime(`FDCAN2::dbNode::`SGW::`TELEMATIC_FD_5::`CameraDisplaySts2), __cArray2, __cArray4, 8192);
      ReportTableRow(__tableHandle, 0, __cArray4, __cAOp, 13, __cArray3, __oneOfFlag, __bSetInCheckAlignment);
      
  
    }
    ReportTableEndTestStep(__tableHandle, "1");
  }
  TestCommandEnd();


  TestCommandBegin(__eWait, __cWait, "", "1");
  {
    Wait("1", (1000 * 1000000LL), 1000000, "");
  }
  TestCommandEnd();

  TestCommandBegin(__eCheck, __cCheck, "", "2");
  {
    __bVerdict = __eVerdictPass;
    __tableHandle = ReportTableHead5Columns(__cCheckCaption, __cTSym, __cTOp, __cRefVal, __cActual, __cRes);
    {
      {
        int __res1,__res2;
        __res1 = CheckSignalMatch(`FDCAN2::dbNode::`CVADAS::`CVPAM_FD_Info::`DisplayView2, 1, __cGreaterEqualThan) == 1;
        __res2 = CheckSignalMatch(`FDCAN2::dbNode::`CVADAS::`CVPAM_FD_Info::`DisplayView2, 15, __cLessEqualThan) == 1;
        __csr = __res1 && __res2;
        snprintf(__cArray, 8192, "%s", "DisplayView2");
        snprintf(__cArray2, 8192, "%s '%s'", __cCANSignal, __cArray);
        snprintf(__cArray3, 8192, "%s", "");
        snprintf(__cArray4, 8192, "%s", "");
        snprintf(__cArray5, 8192, "%s", __cArray3);
        snprintf(__cArray6, 8192, "%s", __cArray4);
        ReportRange(1, 15, __cArray5, __cArray6, __cArray7, 8192);
        ReportTableRow(__tableHandle, 0, __cArray2, __cRange, __cArray7, __cEmpty, __oneOfFlag, __bSetInCheckAlignment);
        ReportLValueOrSignalNotOnline(`FDCAN2::dbNode::`CVADAS::`CVPAM_FD_Info::`DisplayView2, __cArray8, 8192);
        ReportCell(__tableHandle, __cArray8);
        ReportCellResult(__tableHandle, __csr, __ePassFail);
      }
  
      __bVerdict = __bVerdict && __csr;
    }
    ReportTableEndVerdict(__tableHandle, "1", __bVerdict);
  }
  TestCommandEnd();


}

void Tt4h42sqi_Tet_Tc112()
{
  CreateTTEIFFunction("Tt4h42sqi_Tc112", __eTcDef, __eLocal);  
  AddIFParameterTestCaseAttribute("TC_ID", "");
  AddIFParameterTestCaseAttribute("Test Case ID", "");
  CallInterfaceFunction("View 14: RearCrossPathView", __cEmpty , __cEmpty );
}
testcase Tt4h42sqi_Tc112()
{
  stack long __tableHandle;
  SetBreakOnFail(1);

  TestCommandBegin(__eSet, __cSet, "", "0");
  {
    __tableHandle = ReportTableHead3Columns(__cSetCaption , __cTSym, __cTOp, __cAssigned); 
    {
      $`FDCAN2::dbNode::`SGW::`TELEMATIC_FD_5::`CameraDisplaySts2.phys = 14;
      snprintf(__cArray, 8192, "%s", "CameraDisplaySts2");
      snprintf(__cArray2, 8192, "%s '%s'", __cCANSignal, __cArray);
      snprintf(__cArray3, 8192, "%s", "");
      
      ReportSetLValueOrSignalNotOnline(getSignalTime(`FDCAN2::dbNode::`SGW::`TELEMATIC_FD_5::`CameraDisplaySts2), __cArray2, __cArray4, 8192);
      ReportTableRow(__tableHandle, 0, __cArray4, __cAOp, 14, __cArray3, __oneOfFlag, __bSetInCheckAlignment);
      
  
    }
    ReportTableEndTestStep(__tableHandle, "1");
  }
  TestCommandEnd();


  TestCommandBegin(__eWait, __cWait, "", "1");
  {
    Wait("1", (1000 * 1000000LL), 1000000, "");
  }
  TestCommandEnd();

  TestCommandBegin(__eCheck, __cCheck, "", "2");
  {
    __bVerdict = __eVerdictPass;
    __tableHandle = ReportTableHead5Columns(__cCheckCaption, __cTSym, __cTOp, __cRefVal, __cActual, __cRes);
    {
      {
        int __res1,__res2;
        __res1 = CheckSignalMatch(`FDCAN2::dbNode::`CVADAS::`CVPAM_FD_Info::`DisplayView2, 1, __cGreaterEqualThan) == 1;
        __res2 = CheckSignalMatch(`FDCAN2::dbNode::`CVADAS::`CVPAM_FD_Info::`DisplayView2, 15, __cLessEqualThan) == 1;
        __csr = __res1 && __res2;
        snprintf(__cArray, 8192, "%s", "DisplayView2");
        snprintf(__cArray2, 8192, "%s '%s'", __cCANSignal, __cArray);
        snprintf(__cArray3, 8192, "%s", "");
        snprintf(__cArray4, 8192, "%s", "");
        snprintf(__cArray5, 8192, "%s", __cArray3);
        snprintf(__cArray6, 8192, "%s", __cArray4);
        ReportRange(1, 15, __cArray5, __cArray6, __cArray7, 8192);
        ReportTableRow(__tableHandle, 0, __cArray2, __cRange, __cArray7, __cEmpty, __oneOfFlag, __bSetInCheckAlignment);
        ReportLValueOrSignalNotOnline(`FDCAN2::dbNode::`CVADAS::`CVPAM_FD_Info::`DisplayView2, __cArray8, 8192);
        ReportCell(__tableHandle, __cArray8);
        ReportCellResult(__tableHandle, __csr, __ePassFail);
      }
  
      __bVerdict = __bVerdict && __csr;
    }
    ReportTableEndVerdict(__tableHandle, "1", __bVerdict);
  }
  TestCommandEnd();


}

void Tt4h42sqi_Tet_CaplTcCall8()
{
  stack long __tableHandle;
  CreateCaplIFFunction("Send_Proxi", __eTcDef);
  AddIFParameterTestCaseAttribute("TC_ID", "");
  AddIFParameterTestCaseAttribute("Test Case ID", "");
  AddIFParameterChar(syspar::`VehicleProxy9);
  CallInterfaceFunction(__cEmpty , "", __cEmpty );
}

void Tt4h42sqi_Tet_Tc113()
{
  CreateTTEIFFunction("Tt4h42sqi_Tc113", __eTcDef, __eLocal);  
  AddIFParameterTestCaseAttribute("TC_ID", "");
  AddIFParameterTestCaseAttribute("Test Case ID", "");
  CallInterfaceFunction("Set to Surround View Camera", __cEmpty , __cEmpty );
}
testcase Tt4h42sqi_Tc113()
{
  stack long __tableHandle;
  SetBreakOnFail(1);

  TestPreparationBegin();
  {
  }
  TestPreparationEnd();

  TestCommandBegin(__eSet, __cSet, "", "0");
  {
    __tableHandle = ReportTableHead3Columns(__cSetCaption , __cTSym, __cTOp, __cAssigned); 
    {
      $`FDCAN2::dbNode::`SGW::`TELEMATIC_FD_14::`TGW_CAMERA_DISP_STAT.phys = 4;
      snprintf(__cArray, 8192, "%s", "TGW_CAMERA_DISP_STAT");
      snprintf(__cArray2, 8192, "%s '%s'", __cCANSignal, __cArray);
      snprintf(__cArray3, 8192, "%s", "");
      
      ReportSetLValueOrSignalNotOnline(getSignalTime(`FDCAN2::dbNode::`SGW::`TELEMATIC_FD_14::`TGW_CAMERA_DISP_STAT), __cArray2, __cArray4, 8192);
      ReportTableRow(__tableHandle, 0, __cArray4, __cAOp, 4, __cArray3, __oneOfFlag, __bSetInCheckAlignment);
      
  
    }
    {
      $`FDCAN2::dbNode::`SGW::`TELEMATIC_FD_5::`CameraDisplaySts2.phys = 0;
      snprintf(__cArray, 8192, "%s", "CameraDisplaySts2");
      snprintf(__cArray2, 8192, "%s '%s'", __cCANSignal, __cArray);
      snprintf(__cArray3, 8192, "%s", "Default");
      
      ReportSetLValueOrSignalNotOnline(getSignalTime(`FDCAN2::dbNode::`SGW::`TELEMATIC_FD_5::`CameraDisplaySts2), __cArray2, __cArray4, 8192);
      ReportTableRow(__tableHandle, 0, __cArray4, __cAOp, 0, __cArray3, __oneOfFlag, __bSetInCheckAlignment);
      
  
    }
    ReportTableEndTestStep(__tableHandle, "1");
  }
  TestCommandEnd();


  TestCommandBegin(__eWait, __cWait, "", "1");
  {
    Wait("1", (1000 * 1000000LL), 1000000, "");
  }
  TestCommandEnd();

  TestCommandBegin(__eCheck, __cCheck, "", "2");
  {
    __bVerdict = __eVerdictPass;
    __tableHandle = ReportTableHead5Columns(__cCheckCaption, __cTSym, __cTOp, __cRefVal, __cActual, __cRes);
    {
      {
        int __res1,__res2;
        __res1 = CheckSignalMatch(`FDCAN2::dbNode::`SGW::`TELEMATIC_FD_14::`TGW_CAMERA_DISP_STAT, 0, __cGreaterEqualThan) == 1;
        __res2 = CheckSignalMatch(`FDCAN2::dbNode::`SGW::`TELEMATIC_FD_14::`TGW_CAMERA_DISP_STAT, 4, __cLessEqualThan) == 1;
        __csr = __res1 && __res2;
        snprintf(__cArray, 8192, "%s", "TGW_CAMERA_DISP_STAT");
        snprintf(__cArray2, 8192, "%s '%s'", __cCANSignal, __cArray);
        snprintf(__cArray3, 8192, "%s", "");
        snprintf(__cArray4, 8192, "%s", "");
        snprintf(__cArray5, 8192, "%s", __cArray3);
        snprintf(__cArray6, 8192, "%s", __cArray4);
        ReportRange(0, 4, __cArray5, __cArray6, __cArray7, 8192);
        ReportTableRow(__tableHandle, 0, __cArray2, __cRange, __cArray7, __cEmpty, __oneOfFlag, __bSetInCheckAlignment);
        ReportLValueOrSignalNotOnline(`FDCAN2::dbNode::`SGW::`TELEMATIC_FD_14::`TGW_CAMERA_DISP_STAT, __cArray8, 8192);
        ReportCell(__tableHandle, __cArray8);
        ReportCellResult(__tableHandle, __csr, __ePassFail);
      }
  
      __bVerdict = __bVerdict && __csr;
    }
    ReportTableEndVerdict(__tableHandle, "1", __bVerdict);
  }
  TestCommandEnd();


  TestCommandBegin(__eWait, __cWait, "", "3");
  {
    Wait("1", (3000 * 1000000LL), 1000000, "");
  }
  TestCommandEnd();

}

void Tt4h42sqi_Tet_Tc114()
{
  CreateTTEIFFunction("Tt4h42sqi_Tc114", __eTcDef, __eLocal);  
  AddIFParameterTestCaseAttribute("TC_ID", "");
  AddIFParameterTestCaseAttribute("Test Case ID", "");
  CallInterfaceFunction("Default View", __cEmpty , __cEmpty );
}
testcase Tt4h42sqi_Tc114()
{
  stack long __tableHandle;
  SetBreakOnFail(1);

  TestCommandBegin(__eSet, __cSet, "", "0");
  {
    __tableHandle = ReportTableHead3Columns(__cSetCaption , __cTSym, __cTOp, __cAssigned); 
    {
      $`FDCAN2::dbNode::`SGW::`TELEMATIC_FD_5::`CameraDisplaySts2.phys = 2;
      snprintf(__cArray, 8192, "%s", "CameraDisplaySts2");
      snprintf(__cArray2, 8192, "%s '%s'", __cCANSignal, __cArray);
      snprintf(__cArray3, 8192, "%s", "");
      
      ReportSetLValueOrSignalNotOnline(getSignalTime(`FDCAN2::dbNode::`SGW::`TELEMATIC_FD_5::`CameraDisplaySts2), __cArray2, __cArray4, 8192);
      ReportTableRow(__tableHandle, 0, __cArray4, __cAOp, 2, __cArray3, __oneOfFlag, __bSetInCheckAlignment);
      
  
    }
    ReportTableEndTestStep(__tableHandle, "1");
  }
  TestCommandEnd();


  TestCommandBegin(__eWait, __cWait, "", "1");
  {
    Wait("1", (1000 * 1000000LL), 1000000, "");
  }
  TestCommandEnd();

  TestCommandBegin(__eSet, __cSet, "", "2");
  {
    __tableHandle = ReportTableHead3Columns(__cSetCaption , __cTSym, __cTOp, __cAssigned); 
    {
      $`FDCAN2::dbNode::`SGW::`TELEMATIC_FD_5::`CameraDisplaySts2.phys = 0;
      snprintf(__cArray, 8192, "%s", "CameraDisplaySts2");
      snprintf(__cArray2, 8192, "%s '%s'", __cCANSignal, __cArray);
      snprintf(__cArray3, 8192, "%s", "");
      
      ReportSetLValueOrSignalNotOnline(getSignalTime(`FDCAN2::dbNode::`SGW::`TELEMATIC_FD_5::`CameraDisplaySts2), __cArray2, __cArray4, 8192);
      ReportTableRow(__tableHandle, 0, __cArray4, __cAOp, 0, __cArray3, __oneOfFlag, __bSetInCheckAlignment);
      
  
    }
    ReportTableEndTestStep(__tableHandle, "1");
  }
  TestCommandEnd();


  TestCommandBegin(__eWait, __cWait, "", "3");
  {
    Wait("1", (1000 * 1000000LL), 1000000, "");
  }
  TestCommandEnd();

  TestCommandBegin(__eCheck, __cCheck, "", "4");
  {
    __bVerdict = __eVerdictPass;
    __tableHandle = ReportTableHead5Columns(__cCheckCaption, __cTSym, __cTOp, __cRefVal, __cActual, __cRes);
    {
      {
        int __res1,__res2;
        __res1 = CheckSignalMatch(`FDCAN2::dbNode::`CVADAS::`CVPAM_FD_Info::`DisplayView2, 1, __cGreaterEqualThan) == 1;
        __res2 = CheckSignalMatch(`FDCAN2::dbNode::`CVADAS::`CVPAM_FD_Info::`DisplayView2, 15, __cLessEqualThan) == 1;
        __csr = __res1 && __res2;
        snprintf(__cArray, 8192, "%s", "DisplayView2");
        snprintf(__cArray2, 8192, "%s '%s'", __cCANSignal, __cArray);
        snprintf(__cArray3, 8192, "%s", "");
        snprintf(__cArray4, 8192, "%s", "");
        snprintf(__cArray5, 8192, "%s", __cArray3);
        snprintf(__cArray6, 8192, "%s", __cArray4);
        ReportRange(1, 15, __cArray5, __cArray6, __cArray7, 8192);
        ReportTableRow(__tableHandle, 0, __cArray2, __cRange, __cArray7, __cEmpty, __oneOfFlag, __bSetInCheckAlignment);
        ReportLValueOrSignalNotOnline(`FDCAN2::dbNode::`CVADAS::`CVPAM_FD_Info::`DisplayView2, __cArray8, 8192);
        ReportCell(__tableHandle, __cArray8);
        ReportCellResult(__tableHandle, __csr, __ePassFail);
      }
  
      __bVerdict = __bVerdict && __csr;
    }
    ReportTableEndVerdict(__tableHandle, "1", __bVerdict);
  }
  TestCommandEnd();


  {
    CreateTTEIFFunction("Tt4h42sqi_CaptureImage", __eFct, __eLocal);
    CallInterfaceFunction(__cEmpty, __cEmpty, "6684ffe3-1b9d-493e-a7be-53a7c51a24bb");
  }


}

void Tt4h42sqi_Tet_Tc115()
{
  CreateTTEIFFunction("Tt4h42sqi_Tc115", __eTcDef, __eLocal);  
  AddIFParameterTestCaseAttribute("TC_ID", "");
  AddIFParameterTestCaseAttribute("Test Case ID", "");
  CallInterfaceFunction("View 1: FVTV_RVTV", __cEmpty , __cEmpty );
}
testcase Tt4h42sqi_Tc115()
{
  stack long __tableHandle;
  SetBreakOnFail(1);

  TestCommandBegin(__eSet, __cSet, "", "0");
  {
    __tableHandle = ReportTableHead3Columns(__cSetCaption , __cTSym, __cTOp, __cAssigned); 
    {
      $`FDCAN2::dbNode::`SGW::`TELEMATIC_FD_5::`CameraDisplaySts2.phys = 1;
      snprintf(__cArray, 8192, "%s", "CameraDisplaySts2");
      snprintf(__cArray2, 8192, "%s '%s'", __cCANSignal, __cArray);
      snprintf(__cArray3, 8192, "%s", "");
      
      ReportSetLValueOrSignalNotOnline(getSignalTime(`FDCAN2::dbNode::`SGW::`TELEMATIC_FD_5::`CameraDisplaySts2), __cArray2, __cArray4, 8192);
      ReportTableRow(__tableHandle, 0, __cArray4, __cAOp, 1, __cArray3, __oneOfFlag, __bSetInCheckAlignment);
      
  
    }
    ReportTableEndTestStep(__tableHandle, "1");
  }
  TestCommandEnd();


  TestCommandBegin(__eWait, __cWait, "", "1");
  {
    Wait("1", (1000 * 1000000LL), 1000000, "");
  }
  TestCommandEnd();

  TestCommandBegin(__eCheck, __cCheck, "", "2");
  {
    __bVerdict = __eVerdictPass;
    __tableHandle = ReportTableHead5Columns(__cCheckCaption, __cTSym, __cTOp, __cRefVal, __cActual, __cRes);
    {
      {
        int __res1,__res2;
        __res1 = CheckSignalMatch(`FDCAN2::dbNode::`CVADAS::`CVPAM_FD_Info::`DisplayView2, 1, __cGreaterEqualThan) == 1;
        __res2 = CheckSignalMatch(`FDCAN2::dbNode::`CVADAS::`CVPAM_FD_Info::`DisplayView2, 15, __cLessEqualThan) == 1;
        __csr = __res1 && __res2;
        snprintf(__cArray, 8192, "%s", "DisplayView2");
        snprintf(__cArray2, 8192, "%s '%s'", __cCANSignal, __cArray);
        snprintf(__cArray3, 8192, "%s", "");
        snprintf(__cArray4, 8192, "%s", "");
        snprintf(__cArray5, 8192, "%s", __cArray3);
        snprintf(__cArray6, 8192, "%s", __cArray4);
        ReportRange(1, 15, __cArray5, __cArray6, __cArray7, 8192);
        ReportTableRow(__tableHandle, 0, __cArray2, __cRange, __cArray7, __cEmpty, __oneOfFlag, __bSetInCheckAlignment);
        ReportLValueOrSignalNotOnline(`FDCAN2::dbNode::`CVADAS::`CVPAM_FD_Info::`DisplayView2, __cArray8, 8192);
        ReportCell(__tableHandle, __cArray8);
        ReportCellResult(__tableHandle, __csr, __ePassFail);
      }
  
      __bVerdict = __bVerdict && __csr;
    }
    ReportTableEndVerdict(__tableHandle, "1", __bVerdict);
  }
  TestCommandEnd();


  {
    CreateTTEIFFunction("Tt4h42sqi_CaptureImage", __eFct, __eLocal);
    CallInterfaceFunction(__cEmpty, __cEmpty, "6684ffe3-1b9d-493e-a7be-53a7c51a24bb");
  }


}

void Tt4h42sqi_Tet_Tc116()
{
  CreateTTEIFFunction("Tt4h42sqi_Tc116", __eTcDef, __eLocal);  
  AddIFParameterTestCaseAttribute("TC_ID", "");
  AddIFParameterTestCaseAttribute("Test Case ID", "");
  CallInterfaceFunction("View 2: BackupRearView", __cEmpty , __cEmpty );
}
testcase Tt4h42sqi_Tc116()
{
  stack long __tableHandle;
  SetBreakOnFail(1);

  TestCommandBegin(__eSet, __cSet, "", "0");
  {
    __tableHandle = ReportTableHead3Columns(__cSetCaption , __cTSym, __cTOp, __cAssigned); 
    {
      $`FDCAN2::dbNode::`SGW::`TELEMATIC_FD_5::`CameraDisplaySts2.phys = 2;
      snprintf(__cArray, 8192, "%s", "CameraDisplaySts2");
      snprintf(__cArray2, 8192, "%s '%s'", __cCANSignal, __cArray);
      snprintf(__cArray3, 8192, "%s", "");
      
      ReportSetLValueOrSignalNotOnline(getSignalTime(`FDCAN2::dbNode::`SGW::`TELEMATIC_FD_5::`CameraDisplaySts2), __cArray2, __cArray4, 8192);
      ReportTableRow(__tableHandle, 0, __cArray4, __cAOp, 2, __cArray3, __oneOfFlag, __bSetInCheckAlignment);
      
  
    }
    ReportTableEndTestStep(__tableHandle, "1");
  }
  TestCommandEnd();


  TestCommandBegin(__eWait, __cWait, "", "1");
  {
    Wait("1", (1000 * 1000000LL), 1000000, "");
  }
  TestCommandEnd();

  TestCommandBegin(__eCheck, __cCheck, "", "2");
  {
    __bVerdict = __eVerdictPass;
    __tableHandle = ReportTableHead5Columns(__cCheckCaption, __cTSym, __cTOp, __cRefVal, __cActual, __cRes);
    {
      {
        int __res1,__res2;
        __res1 = CheckSignalMatch(`FDCAN2::dbNode::`CVADAS::`CVPAM_FD_Info::`DisplayView2, 1, __cGreaterEqualThan) == 1;
        __res2 = CheckSignalMatch(`FDCAN2::dbNode::`CVADAS::`CVPAM_FD_Info::`DisplayView2, 15, __cLessEqualThan) == 1;
        __csr = __res1 && __res2;
        snprintf(__cArray, 8192, "%s", "DisplayView2");
        snprintf(__cArray2, 8192, "%s '%s'", __cCANSignal, __cArray);
        snprintf(__cArray3, 8192, "%s", "");
        snprintf(__cArray4, 8192, "%s", "");
        snprintf(__cArray5, 8192, "%s", __cArray3);
        snprintf(__cArray6, 8192, "%s", __cArray4);
        ReportRange(1, 15, __cArray5, __cArray6, __cArray7, 8192);
        ReportTableRow(__tableHandle, 0, __cArray2, __cRange, __cArray7, __cEmpty, __oneOfFlag, __bSetInCheckAlignment);
        ReportLValueOrSignalNotOnline(`FDCAN2::dbNode::`CVADAS::`CVPAM_FD_Info::`DisplayView2, __cArray8, 8192);
        ReportCell(__tableHandle, __cArray8);
        ReportCellResult(__tableHandle, __csr, __ePassFail);
      }
  
      __bVerdict = __bVerdict && __csr;
    }
    ReportTableEndVerdict(__tableHandle, "1", __bVerdict);
  }
  TestCommandEnd();


  {
    CreateTTEIFFunction("Tt4h42sqi_CaptureImage", __eFct, __eLocal);
    CallInterfaceFunction(__cEmpty, __cEmpty, "6684ffe3-1b9d-493e-a7be-53a7c51a24bb");
  }


}

void Tt4h42sqi_Tet_Tc117()
{
  CreateTTEIFFunction("Tt4h42sqi_Tc117", __eTcDef, __eLocal);  
  AddIFParameterTestCaseAttribute("TC_ID", "");
  AddIFParameterTestCaseAttribute("Test Case ID", "");
  CallInterfaceFunction("View 3: Forward Facing Camera", __cEmpty , __cEmpty );
}
testcase Tt4h42sqi_Tc117()
{
  stack long __tableHandle;
  SetBreakOnFail(1);

  TestCommandBegin(__eSet, __cSet, "", "0");
  {
    __tableHandle = ReportTableHead3Columns(__cSetCaption , __cTSym, __cTOp, __cAssigned); 
    {
      $`FDCAN2::dbNode::`SGW::`TELEMATIC_FD_5::`CameraDisplaySts2.phys = 3;
      snprintf(__cArray, 8192, "%s", "CameraDisplaySts2");
      snprintf(__cArray2, 8192, "%s '%s'", __cCANSignal, __cArray);
      snprintf(__cArray3, 8192, "%s", "");
      
      ReportSetLValueOrSignalNotOnline(getSignalTime(`FDCAN2::dbNode::`SGW::`TELEMATIC_FD_5::`CameraDisplaySts2), __cArray2, __cArray4, 8192);
      ReportTableRow(__tableHandle, 0, __cArray4, __cAOp, 3, __cArray3, __oneOfFlag, __bSetInCheckAlignment);
      
  
    }
    ReportTableEndTestStep(__tableHandle, "1");
  }
  TestCommandEnd();


  TestCommandBegin(__eWait, __cWait, "", "1");
  {
    Wait("1", (1000 * 1000000LL), 1000000, "");
  }
  TestCommandEnd();

  TestCommandBegin(__eCheck, __cCheck, "", "2");
  {
    __bVerdict = __eVerdictPass;
    __tableHandle = ReportTableHead5Columns(__cCheckCaption, __cTSym, __cTOp, __cRefVal, __cActual, __cRes);
    {
      {
        int __res1,__res2;
        __res1 = CheckSignalMatch(`FDCAN2::dbNode::`CVADAS::`CVPAM_FD_Info::`DisplayView2, 1, __cGreaterEqualThan) == 1;
        __res2 = CheckSignalMatch(`FDCAN2::dbNode::`CVADAS::`CVPAM_FD_Info::`DisplayView2, 15, __cLessEqualThan) == 1;
        __csr = __res1 && __res2;
        snprintf(__cArray, 8192, "%s", "DisplayView2");
        snprintf(__cArray2, 8192, "%s '%s'", __cCANSignal, __cArray);
        snprintf(__cArray3, 8192, "%s", "");
        snprintf(__cArray4, 8192, "%s", "");
        snprintf(__cArray5, 8192, "%s", __cArray3);
        snprintf(__cArray6, 8192, "%s", __cArray4);
        ReportRange(1, 15, __cArray5, __cArray6, __cArray7, 8192);
        ReportTableRow(__tableHandle, 0, __cArray2, __cRange, __cArray7, __cEmpty, __oneOfFlag, __bSetInCheckAlignment);
        ReportLValueOrSignalNotOnline(`FDCAN2::dbNode::`CVADAS::`CVPAM_FD_Info::`DisplayView2, __cArray8, 8192);
        ReportCell(__tableHandle, __cArray8);
        ReportCellResult(__tableHandle, __csr, __ePassFail);
      }
  
      __bVerdict = __bVerdict && __csr;
    }
    ReportTableEndVerdict(__tableHandle, "1", __bVerdict);
  }
  TestCommandEnd();


  {
    CreateTTEIFFunction("Tt4h42sqi_CaptureImage", __eFct, __eLocal);
    CallInterfaceFunction(__cEmpty, __cEmpty, "6684ffe3-1b9d-493e-a7be-53a7c51a24bb");
  }


}

void Tt4h42sqi_Tet_Tc118()
{
  CreateTTEIFFunction("Tt4h42sqi_Tc118", __eTcDef, __eLocal);  
  AddIFParameterTestCaseAttribute("TC_ID", "");
  AddIFParameterTestCaseAttribute("Test Case ID", "");
  CallInterfaceFunction("View 5: Trailer Reverse Guidance", __cEmpty , __cEmpty );
}
testcase Tt4h42sqi_Tc118()
{
  stack long __tableHandle;
  SetBreakOnFail(1);

  TestCommandBegin(__eSet, __cSet, "", "0");
  {
    __tableHandle = ReportTableHead3Columns(__cSetCaption , __cTSym, __cTOp, __cAssigned); 
    {
      $`FDCAN2::dbNode::`SGW::`TELEMATIC_FD_5::`CameraDisplaySts2.phys = 5;
      snprintf(__cArray, 8192, "%s", "CameraDisplaySts2");
      snprintf(__cArray2, 8192, "%s '%s'", __cCANSignal, __cArray);
      snprintf(__cArray3, 8192, "%s", "");
      
      ReportSetLValueOrSignalNotOnline(getSignalTime(`FDCAN2::dbNode::`SGW::`TELEMATIC_FD_5::`CameraDisplaySts2), __cArray2, __cArray4, 8192);
      ReportTableRow(__tableHandle, 0, __cArray4, __cAOp, 5, __cArray3, __oneOfFlag, __bSetInCheckAlignment);
      
  
    }
    ReportTableEndTestStep(__tableHandle, "1");
  }
  TestCommandEnd();


  TestCommandBegin(__eWait, __cWait, "", "1");
  {
    Wait("1", (1000 * 1000000LL), 1000000, "");
  }
  TestCommandEnd();

  TestCommandBegin(__eCheck, __cCheck, "", "2");
  {
    __bVerdict = __eVerdictPass;
    __tableHandle = ReportTableHead5Columns(__cCheckCaption, __cTSym, __cTOp, __cRefVal, __cActual, __cRes);
    {
      {
        int __res1,__res2;
        __res1 = CheckSignalMatch(`FDCAN2::dbNode::`CVADAS::`CVPAM_FD_Info::`DisplayView2, 1, __cGreaterEqualThan) == 1;
        __res2 = CheckSignalMatch(`FDCAN2::dbNode::`CVADAS::`CVPAM_FD_Info::`DisplayView2, 15, __cLessEqualThan) == 1;
        __csr = __res1 && __res2;
        snprintf(__cArray, 8192, "%s", "DisplayView2");
        snprintf(__cArray2, 8192, "%s '%s'", __cCANSignal, __cArray);
        snprintf(__cArray3, 8192, "%s", "");
        snprintf(__cArray4, 8192, "%s", "");
        snprintf(__cArray5, 8192, "%s", __cArray3);
        snprintf(__cArray6, 8192, "%s", __cArray4);
        ReportRange(1, 15, __cArray5, __cArray6, __cArray7, 8192);
        ReportTableRow(__tableHandle, 0, __cArray2, __cRange, __cArray7, __cEmpty, __oneOfFlag, __bSetInCheckAlignment);
        ReportLValueOrSignalNotOnline(`FDCAN2::dbNode::`CVADAS::`CVPAM_FD_Info::`DisplayView2, __cArray8, 8192);
        ReportCell(__tableHandle, __cArray8);
        ReportCellResult(__tableHandle, __csr, __ePassFail);
      }
  
      __bVerdict = __bVerdict && __csr;
    }
    ReportTableEndVerdict(__tableHandle, "1", __bVerdict);
  }
  TestCommandEnd();


  {
    CreateTTEIFFunction("Tt4h42sqi_CaptureImage", __eFct, __eLocal);
    CallInterfaceFunction(__cEmpty, __cEmpty, "6684ffe3-1b9d-493e-a7be-53a7c51a24bb");
  }


}

void Tt4h42sqi_Tet_Tc119()
{
  CreateTTEIFFunction("Tt4h42sqi_Tc119", __eTcDef, __eLocal);  
  AddIFParameterTestCaseAttribute("TC_ID", "");
  AddIFParameterTestCaseAttribute("Test Case ID", "");
  CallInterfaceFunction("View 6: Trailer Left View", __cEmpty , __cEmpty );
}
testcase Tt4h42sqi_Tc119()
{
  stack long __tableHandle;
  SetBreakOnFail(1);

  TestCommandBegin(__eSet, __cSet, "", "0");
  {
    __tableHandle = ReportTableHead3Columns(__cSetCaption , __cTSym, __cTOp, __cAssigned); 
    {
      $`FDCAN2::dbNode::`SGW::`TELEMATIC_FD_5::`CameraDisplaySts2.phys = 6;
      snprintf(__cArray, 8192, "%s", "CameraDisplaySts2");
      snprintf(__cArray2, 8192, "%s '%s'", __cCANSignal, __cArray);
      snprintf(__cArray3, 8192, "%s", "");
      
      ReportSetLValueOrSignalNotOnline(getSignalTime(`FDCAN2::dbNode::`SGW::`TELEMATIC_FD_5::`CameraDisplaySts2), __cArray2, __cArray4, 8192);
      ReportTableRow(__tableHandle, 0, __cArray4, __cAOp, 6, __cArray3, __oneOfFlag, __bSetInCheckAlignment);
      
  
    }
    ReportTableEndTestStep(__tableHandle, "1");
  }
  TestCommandEnd();


  TestCommandBegin(__eWait, __cWait, "", "1");
  {
    Wait("1", (1000 * 1000000LL), 1000000, "");
  }
  TestCommandEnd();

  TestCommandBegin(__eCheck, __cCheck, "", "2");
  {
    __bVerdict = __eVerdictPass;
    __tableHandle = ReportTableHead5Columns(__cCheckCaption, __cTSym, __cTOp, __cRefVal, __cActual, __cRes);
    {
      {
        int __res1,__res2;
        __res1 = CheckSignalMatch(`FDCAN2::dbNode::`CVADAS::`CVPAM_FD_Info::`DisplayView2, 1, __cGreaterEqualThan) == 1;
        __res2 = CheckSignalMatch(`FDCAN2::dbNode::`CVADAS::`CVPAM_FD_Info::`DisplayView2, 15, __cLessEqualThan) == 1;
        __csr = __res1 && __res2;
        snprintf(__cArray, 8192, "%s", "DisplayView2");
        snprintf(__cArray2, 8192, "%s '%s'", __cCANSignal, __cArray);
        snprintf(__cArray3, 8192, "%s", "");
        snprintf(__cArray4, 8192, "%s", "");
        snprintf(__cArray5, 8192, "%s", __cArray3);
        snprintf(__cArray6, 8192, "%s", __cArray4);
        ReportRange(1, 15, __cArray5, __cArray6, __cArray7, 8192);
        ReportTableRow(__tableHandle, 0, __cArray2, __cRange, __cArray7, __cEmpty, __oneOfFlag, __bSetInCheckAlignment);
        ReportLValueOrSignalNotOnline(`FDCAN2::dbNode::`CVADAS::`CVPAM_FD_Info::`DisplayView2, __cArray8, 8192);
        ReportCell(__tableHandle, __cArray8);
        ReportCellResult(__tableHandle, __csr, __ePassFail);
      }
  
      __bVerdict = __bVerdict && __csr;
    }
    ReportTableEndVerdict(__tableHandle, "1", __bVerdict);
  }
  TestCommandEnd();


  {
    CreateTTEIFFunction("Tt4h42sqi_CaptureImage", __eFct, __eLocal);
    CallInterfaceFunction(__cEmpty, __cEmpty, "6684ffe3-1b9d-493e-a7be-53a7c51a24bb");
  }


}

void Tt4h42sqi_Tet_Tc120()
{
  CreateTTEIFFunction("Tt4h42sqi_Tc120", __eTcDef, __eLocal);  
  AddIFParameterTestCaseAttribute("TC_ID", "");
  AddIFParameterTestCaseAttribute("Test Case ID", "");
  CallInterfaceFunction("View 7: Trailer Right View", __cEmpty , __cEmpty );
}
testcase Tt4h42sqi_Tc120()
{
  stack long __tableHandle;
  SetBreakOnFail(1);

  TestCommandBegin(__eSet, __cSet, "", "0");
  {
    __tableHandle = ReportTableHead3Columns(__cSetCaption , __cTSym, __cTOp, __cAssigned); 
    {
      $`FDCAN2::dbNode::`SGW::`TELEMATIC_FD_5::`CameraDisplaySts2.phys = 7;
      snprintf(__cArray, 8192, "%s", "CameraDisplaySts2");
      snprintf(__cArray2, 8192, "%s '%s'", __cCANSignal, __cArray);
      snprintf(__cArray3, 8192, "%s", "");
      
      ReportSetLValueOrSignalNotOnline(getSignalTime(`FDCAN2::dbNode::`SGW::`TELEMATIC_FD_5::`CameraDisplaySts2), __cArray2, __cArray4, 8192);
      ReportTableRow(__tableHandle, 0, __cArray4, __cAOp, 7, __cArray3, __oneOfFlag, __bSetInCheckAlignment);
      
  
    }
    ReportTableEndTestStep(__tableHandle, "1");
  }
  TestCommandEnd();


  TestCommandBegin(__eWait, __cWait, "", "1");
  {
    Wait("1", (1000 * 1000000LL), 1000000, "");
  }
  TestCommandEnd();

  TestCommandBegin(__eCheck, __cCheck, "", "2");
  {
    __bVerdict = __eVerdictPass;
    __tableHandle = ReportTableHead5Columns(__cCheckCaption, __cTSym, __cTOp, __cRefVal, __cActual, __cRes);
    {
      {
        int __res1,__res2;
        __res1 = CheckSignalMatch(`FDCAN2::dbNode::`CVADAS::`CVPAM_FD_Info::`DisplayView2, 1, __cGreaterEqualThan) == 1;
        __res2 = CheckSignalMatch(`FDCAN2::dbNode::`CVADAS::`CVPAM_FD_Info::`DisplayView2, 15, __cLessEqualThan) == 1;
        __csr = __res1 && __res2;
        snprintf(__cArray, 8192, "%s", "DisplayView2");
        snprintf(__cArray2, 8192, "%s '%s'", __cCANSignal, __cArray);
        snprintf(__cArray3, 8192, "%s", "");
        snprintf(__cArray4, 8192, "%s", "");
        snprintf(__cArray5, 8192, "%s", __cArray3);
        snprintf(__cArray6, 8192, "%s", __cArray4);
        ReportRange(1, 15, __cArray5, __cArray6, __cArray7, 8192);
        ReportTableRow(__tableHandle, 0, __cArray2, __cRange, __cArray7, __cEmpty, __oneOfFlag, __bSetInCheckAlignment);
        ReportLValueOrSignalNotOnline(`FDCAN2::dbNode::`CVADAS::`CVPAM_FD_Info::`DisplayView2, __cArray8, 8192);
        ReportCell(__tableHandle, __cArray8);
        ReportCellResult(__tableHandle, __csr, __ePassFail);
      }
  
      __bVerdict = __bVerdict && __csr;
    }
    ReportTableEndVerdict(__tableHandle, "1", __bVerdict);
  }
  TestCommandEnd();


  {
    CreateTTEIFFunction("Tt4h42sqi_CaptureImage", __eFct, __eLocal);
    CallInterfaceFunction(__cEmpty, __cEmpty, "6684ffe3-1b9d-493e-a7be-53a7c51a24bb");
  }


}

void Tt4h42sqi_Tet_Tc121()
{
  CreateTTEIFFunction("Tt4h42sqi_Tc121", __eTcDef, __eLocal);  
  AddIFParameterTestCaseAttribute("TC_ID", "");
  AddIFParameterTestCaseAttribute("Test Case ID", "");
  CallInterfaceFunction("View 8: Blind Spot Left View", __cEmpty , __cEmpty );
}
testcase Tt4h42sqi_Tc121()
{
  stack long __tableHandle;
  SetBreakOnFail(1);

  TestCommandBegin(__eSet, __cSet, "", "0");
  {
    __tableHandle = ReportTableHead3Columns(__cSetCaption , __cTSym, __cTOp, __cAssigned); 
    {
      $`FDCAN2::dbNode::`SGW::`TELEMATIC_FD_5::`CameraDisplaySts2.phys = 8;
      snprintf(__cArray, 8192, "%s", "CameraDisplaySts2");
      snprintf(__cArray2, 8192, "%s '%s'", __cCANSignal, __cArray);
      snprintf(__cArray3, 8192, "%s", "");
      
      ReportSetLValueOrSignalNotOnline(getSignalTime(`FDCAN2::dbNode::`SGW::`TELEMATIC_FD_5::`CameraDisplaySts2), __cArray2, __cArray4, 8192);
      ReportTableRow(__tableHandle, 0, __cArray4, __cAOp, 8, __cArray3, __oneOfFlag, __bSetInCheckAlignment);
      
  
    }
    ReportTableEndTestStep(__tableHandle, "1");
  }
  TestCommandEnd();


  TestCommandBegin(__eWait, __cWait, "", "1");
  {
    Wait("1", (1000 * 1000000LL), 1000000, "");
  }
  TestCommandEnd();

  {
    CreateTTEIFFunction("Tt4h42sqi_CaptureImage", __eFct, __eLocal);
    CallInterfaceFunction(__cEmpty, __cEmpty, "6684ffe3-1b9d-493e-a7be-53a7c51a24bb");
  }


}

void Tt4h42sqi_Tet_Tc122()
{
  CreateTTEIFFunction("Tt4h42sqi_Tc122", __eTcDef, __eLocal);  
  AddIFParameterTestCaseAttribute("TC_ID", "");
  AddIFParameterTestCaseAttribute("Test Case ID", "");
  CallInterfaceFunction("View 9: Blind Spot Right View", __cEmpty , __cEmpty );
}
testcase Tt4h42sqi_Tc122()
{
  stack long __tableHandle;
  SetBreakOnFail(1);

  TestCommandBegin(__eSet, __cSet, "", "0");
  {
    __tableHandle = ReportTableHead3Columns(__cSetCaption , __cTSym, __cTOp, __cAssigned); 
    {
      $`FDCAN2::dbNode::`SGW::`TELEMATIC_FD_5::`CameraDisplaySts2.phys = 9;
      snprintf(__cArray, 8192, "%s", "CameraDisplaySts2");
      snprintf(__cArray2, 8192, "%s '%s'", __cCANSignal, __cArray);
      snprintf(__cArray3, 8192, "%s", "");
      
      ReportSetLValueOrSignalNotOnline(getSignalTime(`FDCAN2::dbNode::`SGW::`TELEMATIC_FD_5::`CameraDisplaySts2), __cArray2, __cArray4, 8192);
      ReportTableRow(__tableHandle, 0, __cArray4, __cAOp, 9, __cArray3, __oneOfFlag, __bSetInCheckAlignment);
      
  
    }
    ReportTableEndTestStep(__tableHandle, "1");
  }
  TestCommandEnd();


  TestCommandBegin(__eWait, __cWait, "", "1");
  {
    Wait("1", (1000 * 1000000LL), 1000000, "");
  }
  TestCommandEnd();

  {
    CreateTTEIFFunction("Tt4h42sqi_CaptureImage", __eFct, __eLocal);
    CallInterfaceFunction(__cEmpty, __cEmpty, "6684ffe3-1b9d-493e-a7be-53a7c51a24bb");
  }


}

void Tt4h42sqi_Tet_Tc123()
{
  CreateTTEIFFunction("Tt4h42sqi_Tc123", __eTcDef, __eLocal);  
  AddIFParameterTestCaseAttribute("TC_ID", "");
  AddIFParameterTestCaseAttribute("Test Case ID", "");
  CallInterfaceFunction("View 11: FVTV", __cEmpty , __cEmpty );
}
testcase Tt4h42sqi_Tc123()
{
  stack long __tableHandle;
  SetBreakOnFail(1);

  TestCommandBegin(__eSet, __cSet, "", "0");
  {
    __tableHandle = ReportTableHead3Columns(__cSetCaption , __cTSym, __cTOp, __cAssigned); 
    {
      $`FDCAN2::dbNode::`SGW::`TELEMATIC_FD_5::`CameraDisplaySts2.phys = 11;
      snprintf(__cArray, 8192, "%s", "CameraDisplaySts2");
      snprintf(__cArray2, 8192, "%s '%s'", __cCANSignal, __cArray);
      snprintf(__cArray3, 8192, "%s", "");
      
      ReportSetLValueOrSignalNotOnline(getSignalTime(`FDCAN2::dbNode::`SGW::`TELEMATIC_FD_5::`CameraDisplaySts2), __cArray2, __cArray4, 8192);
      ReportTableRow(__tableHandle, 0, __cArray4, __cAOp, 11, __cArray3, __oneOfFlag, __bSetInCheckAlignment);
      
  
    }
    ReportTableEndTestStep(__tableHandle, "1");
  }
  TestCommandEnd();


  TestCommandBegin(__eWait, __cWait, "", "1");
  {
    Wait("1", (1000 * 1000000LL), 1000000, "");
  }
  TestCommandEnd();

  TestCommandBegin(__eCheck, __cCheck, "", "2");
  {
    __bVerdict = __eVerdictPass;
    __tableHandle = ReportTableHead5Columns(__cCheckCaption, __cTSym, __cTOp, __cRefVal, __cActual, __cRes);
    {
      {
        int __res1,__res2;
        __res1 = CheckSignalMatch(`FDCAN2::dbNode::`CVADAS::`CVPAM_FD_Info::`DisplayView2, 1, __cGreaterEqualThan) == 1;
        __res2 = CheckSignalMatch(`FDCAN2::dbNode::`CVADAS::`CVPAM_FD_Info::`DisplayView2, 15, __cLessEqualThan) == 1;
        __csr = __res1 && __res2;
        snprintf(__cArray, 8192, "%s", "DisplayView2");
        snprintf(__cArray2, 8192, "%s '%s'", __cCANSignal, __cArray);
        snprintf(__cArray3, 8192, "%s", "");
        snprintf(__cArray4, 8192, "%s", "");
        snprintf(__cArray5, 8192, "%s", __cArray3);
        snprintf(__cArray6, 8192, "%s", __cArray4);
        ReportRange(1, 15, __cArray5, __cArray6, __cArray7, 8192);
        ReportTableRow(__tableHandle, 0, __cArray2, __cRange, __cArray7, __cEmpty, __oneOfFlag, __bSetInCheckAlignment);
        ReportLValueOrSignalNotOnline(`FDCAN2::dbNode::`CVADAS::`CVPAM_FD_Info::`DisplayView2, __cArray8, 8192);
        ReportCell(__tableHandle, __cArray8);
        ReportCellResult(__tableHandle, __csr, __ePassFail);
      }
  
      __bVerdict = __bVerdict && __csr;
    }
    ReportTableEndVerdict(__tableHandle, "1", __bVerdict);
  }
  TestCommandEnd();


  {
    CreateTTEIFFunction("Tt4h42sqi_CaptureImage", __eFct, __eLocal);
    CallInterfaceFunction(__cEmpty, __cEmpty, "6684ffe3-1b9d-493e-a7be-53a7c51a24bb");
  }


}

void Tt4h42sqi_Tet_Tc124()
{
  CreateTTEIFFunction("Tt4h42sqi_Tc124", __eTcDef, __eLocal);  
  AddIFParameterTestCaseAttribute("TC_ID", "");
  AddIFParameterTestCaseAttribute("Test Case ID", "");
  CallInterfaceFunction("View 12: RVTV", __cEmpty , __cEmpty );
}
testcase Tt4h42sqi_Tc124()
{
  stack long __tableHandle;
  SetBreakOnFail(1);

  TestCommandBegin(__eSet, __cSet, "", "0");
  {
    __tableHandle = ReportTableHead3Columns(__cSetCaption , __cTSym, __cTOp, __cAssigned); 
    {
      $`FDCAN2::dbNode::`SGW::`TELEMATIC_FD_5::`CameraDisplaySts2.phys = 12;
      snprintf(__cArray, 8192, "%s", "CameraDisplaySts2");
      snprintf(__cArray2, 8192, "%s '%s'", __cCANSignal, __cArray);
      snprintf(__cArray3, 8192, "%s", "");
      
      ReportSetLValueOrSignalNotOnline(getSignalTime(`FDCAN2::dbNode::`SGW::`TELEMATIC_FD_5::`CameraDisplaySts2), __cArray2, __cArray4, 8192);
      ReportTableRow(__tableHandle, 0, __cArray4, __cAOp, 12, __cArray3, __oneOfFlag, __bSetInCheckAlignment);
      
  
    }
    ReportTableEndTestStep(__tableHandle, "1");
  }
  TestCommandEnd();


  TestCommandBegin(__eWait, __cWait, "", "1");
  {
    Wait("1", (1000 * 1000000LL), 1000000, "");
  }
  TestCommandEnd();

  TestCommandBegin(__eCheck, __cCheck, "", "2");
  {
    __bVerdict = __eVerdictPass;
    __tableHandle = ReportTableHead5Columns(__cCheckCaption, __cTSym, __cTOp, __cRefVal, __cActual, __cRes);
    {
      {
        int __res1,__res2;
        __res1 = CheckSignalMatch(`FDCAN2::dbNode::`CVADAS::`CVPAM_FD_Info::`DisplayView2, 1, __cGreaterEqualThan) == 1;
        __res2 = CheckSignalMatch(`FDCAN2::dbNode::`CVADAS::`CVPAM_FD_Info::`DisplayView2, 15, __cLessEqualThan) == 1;
        __csr = __res1 && __res2;
        snprintf(__cArray, 8192, "%s", "DisplayView2");
        snprintf(__cArray2, 8192, "%s '%s'", __cCANSignal, __cArray);
        snprintf(__cArray3, 8192, "%s", "");
        snprintf(__cArray4, 8192, "%s", "");
        snprintf(__cArray5, 8192, "%s", __cArray3);
        snprintf(__cArray6, 8192, "%s", __cArray4);
        ReportRange(1, 15, __cArray5, __cArray6, __cArray7, 8192);
        ReportTableRow(__tableHandle, 0, __cArray2, __cRange, __cArray7, __cEmpty, __oneOfFlag, __bSetInCheckAlignment);
        ReportLValueOrSignalNotOnline(`FDCAN2::dbNode::`CVADAS::`CVPAM_FD_Info::`DisplayView2, __cArray8, 8192);
        ReportCell(__tableHandle, __cArray8);
        ReportCellResult(__tableHandle, __csr, __ePassFail);
      }
  
      __bVerdict = __bVerdict && __csr;
    }
    ReportTableEndVerdict(__tableHandle, "1", __bVerdict);
  }
  TestCommandEnd();


  {
    CreateTTEIFFunction("Tt4h42sqi_CaptureImage", __eFct, __eLocal);
    CallInterfaceFunction(__cEmpty, __cEmpty, "6684ffe3-1b9d-493e-a7be-53a7c51a24bb");
  }


}

void Tt4h42sqi_Tet_Tc125()
{
  CreateTTEIFFunction("Tt4h42sqi_Tc125", __eTcDef, __eLocal);  
  AddIFParameterTestCaseAttribute("TC_ID", "");
  AddIFParameterTestCaseAttribute("Test Case ID", "");
  CallInterfaceFunction("View 13: FrontCrossPathView", __cEmpty , __cEmpty );
}
testcase Tt4h42sqi_Tc125()
{
  stack long __tableHandle;
  SetBreakOnFail(1);

  TestCommandBegin(__eSet, __cSet, "", "0");
  {
    __tableHandle = ReportTableHead3Columns(__cSetCaption , __cTSym, __cTOp, __cAssigned); 
    {
      $`FDCAN2::dbNode::`SGW::`TELEMATIC_FD_5::`CameraDisplaySts2.phys = 13;
      snprintf(__cArray, 8192, "%s", "CameraDisplaySts2");
      snprintf(__cArray2, 8192, "%s '%s'", __cCANSignal, __cArray);
      snprintf(__cArray3, 8192, "%s", "");
      
      ReportSetLValueOrSignalNotOnline(getSignalTime(`FDCAN2::dbNode::`SGW::`TELEMATIC_FD_5::`CameraDisplaySts2), __cArray2, __cArray4, 8192);
      ReportTableRow(__tableHandle, 0, __cArray4, __cAOp, 13, __cArray3, __oneOfFlag, __bSetInCheckAlignment);
      
  
    }
    ReportTableEndTestStep(__tableHandle, "1");
  }
  TestCommandEnd();


  TestCommandBegin(__eWait, __cWait, "", "1");
  {
    Wait("1", (1000 * 1000000LL), 1000000, "");
  }
  TestCommandEnd();

  TestCommandBegin(__eCheck, __cCheck, "", "2");
  {
    __bVerdict = __eVerdictPass;
    __tableHandle = ReportTableHead5Columns(__cCheckCaption, __cTSym, __cTOp, __cRefVal, __cActual, __cRes);
    {
      {
        int __res1,__res2;
        __res1 = CheckSignalMatch(`FDCAN2::dbNode::`CVADAS::`CVPAM_FD_Info::`DisplayView2, 1, __cGreaterEqualThan) == 1;
        __res2 = CheckSignalMatch(`FDCAN2::dbNode::`CVADAS::`CVPAM_FD_Info::`DisplayView2, 15, __cLessEqualThan) == 1;
        __csr = __res1 && __res2;
        snprintf(__cArray, 8192, "%s", "DisplayView2");
        snprintf(__cArray2, 8192, "%s '%s'", __cCANSignal, __cArray);
        snprintf(__cArray3, 8192, "%s", "");
        snprintf(__cArray4, 8192, "%s", "");
        snprintf(__cArray5, 8192, "%s", __cArray3);
        snprintf(__cArray6, 8192, "%s", __cArray4);
        ReportRange(1, 15, __cArray5, __cArray6, __cArray7, 8192);
        ReportTableRow(__tableHandle, 0, __cArray2, __cRange, __cArray7, __cEmpty, __oneOfFlag, __bSetInCheckAlignment);
        ReportLValueOrSignalNotOnline(`FDCAN2::dbNode::`CVADAS::`CVPAM_FD_Info::`DisplayView2, __cArray8, 8192);
        ReportCell(__tableHandle, __cArray8);
        ReportCellResult(__tableHandle, __csr, __ePassFail);
      }
  
      __bVerdict = __bVerdict && __csr;
    }
    ReportTableEndVerdict(__tableHandle, "1", __bVerdict);
  }
  TestCommandEnd();


  {
    CreateTTEIFFunction("Tt4h42sqi_CaptureImage", __eFct, __eLocal);
    CallInterfaceFunction(__cEmpty, __cEmpty, "6684ffe3-1b9d-493e-a7be-53a7c51a24bb");
  }


}

void Tt4h42sqi_Tet_Tc126()
{
  CreateTTEIFFunction("Tt4h42sqi_Tc126", __eTcDef, __eLocal);  
  AddIFParameterTestCaseAttribute("TC_ID", "");
  AddIFParameterTestCaseAttribute("Test Case ID", "");
  CallInterfaceFunction("View 14: RearCrossPathView", __cEmpty , __cEmpty );
}
testcase Tt4h42sqi_Tc126()
{
  stack long __tableHandle;
  SetBreakOnFail(1);

  TestCommandBegin(__eSet, __cSet, "", "0");
  {
    __tableHandle = ReportTableHead3Columns(__cSetCaption , __cTSym, __cTOp, __cAssigned); 
    {
      $`FDCAN2::dbNode::`SGW::`TELEMATIC_FD_5::`CameraDisplaySts2.phys = 14;
      snprintf(__cArray, 8192, "%s", "CameraDisplaySts2");
      snprintf(__cArray2, 8192, "%s '%s'", __cCANSignal, __cArray);
      snprintf(__cArray3, 8192, "%s", "");
      
      ReportSetLValueOrSignalNotOnline(getSignalTime(`FDCAN2::dbNode::`SGW::`TELEMATIC_FD_5::`CameraDisplaySts2), __cArray2, __cArray4, 8192);
      ReportTableRow(__tableHandle, 0, __cArray4, __cAOp, 14, __cArray3, __oneOfFlag, __bSetInCheckAlignment);
      
  
    }
    ReportTableEndTestStep(__tableHandle, "1");
  }
  TestCommandEnd();


  TestCommandBegin(__eWait, __cWait, "", "1");
  {
    Wait("1", (1000 * 1000000LL), 1000000, "");
  }
  TestCommandEnd();

  TestCommandBegin(__eCheck, __cCheck, "", "2");
  {
    __bVerdict = __eVerdictPass;
    __tableHandle = ReportTableHead5Columns(__cCheckCaption, __cTSym, __cTOp, __cRefVal, __cActual, __cRes);
    {
      {
        int __res1,__res2;
        __res1 = CheckSignalMatch(`FDCAN2::dbNode::`CVADAS::`CVPAM_FD_Info::`DisplayView2, 1, __cGreaterEqualThan) == 1;
        __res2 = CheckSignalMatch(`FDCAN2::dbNode::`CVADAS::`CVPAM_FD_Info::`DisplayView2, 15, __cLessEqualThan) == 1;
        __csr = __res1 && __res2;
        snprintf(__cArray, 8192, "%s", "DisplayView2");
        snprintf(__cArray2, 8192, "%s '%s'", __cCANSignal, __cArray);
        snprintf(__cArray3, 8192, "%s", "");
        snprintf(__cArray4, 8192, "%s", "");
        snprintf(__cArray5, 8192, "%s", __cArray3);
        snprintf(__cArray6, 8192, "%s", __cArray4);
        ReportRange(1, 15, __cArray5, __cArray6, __cArray7, 8192);
        ReportTableRow(__tableHandle, 0, __cArray2, __cRange, __cArray7, __cEmpty, __oneOfFlag, __bSetInCheckAlignment);
        ReportLValueOrSignalNotOnline(`FDCAN2::dbNode::`CVADAS::`CVPAM_FD_Info::`DisplayView2, __cArray8, 8192);
        ReportCell(__tableHandle, __cArray8);
        ReportCellResult(__tableHandle, __csr, __ePassFail);
      }
  
      __bVerdict = __bVerdict && __csr;
    }
    ReportTableEndVerdict(__tableHandle, "1", __bVerdict);
  }
  TestCommandEnd();


  {
    CreateTTEIFFunction("Tt4h42sqi_CaptureImage", __eFct, __eLocal);
    CallInterfaceFunction(__cEmpty, __cEmpty, "6684ffe3-1b9d-493e-a7be-53a7c51a24bb");
  }


}

void Tt4h42sqi_Tet_Tc127()
{
  CreateTTEIFFunction("Tt4h42sqi_Tc127", __eTcDef, __eLocal);  
  AddIFParameterTestCaseAttribute("TC_ID", "");
  AddIFParameterTestCaseAttribute("Test Case ID", "");
  CallInterfaceFunction("TC_ID_20205165_Defaults_Session", __cEmpty , __cEmpty );
}
testcase Tt4h42sqi_Tc127()
{
  stack long __tableHandle;
  SetBreakOnFail(0);

  CreateTTEIFFunction("Tt4h42sqi_Tet_Tc127_Completion", __eFct, __eLocal);
  
  AddIFAsCleanUpFunction();

  TestPreparationBegin();
  {
    {
      CreateTTEIFFunction("Tt4h42sqi_General_Precondition", __eFct, __eLocal);
      CallInterfaceFunction(__cEmpty, __cEmpty, "74787266-8376-4866-a392-d0cc32109fae");
    }


  }
  TestPreparationEnd();

  TestCommandBegin(__eDiagService, __cDiagService, "", "2");
  {
    if (DiagIsFunctionalGroup("CVADAS_0001_00000000_000"))
    {
      DiagResponse * __resp;
      DiagRequest CVADAS_0001_00000000_000.Default_Session_Start __req;
      __diagService4h42sqi_55(__req, __resp);
    }
    else
    {
      DiagResponse CVADAS_0001_00000000_000.* __resp;
      DiagRequest CVADAS_0001_00000000_000.Default_Session_Start __req;
      __diagService4h42sqi_55(__req, __resp);
    }
  }
  TestCommandEnd();


  {
    CreateTTEIFFunction("Tt4h42sqi_F186_DID_with_PhysicalAdd_DefaultSession", __eFct, __eLocal);
    CallInterfaceFunction(__cEmpty, __cEmpty, "f479ea65-8c8c-4093-b3d8-2a8374608569");
  }


  {
    CreateTTEIFFunction("Tt4h42sqi_F110_DID_with_Physical_Address", __eFct, __eLocal);
    CallInterfaceFunction(__cEmpty, __cEmpty, "a945bd48-dcc1-4597-9833-50ccc307f21a");
  }



}

  
void __diagService4h42sqi_55(DiagRequest * __req, DiagResponse * __resp )
{
  stack long __tableHandle;
  long __res, __paramLen, __bytePos;

   __bVerdict = __eVerdictPass;

  do {
    TestReportResetDiagObjectList();
    DiagSetReportDetailLevel("CVADAS_0001_00000000_000", EnumServiceDetails_onfail);
    // Request aspect
    {

      if (0 >= DiagSendReqAndWaitForResp("CVADAS_0001_00000000_000", __req, __resp, __res, -1, -1, -1, -1, -1, EnumResult_pos, EnumServiceDetails_onfail, EnumSendingMode_physical, EnumSuppressPosResBit_asconfigured, EnumVerdictOnInvalidValues_fail))
        break;
    }

    __res = DiagErrCodeTestStep(__res, "Can't retrieve last response for request! No check possible.") < 0;
    if(__res)
    {
	  __bVerdict = __eVerdictFail;
      break;
    }
    {
      __res = DiagInterpretAs(__resp, "DSC_PR");
      if(__res != 0)
      {
        __bVerdict = __eVerdictFail;
        DiagErrCodeTestStep(__res, "Can't interpret response as diagnostic primitive 'DSC_PR'.");
        break;
      }
      else
      {
        TestStepPass( "Received primitive can be interpreted as diagnostic primitive 'DSC_PR'.");
      }
    }
  }
  while(0);


  // Response, check & read aspect
  {
    __res = 1;
    __tableHandle = ReportTableHead5Columns(__cCheckCaption, __cTSym, __cTOp, __cRefVal, __cActual, __cRes);
    {
      __bDiagValueArrayCtr = DiagGetParameterErrorHandled(__resp, "DiagSessionType", __bDiagValueArray, elcount(__bDiagValueArray), __cDiagValueArray, elcount(__cDiagValueArray));
      {
        byte __bArray2[1] = { 0x01 };
        __bArrayCtr = __CopyBytes(__bDiagValueArray, __bDiagValueArrayCtr, __bArray);
        __bArrayCtr2 = elCount(__bArray2);
        __csr = CompareBytes(__bArray, __bArrayCtr, __bArray2, __bArrayCtr2) == 0;
        snprintf(__cArray, 8192, "%s", "Diagnostic parameter \'DiagSessionType\'");
        snprintf(__cArray2, 8192, "%s", __cArray);
        snprintf(__cArray3, 8192, "%s", "");
        ReportTableRow(__tableHandle, 0, __cArray2, "Bytes", __bArray2, __bArrayCtr2, __cArray3, __oneOfFlag, __bSetInCheckAlignment);
        ReportCell(__tableHandle, __bArray, __bArrayCtr);
        ReportCellResult(__tableHandle, __csr, __ePassFail);
      }
    
      __res = __res && __csr;
    
    }
    ReportTableEndVerdict(__tableHandle, __cEvaluateResponse, __res);
	__bVerdict = __bVerdict && __res;
  }
  if (__bVerdict == __eVerdictFail)
    TestReportWriteDiagObjectList();
}
void Tt4h42sqi_Tet_Tc127_Completion()
{
  stack long __tableHandle;
  TestCompletionBegin();
  {
    {
      CreateTTEIFFunction("Tt4h42sqi_General_Postconditions", __eFct, __eLocal);
      CallInterfaceFunction(__cEmpty, __cEmpty, "8c04fef4-3bbc-4cc8-b3ee-b62ec5ff47eb");
    }


  }
  TestCompletionEnd();
}

void Tt4h42sqi_Tet_Tc128()
{
  CreateTTEIFFunction("Tt4h42sqi_Tc128", __eTcDef, __eLocal);  
  AddIFParameterTestCaseAttribute("TC_ID", "");
  AddIFParameterTestCaseAttribute("Test Case ID", "");
  CallInterfaceFunction("TC_ID_20205129_Standard_Physical_Address", __cEmpty , __cEmpty );
}
testcase Tt4h42sqi_Tc128()
{
  stack long __tableHandle;
  SetBreakOnFail(0);

  CreateTTEIFFunction("Tt4h42sqi_Tet_Tc128_Completion", __eFct, __eLocal);
  
  AddIFAsCleanUpFunction();

  TestPreparationBegin();
  {
    {
      CreateTTEIFFunction("Tt4h42sqi_General_Precondition", __eFct, __eLocal);
      CallInterfaceFunction(__cEmpty, __cEmpty, "74787266-8376-4866-a392-d0cc32109fae");
    }


  }
  TestPreparationEnd();

  {
    CreateTTEIFFunction("Tt4h42sqi_Default_Session_Standard_Physical_Address", __eFct, __eLocal);
    CallInterfaceFunction(__cEmpty, __cEmpty, "627cb293-726d-49b1-b2f7-7f87145feea3");
  }


  {
    CreateTTEIFFunction("Tt4h42sqi_F186_DID_with_Standard_Physical_Address_Default_Session", __eFct, __eLocal);
    CallInterfaceFunction(__cEmpty, __cEmpty, "94a4fb5c-65ad-4a5d-ac34-b6372d993b69");
  }


  {
    CreateTTEIFFunction("Tt4h42sqi_F110_DID_with_Standard_Physical_Address", __eFct, __eLocal);
    CallInterfaceFunction(__cEmpty, __cEmpty, "036c4af7-09ea-4704-a630-becfb24b20b0");
  }



}

void Tt4h42sqi_Tet_Tc128_Completion()
{
  stack long __tableHandle;
  TestCompletionBegin();
  {
    {
      CreateTTEIFFunction("Tt4h42sqi_General_Postconditions", __eFct, __eLocal);
      CallInterfaceFunction(__cEmpty, __cEmpty, "8c04fef4-3bbc-4cc8-b3ee-b62ec5ff47eb");
    }


  }
  TestCompletionEnd();
}

void Tt4h42sqi_Tet_Tc129()
{
  CreateTTEIFFunction("Tt4h42sqi_Tc129", __eTcDef, __eLocal);  
  AddIFParameterTestCaseAttribute("TC_ID", "");
  AddIFParameterTestCaseAttribute("Test Case ID", "");
  CallInterfaceFunction("TC_ID_20205138_Extended_Session", __cEmpty , __cEmpty );
}
testcase Tt4h42sqi_Tc129()
{
  stack long __tableHandle;
  SetBreakOnFail(0);

  CreateTTEIFFunction("Tt4h42sqi_Tet_Tc129_Completion", __eFct, __eLocal);
  
  AddIFAsCleanUpFunction();

  TestPreparationBegin();
  {
    {
      CreateTTEIFFunction("Tt4h42sqi_General_Precondition", __eFct, __eLocal);
      CallInterfaceFunction(__cEmpty, __cEmpty, "74787266-8376-4866-a392-d0cc32109fae");
    }


  }
  TestPreparationEnd();

  TestCommandBegin(__eDiagService, __cDiagService, "", "2");
  {
    if (DiagIsFunctionalGroup("CVADAS_0001_00000000_000"))
    {
      DiagResponse * __resp;
      DiagRequest CVADAS_0001_00000000_000.Default_Session_Start __req;
      __diagService4h42sqi_56(__req, __resp);
    }
    else
    {
      DiagResponse CVADAS_0001_00000000_000.* __resp;
      DiagRequest CVADAS_0001_00000000_000.Default_Session_Start __req;
      __diagService4h42sqi_56(__req, __resp);
    }
  }
  TestCommandEnd();


  TestCommandBegin(__eDiagService, __cDiagService, "", "3");
  {
    if (DiagIsFunctionalGroup("CVADAS_0001_00000000_000"))
    {
      DiagResponse * __resp;
      DiagRequest CVADAS_0001_00000000_000.Extended_Diagnostic_Session_Start __req;
      __diagService4h42sqi_57(__req, __resp);
    }
    else
    {
      DiagResponse CVADAS_0001_00000000_000.* __resp;
      DiagRequest CVADAS_0001_00000000_000.Extended_Diagnostic_Session_Start __req;
      __diagService4h42sqi_57(__req, __resp);
    }
  }
  TestCommandEnd();


  {
    CreateTTEIFFunction("Tt4h42sqi_F186_DID_with_PhysicalAdd_ExtendedSession", __eFct, __eLocal);
    CallInterfaceFunction(__cEmpty, __cEmpty, "56d9e7a7-9216-4d5f-b776-c5e862f155cb");
  }


  {
    CreateTTEIFFunction("Tt4h42sqi_F110_DID_with_Physical_Address", __eFct, __eLocal);
    CallInterfaceFunction(__cEmpty, __cEmpty, "a945bd48-dcc1-4597-9833-50ccc307f21a");
  }



}

  
void __diagService4h42sqi_56(DiagRequest * __req, DiagResponse * __resp )
{
  stack long __tableHandle;
  long __res, __paramLen, __bytePos;

   __bVerdict = __eVerdictPass;

  do {
    TestReportResetDiagObjectList();
    DiagSetReportDetailLevel("CVADAS_0001_00000000_000", EnumServiceDetails_onfail);
    // Request aspect
    {

      if (0 >= DiagSendReqAndWaitForResp("CVADAS_0001_00000000_000", __req, __resp, __res, -1, -1, -1, -1, -1, EnumResult_pos, EnumServiceDetails_onfail, EnumSendingMode_physical, EnumSuppressPosResBit_asconfigured, EnumVerdictOnInvalidValues_fail))
        break;
    }

    __res = DiagErrCodeTestStep(__res, "Can't retrieve last response for request! No check possible.") < 0;
    if(__res)
    {
	  __bVerdict = __eVerdictFail;
      break;
    }
    {
      __res = DiagInterpretAs(__resp, "DSC_PR");
      if(__res != 0)
      {
        __bVerdict = __eVerdictFail;
        DiagErrCodeTestStep(__res, "Can't interpret response as diagnostic primitive 'DSC_PR'.");
        break;
      }
      else
      {
        TestStepPass( "Received primitive can be interpreted as diagnostic primitive 'DSC_PR'.");
      }
    }
  }
  while(0);


  // Response, check & read aspect
  {
    __res = 1;
    __tableHandle = ReportTableHead5Columns(__cCheckCaption, __cTSym, __cTOp, __cRefVal, __cActual, __cRes);
    {
      __bDiagValueArrayCtr = DiagGetParameterErrorHandled(__resp, "DiagSessionType", __bDiagValueArray, elcount(__bDiagValueArray), __cDiagValueArray, elcount(__cDiagValueArray));
      {
        byte __bArray2[1] = { 0x01 };
        __bArrayCtr = __CopyBytes(__bDiagValueArray, __bDiagValueArrayCtr, __bArray);
        __bArrayCtr2 = elCount(__bArray2);
        __csr = CompareBytes(__bArray, __bArrayCtr, __bArray2, __bArrayCtr2) == 0;
        snprintf(__cArray, 8192, "%s", "Diagnostic parameter \'DiagSessionType\'");
        snprintf(__cArray2, 8192, "%s", __cArray);
        snprintf(__cArray3, 8192, "%s", "");
        ReportTableRow(__tableHandle, 0, __cArray2, "Bytes", __bArray2, __bArrayCtr2, __cArray3, __oneOfFlag, __bSetInCheckAlignment);
        ReportCell(__tableHandle, __bArray, __bArrayCtr);
        ReportCellResult(__tableHandle, __csr, __ePassFail);
      }
    
      __res = __res && __csr;
    
    }
    ReportTableEndVerdict(__tableHandle, __cEvaluateResponse, __res);
	__bVerdict = __bVerdict && __res;
  }
  if (__bVerdict == __eVerdictFail)
    TestReportWriteDiagObjectList();
}
  
void __diagService4h42sqi_57(DiagRequest * __req, DiagResponse * __resp )
{
  stack long __tableHandle;
  long __res, __paramLen, __bytePos;

   __bVerdict = __eVerdictPass;

  do {
    TestReportResetDiagObjectList();
    DiagSetReportDetailLevel("CVADAS_0001_00000000_000", EnumServiceDetails_onfail);
    // Request aspect
    {

      if (0 >= DiagSendReqAndWaitForResp("CVADAS_0001_00000000_000", __req, __resp, __res, -1, -1, -1, -1, -1, EnumResult_pos, EnumServiceDetails_onfail, EnumSendingMode_physical, EnumSuppressPosResBit_asconfigured, EnumVerdictOnInvalidValues_fail))
        break;
    }

    __res = DiagErrCodeTestStep(__res, "Can't retrieve last response for request! No check possible.") < 0;
    if(__res)
    {
	  __bVerdict = __eVerdictFail;
      break;
    }
    {
      __res = DiagInterpretAs(__resp, "DSC_PR");
      if(__res != 0)
      {
        __bVerdict = __eVerdictFail;
        DiagErrCodeTestStep(__res, "Can't interpret response as diagnostic primitive 'DSC_PR'.");
        break;
      }
      else
      {
        TestStepPass( "Received primitive can be interpreted as diagnostic primitive 'DSC_PR'.");
      }
    }
  }
  while(0);


  // Response, check & read aspect
  {
    __res = 1;
    __tableHandle = ReportTableHead5Columns(__cCheckCaption, __cTSym, __cTOp, __cRefVal, __cActual, __cRes);
    {
      __bDiagValueArrayCtr = DiagGetParameterErrorHandled(__resp, "DiagSessionType", __bDiagValueArray, elcount(__bDiagValueArray), __cDiagValueArray, elcount(__cDiagValueArray));
      {
        byte __bArray2[1] = { 0x03 };
        __bArrayCtr = __CopyBytes(__bDiagValueArray, __bDiagValueArrayCtr, __bArray);
        __bArrayCtr2 = elCount(__bArray2);
        __csr = CompareBytes(__bArray, __bArrayCtr, __bArray2, __bArrayCtr2) == 0;
        snprintf(__cArray, 8192, "%s", "Diagnostic parameter \'DiagSessionType\'");
        snprintf(__cArray2, 8192, "%s", __cArray);
        snprintf(__cArray3, 8192, "%s", "");
        ReportTableRow(__tableHandle, 0, __cArray2, "Bytes", __bArray2, __bArrayCtr2, __cArray3, __oneOfFlag, __bSetInCheckAlignment);
        ReportCell(__tableHandle, __bArray, __bArrayCtr);
        ReportCellResult(__tableHandle, __csr, __ePassFail);
      }
    
      __res = __res && __csr;
    
    }
    ReportTableEndVerdict(__tableHandle, __cEvaluateResponse, __res);
	__bVerdict = __bVerdict && __res;
  }
  if (__bVerdict == __eVerdictFail)
    TestReportWriteDiagObjectList();
}
void Tt4h42sqi_Tet_Tc129_Completion()
{
  stack long __tableHandle;
  TestCompletionBegin();
  {
    {
      CreateTTEIFFunction("Tt4h42sqi_General_Postconditions", __eFct, __eLocal);
      CallInterfaceFunction(__cEmpty, __cEmpty, "8c04fef4-3bbc-4cc8-b3ee-b62ec5ff47eb");
    }


  }
  TestCompletionEnd();
}

void Tt4h42sqi_Tet_Tc130()
{
  CreateTTEIFFunction("Tt4h42sqi_Tc130", __eTcDef, __eLocal);  
  AddIFParameterTestCaseAttribute("TC_ID", "");
  AddIFParameterTestCaseAttribute("Test Case ID", "");
  CallInterfaceFunction("TC_ID_20205147_Standard_Physical_Address", __cEmpty , __cEmpty );
}
testcase Tt4h42sqi_Tc130()
{
  stack long __tableHandle;
  SetBreakOnFail(0);

  CreateTTEIFFunction("Tt4h42sqi_Tet_Tc130_Completion", __eFct, __eLocal);
  
  AddIFAsCleanUpFunction();

  TestPreparationBegin();
  {
    {
      CreateTTEIFFunction("Tt4h42sqi_General_Precondition", __eFct, __eLocal);
      CallInterfaceFunction(__cEmpty, __cEmpty, "74787266-8376-4866-a392-d0cc32109fae");
    }


  }
  TestPreparationEnd();

  {
    CreateTTEIFFunction("Tt4h42sqi_Default_Session_Standard_Physical_Address", __eFct, __eLocal);
    CallInterfaceFunction(__cEmpty, __cEmpty, "627cb293-726d-49b1-b2f7-7f87145feea3");
  }


  {
    CreateTTEIFFunction("Tt4h42sqi_Extended_Session_Standard_Physical_Address", __eFct, __eLocal);
    CallInterfaceFunction(__cEmpty, __cEmpty, "58435b58-3d17-4ead-b77b-3e81b0124cf0");
  }


  {
    CreateTTEIFFunction("Tt4h42sqi_F186_DID_with_Standard_Physical_Address_Extended_Session", __eFct, __eLocal);
    CallInterfaceFunction(__cEmpty, __cEmpty, "1164fa28-24b1-4b88-89b6-88fe5bcc87f0");
  }


  {
    CreateTTEIFFunction("Tt4h42sqi_F110_DID_with_Standard_Physical_Address", __eFct, __eLocal);
    CallInterfaceFunction(__cEmpty, __cEmpty, "036c4af7-09ea-4704-a630-becfb24b20b0");
  }



}

void Tt4h42sqi_Tet_Tc130_Completion()
{
  stack long __tableHandle;
  TestCompletionBegin();
  {
    {
      CreateTTEIFFunction("Tt4h42sqi_General_Postconditions", __eFct, __eLocal);
      CallInterfaceFunction(__cEmpty, __cEmpty, "8c04fef4-3bbc-4cc8-b3ee-b62ec5ff47eb");
    }


  }
  TestCompletionEnd();
}

void Tt4h42sqi_Tet_Tc131()
{
  CreateTTEIFFunction("Tt4h42sqi_Tc131", __eTcDef, __eLocal);  
  AddIFParameterTestCaseAttribute("TC_ID", "");
  AddIFParameterTestCaseAttribute("Test Case ID", "");
  CallInterfaceFunction("TC_ID_20205102_Standard_Physical_Address", __cEmpty , __cEmpty );
}
testcase Tt4h42sqi_Tc131()
{
  stack long __tableHandle;
  SetBreakOnFail(0);

  CreateTTEIFFunction("Tt4h42sqi_Tet_Tc131_Completion", __eFct, __eLocal);
  
  AddIFAsCleanUpFunction();

  TestPreparationBegin();
  {
    {
      CreateTTEIFFunction("Tt4h42sqi_General_Precondition", __eFct, __eLocal);
      CallInterfaceFunction(__cEmpty, __cEmpty, "74787266-8376-4866-a392-d0cc32109fae");
    }


  }
  TestPreparationEnd();

  {
    CreateTTEIFFunction("Tt4h42sqi_Default_Session_Standard_Physical_Address", __eFct, __eLocal);
    CallInterfaceFunction(__cEmpty, __cEmpty, "627cb293-726d-49b1-b2f7-7f87145feea3");
  }


  {
    CreateTTEIFFunction("Tt4h42sqi_Extended_Session_Standard_Physical_Address", __eFct, __eLocal);
    CallInterfaceFunction(__cEmpty, __cEmpty, "58435b58-3d17-4ead-b77b-3e81b0124cf0");
  }


  {
    CreateTTEIFFunction("Tt4h42sqi_Programming_Session_Standard_Physical_Address", __eFct, __eLocal);
    CallInterfaceFunction(__cEmpty, __cEmpty, "64df3f17-5288-46ad-be1e-0af37814eba8");
  }


  TestCommandBegin(__eWait, __cWait, "", "6");
  {
    Wait("1", (2000 * 1000000LL), 1000000, "");
  }
  TestCommandEnd();

  {
    CreateTTEIFFunction("Tt4h42sqi_F110_DID_with_Standard_Physical_Address", __eFct, __eLocal);
    CallInterfaceFunction(__cEmpty, __cEmpty, "036c4af7-09ea-4704-a630-becfb24b20b0");
  }



}

void Tt4h42sqi_Tet_Tc131_Completion()
{
  stack long __tableHandle;
  TestCompletionBegin();
  {
    {
      CreateTTEIFFunction("Tt4h42sqi_General_Postconditions", __eFct, __eLocal);
      CallInterfaceFunction(__cEmpty, __cEmpty, "8c04fef4-3bbc-4cc8-b3ee-b62ec5ff47eb");
    }


  }
  TestCompletionEnd();
}

void Tt4h42sqi_Tet_Tc132()
{
  CreateTTEIFFunction("Tt4h42sqi_Tc132", __eTcDef, __eLocal);  
  AddIFParameterTestCaseAttribute("TC_ID", "");
  AddIFParameterTestCaseAttribute("Test Case ID", "");
  CallInterfaceFunction("TC_ID_20205280_Defaults_Session", __cEmpty , __cEmpty );
}
testcase Tt4h42sqi_Tc132()
{
  stack long __tableHandle;
  SetBreakOnFail(0);

  CreateTTEIFFunction("Tt4h42sqi_Tet_Tc132_Completion", __eFct, __eLocal);
  
  AddIFAsCleanUpFunction();

  TestPreparationBegin();
  {
    {
      CreateTTEIFFunction("Tt4h42sqi_General_Precondition", __eFct, __eLocal);
      CallInterfaceFunction(__cEmpty, __cEmpty, "74787266-8376-4866-a392-d0cc32109fae");
    }


  }
  TestPreparationEnd();

  TestCommandBegin(__eDiagService, __cDiagService, "", "2");
  {
    if (DiagIsFunctionalGroup("CVADAS_0001_00000000_000"))
    {
      DiagResponse * __resp;
      DiagRequest CVADAS_0001_00000000_000.Default_Session_Start __req;
      __diagService4h42sqi_58(__req, __resp);
    }
    else
    {
      DiagResponse CVADAS_0001_00000000_000.* __resp;
      DiagRequest CVADAS_0001_00000000_000.Default_Session_Start __req;
      __diagService4h42sqi_58(__req, __resp);
    }
  }
  TestCommandEnd();


  {
    CreateTTEIFFunction("Tt4h42sqi_F186_DID_with_PhysicalAdd_DefaultSession", __eFct, __eLocal);
    CallInterfaceFunction(__cEmpty, __cEmpty, "f479ea65-8c8c-4093-b3d8-2a8374608569");
  }


  {
    CreateTTEIFFunction("Tt4h42sqi_F10D_DID_with_Physical_Address", __eFct, __eLocal);
    CallInterfaceFunction(__cEmpty, __cEmpty, "fa229932-ef82-4a44-86dc-e022c2473f65");
  }



}

  
void __diagService4h42sqi_58(DiagRequest * __req, DiagResponse * __resp )
{
  stack long __tableHandle;
  long __res, __paramLen, __bytePos;

   __bVerdict = __eVerdictPass;

  do {
    TestReportResetDiagObjectList();
    DiagSetReportDetailLevel("CVADAS_0001_00000000_000", EnumServiceDetails_onfail);
    // Request aspect
    {

      if (0 >= DiagSendReqAndWaitForResp("CVADAS_0001_00000000_000", __req, __resp, __res, -1, -1, -1, -1, -1, EnumResult_pos, EnumServiceDetails_onfail, EnumSendingMode_physical, EnumSuppressPosResBit_asconfigured, EnumVerdictOnInvalidValues_fail))
        break;
    }

    __res = DiagErrCodeTestStep(__res, "Can't retrieve last response for request! No check possible.") < 0;
    if(__res)
    {
	  __bVerdict = __eVerdictFail;
      break;
    }
    {
      __res = DiagInterpretAs(__resp, "DSC_PR");
      if(__res != 0)
      {
        __bVerdict = __eVerdictFail;
        DiagErrCodeTestStep(__res, "Can't interpret response as diagnostic primitive 'DSC_PR'.");
        break;
      }
      else
      {
        TestStepPass( "Received primitive can be interpreted as diagnostic primitive 'DSC_PR'.");
      }
    }
  }
  while(0);


  // Response, check & read aspect
  {
    __res = 1;
    __tableHandle = ReportTableHead5Columns(__cCheckCaption, __cTSym, __cTOp, __cRefVal, __cActual, __cRes);
    {
      __bDiagValueArrayCtr = DiagGetParameterErrorHandled(__resp, "DiagSessionType", __bDiagValueArray, elcount(__bDiagValueArray), __cDiagValueArray, elcount(__cDiagValueArray));
      {
        byte __bArray2[1] = { 0x01 };
        __bArrayCtr = __CopyBytes(__bDiagValueArray, __bDiagValueArrayCtr, __bArray);
        __bArrayCtr2 = elCount(__bArray2);
        __csr = CompareBytes(__bArray, __bArrayCtr, __bArray2, __bArrayCtr2) == 0;
        snprintf(__cArray, 8192, "%s", "Diagnostic parameter \'DiagSessionType\'");
        snprintf(__cArray2, 8192, "%s", __cArray);
        snprintf(__cArray3, 8192, "%s", "");
        ReportTableRow(__tableHandle, 0, __cArray2, "Bytes", __bArray2, __bArrayCtr2, __cArray3, __oneOfFlag, __bSetInCheckAlignment);
        ReportCell(__tableHandle, __bArray, __bArrayCtr);
        ReportCellResult(__tableHandle, __csr, __ePassFail);
      }
    
      __res = __res && __csr;
    
    }
    ReportTableEndVerdict(__tableHandle, __cEvaluateResponse, __res);
	__bVerdict = __bVerdict && __res;
  }
  if (__bVerdict == __eVerdictFail)
    TestReportWriteDiagObjectList();
}
void Tt4h42sqi_Tet_Tc132_Completion()
{
  stack long __tableHandle;
  TestCompletionBegin();
  {
    {
      CreateTTEIFFunction("Tt4h42sqi_General_Postconditions", __eFct, __eLocal);
      CallInterfaceFunction(__cEmpty, __cEmpty, "8c04fef4-3bbc-4cc8-b3ee-b62ec5ff47eb");
    }


  }
  TestCompletionEnd();
}

void Tt4h42sqi_Tet_Tc133()
{
  CreateTTEIFFunction("Tt4h42sqi_Tc133", __eTcDef, __eLocal);  
  AddIFParameterTestCaseAttribute("TC_ID", "");
  AddIFParameterTestCaseAttribute("Test Case ID", "");
  CallInterfaceFunction("TC_ID_20205246_Standard_Physical_Address", __cEmpty , __cEmpty );
}
testcase Tt4h42sqi_Tc133()
{
  stack long __tableHandle;
  SetBreakOnFail(0);

  CreateTTEIFFunction("Tt4h42sqi_Tet_Tc133_Completion", __eFct, __eLocal);
  
  AddIFAsCleanUpFunction();

  TestPreparationBegin();
  {
    {
      CreateTTEIFFunction("Tt4h42sqi_General_Precondition", __eFct, __eLocal);
      CallInterfaceFunction(__cEmpty, __cEmpty, "74787266-8376-4866-a392-d0cc32109fae");
    }


  }
  TestPreparationEnd();

  {
    CreateTTEIFFunction("Tt4h42sqi_Default_Session_Standard_Physical_Address", __eFct, __eLocal);
    CallInterfaceFunction(__cEmpty, __cEmpty, "627cb293-726d-49b1-b2f7-7f87145feea3");
  }


  {
    CreateTTEIFFunction("Tt4h42sqi_F186_DID_with_Standard_Physical_Address_Default_Session", __eFct, __eLocal);
    CallInterfaceFunction(__cEmpty, __cEmpty, "94a4fb5c-65ad-4a5d-ac34-b6372d993b69");
  }


  {
    CreateTTEIFFunction("Tt4h42sqi_F10D_DID_with_Standard_Physical_Address", __eFct, __eLocal);
    CallInterfaceFunction(__cEmpty, __cEmpty, "12ba7feb-84d6-45a8-a78a-3d3eca772fca");
  }



}

void Tt4h42sqi_Tet_Tc133_Completion()
{
  stack long __tableHandle;
  TestCompletionBegin();
  {
    {
      CreateTTEIFFunction("Tt4h42sqi_General_Postconditions", __eFct, __eLocal);
      CallInterfaceFunction(__cEmpty, __cEmpty, "8c04fef4-3bbc-4cc8-b3ee-b62ec5ff47eb");
    }


  }
  TestCompletionEnd();
}

void Tt4h42sqi_Tet_Tc134()
{
  CreateTTEIFFunction("Tt4h42sqi_Tc134", __eTcDef, __eLocal);  
  AddIFParameterTestCaseAttribute("TC_ID", "");
  AddIFParameterTestCaseAttribute("Test Case ID", "");
  CallInterfaceFunction("TC_ID_20205217_Extended_Session", __cEmpty , __cEmpty );
}
testcase Tt4h42sqi_Tc134()
{
  stack long __tableHandle;
  SetBreakOnFail(0);

  CreateTTEIFFunction("Tt4h42sqi_Tet_Tc134_Completion", __eFct, __eLocal);
  
  AddIFAsCleanUpFunction();

  TestPreparationBegin();
  {
    {
      CreateTTEIFFunction("Tt4h42sqi_General_Precondition", __eFct, __eLocal);
      CallInterfaceFunction(__cEmpty, __cEmpty, "74787266-8376-4866-a392-d0cc32109fae");
    }


  }
  TestPreparationEnd();

  TestCommandBegin(__eDiagService, __cDiagService, "", "2");
  {
    if (DiagIsFunctionalGroup("CVADAS_0001_00000000_000"))
    {
      DiagResponse * __resp;
      DiagRequest CVADAS_0001_00000000_000.Default_Session_Start __req;
      __diagService4h42sqi_59(__req, __resp);
    }
    else
    {
      DiagResponse CVADAS_0001_00000000_000.* __resp;
      DiagRequest CVADAS_0001_00000000_000.Default_Session_Start __req;
      __diagService4h42sqi_59(__req, __resp);
    }
  }
  TestCommandEnd();


  TestCommandBegin(__eDiagService, __cDiagService, "", "3");
  {
    if (DiagIsFunctionalGroup("CVADAS_0001_00000000_000"))
    {
      DiagResponse * __resp;
      DiagRequest CVADAS_0001_00000000_000.Extended_Diagnostic_Session_Start __req;
      __diagService4h42sqi_60(__req, __resp);
    }
    else
    {
      DiagResponse CVADAS_0001_00000000_000.* __resp;
      DiagRequest CVADAS_0001_00000000_000.Extended_Diagnostic_Session_Start __req;
      __diagService4h42sqi_60(__req, __resp);
    }
  }
  TestCommandEnd();


  {
    CreateTTEIFFunction("Tt4h42sqi_F186_DID_with_PhysicalAdd_ExtendedSession", __eFct, __eLocal);
    CallInterfaceFunction(__cEmpty, __cEmpty, "56d9e7a7-9216-4d5f-b776-c5e862f155cb");
  }


  {
    CreateTTEIFFunction("Tt4h42sqi_F10D_DID_with_Physical_Address", __eFct, __eLocal);
    CallInterfaceFunction(__cEmpty, __cEmpty, "fa229932-ef82-4a44-86dc-e022c2473f65");
  }



}

  
void __diagService4h42sqi_59(DiagRequest * __req, DiagResponse * __resp )
{
  stack long __tableHandle;
  long __res, __paramLen, __bytePos;

   __bVerdict = __eVerdictPass;

  do {
    TestReportResetDiagObjectList();
    DiagSetReportDetailLevel("CVADAS_0001_00000000_000", EnumServiceDetails_onfail);
    // Request aspect
    {

      if (0 >= DiagSendReqAndWaitForResp("CVADAS_0001_00000000_000", __req, __resp, __res, -1, -1, -1, -1, -1, EnumResult_pos, EnumServiceDetails_onfail, EnumSendingMode_physical, EnumSuppressPosResBit_asconfigured, EnumVerdictOnInvalidValues_fail))
        break;
    }

    __res = DiagErrCodeTestStep(__res, "Can't retrieve last response for request! No check possible.") < 0;
    if(__res)
    {
	  __bVerdict = __eVerdictFail;
      break;
    }
    {
      __res = DiagInterpretAs(__resp, "DSC_PR");
      if(__res != 0)
      {
        __bVerdict = __eVerdictFail;
        DiagErrCodeTestStep(__res, "Can't interpret response as diagnostic primitive 'DSC_PR'.");
        break;
      }
      else
      {
        TestStepPass( "Received primitive can be interpreted as diagnostic primitive 'DSC_PR'.");
      }
    }
  }
  while(0);


  // Response, check & read aspect
  {
    __res = 1;
    __tableHandle = ReportTableHead5Columns(__cCheckCaption, __cTSym, __cTOp, __cRefVal, __cActual, __cRes);
    {
      __bDiagValueArrayCtr = DiagGetParameterErrorHandled(__resp, "DiagSessionType", __bDiagValueArray, elcount(__bDiagValueArray), __cDiagValueArray, elcount(__cDiagValueArray));
      {
        byte __bArray2[1] = { 0x01 };
        __bArrayCtr = __CopyBytes(__bDiagValueArray, __bDiagValueArrayCtr, __bArray);
        __bArrayCtr2 = elCount(__bArray2);
        __csr = CompareBytes(__bArray, __bArrayCtr, __bArray2, __bArrayCtr2) == 0;
        snprintf(__cArray, 8192, "%s", "Diagnostic parameter \'DiagSessionType\'");
        snprintf(__cArray2, 8192, "%s", __cArray);
        snprintf(__cArray3, 8192, "%s", "");
        ReportTableRow(__tableHandle, 0, __cArray2, "Bytes", __bArray2, __bArrayCtr2, __cArray3, __oneOfFlag, __bSetInCheckAlignment);
        ReportCell(__tableHandle, __bArray, __bArrayCtr);
        ReportCellResult(__tableHandle, __csr, __ePassFail);
      }
    
      __res = __res && __csr;
    
    }
    ReportTableEndVerdict(__tableHandle, __cEvaluateResponse, __res);
	__bVerdict = __bVerdict && __res;
  }
  if (__bVerdict == __eVerdictFail)
    TestReportWriteDiagObjectList();
}
  
void __diagService4h42sqi_60(DiagRequest * __req, DiagResponse * __resp )
{
  stack long __tableHandle;
  long __res, __paramLen, __bytePos;

   __bVerdict = __eVerdictPass;

  do {
    TestReportResetDiagObjectList();
    DiagSetReportDetailLevel("CVADAS_0001_00000000_000", EnumServiceDetails_onfail);
    // Request aspect
    {

      if (0 >= DiagSendReqAndWaitForResp("CVADAS_0001_00000000_000", __req, __resp, __res, -1, -1, -1, -1, -1, EnumResult_pos, EnumServiceDetails_onfail, EnumSendingMode_physical, EnumSuppressPosResBit_asconfigured, EnumVerdictOnInvalidValues_fail))
        break;
    }

    __res = DiagErrCodeTestStep(__res, "Can't retrieve last response for request! No check possible.") < 0;
    if(__res)
    {
	  __bVerdict = __eVerdictFail;
      break;
    }
    {
      __res = DiagInterpretAs(__resp, "DSC_PR");
      if(__res != 0)
      {
        __bVerdict = __eVerdictFail;
        DiagErrCodeTestStep(__res, "Can't interpret response as diagnostic primitive 'DSC_PR'.");
        break;
      }
      else
      {
        TestStepPass( "Received primitive can be interpreted as diagnostic primitive 'DSC_PR'.");
      }
    }
  }
  while(0);


  // Response, check & read aspect
  {
    __res = 1;
    __tableHandle = ReportTableHead5Columns(__cCheckCaption, __cTSym, __cTOp, __cRefVal, __cActual, __cRes);
    {
      __bDiagValueArrayCtr = DiagGetParameterErrorHandled(__resp, "DiagSessionType", __bDiagValueArray, elcount(__bDiagValueArray), __cDiagValueArray, elcount(__cDiagValueArray));
      {
        byte __bArray2[1] = { 0x03 };
        __bArrayCtr = __CopyBytes(__bDiagValueArray, __bDiagValueArrayCtr, __bArray);
        __bArrayCtr2 = elCount(__bArray2);
        __csr = CompareBytes(__bArray, __bArrayCtr, __bArray2, __bArrayCtr2) == 0;
        snprintf(__cArray, 8192, "%s", "Diagnostic parameter \'DiagSessionType\'");
        snprintf(__cArray2, 8192, "%s", __cArray);
        snprintf(__cArray3, 8192, "%s", "");
        ReportTableRow(__tableHandle, 0, __cArray2, "Bytes", __bArray2, __bArrayCtr2, __cArray3, __oneOfFlag, __bSetInCheckAlignment);
        ReportCell(__tableHandle, __bArray, __bArrayCtr);
        ReportCellResult(__tableHandle, __csr, __ePassFail);
      }
    
      __res = __res && __csr;
    
    }
    ReportTableEndVerdict(__tableHandle, __cEvaluateResponse, __res);
	__bVerdict = __bVerdict && __res;
  }
  if (__bVerdict == __eVerdictFail)
    TestReportWriteDiagObjectList();
}
void Tt4h42sqi_Tet_Tc134_Completion()
{
  stack long __tableHandle;
  TestCompletionBegin();
  {
    {
      CreateTTEIFFunction("Tt4h42sqi_General_Postconditions", __eFct, __eLocal);
      CallInterfaceFunction(__cEmpty, __cEmpty, "8c04fef4-3bbc-4cc8-b3ee-b62ec5ff47eb");
    }


  }
  TestCompletionEnd();
}

void Tt4h42sqi_Tet_Tc135()
{
  CreateTTEIFFunction("Tt4h42sqi_Tc135", __eTcDef, __eLocal);  
  AddIFParameterTestCaseAttribute("TC_ID", "");
  AddIFParameterTestCaseAttribute("Test Case ID", "");
  CallInterfaceFunction("TC_ID_20205220_Standard_Physical_Address", __cEmpty , __cEmpty );
}
testcase Tt4h42sqi_Tc135()
{
  stack long __tableHandle;
  SetBreakOnFail(0);

  CreateTTEIFFunction("Tt4h42sqi_Tet_Tc135_Completion", __eFct, __eLocal);
  
  AddIFAsCleanUpFunction();

  TestPreparationBegin();
  {
    {
      CreateTTEIFFunction("Tt4h42sqi_General_Precondition", __eFct, __eLocal);
      CallInterfaceFunction(__cEmpty, __cEmpty, "74787266-8376-4866-a392-d0cc32109fae");
    }


  }
  TestPreparationEnd();

  {
    CreateTTEIFFunction("Tt4h42sqi_Default_Session_Standard_Physical_Address", __eFct, __eLocal);
    CallInterfaceFunction(__cEmpty, __cEmpty, "627cb293-726d-49b1-b2f7-7f87145feea3");
  }


  {
    CreateTTEIFFunction("Tt4h42sqi_Extended_Session_Standard_Physical_Address", __eFct, __eLocal);
    CallInterfaceFunction(__cEmpty, __cEmpty, "58435b58-3d17-4ead-b77b-3e81b0124cf0");
  }


  {
    CreateTTEIFFunction("Tt4h42sqi_F186_DID_with_Standard_Physical_Address_Extended_Session", __eFct, __eLocal);
    CallInterfaceFunction(__cEmpty, __cEmpty, "1164fa28-24b1-4b88-89b6-88fe5bcc87f0");
  }


  {
    CreateTTEIFFunction("Tt4h42sqi_F10D_DID_with_Standard_Physical_Address", __eFct, __eLocal);
    CallInterfaceFunction(__cEmpty, __cEmpty, "12ba7feb-84d6-45a8-a78a-3d3eca772fca");
  }



}

void Tt4h42sqi_Tet_Tc135_Completion()
{
  stack long __tableHandle;
  TestCompletionBegin();
  {
    {
      CreateTTEIFFunction("Tt4h42sqi_General_Postconditions", __eFct, __eLocal);
      CallInterfaceFunction(__cEmpty, __cEmpty, "8c04fef4-3bbc-4cc8-b3ee-b62ec5ff47eb");
    }


  }
  TestCompletionEnd();
}

void Tt4h42sqi_Tet_Tc136()
{
  CreateTTEIFFunction("Tt4h42sqi_Tc136", __eTcDef, __eLocal);  
  AddIFParameterTestCaseAttribute("TC_ID", "");
  AddIFParameterTestCaseAttribute("Test Case ID", "");
  CallInterfaceFunction("TC_ID_20205104_Defaults_Session", __cEmpty , __cEmpty );
}
testcase Tt4h42sqi_Tc136()
{
  stack long __tableHandle;
  SetBreakOnFail(0);

  CreateTTEIFFunction("Tt4h42sqi_Tet_Tc136_Completion", __eFct, __eLocal);
  
  AddIFAsCleanUpFunction();

  TestPreparationBegin();
  {
    {
      CreateTTEIFFunction("Tt4h42sqi_General_Precondition", __eFct, __eLocal);
      CallInterfaceFunction(__cEmpty, __cEmpty, "74787266-8376-4866-a392-d0cc32109fae");
    }


  }
  TestPreparationEnd();

  TestCommandBegin(__eDiagService, __cDiagService, "", "2");
  {
    if (DiagIsFunctionalGroup("CVADAS_0001_00000000_000"))
    {
      DiagResponse * __resp;
      DiagRequest CVADAS_0001_00000000_000.Default_Session_Start __req;
      __diagService4h42sqi_61(__req, __resp);
    }
    else
    {
      DiagResponse CVADAS_0001_00000000_000.* __resp;
      DiagRequest CVADAS_0001_00000000_000.Default_Session_Start __req;
      __diagService4h42sqi_61(__req, __resp);
    }
  }
  TestCommandEnd();


  {
    CreateTTEIFFunction("Tt4h42sqi_F186_DID_with_PhysicalAdd_DefaultSession", __eFct, __eLocal);
    CallInterfaceFunction(__cEmpty, __cEmpty, "f479ea65-8c8c-4093-b3d8-2a8374608569");
  }


  TestCommandBegin(__eWait, __cWait, "", "4");
  {
    Wait("1", (2000 * 1000000LL), 1000000, "");
  }
  TestCommandEnd();

  {
    CreateTTEIFFunction("Tt4h42sqi_F181_DID_with_Physical_Address", __eFct, __eLocal);
    CallInterfaceFunction(__cEmpty, __cEmpty, "ea468bf6-0fee-4215-a9be-1cdb7bb91d17");
  }



}

  
void __diagService4h42sqi_61(DiagRequest * __req, DiagResponse * __resp )
{
  stack long __tableHandle;
  long __res, __paramLen, __bytePos;

   __bVerdict = __eVerdictPass;

  do {
    TestReportResetDiagObjectList();
    DiagSetReportDetailLevel("CVADAS_0001_00000000_000", EnumServiceDetails_onfail);
    // Request aspect
    {

      if (0 >= DiagSendReqAndWaitForResp("CVADAS_0001_00000000_000", __req, __resp, __res, -1, -1, -1, -1, -1, EnumResult_pos, EnumServiceDetails_onfail, EnumSendingMode_physical, EnumSuppressPosResBit_asconfigured, EnumVerdictOnInvalidValues_fail))
        break;
    }

    __res = DiagErrCodeTestStep(__res, "Can't retrieve last response for request! No check possible.") < 0;
    if(__res)
    {
	  __bVerdict = __eVerdictFail;
      break;
    }
    {
      __res = DiagInterpretAs(__resp, "DSC_PR");
      if(__res != 0)
      {
        __bVerdict = __eVerdictFail;
        DiagErrCodeTestStep(__res, "Can't interpret response as diagnostic primitive 'DSC_PR'.");
        break;
      }
      else
      {
        TestStepPass( "Received primitive can be interpreted as diagnostic primitive 'DSC_PR'.");
      }
    }
  }
  while(0);


  // Response, check & read aspect
  {
    __res = 1;
    __tableHandle = ReportTableHead5Columns(__cCheckCaption, __cTSym, __cTOp, __cRefVal, __cActual, __cRes);
    {
      __bDiagValueArrayCtr = DiagGetParameterErrorHandled(__resp, "DiagSessionType", __bDiagValueArray, elcount(__bDiagValueArray), __cDiagValueArray, elcount(__cDiagValueArray));
      {
        byte __bArray2[1] = { 0x01 };
        __bArrayCtr = __CopyBytes(__bDiagValueArray, __bDiagValueArrayCtr, __bArray);
        __bArrayCtr2 = elCount(__bArray2);
        __csr = CompareBytes(__bArray, __bArrayCtr, __bArray2, __bArrayCtr2) == 0;
        snprintf(__cArray, 8192, "%s", "Diagnostic parameter \'DiagSessionType\'");
        snprintf(__cArray2, 8192, "%s", __cArray);
        snprintf(__cArray3, 8192, "%s", "");
        ReportTableRow(__tableHandle, 0, __cArray2, "Bytes", __bArray2, __bArrayCtr2, __cArray3, __oneOfFlag, __bSetInCheckAlignment);
        ReportCell(__tableHandle, __bArray, __bArrayCtr);
        ReportCellResult(__tableHandle, __csr, __ePassFail);
      }
    
      __res = __res && __csr;
    
    }
    ReportTableEndVerdict(__tableHandle, __cEvaluateResponse, __res);
	__bVerdict = __bVerdict && __res;
  }
  if (__bVerdict == __eVerdictFail)
    TestReportWriteDiagObjectList();
}
void Tt4h42sqi_Tet_Tc136_Completion()
{
  stack long __tableHandle;
  TestCompletionBegin();
  {
    {
      CreateTTEIFFunction("Tt4h42sqi_General_Postconditions", __eFct, __eLocal);
      CallInterfaceFunction(__cEmpty, __cEmpty, "8c04fef4-3bbc-4cc8-b3ee-b62ec5ff47eb");
    }


  }
  TestCompletionEnd();
}

void Tt4h42sqi_Tet_Tc137()
{
  CreateTTEIFFunction("Tt4h42sqi_Tc137", __eTcDef, __eLocal);  
  AddIFParameterTestCaseAttribute("TC_ID", "");
  AddIFParameterTestCaseAttribute("Test Case ID", "");
  CallInterfaceFunction("TC_ID_20205111_Extended_Session", __cEmpty , __cEmpty );
}
testcase Tt4h42sqi_Tc137()
{
  stack long __tableHandle;
  SetBreakOnFail(0);

  CreateTTEIFFunction("Tt4h42sqi_Tet_Tc137_Completion", __eFct, __eLocal);
  
  AddIFAsCleanUpFunction();

  TestPreparationBegin();
  {
    {
      CreateTTEIFFunction("Tt4h42sqi_General_Precondition", __eFct, __eLocal);
      CallInterfaceFunction(__cEmpty, __cEmpty, "74787266-8376-4866-a392-d0cc32109fae");
    }


  }
  TestPreparationEnd();

  TestCommandBegin(__eDiagService, __cDiagService, "", "2");
  {
    if (DiagIsFunctionalGroup("CVADAS_0001_00000000_000"))
    {
      DiagResponse * __resp;
      DiagRequest CVADAS_0001_00000000_000.Default_Session_Start __req;
      __diagService4h42sqi_62(__req, __resp);
    }
    else
    {
      DiagResponse CVADAS_0001_00000000_000.* __resp;
      DiagRequest CVADAS_0001_00000000_000.Default_Session_Start __req;
      __diagService4h42sqi_62(__req, __resp);
    }
  }
  TestCommandEnd();


  TestCommandBegin(__eDiagService, __cDiagService, "", "3");
  {
    if (DiagIsFunctionalGroup("CVADAS_0001_00000000_000"))
    {
      DiagResponse * __resp;
      DiagRequest CVADAS_0001_00000000_000.Extended_Diagnostic_Session_Start __req;
      __diagService4h42sqi_63(__req, __resp);
    }
    else
    {
      DiagResponse CVADAS_0001_00000000_000.* __resp;
      DiagRequest CVADAS_0001_00000000_000.Extended_Diagnostic_Session_Start __req;
      __diagService4h42sqi_63(__req, __resp);
    }
  }
  TestCommandEnd();


  {
    CreateTTEIFFunction("Tt4h42sqi_F186_DID_with_PhysicalAdd_ExtendedSession", __eFct, __eLocal);
    CallInterfaceFunction(__cEmpty, __cEmpty, "56d9e7a7-9216-4d5f-b776-c5e862f155cb");
  }


  TestCommandBegin(__eWait, __cWait, "", "5");
  {
    Wait("1", (2000 * 1000000LL), 1000000, "");
  }
  TestCommandEnd();

  {
    CreateTTEIFFunction("Tt4h42sqi_F181_DID_with_Physical_Address", __eFct, __eLocal);
    CallInterfaceFunction(__cEmpty, __cEmpty, "ea468bf6-0fee-4215-a9be-1cdb7bb91d17");
  }



}

  
void __diagService4h42sqi_62(DiagRequest * __req, DiagResponse * __resp )
{
  stack long __tableHandle;
  long __res, __paramLen, __bytePos;

   __bVerdict = __eVerdictPass;

  do {
    TestReportResetDiagObjectList();
    DiagSetReportDetailLevel("CVADAS_0001_00000000_000", EnumServiceDetails_onfail);
    // Request aspect
    {

      if (0 >= DiagSendReqAndWaitForResp("CVADAS_0001_00000000_000", __req, __resp, __res, -1, -1, -1, -1, -1, EnumResult_pos, EnumServiceDetails_onfail, EnumSendingMode_physical, EnumSuppressPosResBit_asconfigured, EnumVerdictOnInvalidValues_fail))
        break;
    }

    __res = DiagErrCodeTestStep(__res, "Can't retrieve last response for request! No check possible.") < 0;
    if(__res)
    {
	  __bVerdict = __eVerdictFail;
      break;
    }
    {
      __res = DiagInterpretAs(__resp, "DSC_PR");
      if(__res != 0)
      {
        __bVerdict = __eVerdictFail;
        DiagErrCodeTestStep(__res, "Can't interpret response as diagnostic primitive 'DSC_PR'.");
        break;
      }
      else
      {
        TestStepPass( "Received primitive can be interpreted as diagnostic primitive 'DSC_PR'.");
      }
    }
  }
  while(0);


  // Response, check & read aspect
  {
    __res = 1;
    __tableHandle = ReportTableHead5Columns(__cCheckCaption, __cTSym, __cTOp, __cRefVal, __cActual, __cRes);
    {
      __bDiagValueArrayCtr = DiagGetParameterErrorHandled(__resp, "DiagSessionType", __bDiagValueArray, elcount(__bDiagValueArray), __cDiagValueArray, elcount(__cDiagValueArray));
      {
        byte __bArray2[1] = { 0x01 };
        __bArrayCtr = __CopyBytes(__bDiagValueArray, __bDiagValueArrayCtr, __bArray);
        __bArrayCtr2 = elCount(__bArray2);
        __csr = CompareBytes(__bArray, __bArrayCtr, __bArray2, __bArrayCtr2) == 0;
        snprintf(__cArray, 8192, "%s", "Diagnostic parameter \'DiagSessionType\'");
        snprintf(__cArray2, 8192, "%s", __cArray);
        snprintf(__cArray3, 8192, "%s", "");
        ReportTableRow(__tableHandle, 0, __cArray2, "Bytes", __bArray2, __bArrayCtr2, __cArray3, __oneOfFlag, __bSetInCheckAlignment);
        ReportCell(__tableHandle, __bArray, __bArrayCtr);
        ReportCellResult(__tableHandle, __csr, __ePassFail);
      }
    
      __res = __res && __csr;
    
    }
    ReportTableEndVerdict(__tableHandle, __cEvaluateResponse, __res);
	__bVerdict = __bVerdict && __res;
  }
  if (__bVerdict == __eVerdictFail)
    TestReportWriteDiagObjectList();
}
  
void __diagService4h42sqi_63(DiagRequest * __req, DiagResponse * __resp )
{
  stack long __tableHandle;
  long __res, __paramLen, __bytePos;

   __bVerdict = __eVerdictPass;

  do {
    TestReportResetDiagObjectList();
    DiagSetReportDetailLevel("CVADAS_0001_00000000_000", EnumServiceDetails_onfail);
    // Request aspect
    {

      if (0 >= DiagSendReqAndWaitForResp("CVADAS_0001_00000000_000", __req, __resp, __res, -1, -1, -1, -1, -1, EnumResult_pos, EnumServiceDetails_onfail, EnumSendingMode_physical, EnumSuppressPosResBit_asconfigured, EnumVerdictOnInvalidValues_fail))
        break;
    }

    __res = DiagErrCodeTestStep(__res, "Can't retrieve last response for request! No check possible.") < 0;
    if(__res)
    {
	  __bVerdict = __eVerdictFail;
      break;
    }
    {
      __res = DiagInterpretAs(__resp, "DSC_PR");
      if(__res != 0)
      {
        __bVerdict = __eVerdictFail;
        DiagErrCodeTestStep(__res, "Can't interpret response as diagnostic primitive 'DSC_PR'.");
        break;
      }
      else
      {
        TestStepPass( "Received primitive can be interpreted as diagnostic primitive 'DSC_PR'.");
      }
    }
  }
  while(0);


  // Response, check & read aspect
  {
    __res = 1;
    __tableHandle = ReportTableHead5Columns(__cCheckCaption, __cTSym, __cTOp, __cRefVal, __cActual, __cRes);
    {
      __bDiagValueArrayCtr = DiagGetParameterErrorHandled(__resp, "DiagSessionType", __bDiagValueArray, elcount(__bDiagValueArray), __cDiagValueArray, elcount(__cDiagValueArray));
      {
        byte __bArray2[1] = { 0x03 };
        __bArrayCtr = __CopyBytes(__bDiagValueArray, __bDiagValueArrayCtr, __bArray);
        __bArrayCtr2 = elCount(__bArray2);
        __csr = CompareBytes(__bArray, __bArrayCtr, __bArray2, __bArrayCtr2) == 0;
        snprintf(__cArray, 8192, "%s", "Diagnostic parameter \'DiagSessionType\'");
        snprintf(__cArray2, 8192, "%s", __cArray);
        snprintf(__cArray3, 8192, "%s", "");
        ReportTableRow(__tableHandle, 0, __cArray2, "Bytes", __bArray2, __bArrayCtr2, __cArray3, __oneOfFlag, __bSetInCheckAlignment);
        ReportCell(__tableHandle, __bArray, __bArrayCtr);
        ReportCellResult(__tableHandle, __csr, __ePassFail);
      }
    
      __res = __res && __csr;
    
    }
    ReportTableEndVerdict(__tableHandle, __cEvaluateResponse, __res);
	__bVerdict = __bVerdict && __res;
  }
  if (__bVerdict == __eVerdictFail)
    TestReportWriteDiagObjectList();
}
void Tt4h42sqi_Tet_Tc137_Completion()
{
  stack long __tableHandle;
  TestCompletionBegin();
  {
    {
      CreateTTEIFFunction("Tt4h42sqi_General_Postconditions", __eFct, __eLocal);
      CallInterfaceFunction(__cEmpty, __cEmpty, "8c04fef4-3bbc-4cc8-b3ee-b62ec5ff47eb");
    }


  }
  TestCompletionEnd();
}

void Tt4h42sqi_Tet_Tc138()
{
  CreateTTEIFFunction("Tt4h42sqi_Tc138", __eTcDef, __eLocal);  
  AddIFParameterTestCaseAttribute("TC_ID", "");
  AddIFParameterTestCaseAttribute("Test Case ID", "");
  CallInterfaceFunction("TC_ID_20205127_Standard_Physical_Address", __cEmpty , __cEmpty );
}
testcase Tt4h42sqi_Tc138()
{
  stack long __tableHandle;
  SetBreakOnFail(0);

  CreateTTEIFFunction("Tt4h42sqi_Tet_Tc138_Completion", __eFct, __eLocal);
  
  AddIFAsCleanUpFunction();

  TestPreparationBegin();
  {
    {
      CreateTTEIFFunction("Tt4h42sqi_General_Precondition", __eFct, __eLocal);
      CallInterfaceFunction(__cEmpty, __cEmpty, "74787266-8376-4866-a392-d0cc32109fae");
    }


  }
  TestPreparationEnd();

  {
    CreateTTEIFFunction("Tt4h42sqi_Default_Session_Standard_Physical_Address", __eFct, __eLocal);
    CallInterfaceFunction(__cEmpty, __cEmpty, "627cb293-726d-49b1-b2f7-7f87145feea3");
  }


  {
    CreateTTEIFFunction("Tt4h42sqi_F186_DID_with_Standard_Physical_Address_Default_Session", __eFct, __eLocal);
    CallInterfaceFunction(__cEmpty, __cEmpty, "94a4fb5c-65ad-4a5d-ac34-b6372d993b69");
  }


  {
    CreateTTEIFFunction("Tt4h42sqi_F181_DID_with_Standard_Physical_Address", __eFct, __eLocal);
    CallInterfaceFunction(__cEmpty, __cEmpty, "0cde1cac-3825-4c9c-805b-df649c024899");
  }



}

void Tt4h42sqi_Tet_Tc138_Completion()
{
  stack long __tableHandle;
  TestCompletionBegin();
  {
    {
      CreateTTEIFFunction("Tt4h42sqi_General_Postconditions", __eFct, __eLocal);
      CallInterfaceFunction(__cEmpty, __cEmpty, "8c04fef4-3bbc-4cc8-b3ee-b62ec5ff47eb");
    }


  }
  TestCompletionEnd();
}

void Tt4h42sqi_Tet_Tc139()
{
  CreateTTEIFFunction("Tt4h42sqi_Tc139", __eTcDef, __eLocal);  
  AddIFParameterTestCaseAttribute("TC_ID", "");
  AddIFParameterTestCaseAttribute("Test Case ID", "");
  CallInterfaceFunction("TC_ID_20205076_Standard_Physical_Address", __cEmpty , __cEmpty );
}
testcase Tt4h42sqi_Tc139()
{
  stack long __tableHandle;
  SetBreakOnFail(0);

  CreateTTEIFFunction("Tt4h42sqi_Tet_Tc139_Completion", __eFct, __eLocal);
  
  AddIFAsCleanUpFunction();

  TestPreparationBegin();
  {
    {
      CreateTTEIFFunction("Tt4h42sqi_General_Precondition", __eFct, __eLocal);
      CallInterfaceFunction(__cEmpty, __cEmpty, "74787266-8376-4866-a392-d0cc32109fae");
    }


  }
  TestPreparationEnd();

  {
    CreateTTEIFFunction("Tt4h42sqi_Default_Session_Standard_Physical_Address", __eFct, __eLocal);
    CallInterfaceFunction(__cEmpty, __cEmpty, "627cb293-726d-49b1-b2f7-7f87145feea3");
  }


  {
    CreateTTEIFFunction("Tt4h42sqi_Extended_Session_Standard_Physical_Address", __eFct, __eLocal);
    CallInterfaceFunction(__cEmpty, __cEmpty, "58435b58-3d17-4ead-b77b-3e81b0124cf0");
  }


  {
    CreateTTEIFFunction("Tt4h42sqi_F186_DID_with_Standard_Physical_Address_Extended_Session", __eFct, __eLocal);
    CallInterfaceFunction(__cEmpty, __cEmpty, "1164fa28-24b1-4b88-89b6-88fe5bcc87f0");
  }


  {
    CreateTTEIFFunction("Tt4h42sqi_F181_DID_with_Standard_Physical_Address", __eFct, __eLocal);
    CallInterfaceFunction(__cEmpty, __cEmpty, "0cde1cac-3825-4c9c-805b-df649c024899");
  }



}

void Tt4h42sqi_Tet_Tc139_Completion()
{
  stack long __tableHandle;
  TestCompletionBegin();
  {
    {
      CreateTTEIFFunction("Tt4h42sqi_General_Postconditions", __eFct, __eLocal);
      CallInterfaceFunction(__cEmpty, __cEmpty, "8c04fef4-3bbc-4cc8-b3ee-b62ec5ff47eb");
    }


  }
  TestCompletionEnd();
}

void Tt4h42sqi_Tet_Tc140()
{
  CreateTTEIFFunction("Tt4h42sqi_Tc140", __eTcDef, __eLocal);  
  AddIFParameterTestCaseAttribute("TC_ID", "");
  AddIFParameterTestCaseAttribute("Test Case ID", "");
  CallInterfaceFunction("TC_ID_20205284_Defaults_Session", __cEmpty , __cEmpty );
}
testcase Tt4h42sqi_Tc140()
{
  stack long __tableHandle;
  SetBreakOnFail(0);

  CreateTTEIFFunction("Tt4h42sqi_Tet_Tc140_Completion", __eFct, __eLocal);
  
  AddIFAsCleanUpFunction();

  TestPreparationBegin();
  {
    {
      CreateTTEIFFunction("Tt4h42sqi_General_Precondition", __eFct, __eLocal);
      CallInterfaceFunction(__cEmpty, __cEmpty, "74787266-8376-4866-a392-d0cc32109fae");
    }


  }
  TestPreparationEnd();

  TestCommandBegin(__eDiagService, __cDiagService, "", "2");
  {
    if (DiagIsFunctionalGroup("CVADAS_0001_00000000_000"))
    {
      DiagResponse * __resp;
      DiagRequest CVADAS_0001_00000000_000.Default_Session_Start __req;
      __diagService4h42sqi_64(__req, __resp);
    }
    else
    {
      DiagResponse CVADAS_0001_00000000_000.* __resp;
      DiagRequest CVADAS_0001_00000000_000.Default_Session_Start __req;
      __diagService4h42sqi_64(__req, __resp);
    }
  }
  TestCommandEnd();


  {
    CreateTTEIFFunction("Tt4h42sqi_F186_DID_with_PhysicalAdd_DefaultSession", __eFct, __eLocal);
    CallInterfaceFunction(__cEmpty, __cEmpty, "f479ea65-8c8c-4093-b3d8-2a8374608569");
  }


  {
    CreateTTEIFFunction("Tt4h42sqi_F182_DID_with_Physical_Address", __eFct, __eLocal);
    CallInterfaceFunction(__cEmpty, __cEmpty, "a13536bc-94d5-4bcd-9735-469488b2ac14");
  }



}

  
void __diagService4h42sqi_64(DiagRequest * __req, DiagResponse * __resp )
{
  stack long __tableHandle;
  long __res, __paramLen, __bytePos;

   __bVerdict = __eVerdictPass;

  do {
    TestReportResetDiagObjectList();
    DiagSetReportDetailLevel("CVADAS_0001_00000000_000", EnumServiceDetails_onfail);
    // Request aspect
    {

      if (0 >= DiagSendReqAndWaitForResp("CVADAS_0001_00000000_000", __req, __resp, __res, -1, -1, -1, -1, -1, EnumResult_pos, EnumServiceDetails_onfail, EnumSendingMode_physical, EnumSuppressPosResBit_asconfigured, EnumVerdictOnInvalidValues_fail))
        break;
    }

    __res = DiagErrCodeTestStep(__res, "Can't retrieve last response for request! No check possible.") < 0;
    if(__res)
    {
	  __bVerdict = __eVerdictFail;
      break;
    }
    {
      __res = DiagInterpretAs(__resp, "DSC_PR");
      if(__res != 0)
      {
        __bVerdict = __eVerdictFail;
        DiagErrCodeTestStep(__res, "Can't interpret response as diagnostic primitive 'DSC_PR'.");
        break;
      }
      else
      {
        TestStepPass( "Received primitive can be interpreted as diagnostic primitive 'DSC_PR'.");
      }
    }
  }
  while(0);


  // Response, check & read aspect
  {
    __res = 1;
    __tableHandle = ReportTableHead5Columns(__cCheckCaption, __cTSym, __cTOp, __cRefVal, __cActual, __cRes);
    {
      __bDiagValueArrayCtr = DiagGetParameterErrorHandled(__resp, "DiagSessionType", __bDiagValueArray, elcount(__bDiagValueArray), __cDiagValueArray, elcount(__cDiagValueArray));
      {
        byte __bArray2[1] = { 0x01 };
        __bArrayCtr = __CopyBytes(__bDiagValueArray, __bDiagValueArrayCtr, __bArray);
        __bArrayCtr2 = elCount(__bArray2);
        __csr = CompareBytes(__bArray, __bArrayCtr, __bArray2, __bArrayCtr2) == 0;
        snprintf(__cArray, 8192, "%s", "Diagnostic parameter \'DiagSessionType\'");
        snprintf(__cArray2, 8192, "%s", __cArray);
        snprintf(__cArray3, 8192, "%s", "");
        ReportTableRow(__tableHandle, 0, __cArray2, "Bytes", __bArray2, __bArrayCtr2, __cArray3, __oneOfFlag, __bSetInCheckAlignment);
        ReportCell(__tableHandle, __bArray, __bArrayCtr);
        ReportCellResult(__tableHandle, __csr, __ePassFail);
      }
    
      __res = __res && __csr;
    
    }
    ReportTableEndVerdict(__tableHandle, __cEvaluateResponse, __res);
	__bVerdict = __bVerdict && __res;
  }
  if (__bVerdict == __eVerdictFail)
    TestReportWriteDiagObjectList();
}
void Tt4h42sqi_Tet_Tc140_Completion()
{
  stack long __tableHandle;
  TestCompletionBegin();
  {
    {
      CreateTTEIFFunction("Tt4h42sqi_General_Postconditions", __eFct, __eLocal);
      CallInterfaceFunction(__cEmpty, __cEmpty, "8c04fef4-3bbc-4cc8-b3ee-b62ec5ff47eb");
    }


  }
  TestCompletionEnd();
}

void Tt4h42sqi_Tet_Tc141()
{
  CreateTTEIFFunction("Tt4h42sqi_Tc141", __eTcDef, __eLocal);  
  AddIFParameterTestCaseAttribute("TC_ID", "");
  AddIFParameterTestCaseAttribute("Test Case ID", "");
  CallInterfaceFunction("TC_ID_20205286_Extended_Session", __cEmpty , __cEmpty );
}
testcase Tt4h42sqi_Tc141()
{
  stack long __tableHandle;
  SetBreakOnFail(0);

  CreateTTEIFFunction("Tt4h42sqi_Tet_Tc141_Completion", __eFct, __eLocal);
  
  AddIFAsCleanUpFunction();

  TestPreparationBegin();
  {
    {
      CreateTTEIFFunction("Tt4h42sqi_General_Precondition", __eFct, __eLocal);
      CallInterfaceFunction(__cEmpty, __cEmpty, "74787266-8376-4866-a392-d0cc32109fae");
    }


  }
  TestPreparationEnd();

  TestCommandBegin(__eDiagService, __cDiagService, "", "2");
  {
    if (DiagIsFunctionalGroup("CVADAS_0001_00000000_000"))
    {
      DiagResponse * __resp;
      DiagRequest CVADAS_0001_00000000_000.Default_Session_Start __req;
      __diagService4h42sqi_65(__req, __resp);
    }
    else
    {
      DiagResponse CVADAS_0001_00000000_000.* __resp;
      DiagRequest CVADAS_0001_00000000_000.Default_Session_Start __req;
      __diagService4h42sqi_65(__req, __resp);
    }
  }
  TestCommandEnd();


  TestCommandBegin(__eDiagService, __cDiagService, "", "3");
  {
    if (DiagIsFunctionalGroup("CVADAS_0001_00000000_000"))
    {
      DiagResponse * __resp;
      DiagRequest CVADAS_0001_00000000_000.Extended_Diagnostic_Session_Start __req;
      __diagService4h42sqi_66(__req, __resp);
    }
    else
    {
      DiagResponse CVADAS_0001_00000000_000.* __resp;
      DiagRequest CVADAS_0001_00000000_000.Extended_Diagnostic_Session_Start __req;
      __diagService4h42sqi_66(__req, __resp);
    }
  }
  TestCommandEnd();


  {
    CreateTTEIFFunction("Tt4h42sqi_F186_DID_with_PhysicalAdd_ExtendedSession", __eFct, __eLocal);
    CallInterfaceFunction(__cEmpty, __cEmpty, "56d9e7a7-9216-4d5f-b776-c5e862f155cb");
  }


  {
    CreateTTEIFFunction("Tt4h42sqi_F182_DID_with_Physical_Address", __eFct, __eLocal);
    CallInterfaceFunction(__cEmpty, __cEmpty, "a13536bc-94d5-4bcd-9735-469488b2ac14");
  }



}

  
void __diagService4h42sqi_65(DiagRequest * __req, DiagResponse * __resp )
{
  stack long __tableHandle;
  long __res, __paramLen, __bytePos;

   __bVerdict = __eVerdictPass;

  do {
    TestReportResetDiagObjectList();
    DiagSetReportDetailLevel("CVADAS_0001_00000000_000", EnumServiceDetails_onfail);
    // Request aspect
    {

      if (0 >= DiagSendReqAndWaitForResp("CVADAS_0001_00000000_000", __req, __resp, __res, -1, -1, -1, -1, -1, EnumResult_pos, EnumServiceDetails_onfail, EnumSendingMode_physical, EnumSuppressPosResBit_asconfigured, EnumVerdictOnInvalidValues_fail))
        break;
    }

    __res = DiagErrCodeTestStep(__res, "Can't retrieve last response for request! No check possible.") < 0;
    if(__res)
    {
	  __bVerdict = __eVerdictFail;
      break;
    }
    {
      __res = DiagInterpretAs(__resp, "DSC_PR");
      if(__res != 0)
      {
        __bVerdict = __eVerdictFail;
        DiagErrCodeTestStep(__res, "Can't interpret response as diagnostic primitive 'DSC_PR'.");
        break;
      }
      else
      {
        TestStepPass( "Received primitive can be interpreted as diagnostic primitive 'DSC_PR'.");
      }
    }
  }
  while(0);


  // Response, check & read aspect
  {
    __res = 1;
    __tableHandle = ReportTableHead5Columns(__cCheckCaption, __cTSym, __cTOp, __cRefVal, __cActual, __cRes);
    {
      __bDiagValueArrayCtr = DiagGetParameterErrorHandled(__resp, "DiagSessionType", __bDiagValueArray, elcount(__bDiagValueArray), __cDiagValueArray, elcount(__cDiagValueArray));
      {
        byte __bArray2[1] = { 0x01 };
        __bArrayCtr = __CopyBytes(__bDiagValueArray, __bDiagValueArrayCtr, __bArray);
        __bArrayCtr2 = elCount(__bArray2);
        __csr = CompareBytes(__bArray, __bArrayCtr, __bArray2, __bArrayCtr2) == 0;
        snprintf(__cArray, 8192, "%s", "Diagnostic parameter \'DiagSessionType\'");
        snprintf(__cArray2, 8192, "%s", __cArray);
        snprintf(__cArray3, 8192, "%s", "");
        ReportTableRow(__tableHandle, 0, __cArray2, "Bytes", __bArray2, __bArrayCtr2, __cArray3, __oneOfFlag, __bSetInCheckAlignment);
        ReportCell(__tableHandle, __bArray, __bArrayCtr);
        ReportCellResult(__tableHandle, __csr, __ePassFail);
      }
    
      __res = __res && __csr;
    
    }
    ReportTableEndVerdict(__tableHandle, __cEvaluateResponse, __res);
	__bVerdict = __bVerdict && __res;
  }
  if (__bVerdict == __eVerdictFail)
    TestReportWriteDiagObjectList();
}
  
void __diagService4h42sqi_66(DiagRequest * __req, DiagResponse * __resp )
{
  stack long __tableHandle;
  long __res, __paramLen, __bytePos;

   __bVerdict = __eVerdictPass;

  do {
    TestReportResetDiagObjectList();
    DiagSetReportDetailLevel("CVADAS_0001_00000000_000", EnumServiceDetails_onfail);
    // Request aspect
    {

      if (0 >= DiagSendReqAndWaitForResp("CVADAS_0001_00000000_000", __req, __resp, __res, -1, -1, -1, -1, -1, EnumResult_pos, EnumServiceDetails_onfail, EnumSendingMode_physical, EnumSuppressPosResBit_asconfigured, EnumVerdictOnInvalidValues_fail))
        break;
    }

    __res = DiagErrCodeTestStep(__res, "Can't retrieve last response for request! No check possible.") < 0;
    if(__res)
    {
	  __bVerdict = __eVerdictFail;
      break;
    }
    {
      __res = DiagInterpretAs(__resp, "DSC_PR");
      if(__res != 0)
      {
        __bVerdict = __eVerdictFail;
        DiagErrCodeTestStep(__res, "Can't interpret response as diagnostic primitive 'DSC_PR'.");
        break;
      }
      else
      {
        TestStepPass( "Received primitive can be interpreted as diagnostic primitive 'DSC_PR'.");
      }
    }
  }
  while(0);


  // Response, check & read aspect
  {
    __res = 1;
    __tableHandle = ReportTableHead5Columns(__cCheckCaption, __cTSym, __cTOp, __cRefVal, __cActual, __cRes);
    {
      __bDiagValueArrayCtr = DiagGetParameterErrorHandled(__resp, "DiagSessionType", __bDiagValueArray, elcount(__bDiagValueArray), __cDiagValueArray, elcount(__cDiagValueArray));
      {
        byte __bArray2[1] = { 0x03 };
        __bArrayCtr = __CopyBytes(__bDiagValueArray, __bDiagValueArrayCtr, __bArray);
        __bArrayCtr2 = elCount(__bArray2);
        __csr = CompareBytes(__bArray, __bArrayCtr, __bArray2, __bArrayCtr2) == 0;
        snprintf(__cArray, 8192, "%s", "Diagnostic parameter \'DiagSessionType\'");
        snprintf(__cArray2, 8192, "%s", __cArray);
        snprintf(__cArray3, 8192, "%s", "");
        ReportTableRow(__tableHandle, 0, __cArray2, "Bytes", __bArray2, __bArrayCtr2, __cArray3, __oneOfFlag, __bSetInCheckAlignment);
        ReportCell(__tableHandle, __bArray, __bArrayCtr);
        ReportCellResult(__tableHandle, __csr, __ePassFail);
      }
    
      __res = __res && __csr;
    
    }
    ReportTableEndVerdict(__tableHandle, __cEvaluateResponse, __res);
	__bVerdict = __bVerdict && __res;
  }
  if (__bVerdict == __eVerdictFail)
    TestReportWriteDiagObjectList();
}
void Tt4h42sqi_Tet_Tc141_Completion()
{
  stack long __tableHandle;
  TestCompletionBegin();
  {
    {
      CreateTTEIFFunction("Tt4h42sqi_General_Postconditions", __eFct, __eLocal);
      CallInterfaceFunction(__cEmpty, __cEmpty, "8c04fef4-3bbc-4cc8-b3ee-b62ec5ff47eb");
    }


  }
  TestCompletionEnd();
}

void Tt4h42sqi_Tet_Tc142()
{
  CreateTTEIFFunction("Tt4h42sqi_Tc142", __eTcDef, __eLocal);  
  AddIFParameterTestCaseAttribute("TC_ID", "");
  AddIFParameterTestCaseAttribute("Test Case ID", "");
  CallInterfaceFunction("TC_ID_20205288_Standard_Physical_Address", __cEmpty , __cEmpty );
}
testcase Tt4h42sqi_Tc142()
{
  stack long __tableHandle;
  SetBreakOnFail(0);

  CreateTTEIFFunction("Tt4h42sqi_Tet_Tc142_Completion", __eFct, __eLocal);
  
  AddIFAsCleanUpFunction();

  TestPreparationBegin();
  {
    {
      CreateTTEIFFunction("Tt4h42sqi_General_Precondition", __eFct, __eLocal);
      CallInterfaceFunction(__cEmpty, __cEmpty, "74787266-8376-4866-a392-d0cc32109fae");
    }


  }
  TestPreparationEnd();

  {
    CreateTTEIFFunction("Tt4h42sqi_Default_Session_Standard_Physical_Address", __eFct, __eLocal);
    CallInterfaceFunction(__cEmpty, __cEmpty, "627cb293-726d-49b1-b2f7-7f87145feea3");
  }


  {
    CreateTTEIFFunction("Tt4h42sqi_Extended_Session_Standard_Physical_Address", __eFct, __eLocal);
    CallInterfaceFunction(__cEmpty, __cEmpty, "58435b58-3d17-4ead-b77b-3e81b0124cf0");
  }


  {
    CreateTTEIFFunction("Tt4h42sqi_F186_DID_with_Standard_Physical_Address_Extended_Session", __eFct, __eLocal);
    CallInterfaceFunction(__cEmpty, __cEmpty, "1164fa28-24b1-4b88-89b6-88fe5bcc87f0");
  }


  {
    CreateTTEIFFunction("Tt4h42sqi_F182_DID_with_Standard_Physical_Address", __eFct, __eLocal);
    CallInterfaceFunction(__cEmpty, __cEmpty, "cb06dd89-9274-4c9f-9244-0e3e167f845e");
  }



}

void Tt4h42sqi_Tet_Tc142_Completion()
{
  stack long __tableHandle;
  TestCompletionBegin();
  {
    {
      CreateTTEIFFunction("Tt4h42sqi_General_Postconditions", __eFct, __eLocal);
      CallInterfaceFunction(__cEmpty, __cEmpty, "8c04fef4-3bbc-4cc8-b3ee-b62ec5ff47eb");
    }


  }
  TestCompletionEnd();
}

void Tt4h42sqi_Tet_Tc143()
{
  CreateTTEIFFunction("Tt4h42sqi_Tc143", __eTcDef, __eLocal);  
  AddIFParameterTestCaseAttribute("TC_ID", "");
  AddIFParameterTestCaseAttribute("Test Case ID", "");
  CallInterfaceFunction("TC_ID_20205268_Standard_Physical_Address", __cEmpty , __cEmpty );
}
testcase Tt4h42sqi_Tc143()
{
  stack long __tableHandle;
  SetBreakOnFail(0);

  CreateTTEIFFunction("Tt4h42sqi_Tet_Tc143_Completion", __eFct, __eLocal);
  
  AddIFAsCleanUpFunction();

  TestPreparationBegin();
  {
    {
      CreateTTEIFFunction("Tt4h42sqi_General_Precondition", __eFct, __eLocal);
      CallInterfaceFunction(__cEmpty, __cEmpty, "74787266-8376-4866-a392-d0cc32109fae");
    }


  }
  TestPreparationEnd();

  {
    CreateTTEIFFunction("Tt4h42sqi_Default_Session_Standard_Physical_Address", __eFct, __eLocal);
    CallInterfaceFunction(__cEmpty, __cEmpty, "627cb293-726d-49b1-b2f7-7f87145feea3");
  }


  {
    CreateTTEIFFunction("Tt4h42sqi_F186_DID_with_Standard_Physical_Address_Default_Session", __eFct, __eLocal);
    CallInterfaceFunction(__cEmpty, __cEmpty, "94a4fb5c-65ad-4a5d-ac34-b6372d993b69");
  }


  {
    CreateTTEIFFunction("Tt4h42sqi_F182_DID_with_Standard_Physical_Address", __eFct, __eLocal);
    CallInterfaceFunction(__cEmpty, __cEmpty, "cb06dd89-9274-4c9f-9244-0e3e167f845e");
  }



}

void Tt4h42sqi_Tet_Tc143_Completion()
{
  stack long __tableHandle;
  TestCompletionBegin();
  {
    {
      CreateTTEIFFunction("Tt4h42sqi_General_Postconditions", __eFct, __eLocal);
      CallInterfaceFunction(__cEmpty, __cEmpty, "8c04fef4-3bbc-4cc8-b3ee-b62ec5ff47eb");
    }


  }
  TestCompletionEnd();
}

void Tt4h42sqi_Tet_Tc144()
{
  CreateTTEIFFunction("Tt4h42sqi_Tc144", __eTcDef, __eLocal);  
  AddIFParameterTestCaseAttribute("TC_ID", "");
  AddIFParameterTestCaseAttribute("Test Case ID", "");
  CallInterfaceFunction("TC_ID_20205222_Defaults_Session_Physical_and_Standard_Addressing", __cEmpty , __cEmpty );
}
testcase Tt4h42sqi_Tc144()
{
  stack long __tableHandle;
  SetBreakOnFail(0);

  CreateTTEIFFunction("Tt4h42sqi_Tet_Tc144_Completion", __eFct, __eLocal);
  
  AddIFAsCleanUpFunction();

  TestPreparationBegin();
  {
    {
      CreateTTEIFFunction("Tt4h42sqi_General_Precondition", __eFct, __eLocal);
      CallInterfaceFunction(__cEmpty, __cEmpty, "74787266-8376-4866-a392-d0cc32109fae");
    }


  }
  TestPreparationEnd();

  TestCommandBegin(__eDiagService, __cDiagService, "", "2");
  {
    if (DiagIsFunctionalGroup("CVADAS_0001_00000000_000"))
    {
      DiagResponse * __resp;
      DiagRequest CVADAS_0001_00000000_000.Default_Session_Start __req;
      __diagService4h42sqi_67(__req, __resp);
    }
    else
    {
      DiagResponse CVADAS_0001_00000000_000.* __resp;
      DiagRequest CVADAS_0001_00000000_000.Default_Session_Start __req;
      __diagService4h42sqi_67(__req, __resp);
    }
  }
  TestCommandEnd();


  {
    CreateTTEIFFunction("Tt4h42sqi_F186_DID_with_PhysicalAdd_DefaultSession", __eFct, __eLocal);
    CallInterfaceFunction(__cEmpty, __cEmpty, "f479ea65-8c8c-4093-b3d8-2a8374608569");
  }



}

  
void __diagService4h42sqi_67(DiagRequest * __req, DiagResponse * __resp )
{
  stack long __tableHandle;
  long __res, __paramLen, __bytePos;

   __bVerdict = __eVerdictPass;

  do {
    TestReportResetDiagObjectList();
    DiagSetReportDetailLevel("CVADAS_0001_00000000_000", EnumServiceDetails_onfail);
    // Request aspect
    {

      if (0 >= DiagSendReqAndWaitForResp("CVADAS_0001_00000000_000", __req, __resp, __res, -1, -1, -1, -1, -1, EnumResult_pos, EnumServiceDetails_onfail, EnumSendingMode_physical, EnumSuppressPosResBit_asconfigured, EnumVerdictOnInvalidValues_fail))
        break;
    }

    __res = DiagErrCodeTestStep(__res, "Can't retrieve last response for request! No check possible.") < 0;
    if(__res)
    {
	  __bVerdict = __eVerdictFail;
      break;
    }
    {
      __res = DiagInterpretAs(__resp, "DSC_PR");
      if(__res != 0)
      {
        __bVerdict = __eVerdictFail;
        DiagErrCodeTestStep(__res, "Can't interpret response as diagnostic primitive 'DSC_PR'.");
        break;
      }
      else
      {
        TestStepPass( "Received primitive can be interpreted as diagnostic primitive 'DSC_PR'.");
      }
    }
  }
  while(0);


  // Response, check & read aspect
  {
    __res = 1;
    __tableHandle = ReportTableHead5Columns(__cCheckCaption, __cTSym, __cTOp, __cRefVal, __cActual, __cRes);
    {
      __bDiagValueArrayCtr = DiagGetParameterErrorHandled(__resp, "DiagSessionType", __bDiagValueArray, elcount(__bDiagValueArray), __cDiagValueArray, elcount(__cDiagValueArray));
      {
        byte __bArray2[1] = { 0x01 };
        __bArrayCtr = __CopyBytes(__bDiagValueArray, __bDiagValueArrayCtr, __bArray);
        __bArrayCtr2 = elCount(__bArray2);
        __csr = CompareBytes(__bArray, __bArrayCtr, __bArray2, __bArrayCtr2) == 0;
        snprintf(__cArray, 8192, "%s", "Diagnostic parameter \'DiagSessionType\'");
        snprintf(__cArray2, 8192, "%s", __cArray);
        snprintf(__cArray3, 8192, "%s", "");
        ReportTableRow(__tableHandle, 0, __cArray2, "Bytes", __bArray2, __bArrayCtr2, __cArray3, __oneOfFlag, __bSetInCheckAlignment);
        ReportCell(__tableHandle, __bArray, __bArrayCtr);
        ReportCellResult(__tableHandle, __csr, __ePassFail);
      }
    
      __res = __res && __csr;
    
    }
    ReportTableEndVerdict(__tableHandle, __cEvaluateResponse, __res);
	__bVerdict = __bVerdict && __res;
  }
  if (__bVerdict == __eVerdictFail)
    TestReportWriteDiagObjectList();
}
void Tt4h42sqi_Tet_Tc144_Completion()
{
  stack long __tableHandle;
  TestCompletionBegin();
  {
    {
      CreateTTEIFFunction("Tt4h42sqi_General_Postconditions", __eFct, __eLocal);
      CallInterfaceFunction(__cEmpty, __cEmpty, "8c04fef4-3bbc-4cc8-b3ee-b62ec5ff47eb");
    }


  }
  TestCompletionEnd();
}

void Tt4h42sqi_Tet_Tc145()
{
  CreateTTEIFFunction("Tt4h42sqi_Tc145", __eTcDef, __eLocal);  
  AddIFParameterTestCaseAttribute("TC_ID", "");
  AddIFParameterTestCaseAttribute("Test Case ID", "");
  CallInterfaceFunction("TC_ID_20205226_Extended_Session_Physical_and_Standard_Addressing", __cEmpty , __cEmpty );
}
testcase Tt4h42sqi_Tc145()
{
  stack long __tableHandle;
  SetBreakOnFail(0);

  CreateTTEIFFunction("Tt4h42sqi_Tet_Tc145_Completion", __eFct, __eLocal);
  
  AddIFAsCleanUpFunction();

  TestPreparationBegin();
  {
    {
      CreateTTEIFFunction("Tt4h42sqi_General_Precondition", __eFct, __eLocal);
      CallInterfaceFunction(__cEmpty, __cEmpty, "74787266-8376-4866-a392-d0cc32109fae");
    }


  }
  TestPreparationEnd();

  TestCommandBegin(__eDiagService, __cDiagService, "", "2");
  {
    if (DiagIsFunctionalGroup("CVADAS_0001_00000000_000"))
    {
      DiagResponse * __resp;
      DiagRequest CVADAS_0001_00000000_000.Default_Session_Start __req;
      __diagService4h42sqi_68(__req, __resp);
    }
    else
    {
      DiagResponse CVADAS_0001_00000000_000.* __resp;
      DiagRequest CVADAS_0001_00000000_000.Default_Session_Start __req;
      __diagService4h42sqi_68(__req, __resp);
    }
  }
  TestCommandEnd();


  TestCommandBegin(__eDiagService, __cDiagService, "", "3");
  {
    if (DiagIsFunctionalGroup("CVADAS_0001_00000000_000"))
    {
      DiagResponse * __resp;
      DiagRequest CVADAS_0001_00000000_000.Extended_Diagnostic_Session_Start __req;
      __diagService4h42sqi_69(__req, __resp);
    }
    else
    {
      DiagResponse CVADAS_0001_00000000_000.* __resp;
      DiagRequest CVADAS_0001_00000000_000.Extended_Diagnostic_Session_Start __req;
      __diagService4h42sqi_69(__req, __resp);
    }
  }
  TestCommandEnd();


  {
    CreateTTEIFFunction("Tt4h42sqi_F186_DID_with_PhysicalAdd_ExtendedSession", __eFct, __eLocal);
    CallInterfaceFunction(__cEmpty, __cEmpty, "56d9e7a7-9216-4d5f-b776-c5e862f155cb");
  }



}

  
void __diagService4h42sqi_68(DiagRequest * __req, DiagResponse * __resp )
{
  stack long __tableHandle;
  long __res, __paramLen, __bytePos;

   __bVerdict = __eVerdictPass;

  do {
    TestReportResetDiagObjectList();
    DiagSetReportDetailLevel("CVADAS_0001_00000000_000", EnumServiceDetails_onfail);
    // Request aspect
    {

      if (0 >= DiagSendReqAndWaitForResp("CVADAS_0001_00000000_000", __req, __resp, __res, -1, -1, -1, -1, -1, EnumResult_pos, EnumServiceDetails_onfail, EnumSendingMode_physical, EnumSuppressPosResBit_asconfigured, EnumVerdictOnInvalidValues_fail))
        break;
    }

    __res = DiagErrCodeTestStep(__res, "Can't retrieve last response for request! No check possible.") < 0;
    if(__res)
    {
	  __bVerdict = __eVerdictFail;
      break;
    }
    {
      __res = DiagInterpretAs(__resp, "DSC_PR");
      if(__res != 0)
      {
        __bVerdict = __eVerdictFail;
        DiagErrCodeTestStep(__res, "Can't interpret response as diagnostic primitive 'DSC_PR'.");
        break;
      }
      else
      {
        TestStepPass( "Received primitive can be interpreted as diagnostic primitive 'DSC_PR'.");
      }
    }
  }
  while(0);


  // Response, check & read aspect
  {
    __res = 1;
    __tableHandle = ReportTableHead5Columns(__cCheckCaption, __cTSym, __cTOp, __cRefVal, __cActual, __cRes);
    {
      __bDiagValueArrayCtr = DiagGetParameterErrorHandled(__resp, "DiagSessionType", __bDiagValueArray, elcount(__bDiagValueArray), __cDiagValueArray, elcount(__cDiagValueArray));
      {
        byte __bArray2[1] = { 0x01 };
        __bArrayCtr = __CopyBytes(__bDiagValueArray, __bDiagValueArrayCtr, __bArray);
        __bArrayCtr2 = elCount(__bArray2);
        __csr = CompareBytes(__bArray, __bArrayCtr, __bArray2, __bArrayCtr2) == 0;
        snprintf(__cArray, 8192, "%s", "Diagnostic parameter \'DiagSessionType\'");
        snprintf(__cArray2, 8192, "%s", __cArray);
        snprintf(__cArray3, 8192, "%s", "");
        ReportTableRow(__tableHandle, 0, __cArray2, "Bytes", __bArray2, __bArrayCtr2, __cArray3, __oneOfFlag, __bSetInCheckAlignment);
        ReportCell(__tableHandle, __bArray, __bArrayCtr);
        ReportCellResult(__tableHandle, __csr, __ePassFail);
      }
    
      __res = __res && __csr;
    
    }
    ReportTableEndVerdict(__tableHandle, __cEvaluateResponse, __res);
	__bVerdict = __bVerdict && __res;
  }
  if (__bVerdict == __eVerdictFail)
    TestReportWriteDiagObjectList();
}
  
void __diagService4h42sqi_69(DiagRequest * __req, DiagResponse * __resp )
{
  stack long __tableHandle;
  long __res, __paramLen, __bytePos;

   __bVerdict = __eVerdictPass;

  do {
    TestReportResetDiagObjectList();
    DiagSetReportDetailLevel("CVADAS_0001_00000000_000", EnumServiceDetails_onfail);
    // Request aspect
    {

      if (0 >= DiagSendReqAndWaitForResp("CVADAS_0001_00000000_000", __req, __resp, __res, -1, -1, -1, -1, -1, EnumResult_pos, EnumServiceDetails_onfail, EnumSendingMode_physical, EnumSuppressPosResBit_asconfigured, EnumVerdictOnInvalidValues_fail))
        break;
    }

    __res = DiagErrCodeTestStep(__res, "Can't retrieve last response for request! No check possible.") < 0;
    if(__res)
    {
	  __bVerdict = __eVerdictFail;
      break;
    }
    {
      __res = DiagInterpretAs(__resp, "DSC_PR");
      if(__res != 0)
      {
        __bVerdict = __eVerdictFail;
        DiagErrCodeTestStep(__res, "Can't interpret response as diagnostic primitive 'DSC_PR'.");
        break;
      }
      else
      {
        TestStepPass( "Received primitive can be interpreted as diagnostic primitive 'DSC_PR'.");
      }
    }
  }
  while(0);


  // Response, check & read aspect
  {
    __res = 1;
    __tableHandle = ReportTableHead5Columns(__cCheckCaption, __cTSym, __cTOp, __cRefVal, __cActual, __cRes);
    {
      __bDiagValueArrayCtr = DiagGetParameterErrorHandled(__resp, "DiagSessionType", __bDiagValueArray, elcount(__bDiagValueArray), __cDiagValueArray, elcount(__cDiagValueArray));
      {
        byte __bArray2[1] = { 0x03 };
        __bArrayCtr = __CopyBytes(__bDiagValueArray, __bDiagValueArrayCtr, __bArray);
        __bArrayCtr2 = elCount(__bArray2);
        __csr = CompareBytes(__bArray, __bArrayCtr, __bArray2, __bArrayCtr2) == 0;
        snprintf(__cArray, 8192, "%s", "Diagnostic parameter \'DiagSessionType\'");
        snprintf(__cArray2, 8192, "%s", __cArray);
        snprintf(__cArray3, 8192, "%s", "");
        ReportTableRow(__tableHandle, 0, __cArray2, "Bytes", __bArray2, __bArrayCtr2, __cArray3, __oneOfFlag, __bSetInCheckAlignment);
        ReportCell(__tableHandle, __bArray, __bArrayCtr);
        ReportCellResult(__tableHandle, __csr, __ePassFail);
      }
    
      __res = __res && __csr;
    
    }
    ReportTableEndVerdict(__tableHandle, __cEvaluateResponse, __res);
	__bVerdict = __bVerdict && __res;
  }
  if (__bVerdict == __eVerdictFail)
    TestReportWriteDiagObjectList();
}
void Tt4h42sqi_Tet_Tc145_Completion()
{
  stack long __tableHandle;
  TestCompletionBegin();
  {
    {
      CreateTTEIFFunction("Tt4h42sqi_General_Postconditions", __eFct, __eLocal);
      CallInterfaceFunction(__cEmpty, __cEmpty, "8c04fef4-3bbc-4cc8-b3ee-b62ec5ff47eb");
    }


  }
  TestCompletionEnd();
}

void Tt4h42sqi_Tet_Tc146()
{
  CreateTTEIFFunction("Tt4h42sqi_Tc146", __eTcDef, __eLocal);  
  AddIFParameterTestCaseAttribute("TC_ID", "");
  AddIFParameterTestCaseAttribute("Test Case ID", "");
  CallInterfaceFunction("TC_ID_20205318_Defaults_Session", __cEmpty , __cEmpty );
}
testcase Tt4h42sqi_Tc146()
{
  stack long __tableHandle;
  SetBreakOnFail(0);

  CreateTTEIFFunction("Tt4h42sqi_Tet_Tc146_Completion", __eFct, __eLocal);
  
  AddIFAsCleanUpFunction();

  TestPreparationBegin();
  {
    {
      CreateTTEIFFunction("Tt4h42sqi_General_Precondition", __eFct, __eLocal);
      CallInterfaceFunction(__cEmpty, __cEmpty, "74787266-8376-4866-a392-d0cc32109fae");
    }


  }
  TestPreparationEnd();

  TestCommandBegin(__eDiagService, __cDiagService, "", "2");
  {
    if (DiagIsFunctionalGroup("CVADAS_0001_00000000_000"))
    {
      DiagResponse * __resp;
      DiagRequest CVADAS_0001_00000000_000.Default_Session_Start __req;
      __diagService4h42sqi_70(__req, __resp);
    }
    else
    {
      DiagResponse CVADAS_0001_00000000_000.* __resp;
      DiagRequest CVADAS_0001_00000000_000.Default_Session_Start __req;
      __diagService4h42sqi_70(__req, __resp);
    }
  }
  TestCommandEnd();


  {
    CreateTTEIFFunction("Tt4h42sqi_F186_DID_with_PhysicalAdd_DefaultSession", __eFct, __eLocal);
    CallInterfaceFunction(__cEmpty, __cEmpty, "f479ea65-8c8c-4093-b3d8-2a8374608569");
  }


  TestCommandBegin(__eWait, __cWait, "", "4");
  {
    Wait("1", (2000 * 1000000LL), 1000000, "");
  }
  TestCommandEnd();

  {
    CreateTTEIFFunction("Tt4h42sqi_F154_DID_with_Physical_Address", __eFct, __eLocal);
    CallInterfaceFunction(__cEmpty, __cEmpty, "69a5ea02-af07-4beb-8887-b2989586337a");
  }



}

  
void __diagService4h42sqi_70(DiagRequest * __req, DiagResponse * __resp )
{
  stack long __tableHandle;
  long __res, __paramLen, __bytePos;

   __bVerdict = __eVerdictPass;

  do {
    TestReportResetDiagObjectList();
    DiagSetReportDetailLevel("CVADAS_0001_00000000_000", EnumServiceDetails_onfail);
    // Request aspect
    {

      if (0 >= DiagSendReqAndWaitForResp("CVADAS_0001_00000000_000", __req, __resp, __res, -1, -1, -1, -1, -1, EnumResult_pos, EnumServiceDetails_onfail, EnumSendingMode_physical, EnumSuppressPosResBit_asconfigured, EnumVerdictOnInvalidValues_fail))
        break;
    }

    __res = DiagErrCodeTestStep(__res, "Can't retrieve last response for request! No check possible.") < 0;
    if(__res)
    {
	  __bVerdict = __eVerdictFail;
      break;
    }
    {
      __res = DiagInterpretAs(__resp, "DSC_PR");
      if(__res != 0)
      {
        __bVerdict = __eVerdictFail;
        DiagErrCodeTestStep(__res, "Can't interpret response as diagnostic primitive 'DSC_PR'.");
        break;
      }
      else
      {
        TestStepPass( "Received primitive can be interpreted as diagnostic primitive 'DSC_PR'.");
      }
    }
  }
  while(0);


  // Response, check & read aspect
  {
    __res = 1;
    __tableHandle = ReportTableHead5Columns(__cCheckCaption, __cTSym, __cTOp, __cRefVal, __cActual, __cRes);
    {
      __bDiagValueArrayCtr = DiagGetParameterErrorHandled(__resp, "DiagSessionType", __bDiagValueArray, elcount(__bDiagValueArray), __cDiagValueArray, elcount(__cDiagValueArray));
      {
        byte __bArray2[1] = { 0x01 };
        __bArrayCtr = __CopyBytes(__bDiagValueArray, __bDiagValueArrayCtr, __bArray);
        __bArrayCtr2 = elCount(__bArray2);
        __csr = CompareBytes(__bArray, __bArrayCtr, __bArray2, __bArrayCtr2) == 0;
        snprintf(__cArray, 8192, "%s", "Diagnostic parameter \'DiagSessionType\'");
        snprintf(__cArray2, 8192, "%s", __cArray);
        snprintf(__cArray3, 8192, "%s", "");
        ReportTableRow(__tableHandle, 0, __cArray2, "Bytes", __bArray2, __bArrayCtr2, __cArray3, __oneOfFlag, __bSetInCheckAlignment);
        ReportCell(__tableHandle, __bArray, __bArrayCtr);
        ReportCellResult(__tableHandle, __csr, __ePassFail);
      }
    
      __res = __res && __csr;
    
    }
    ReportTableEndVerdict(__tableHandle, __cEvaluateResponse, __res);
	__bVerdict = __bVerdict && __res;
  }
  if (__bVerdict == __eVerdictFail)
    TestReportWriteDiagObjectList();
}
void Tt4h42sqi_Tet_Tc146_Completion()
{
  stack long __tableHandle;
  TestCompletionBegin();
  {
    {
      CreateTTEIFFunction("Tt4h42sqi_General_Postconditions", __eFct, __eLocal);
      CallInterfaceFunction(__cEmpty, __cEmpty, "8c04fef4-3bbc-4cc8-b3ee-b62ec5ff47eb");
    }


  }
  TestCompletionEnd();
}

void Tt4h42sqi_Tet_Tc147()
{
  CreateTTEIFFunction("Tt4h42sqi_Tc147", __eTcDef, __eLocal);  
  AddIFParameterTestCaseAttribute("TC_ID", "");
  AddIFParameterTestCaseAttribute("Test Case ID", "");
  CallInterfaceFunction("TC_ID_20205290_Standard_Physical_Address", __cEmpty , __cEmpty );
}
testcase Tt4h42sqi_Tc147()
{
  stack long __tableHandle;
  SetBreakOnFail(0);

  CreateTTEIFFunction("Tt4h42sqi_Tet_Tc147_Completion", __eFct, __eLocal);
  
  AddIFAsCleanUpFunction();

  TestPreparationBegin();
  {
    {
      CreateTTEIFFunction("Tt4h42sqi_General_Precondition", __eFct, __eLocal);
      CallInterfaceFunction(__cEmpty, __cEmpty, "74787266-8376-4866-a392-d0cc32109fae");
    }


  }
  TestPreparationEnd();

  {
    CreateTTEIFFunction("Tt4h42sqi_Default_Session_Standard_Physical_Address", __eFct, __eLocal);
    CallInterfaceFunction(__cEmpty, __cEmpty, "627cb293-726d-49b1-b2f7-7f87145feea3");
  }


  {
    CreateTTEIFFunction("Tt4h42sqi_F186_DID_with_Standard_Physical_Address_Default_Session", __eFct, __eLocal);
    CallInterfaceFunction(__cEmpty, __cEmpty, "94a4fb5c-65ad-4a5d-ac34-b6372d993b69");
  }


  {
    CreateTTEIFFunction("Tt4h42sqi_F154_DID_with_Standard_Physical_Address", __eFct, __eLocal);
    CallInterfaceFunction(__cEmpty, __cEmpty, "e75e97fe-e136-4d89-bc71-4cabed643993");
  }



}

void Tt4h42sqi_Tet_Tc147_Completion()
{
  stack long __tableHandle;
  TestCompletionBegin();
  {
    {
      CreateTTEIFFunction("Tt4h42sqi_General_Postconditions", __eFct, __eLocal);
      CallInterfaceFunction(__cEmpty, __cEmpty, "8c04fef4-3bbc-4cc8-b3ee-b62ec5ff47eb");
    }


  }
  TestCompletionEnd();
}

void Tt4h42sqi_Tet_Tc148()
{
  CreateTTEIFFunction("Tt4h42sqi_Tc148", __eTcDef, __eLocal);  
  AddIFParameterTestCaseAttribute("TC_ID", "");
  AddIFParameterTestCaseAttribute("Test Case ID", "");
  CallInterfaceFunction("TC_ID_20205281_Extended_Session", __cEmpty , __cEmpty );
}
testcase Tt4h42sqi_Tc148()
{
  stack long __tableHandle;
  SetBreakOnFail(0);

  CreateTTEIFFunction("Tt4h42sqi_Tet_Tc148_Completion", __eFct, __eLocal);
  
  AddIFAsCleanUpFunction();

  TestPreparationBegin();
  {
    {
      CreateTTEIFFunction("Tt4h42sqi_General_Precondition", __eFct, __eLocal);
      CallInterfaceFunction(__cEmpty, __cEmpty, "74787266-8376-4866-a392-d0cc32109fae");
    }


  }
  TestPreparationEnd();

  TestCommandBegin(__eDiagService, __cDiagService, "", "2");
  {
    if (DiagIsFunctionalGroup("CVADAS_0001_00000000_000"))
    {
      DiagResponse * __resp;
      DiagRequest CVADAS_0001_00000000_000.Default_Session_Start __req;
      __diagService4h42sqi_71(__req, __resp);
    }
    else
    {
      DiagResponse CVADAS_0001_00000000_000.* __resp;
      DiagRequest CVADAS_0001_00000000_000.Default_Session_Start __req;
      __diagService4h42sqi_71(__req, __resp);
    }
  }
  TestCommandEnd();


  TestCommandBegin(__eDiagService, __cDiagService, "", "3");
  {
    if (DiagIsFunctionalGroup("CVADAS_0001_00000000_000"))
    {
      DiagResponse * __resp;
      DiagRequest CVADAS_0001_00000000_000.Extended_Diagnostic_Session_Start __req;
      __diagService4h42sqi_72(__req, __resp);
    }
    else
    {
      DiagResponse CVADAS_0001_00000000_000.* __resp;
      DiagRequest CVADAS_0001_00000000_000.Extended_Diagnostic_Session_Start __req;
      __diagService4h42sqi_72(__req, __resp);
    }
  }
  TestCommandEnd();


  {
    CreateTTEIFFunction("Tt4h42sqi_F186_DID_with_PhysicalAdd_ExtendedSession", __eFct, __eLocal);
    CallInterfaceFunction(__cEmpty, __cEmpty, "56d9e7a7-9216-4d5f-b776-c5e862f155cb");
  }


  TestCommandBegin(__eWait, __cWait, "", "6");
  {
    Wait("1", (2000 * 1000000LL), 1000000, "");
  }
  TestCommandEnd();

  {
    CreateTTEIFFunction("Tt4h42sqi_F154_DID_with_Physical_Address", __eFct, __eLocal);
    CallInterfaceFunction(__cEmpty, __cEmpty, "69a5ea02-af07-4beb-8887-b2989586337a");
  }



}

  
void __diagService4h42sqi_71(DiagRequest * __req, DiagResponse * __resp )
{
  stack long __tableHandle;
  long __res, __paramLen, __bytePos;

   __bVerdict = __eVerdictPass;

  do {
    TestReportResetDiagObjectList();
    DiagSetReportDetailLevel("CVADAS_0001_00000000_000", EnumServiceDetails_onfail);
    // Request aspect
    {

      if (0 >= DiagSendReqAndWaitForResp("CVADAS_0001_00000000_000", __req, __resp, __res, -1, -1, -1, -1, -1, EnumResult_pos, EnumServiceDetails_onfail, EnumSendingMode_physical, EnumSuppressPosResBit_asconfigured, EnumVerdictOnInvalidValues_fail))
        break;
    }

    __res = DiagErrCodeTestStep(__res, "Can't retrieve last response for request! No check possible.") < 0;
    if(__res)
    {
	  __bVerdict = __eVerdictFail;
      break;
    }
    {
      __res = DiagInterpretAs(__resp, "DSC_PR");
      if(__res != 0)
      {
        __bVerdict = __eVerdictFail;
        DiagErrCodeTestStep(__res, "Can't interpret response as diagnostic primitive 'DSC_PR'.");
        break;
      }
      else
      {
        TestStepPass( "Received primitive can be interpreted as diagnostic primitive 'DSC_PR'.");
      }
    }
  }
  while(0);


  // Response, check & read aspect
  {
    __res = 1;
    __tableHandle = ReportTableHead5Columns(__cCheckCaption, __cTSym, __cTOp, __cRefVal, __cActual, __cRes);
    {
      __bDiagValueArrayCtr = DiagGetParameterErrorHandled(__resp, "DiagSessionType", __bDiagValueArray, elcount(__bDiagValueArray), __cDiagValueArray, elcount(__cDiagValueArray));
      {
        byte __bArray2[1] = { 0x01 };
        __bArrayCtr = __CopyBytes(__bDiagValueArray, __bDiagValueArrayCtr, __bArray);
        __bArrayCtr2 = elCount(__bArray2);
        __csr = CompareBytes(__bArray, __bArrayCtr, __bArray2, __bArrayCtr2) == 0;
        snprintf(__cArray, 8192, "%s", "Diagnostic parameter \'DiagSessionType\'");
        snprintf(__cArray2, 8192, "%s", __cArray);
        snprintf(__cArray3, 8192, "%s", "");
        ReportTableRow(__tableHandle, 0, __cArray2, "Bytes", __bArray2, __bArrayCtr2, __cArray3, __oneOfFlag, __bSetInCheckAlignment);
        ReportCell(__tableHandle, __bArray, __bArrayCtr);
        ReportCellResult(__tableHandle, __csr, __ePassFail);
      }
    
      __res = __res && __csr;
    
    }
    ReportTableEndVerdict(__tableHandle, __cEvaluateResponse, __res);
	__bVerdict = __bVerdict && __res;
  }
  if (__bVerdict == __eVerdictFail)
    TestReportWriteDiagObjectList();
}
  
void __diagService4h42sqi_72(DiagRequest * __req, DiagResponse * __resp )
{
  stack long __tableHandle;
  long __res, __paramLen, __bytePos;

   __bVerdict = __eVerdictPass;

  do {
    TestReportResetDiagObjectList();
    DiagSetReportDetailLevel("CVADAS_0001_00000000_000", EnumServiceDetails_onfail);
    // Request aspect
    {

      if (0 >= DiagSendReqAndWaitForResp("CVADAS_0001_00000000_000", __req, __resp, __res, -1, -1, -1, -1, -1, EnumResult_pos, EnumServiceDetails_onfail, EnumSendingMode_physical, EnumSuppressPosResBit_asconfigured, EnumVerdictOnInvalidValues_fail))
        break;
    }

    __res = DiagErrCodeTestStep(__res, "Can't retrieve last response for request! No check possible.") < 0;
    if(__res)
    {
	  __bVerdict = __eVerdictFail;
      break;
    }
    {
      __res = DiagInterpretAs(__resp, "DSC_PR");
      if(__res != 0)
      {
        __bVerdict = __eVerdictFail;
        DiagErrCodeTestStep(__res, "Can't interpret response as diagnostic primitive 'DSC_PR'.");
        break;
      }
      else
      {
        TestStepPass( "Received primitive can be interpreted as diagnostic primitive 'DSC_PR'.");
      }
    }
  }
  while(0);


  // Response, check & read aspect
  {
    __res = 1;
    __tableHandle = ReportTableHead5Columns(__cCheckCaption, __cTSym, __cTOp, __cRefVal, __cActual, __cRes);
    {
      __bDiagValueArrayCtr = DiagGetParameterErrorHandled(__resp, "DiagSessionType", __bDiagValueArray, elcount(__bDiagValueArray), __cDiagValueArray, elcount(__cDiagValueArray));
      {
        byte __bArray2[1] = { 0x03 };
        __bArrayCtr = __CopyBytes(__bDiagValueArray, __bDiagValueArrayCtr, __bArray);
        __bArrayCtr2 = elCount(__bArray2);
        __csr = CompareBytes(__bArray, __bArrayCtr, __bArray2, __bArrayCtr2) == 0;
        snprintf(__cArray, 8192, "%s", "Diagnostic parameter \'DiagSessionType\'");
        snprintf(__cArray2, 8192, "%s", __cArray);
        snprintf(__cArray3, 8192, "%s", "");
        ReportTableRow(__tableHandle, 0, __cArray2, "Bytes", __bArray2, __bArrayCtr2, __cArray3, __oneOfFlag, __bSetInCheckAlignment);
        ReportCell(__tableHandle, __bArray, __bArrayCtr);
        ReportCellResult(__tableHandle, __csr, __ePassFail);
      }
    
      __res = __res && __csr;
    
    }
    ReportTableEndVerdict(__tableHandle, __cEvaluateResponse, __res);
	__bVerdict = __bVerdict && __res;
  }
  if (__bVerdict == __eVerdictFail)
    TestReportWriteDiagObjectList();
}
void Tt4h42sqi_Tet_Tc148_Completion()
{
  stack long __tableHandle;
  TestCompletionBegin();
  {
    {
      CreateTTEIFFunction("Tt4h42sqi_General_Postconditions", __eFct, __eLocal);
      CallInterfaceFunction(__cEmpty, __cEmpty, "8c04fef4-3bbc-4cc8-b3ee-b62ec5ff47eb");
    }


  }
  TestCompletionEnd();
}

void Tt4h42sqi_Tet_Tc149()
{
  CreateTTEIFFunction("Tt4h42sqi_Tc149", __eTcDef, __eLocal);  
  AddIFParameterTestCaseAttribute("TC_ID", "");
  AddIFParameterTestCaseAttribute("Test Case ID", "");
  CallInterfaceFunction("TC_ID_20205247_Standard_Physical_Address", __cEmpty , __cEmpty );
}
testcase Tt4h42sqi_Tc149()
{
  stack long __tableHandle;
  SetBreakOnFail(0);

  CreateTTEIFFunction("Tt4h42sqi_Tet_Tc149_Completion", __eFct, __eLocal);
  
  AddIFAsCleanUpFunction();

  TestPreparationBegin();
  {
    {
      CreateTTEIFFunction("Tt4h42sqi_General_Precondition", __eFct, __eLocal);
      CallInterfaceFunction(__cEmpty, __cEmpty, "74787266-8376-4866-a392-d0cc32109fae");
    }


  }
  TestPreparationEnd();

  {
    CreateTTEIFFunction("Tt4h42sqi_Default_Session_Standard_Physical_Address", __eFct, __eLocal);
    CallInterfaceFunction(__cEmpty, __cEmpty, "627cb293-726d-49b1-b2f7-7f87145feea3");
  }


  {
    CreateTTEIFFunction("Tt4h42sqi_Extended_Session_Standard_Physical_Address", __eFct, __eLocal);
    CallInterfaceFunction(__cEmpty, __cEmpty, "58435b58-3d17-4ead-b77b-3e81b0124cf0");
  }


  {
    CreateTTEIFFunction("Tt4h42sqi_F186_DID_with_Standard_Physical_Address_Extended_Session", __eFct, __eLocal);
    CallInterfaceFunction(__cEmpty, __cEmpty, "1164fa28-24b1-4b88-89b6-88fe5bcc87f0");
  }


  {
    CreateTTEIFFunction("Tt4h42sqi_F154_DID_with_Standard_Physical_Address", __eFct, __eLocal);
    CallInterfaceFunction(__cEmpty, __cEmpty, "e75e97fe-e136-4d89-bc71-4cabed643993");
  }



}

void Tt4h42sqi_Tet_Tc149_Completion()
{
  stack long __tableHandle;
  TestCompletionBegin();
  {
    {
      CreateTTEIFFunction("Tt4h42sqi_General_Postconditions", __eFct, __eLocal);
      CallInterfaceFunction(__cEmpty, __cEmpty, "8c04fef4-3bbc-4cc8-b3ee-b62ec5ff47eb");
    }


  }
  TestCompletionEnd();
}

void Tt4h42sqi_Tet_Tc150()
{
  CreateTTEIFFunction("Tt4h42sqi_Tc150", __eTcDef, __eLocal);  
  AddIFParameterTestCaseAttribute("TC_ID", "");
  AddIFParameterTestCaseAttribute("Test Case ID", "");
  CallInterfaceFunction("TC_ID_20205248_Defaults_Session_Physical_and_Standard_Addressing", __cEmpty , __cEmpty );
}
testcase Tt4h42sqi_Tc150()
{
  stack long __tableHandle;
  SetBreakOnFail(0);

  CreateTTEIFFunction("Tt4h42sqi_Tet_Tc150_Completion", __eFct, __eLocal);
  
  AddIFAsCleanUpFunction();

  TestPreparationBegin();
  {
    {
      CreateTTEIFFunction("Tt4h42sqi_General_Precondition", __eFct, __eLocal);
      CallInterfaceFunction(__cEmpty, __cEmpty, "74787266-8376-4866-a392-d0cc32109fae");
    }


  }
  TestPreparationEnd();

  TestCommandBegin(__eDiagService, __cDiagService, "", "2");
  {
    if (DiagIsFunctionalGroup("CVADAS_0001_00000000_000"))
    {
      DiagResponse * __resp;
      DiagRequest CVADAS_0001_00000000_000.Default_Session_Start __req;
      __diagService4h42sqi_73(__req, __resp);
    }
    else
    {
      DiagResponse CVADAS_0001_00000000_000.* __resp;
      DiagRequest CVADAS_0001_00000000_000.Default_Session_Start __req;
      __diagService4h42sqi_73(__req, __resp);
    }
  }
  TestCommandEnd();


  {
    CreateTTEIFFunction("Tt4h42sqi_F186_DID_with_PhysicalAdd_DefaultSession", __eFct, __eLocal);
    CallInterfaceFunction(__cEmpty, __cEmpty, "f479ea65-8c8c-4093-b3d8-2a8374608569");
  }


  TestCommandBegin(__eWait, __cWait, "", "5");
  {
    Wait("1", (2000 * 1000000LL), 1000000, "");
  }
  TestCommandEnd();

  {
    CreateTTEIFFunction("Tt4h42sqi_F155_DID_with_Physical_Address", __eFct, __eLocal);
    CallInterfaceFunction(__cEmpty, __cEmpty, "ae470781-01f8-4709-bed8-d79e10da78a1");
  }



}

  
void __diagService4h42sqi_73(DiagRequest * __req, DiagResponse * __resp )
{
  stack long __tableHandle;
  long __res, __paramLen, __bytePos;

   __bVerdict = __eVerdictPass;

  do {
    TestReportResetDiagObjectList();
    DiagSetReportDetailLevel("CVADAS_0001_00000000_000", EnumServiceDetails_onfail);
    // Request aspect
    {

      if (0 >= DiagSendReqAndWaitForResp("CVADAS_0001_00000000_000", __req, __resp, __res, -1, -1, -1, -1, -1, EnumResult_pos, EnumServiceDetails_onfail, EnumSendingMode_physical, EnumSuppressPosResBit_asconfigured, EnumVerdictOnInvalidValues_fail))
        break;
    }

    __res = DiagErrCodeTestStep(__res, "Can't retrieve last response for request! No check possible.") < 0;
    if(__res)
    {
	  __bVerdict = __eVerdictFail;
      break;
    }
    {
      __res = DiagInterpretAs(__resp, "DSC_PR");
      if(__res != 0)
      {
        __bVerdict = __eVerdictFail;
        DiagErrCodeTestStep(__res, "Can't interpret response as diagnostic primitive 'DSC_PR'.");
        break;
      }
      else
      {
        TestStepPass( "Received primitive can be interpreted as diagnostic primitive 'DSC_PR'.");
      }
    }
  }
  while(0);


  // Response, check & read aspect
  {
    __res = 1;
    __tableHandle = ReportTableHead5Columns(__cCheckCaption, __cTSym, __cTOp, __cRefVal, __cActual, __cRes);
    {
      __bDiagValueArrayCtr = DiagGetParameterErrorHandled(__resp, "DiagSessionType", __bDiagValueArray, elcount(__bDiagValueArray), __cDiagValueArray, elcount(__cDiagValueArray));
      {
        byte __bArray2[1] = { 0x01 };
        __bArrayCtr = __CopyBytes(__bDiagValueArray, __bDiagValueArrayCtr, __bArray);
        __bArrayCtr2 = elCount(__bArray2);
        __csr = CompareBytes(__bArray, __bArrayCtr, __bArray2, __bArrayCtr2) == 0;
        snprintf(__cArray, 8192, "%s", "Diagnostic parameter \'DiagSessionType\'");
        snprintf(__cArray2, 8192, "%s", __cArray);
        snprintf(__cArray3, 8192, "%s", "");
        ReportTableRow(__tableHandle, 0, __cArray2, "Bytes", __bArray2, __bArrayCtr2, __cArray3, __oneOfFlag, __bSetInCheckAlignment);
        ReportCell(__tableHandle, __bArray, __bArrayCtr);
        ReportCellResult(__tableHandle, __csr, __ePassFail);
      }
    
      __res = __res && __csr;
    
    }
    ReportTableEndVerdict(__tableHandle, __cEvaluateResponse, __res);
	__bVerdict = __bVerdict && __res;
  }
  if (__bVerdict == __eVerdictFail)
    TestReportWriteDiagObjectList();
}
void Tt4h42sqi_Tet_Tc150_Completion()
{
  stack long __tableHandle;
  TestCompletionBegin();
  {
    {
      CreateTTEIFFunction("Tt4h42sqi_General_Postconditions", __eFct, __eLocal);
      CallInterfaceFunction(__cEmpty, __cEmpty, "8c04fef4-3bbc-4cc8-b3ee-b62ec5ff47eb");
    }


  }
  TestCompletionEnd();
}

void Tt4h42sqi_Tet_Tc151()
{
  CreateTTEIFFunction("Tt4h42sqi_Tc151", __eTcDef, __eLocal);  
  AddIFParameterTestCaseAttribute("TC_ID", "");
  AddIFParameterTestCaseAttribute("Test Case ID", "");
  CallInterfaceFunction("TC_ID_20205257_Extended_Session_Physical_and_Standard_Addressing", __cEmpty , __cEmpty );
}
testcase Tt4h42sqi_Tc151()
{
  stack long __tableHandle;
  SetBreakOnFail(0);

  CreateTTEIFFunction("Tt4h42sqi_Tet_Tc151_Completion", __eFct, __eLocal);
  
  AddIFAsCleanUpFunction();

  TestPreparationBegin();
  {
    {
      CreateTTEIFFunction("Tt4h42sqi_General_Precondition", __eFct, __eLocal);
      CallInterfaceFunction(__cEmpty, __cEmpty, "74787266-8376-4866-a392-d0cc32109fae");
    }


  }
  TestPreparationEnd();

  TestCommandBegin(__eDiagService, __cDiagService, "", "2");
  {
    if (DiagIsFunctionalGroup("CVADAS_0001_00000000_000"))
    {
      DiagResponse * __resp;
      DiagRequest CVADAS_0001_00000000_000.Default_Session_Start __req;
      __diagService4h42sqi_74(__req, __resp);
    }
    else
    {
      DiagResponse CVADAS_0001_00000000_000.* __resp;
      DiagRequest CVADAS_0001_00000000_000.Default_Session_Start __req;
      __diagService4h42sqi_74(__req, __resp);
    }
  }
  TestCommandEnd();


  TestCommandBegin(__eDiagService, __cDiagService, "", "3");
  {
    if (DiagIsFunctionalGroup("CVADAS_0001_00000000_000"))
    {
      DiagResponse * __resp;
      DiagRequest CVADAS_0001_00000000_000.Extended_Diagnostic_Session_Start __req;
      __diagService4h42sqi_75(__req, __resp);
    }
    else
    {
      DiagResponse CVADAS_0001_00000000_000.* __resp;
      DiagRequest CVADAS_0001_00000000_000.Extended_Diagnostic_Session_Start __req;
      __diagService4h42sqi_75(__req, __resp);
    }
  }
  TestCommandEnd();


  {
    CreateTTEIFFunction("Tt4h42sqi_F186_DID_with_PhysicalAdd_ExtendedSession", __eFct, __eLocal);
    CallInterfaceFunction(__cEmpty, __cEmpty, "56d9e7a7-9216-4d5f-b776-c5e862f155cb");
  }


  TestCommandBegin(__eWait, __cWait, "", "6");
  {
    Wait("1", (2000 * 1000000LL), 1000000, "");
  }
  TestCommandEnd();

  {
    CreateTTEIFFunction("Tt4h42sqi_F155_DID_with_Physical_Address", __eFct, __eLocal);
    CallInterfaceFunction(__cEmpty, __cEmpty, "ae470781-01f8-4709-bed8-d79e10da78a1");
  }



}

  
void __diagService4h42sqi_74(DiagRequest * __req, DiagResponse * __resp )
{
  stack long __tableHandle;
  long __res, __paramLen, __bytePos;

   __bVerdict = __eVerdictPass;

  do {
    TestReportResetDiagObjectList();
    DiagSetReportDetailLevel("CVADAS_0001_00000000_000", EnumServiceDetails_onfail);
    // Request aspect
    {

      if (0 >= DiagSendReqAndWaitForResp("CVADAS_0001_00000000_000", __req, __resp, __res, -1, -1, -1, -1, -1, EnumResult_pos, EnumServiceDetails_onfail, EnumSendingMode_physical, EnumSuppressPosResBit_asconfigured, EnumVerdictOnInvalidValues_fail))
        break;
    }

    __res = DiagErrCodeTestStep(__res, "Can't retrieve last response for request! No check possible.") < 0;
    if(__res)
    {
	  __bVerdict = __eVerdictFail;
      break;
    }
    {
      __res = DiagInterpretAs(__resp, "DSC_PR");
      if(__res != 0)
      {
        __bVerdict = __eVerdictFail;
        DiagErrCodeTestStep(__res, "Can't interpret response as diagnostic primitive 'DSC_PR'.");
        break;
      }
      else
      {
        TestStepPass( "Received primitive can be interpreted as diagnostic primitive 'DSC_PR'.");
      }
    }
  }
  while(0);


  // Response, check & read aspect
  {
    __res = 1;
    __tableHandle = ReportTableHead5Columns(__cCheckCaption, __cTSym, __cTOp, __cRefVal, __cActual, __cRes);
    {
      __bDiagValueArrayCtr = DiagGetParameterErrorHandled(__resp, "DiagSessionType", __bDiagValueArray, elcount(__bDiagValueArray), __cDiagValueArray, elcount(__cDiagValueArray));
      {
        byte __bArray2[1] = { 0x01 };
        __bArrayCtr = __CopyBytes(__bDiagValueArray, __bDiagValueArrayCtr, __bArray);
        __bArrayCtr2 = elCount(__bArray2);
        __csr = CompareBytes(__bArray, __bArrayCtr, __bArray2, __bArrayCtr2) == 0;
        snprintf(__cArray, 8192, "%s", "Diagnostic parameter \'DiagSessionType\'");
        snprintf(__cArray2, 8192, "%s", __cArray);
        snprintf(__cArray3, 8192, "%s", "");
        ReportTableRow(__tableHandle, 0, __cArray2, "Bytes", __bArray2, __bArrayCtr2, __cArray3, __oneOfFlag, __bSetInCheckAlignment);
        ReportCell(__tableHandle, __bArray, __bArrayCtr);
        ReportCellResult(__tableHandle, __csr, __ePassFail);
      }
    
      __res = __res && __csr;
    
    }
    ReportTableEndVerdict(__tableHandle, __cEvaluateResponse, __res);
	__bVerdict = __bVerdict && __res;
  }
  if (__bVerdict == __eVerdictFail)
    TestReportWriteDiagObjectList();
}
  
void __diagService4h42sqi_75(DiagRequest * __req, DiagResponse * __resp )
{
  stack long __tableHandle;
  long __res, __paramLen, __bytePos;

   __bVerdict = __eVerdictPass;

  do {
    TestReportResetDiagObjectList();
    DiagSetReportDetailLevel("CVADAS_0001_00000000_000", EnumServiceDetails_onfail);
    // Request aspect
    {

      if (0 >= DiagSendReqAndWaitForResp("CVADAS_0001_00000000_000", __req, __resp, __res, -1, -1, -1, -1, -1, EnumResult_pos, EnumServiceDetails_onfail, EnumSendingMode_physical, EnumSuppressPosResBit_asconfigured, EnumVerdictOnInvalidValues_fail))
        break;
    }

    __res = DiagErrCodeTestStep(__res, "Can't retrieve last response for request! No check possible.") < 0;
    if(__res)
    {
	  __bVerdict = __eVerdictFail;
      break;
    }
    {
      __res = DiagInterpretAs(__resp, "DSC_PR");
      if(__res != 0)
      {
        __bVerdict = __eVerdictFail;
        DiagErrCodeTestStep(__res, "Can't interpret response as diagnostic primitive 'DSC_PR'.");
        break;
      }
      else
      {
        TestStepPass( "Received primitive can be interpreted as diagnostic primitive 'DSC_PR'.");
      }
    }
  }
  while(0);


  // Response, check & read aspect
  {
    __res = 1;
    __tableHandle = ReportTableHead5Columns(__cCheckCaption, __cTSym, __cTOp, __cRefVal, __cActual, __cRes);
    {
      __bDiagValueArrayCtr = DiagGetParameterErrorHandled(__resp, "DiagSessionType", __bDiagValueArray, elcount(__bDiagValueArray), __cDiagValueArray, elcount(__cDiagValueArray));
      {
        byte __bArray2[1] = { 0x03 };
        __bArrayCtr = __CopyBytes(__bDiagValueArray, __bDiagValueArrayCtr, __bArray);
        __bArrayCtr2 = elCount(__bArray2);
        __csr = CompareBytes(__bArray, __bArrayCtr, __bArray2, __bArrayCtr2) == 0;
        snprintf(__cArray, 8192, "%s", "Diagnostic parameter \'DiagSessionType\'");
        snprintf(__cArray2, 8192, "%s", __cArray);
        snprintf(__cArray3, 8192, "%s", "");
        ReportTableRow(__tableHandle, 0, __cArray2, "Bytes", __bArray2, __bArrayCtr2, __cArray3, __oneOfFlag, __bSetInCheckAlignment);
        ReportCell(__tableHandle, __bArray, __bArrayCtr);
        ReportCellResult(__tableHandle, __csr, __ePassFail);
      }
    
      __res = __res && __csr;
    
    }
    ReportTableEndVerdict(__tableHandle, __cEvaluateResponse, __res);
	__bVerdict = __bVerdict && __res;
  }
  if (__bVerdict == __eVerdictFail)
    TestReportWriteDiagObjectList();
}
void Tt4h42sqi_Tet_Tc151_Completion()
{
  stack long __tableHandle;
  TestCompletionBegin();
  {
    {
      CreateTTEIFFunction("Tt4h42sqi_General_Postconditions", __eFct, __eLocal);
      CallInterfaceFunction(__cEmpty, __cEmpty, "8c04fef4-3bbc-4cc8-b3ee-b62ec5ff47eb");
    }


  }
  TestCompletionEnd();
}

void Tt4h42sqi_Tet_Tc152()
{
  CreateTTEIFFunction("Tt4h42sqi_Tc152", __eTcDef, __eLocal);  
  AddIFParameterTestCaseAttribute("TC_ID", "");
  AddIFParameterTestCaseAttribute("Test Case ID", "");
  CallInterfaceFunction("TC_ID_20205191_Defaults_Session_Physical_and_Standard_Addressing", __cEmpty , __cEmpty );
}
testcase Tt4h42sqi_Tc152()
{
  stack long __tableHandle;
  SetBreakOnFail(0);

  CreateTTEIFFunction("Tt4h42sqi_Tet_Tc152_Completion", __eFct, __eLocal);
  
  AddIFAsCleanUpFunction();

  TestPreparationBegin();
  {
    {
      CreateTTEIFFunction("Tt4h42sqi_General_Precondition", __eFct, __eLocal);
      CallInterfaceFunction(__cEmpty, __cEmpty, "74787266-8376-4866-a392-d0cc32109fae");
    }


  }
  TestPreparationEnd();

  TestCommandBegin(__eDiagService, __cDiagService, "", "2");
  {
    if (DiagIsFunctionalGroup("CVADAS_0001_00000000_000"))
    {
      DiagResponse * __resp;
      DiagRequest CVADAS_0001_00000000_000.Default_Session_Start __req;
      __diagService4h42sqi_76(__req, __resp);
    }
    else
    {
      DiagResponse CVADAS_0001_00000000_000.* __resp;
      DiagRequest CVADAS_0001_00000000_000.Default_Session_Start __req;
      __diagService4h42sqi_76(__req, __resp);
    }
  }
  TestCommandEnd();


  {
    CreateTTEIFFunction("Tt4h42sqi_F186_DID_with_PhysicalAdd_DefaultSession", __eFct, __eLocal);
    CallInterfaceFunction(__cEmpty, __cEmpty, "f479ea65-8c8c-4093-b3d8-2a8374608569");
  }


  TestCommandBegin(__eWait, __cWait, "", "5");
  {
    Wait("1", (2000 * 1000000LL), 1000000, "");
  }
  TestCommandEnd();

  {
    CreateTTEIFFunction("Tt4h42sqi_F180_DID_with_Physical_Address", __eFct, __eLocal);
    CallInterfaceFunction(__cEmpty, __cEmpty, "c6518c74-8716-4a5d-a001-f1bb5701c4fc");
  }



}

  
void __diagService4h42sqi_76(DiagRequest * __req, DiagResponse * __resp )
{
  stack long __tableHandle;
  long __res, __paramLen, __bytePos;

   __bVerdict = __eVerdictPass;

  do {
    TestReportResetDiagObjectList();
    DiagSetReportDetailLevel("CVADAS_0001_00000000_000", EnumServiceDetails_onfail);
    // Request aspect
    {

      if (0 >= DiagSendReqAndWaitForResp("CVADAS_0001_00000000_000", __req, __resp, __res, -1, -1, -1, -1, -1, EnumResult_pos, EnumServiceDetails_onfail, EnumSendingMode_physical, EnumSuppressPosResBit_asconfigured, EnumVerdictOnInvalidValues_fail))
        break;
    }

    __res = DiagErrCodeTestStep(__res, "Can't retrieve last response for request! No check possible.") < 0;
    if(__res)
    {
	  __bVerdict = __eVerdictFail;
      break;
    }
    {
      __res = DiagInterpretAs(__resp, "DSC_PR");
      if(__res != 0)
      {
        __bVerdict = __eVerdictFail;
        DiagErrCodeTestStep(__res, "Can't interpret response as diagnostic primitive 'DSC_PR'.");
        break;
      }
      else
      {
        TestStepPass( "Received primitive can be interpreted as diagnostic primitive 'DSC_PR'.");
      }
    }
  }
  while(0);


  // Response, check & read aspect
  {
    __res = 1;
    __tableHandle = ReportTableHead5Columns(__cCheckCaption, __cTSym, __cTOp, __cRefVal, __cActual, __cRes);
    {
      __bDiagValueArrayCtr = DiagGetParameterErrorHandled(__resp, "DiagSessionType", __bDiagValueArray, elcount(__bDiagValueArray), __cDiagValueArray, elcount(__cDiagValueArray));
      {
        byte __bArray2[1] = { 0x01 };
        __bArrayCtr = __CopyBytes(__bDiagValueArray, __bDiagValueArrayCtr, __bArray);
        __bArrayCtr2 = elCount(__bArray2);
        __csr = CompareBytes(__bArray, __bArrayCtr, __bArray2, __bArrayCtr2) == 0;
        snprintf(__cArray, 8192, "%s", "Diagnostic parameter \'DiagSessionType\'");
        snprintf(__cArray2, 8192, "%s", __cArray);
        snprintf(__cArray3, 8192, "%s", "");
        ReportTableRow(__tableHandle, 0, __cArray2, "Bytes", __bArray2, __bArrayCtr2, __cArray3, __oneOfFlag, __bSetInCheckAlignment);
        ReportCell(__tableHandle, __bArray, __bArrayCtr);
        ReportCellResult(__tableHandle, __csr, __ePassFail);
      }
    
      __res = __res && __csr;
    
    }
    ReportTableEndVerdict(__tableHandle, __cEvaluateResponse, __res);
	__bVerdict = __bVerdict && __res;
  }
  if (__bVerdict == __eVerdictFail)
    TestReportWriteDiagObjectList();
}
void Tt4h42sqi_Tet_Tc152_Completion()
{
  stack long __tableHandle;
  TestCompletionBegin();
  {
    {
      CreateTTEIFFunction("Tt4h42sqi_General_Postconditions", __eFct, __eLocal);
      CallInterfaceFunction(__cEmpty, __cEmpty, "8c04fef4-3bbc-4cc8-b3ee-b62ec5ff47eb");
    }


  }
  TestCompletionEnd();
}

void Tt4h42sqi_Tet_Tc153()
{
  CreateTTEIFFunction("Tt4h42sqi_Tc153", __eTcDef, __eLocal);  
  AddIFParameterTestCaseAttribute("TC_ID", "");
  AddIFParameterTestCaseAttribute("Test Case ID", "");
  CallInterfaceFunction("TC_ID_20205193_Extended_Session_Physical_and_Standard_Addressing", __cEmpty , __cEmpty );
}
testcase Tt4h42sqi_Tc153()
{
  stack long __tableHandle;
  SetBreakOnFail(0);

  CreateTTEIFFunction("Tt4h42sqi_Tet_Tc153_Completion", __eFct, __eLocal);
  
  AddIFAsCleanUpFunction();

  TestPreparationBegin();
  {
    {
      CreateTTEIFFunction("Tt4h42sqi_General_Precondition", __eFct, __eLocal);
      CallInterfaceFunction(__cEmpty, __cEmpty, "74787266-8376-4866-a392-d0cc32109fae");
    }


  }
  TestPreparationEnd();

  TestCommandBegin(__eDiagService, __cDiagService, "", "2");
  {
    if (DiagIsFunctionalGroup("CVADAS_0001_00000000_000"))
    {
      DiagResponse * __resp;
      DiagRequest CVADAS_0001_00000000_000.Default_Session_Start __req;
      __diagService4h42sqi_77(__req, __resp);
    }
    else
    {
      DiagResponse CVADAS_0001_00000000_000.* __resp;
      DiagRequest CVADAS_0001_00000000_000.Default_Session_Start __req;
      __diagService4h42sqi_77(__req, __resp);
    }
  }
  TestCommandEnd();


  TestCommandBegin(__eDiagService, __cDiagService, "", "3");
  {
    if (DiagIsFunctionalGroup("CVADAS_0001_00000000_000"))
    {
      DiagResponse * __resp;
      DiagRequest CVADAS_0001_00000000_000.Extended_Diagnostic_Session_Start __req;
      __diagService4h42sqi_78(__req, __resp);
    }
    else
    {
      DiagResponse CVADAS_0001_00000000_000.* __resp;
      DiagRequest CVADAS_0001_00000000_000.Extended_Diagnostic_Session_Start __req;
      __diagService4h42sqi_78(__req, __resp);
    }
  }
  TestCommandEnd();


  {
    CreateTTEIFFunction("Tt4h42sqi_F186_DID_with_PhysicalAdd_ExtendedSession", __eFct, __eLocal);
    CallInterfaceFunction(__cEmpty, __cEmpty, "56d9e7a7-9216-4d5f-b776-c5e862f155cb");
  }


  TestCommandBegin(__eWait, __cWait, "", "6");
  {
    Wait("1", (2000 * 1000000LL), 1000000, "");
  }
  TestCommandEnd();

  {
    CreateTTEIFFunction("Tt4h42sqi_F180_DID_with_Physical_Address", __eFct, __eLocal);
    CallInterfaceFunction(__cEmpty, __cEmpty, "c6518c74-8716-4a5d-a001-f1bb5701c4fc");
  }



}

  
void __diagService4h42sqi_77(DiagRequest * __req, DiagResponse * __resp )
{
  stack long __tableHandle;
  long __res, __paramLen, __bytePos;

   __bVerdict = __eVerdictPass;

  do {
    TestReportResetDiagObjectList();
    DiagSetReportDetailLevel("CVADAS_0001_00000000_000", EnumServiceDetails_onfail);
    // Request aspect
    {

      if (0 >= DiagSendReqAndWaitForResp("CVADAS_0001_00000000_000", __req, __resp, __res, -1, -1, -1, -1, -1, EnumResult_pos, EnumServiceDetails_onfail, EnumSendingMode_physical, EnumSuppressPosResBit_asconfigured, EnumVerdictOnInvalidValues_fail))
        break;
    }

    __res = DiagErrCodeTestStep(__res, "Can't retrieve last response for request! No check possible.") < 0;
    if(__res)
    {
	  __bVerdict = __eVerdictFail;
      break;
    }
    {
      __res = DiagInterpretAs(__resp, "DSC_PR");
      if(__res != 0)
      {
        __bVerdict = __eVerdictFail;
        DiagErrCodeTestStep(__res, "Can't interpret response as diagnostic primitive 'DSC_PR'.");
        break;
      }
      else
      {
        TestStepPass( "Received primitive can be interpreted as diagnostic primitive 'DSC_PR'.");
      }
    }
  }
  while(0);


  // Response, check & read aspect
  {
    __res = 1;
    __tableHandle = ReportTableHead5Columns(__cCheckCaption, __cTSym, __cTOp, __cRefVal, __cActual, __cRes);
    {
      __bDiagValueArrayCtr = DiagGetParameterErrorHandled(__resp, "DiagSessionType", __bDiagValueArray, elcount(__bDiagValueArray), __cDiagValueArray, elcount(__cDiagValueArray));
      {
        byte __bArray2[1] = { 0x01 };
        __bArrayCtr = __CopyBytes(__bDiagValueArray, __bDiagValueArrayCtr, __bArray);
        __bArrayCtr2 = elCount(__bArray2);
        __csr = CompareBytes(__bArray, __bArrayCtr, __bArray2, __bArrayCtr2) == 0;
        snprintf(__cArray, 8192, "%s", "Diagnostic parameter \'DiagSessionType\'");
        snprintf(__cArray2, 8192, "%s", __cArray);
        snprintf(__cArray3, 8192, "%s", "");
        ReportTableRow(__tableHandle, 0, __cArray2, "Bytes", __bArray2, __bArrayCtr2, __cArray3, __oneOfFlag, __bSetInCheckAlignment);
        ReportCell(__tableHandle, __bArray, __bArrayCtr);
        ReportCellResult(__tableHandle, __csr, __ePassFail);
      }
    
      __res = __res && __csr;
    
    }
    ReportTableEndVerdict(__tableHandle, __cEvaluateResponse, __res);
	__bVerdict = __bVerdict && __res;
  }
  if (__bVerdict == __eVerdictFail)
    TestReportWriteDiagObjectList();
}
  
void __diagService4h42sqi_78(DiagRequest * __req, DiagResponse * __resp )
{
  stack long __tableHandle;
  long __res, __paramLen, __bytePos;

   __bVerdict = __eVerdictPass;

  do {
    TestReportResetDiagObjectList();
    DiagSetReportDetailLevel("CVADAS_0001_00000000_000", EnumServiceDetails_onfail);
    // Request aspect
    {

      if (0 >= DiagSendReqAndWaitForResp("CVADAS_0001_00000000_000", __req, __resp, __res, -1, -1, -1, -1, -1, EnumResult_pos, EnumServiceDetails_onfail, EnumSendingMode_physical, EnumSuppressPosResBit_asconfigured, EnumVerdictOnInvalidValues_fail))
        break;
    }

    __res = DiagErrCodeTestStep(__res, "Can't retrieve last response for request! No check possible.") < 0;
    if(__res)
    {
	  __bVerdict = __eVerdictFail;
      break;
    }
    {
      __res = DiagInterpretAs(__resp, "DSC_PR");
      if(__res != 0)
      {
        __bVerdict = __eVerdictFail;
        DiagErrCodeTestStep(__res, "Can't interpret response as diagnostic primitive 'DSC_PR'.");
        break;
      }
      else
      {
        TestStepPass( "Received primitive can be interpreted as diagnostic primitive 'DSC_PR'.");
      }
    }
  }
  while(0);


  // Response, check & read aspect
  {
    __res = 1;
    __tableHandle = ReportTableHead5Columns(__cCheckCaption, __cTSym, __cTOp, __cRefVal, __cActual, __cRes);
    {
      __bDiagValueArrayCtr = DiagGetParameterErrorHandled(__resp, "DiagSessionType", __bDiagValueArray, elcount(__bDiagValueArray), __cDiagValueArray, elcount(__cDiagValueArray));
      {
        byte __bArray2[1] = { 0x03 };
        __bArrayCtr = __CopyBytes(__bDiagValueArray, __bDiagValueArrayCtr, __bArray);
        __bArrayCtr2 = elCount(__bArray2);
        __csr = CompareBytes(__bArray, __bArrayCtr, __bArray2, __bArrayCtr2) == 0;
        snprintf(__cArray, 8192, "%s", "Diagnostic parameter \'DiagSessionType\'");
        snprintf(__cArray2, 8192, "%s", __cArray);
        snprintf(__cArray3, 8192, "%s", "");
        ReportTableRow(__tableHandle, 0, __cArray2, "Bytes", __bArray2, __bArrayCtr2, __cArray3, __oneOfFlag, __bSetInCheckAlignment);
        ReportCell(__tableHandle, __bArray, __bArrayCtr);
        ReportCellResult(__tableHandle, __csr, __ePassFail);
      }
    
      __res = __res && __csr;
    
    }
    ReportTableEndVerdict(__tableHandle, __cEvaluateResponse, __res);
	__bVerdict = __bVerdict && __res;
  }
  if (__bVerdict == __eVerdictFail)
    TestReportWriteDiagObjectList();
}
void Tt4h42sqi_Tet_Tc153_Completion()
{
  stack long __tableHandle;
  TestCompletionBegin();
  {
    {
      CreateTTEIFFunction("Tt4h42sqi_General_Postconditions", __eFct, __eLocal);
      CallInterfaceFunction(__cEmpty, __cEmpty, "8c04fef4-3bbc-4cc8-b3ee-b62ec5ff47eb");
    }


  }
  TestCompletionEnd();
}

void Tt4h42sqi_Tet_Tc154()
{
  CreateTTEIFFunction("Tt4h42sqi_Tc154", __eTcDef, __eLocal);  
  AddIFParameterTestCaseAttribute("TC_ID", "");
  AddIFParameterTestCaseAttribute("Test Case ID", "");
  CallInterfaceFunction("TC_ID_20205179_Defaults_Session_Physical_and_Standard_Addressing", __cEmpty , __cEmpty );
}
testcase Tt4h42sqi_Tc154()
{
  stack long __tableHandle;
  SetBreakOnFail(0);

  CreateTTEIFFunction("Tt4h42sqi_Tet_Tc154_Completion", __eFct, __eLocal);
  
  AddIFAsCleanUpFunction();

  TestPreparationBegin();
  {
    {
      CreateTTEIFFunction("Tt4h42sqi_General_Precondition", __eFct, __eLocal);
      CallInterfaceFunction(__cEmpty, __cEmpty, "74787266-8376-4866-a392-d0cc32109fae");
    }


  }
  TestPreparationEnd();

  TestCommandBegin(__eDiagService, __cDiagService, "", "2");
  {
    if (DiagIsFunctionalGroup("CVADAS_0001_00000000_000"))
    {
      DiagResponse * __resp;
      DiagRequest CVADAS_0001_00000000_000.Default_Session_Start __req;
      __diagService4h42sqi_79(__req, __resp);
    }
    else
    {
      DiagResponse CVADAS_0001_00000000_000.* __resp;
      DiagRequest CVADAS_0001_00000000_000.Default_Session_Start __req;
      __diagService4h42sqi_79(__req, __resp);
    }
  }
  TestCommandEnd();


  {
    CreateTTEIFFunction("Tt4h42sqi_F186_DID_with_PhysicalAdd_DefaultSession", __eFct, __eLocal);
    CallInterfaceFunction(__cEmpty, __cEmpty, "f479ea65-8c8c-4093-b3d8-2a8374608569");
  }


  {
    CreateTTEIFFunction("Tt4h42sqi_F132_DID_with_Physical_Address", __eFct, __eLocal);
    CallInterfaceFunction(__cEmpty, __cEmpty, "310a1582-8533-4092-a15c-753d00844910");
  }



}

  
void __diagService4h42sqi_79(DiagRequest * __req, DiagResponse * __resp )
{
  stack long __tableHandle;
  long __res, __paramLen, __bytePos;

   __bVerdict = __eVerdictPass;

  do {
    TestReportResetDiagObjectList();
    DiagSetReportDetailLevel("CVADAS_0001_00000000_000", EnumServiceDetails_onfail);
    // Request aspect
    {

      if (0 >= DiagSendReqAndWaitForResp("CVADAS_0001_00000000_000", __req, __resp, __res, -1, -1, -1, -1, -1, EnumResult_pos, EnumServiceDetails_onfail, EnumSendingMode_physical, EnumSuppressPosResBit_asconfigured, EnumVerdictOnInvalidValues_fail))
        break;
    }

    __res = DiagErrCodeTestStep(__res, "Can't retrieve last response for request! No check possible.") < 0;
    if(__res)
    {
	  __bVerdict = __eVerdictFail;
      break;
    }
    {
      __res = DiagInterpretAs(__resp, "DSC_PR");
      if(__res != 0)
      {
        __bVerdict = __eVerdictFail;
        DiagErrCodeTestStep(__res, "Can't interpret response as diagnostic primitive 'DSC_PR'.");
        break;
      }
      else
      {
        TestStepPass( "Received primitive can be interpreted as diagnostic primitive 'DSC_PR'.");
      }
    }
  }
  while(0);


  // Response, check & read aspect
  {
    __res = 1;
    __tableHandle = ReportTableHead5Columns(__cCheckCaption, __cTSym, __cTOp, __cRefVal, __cActual, __cRes);
    {
      __bDiagValueArrayCtr = DiagGetParameterErrorHandled(__resp, "DiagSessionType", __bDiagValueArray, elcount(__bDiagValueArray), __cDiagValueArray, elcount(__cDiagValueArray));
      {
        byte __bArray2[1] = { 0x01 };
        __bArrayCtr = __CopyBytes(__bDiagValueArray, __bDiagValueArrayCtr, __bArray);
        __bArrayCtr2 = elCount(__bArray2);
        __csr = CompareBytes(__bArray, __bArrayCtr, __bArray2, __bArrayCtr2) == 0;
        snprintf(__cArray, 8192, "%s", "Diagnostic parameter \'DiagSessionType\'");
        snprintf(__cArray2, 8192, "%s", __cArray);
        snprintf(__cArray3, 8192, "%s", "");
        ReportTableRow(__tableHandle, 0, __cArray2, "Bytes", __bArray2, __bArrayCtr2, __cArray3, __oneOfFlag, __bSetInCheckAlignment);
        ReportCell(__tableHandle, __bArray, __bArrayCtr);
        ReportCellResult(__tableHandle, __csr, __ePassFail);
      }
    
      __res = __res && __csr;
    
    }
    ReportTableEndVerdict(__tableHandle, __cEvaluateResponse, __res);
	__bVerdict = __bVerdict && __res;
  }
  if (__bVerdict == __eVerdictFail)
    TestReportWriteDiagObjectList();
}
void Tt4h42sqi_Tet_Tc154_Completion()
{
  stack long __tableHandle;
  TestCompletionBegin();
  {
    {
      CreateTTEIFFunction("Tt4h42sqi_General_Postconditions", __eFct, __eLocal);
      CallInterfaceFunction(__cEmpty, __cEmpty, "8c04fef4-3bbc-4cc8-b3ee-b62ec5ff47eb");
    }


  }
  TestCompletionEnd();
}

void Tt4h42sqi_Tet_Tc155()
{
  CreateTTEIFFunction("Tt4h42sqi_Tc155", __eTcDef, __eLocal);  
  AddIFParameterTestCaseAttribute("TC_ID", "");
  AddIFParameterTestCaseAttribute("Test Case ID", "");
  CallInterfaceFunction("TC_ID_20205181_Extended_Session_Physical_and_Standard_Addressing", __cEmpty , __cEmpty );
}
testcase Tt4h42sqi_Tc155()
{
  stack long __tableHandle;
  SetBreakOnFail(0);

  CreateTTEIFFunction("Tt4h42sqi_Tet_Tc155_Completion", __eFct, __eLocal);
  
  AddIFAsCleanUpFunction();

  TestPreparationBegin();
  {
    {
      CreateTTEIFFunction("Tt4h42sqi_General_Precondition", __eFct, __eLocal);
      CallInterfaceFunction(__cEmpty, __cEmpty, "74787266-8376-4866-a392-d0cc32109fae");
    }


  }
  TestPreparationEnd();

  TestCommandBegin(__eDiagService, __cDiagService, "", "2");
  {
    if (DiagIsFunctionalGroup("CVADAS_0001_00000000_000"))
    {
      DiagResponse * __resp;
      DiagRequest CVADAS_0001_00000000_000.Default_Session_Start __req;
      __diagService4h42sqi_80(__req, __resp);
    }
    else
    {
      DiagResponse CVADAS_0001_00000000_000.* __resp;
      DiagRequest CVADAS_0001_00000000_000.Default_Session_Start __req;
      __diagService4h42sqi_80(__req, __resp);
    }
  }
  TestCommandEnd();


  TestCommandBegin(__eDiagService, __cDiagService, "", "3");
  {
    if (DiagIsFunctionalGroup("CVADAS_0001_00000000_000"))
    {
      DiagResponse * __resp;
      DiagRequest CVADAS_0001_00000000_000.Extended_Diagnostic_Session_Start __req;
      __diagService4h42sqi_81(__req, __resp);
    }
    else
    {
      DiagResponse CVADAS_0001_00000000_000.* __resp;
      DiagRequest CVADAS_0001_00000000_000.Extended_Diagnostic_Session_Start __req;
      __diagService4h42sqi_81(__req, __resp);
    }
  }
  TestCommandEnd();


  {
    CreateTTEIFFunction("Tt4h42sqi_F186_DID_with_PhysicalAdd_ExtendedSession", __eFct, __eLocal);
    CallInterfaceFunction(__cEmpty, __cEmpty, "56d9e7a7-9216-4d5f-b776-c5e862f155cb");
  }


  {
    CreateTTEIFFunction("Tt4h42sqi_F132_DID_with_Physical_Address", __eFct, __eLocal);
    CallInterfaceFunction(__cEmpty, __cEmpty, "310a1582-8533-4092-a15c-753d00844910");
  }



}

  
void __diagService4h42sqi_80(DiagRequest * __req, DiagResponse * __resp )
{
  stack long __tableHandle;
  long __res, __paramLen, __bytePos;

   __bVerdict = __eVerdictPass;

  do {
    TestReportResetDiagObjectList();
    DiagSetReportDetailLevel("CVADAS_0001_00000000_000", EnumServiceDetails_onfail);
    // Request aspect
    {

      if (0 >= DiagSendReqAndWaitForResp("CVADAS_0001_00000000_000", __req, __resp, __res, -1, -1, -1, -1, -1, EnumResult_pos, EnumServiceDetails_onfail, EnumSendingMode_physical, EnumSuppressPosResBit_asconfigured, EnumVerdictOnInvalidValues_fail))
        break;
    }

    __res = DiagErrCodeTestStep(__res, "Can't retrieve last response for request! No check possible.") < 0;
    if(__res)
    {
	  __bVerdict = __eVerdictFail;
      break;
    }
    {
      __res = DiagInterpretAs(__resp, "DSC_PR");
      if(__res != 0)
      {
        __bVerdict = __eVerdictFail;
        DiagErrCodeTestStep(__res, "Can't interpret response as diagnostic primitive 'DSC_PR'.");
        break;
      }
      else
      {
        TestStepPass( "Received primitive can be interpreted as diagnostic primitive 'DSC_PR'.");
      }
    }
  }
  while(0);


  // Response, check & read aspect
  {
    __res = 1;
    __tableHandle = ReportTableHead5Columns(__cCheckCaption, __cTSym, __cTOp, __cRefVal, __cActual, __cRes);
    {
      __bDiagValueArrayCtr = DiagGetParameterErrorHandled(__resp, "DiagSessionType", __bDiagValueArray, elcount(__bDiagValueArray), __cDiagValueArray, elcount(__cDiagValueArray));
      {
        byte __bArray2[1] = { 0x01 };
        __bArrayCtr = __CopyBytes(__bDiagValueArray, __bDiagValueArrayCtr, __bArray);
        __bArrayCtr2 = elCount(__bArray2);
        __csr = CompareBytes(__bArray, __bArrayCtr, __bArray2, __bArrayCtr2) == 0;
        snprintf(__cArray, 8192, "%s", "Diagnostic parameter \'DiagSessionType\'");
        snprintf(__cArray2, 8192, "%s", __cArray);
        snprintf(__cArray3, 8192, "%s", "");
        ReportTableRow(__tableHandle, 0, __cArray2, "Bytes", __bArray2, __bArrayCtr2, __cArray3, __oneOfFlag, __bSetInCheckAlignment);
        ReportCell(__tableHandle, __bArray, __bArrayCtr);
        ReportCellResult(__tableHandle, __csr, __ePassFail);
      }
    
      __res = __res && __csr;
    
    }
    ReportTableEndVerdict(__tableHandle, __cEvaluateResponse, __res);
	__bVerdict = __bVerdict && __res;
  }
  if (__bVerdict == __eVerdictFail)
    TestReportWriteDiagObjectList();
}
  
void __diagService4h42sqi_81(DiagRequest * __req, DiagResponse * __resp )
{
  stack long __tableHandle;
  long __res, __paramLen, __bytePos;

   __bVerdict = __eVerdictPass;

  do {
    TestReportResetDiagObjectList();
    DiagSetReportDetailLevel("CVADAS_0001_00000000_000", EnumServiceDetails_onfail);
    // Request aspect
    {

      if (0 >= DiagSendReqAndWaitForResp("CVADAS_0001_00000000_000", __req, __resp, __res, -1, -1, -1, -1, -1, EnumResult_pos, EnumServiceDetails_onfail, EnumSendingMode_physical, EnumSuppressPosResBit_asconfigured, EnumVerdictOnInvalidValues_fail))
        break;
    }

    __res = DiagErrCodeTestStep(__res, "Can't retrieve last response for request! No check possible.") < 0;
    if(__res)
    {
	  __bVerdict = __eVerdictFail;
      break;
    }
    {
      __res = DiagInterpretAs(__resp, "DSC_PR");
      if(__res != 0)
      {
        __bVerdict = __eVerdictFail;
        DiagErrCodeTestStep(__res, "Can't interpret response as diagnostic primitive 'DSC_PR'.");
        break;
      }
      else
      {
        TestStepPass( "Received primitive can be interpreted as diagnostic primitive 'DSC_PR'.");
      }
    }
  }
  while(0);


  // Response, check & read aspect
  {
    __res = 1;
    __tableHandle = ReportTableHead5Columns(__cCheckCaption, __cTSym, __cTOp, __cRefVal, __cActual, __cRes);
    {
      __bDiagValueArrayCtr = DiagGetParameterErrorHandled(__resp, "DiagSessionType", __bDiagValueArray, elcount(__bDiagValueArray), __cDiagValueArray, elcount(__cDiagValueArray));
      {
        byte __bArray2[1] = { 0x03 };
        __bArrayCtr = __CopyBytes(__bDiagValueArray, __bDiagValueArrayCtr, __bArray);
        __bArrayCtr2 = elCount(__bArray2);
        __csr = CompareBytes(__bArray, __bArrayCtr, __bArray2, __bArrayCtr2) == 0;
        snprintf(__cArray, 8192, "%s", "Diagnostic parameter \'DiagSessionType\'");
        snprintf(__cArray2, 8192, "%s", __cArray);
        snprintf(__cArray3, 8192, "%s", "");
        ReportTableRow(__tableHandle, 0, __cArray2, "Bytes", __bArray2, __bArrayCtr2, __cArray3, __oneOfFlag, __bSetInCheckAlignment);
        ReportCell(__tableHandle, __bArray, __bArrayCtr);
        ReportCellResult(__tableHandle, __csr, __ePassFail);
      }
    
      __res = __res && __csr;
    
    }
    ReportTableEndVerdict(__tableHandle, __cEvaluateResponse, __res);
	__bVerdict = __bVerdict && __res;
  }
  if (__bVerdict == __eVerdictFail)
    TestReportWriteDiagObjectList();
}
void Tt4h42sqi_Tet_Tc155_Completion()
{
  stack long __tableHandle;
  TestCompletionBegin();
  {
    {
      CreateTTEIFFunction("Tt4h42sqi_General_Postconditions", __eFct, __eLocal);
      CallInterfaceFunction(__cEmpty, __cEmpty, "8c04fef4-3bbc-4cc8-b3ee-b62ec5ff47eb");
    }


  }
  TestCompletionEnd();
}

void Tt4h42sqi_Tet_Tc156()
{
  CreateTTEIFFunction("Tt4h42sqi_Tc156", __eTcDef, __eLocal);  
  AddIFParameterTestCaseAttribute("TC_ID", "");
  AddIFParameterTestCaseAttribute("Test Case ID", "");
  CallInterfaceFunction("TC_ID_20205379_Defaults_Session_Physical_and_Standard_Addressing", __cEmpty , __cEmpty );
}
testcase Tt4h42sqi_Tc156()
{
  stack long __tableHandle;
  SetBreakOnFail(0);

  CreateTTEIFFunction("Tt4h42sqi_Tet_Tc156_Completion", __eFct, __eLocal);
  
  AddIFAsCleanUpFunction();

  TestPreparationBegin();
  {
    {
      CreateTTEIFFunction("Tt4h42sqi_General_Precondition", __eFct, __eLocal);
      CallInterfaceFunction(__cEmpty, __cEmpty, "74787266-8376-4866-a392-d0cc32109fae");
    }


  }
  TestPreparationEnd();

  TestCommandBegin(__eDiagService, __cDiagService, "", "2");
  {
    if (DiagIsFunctionalGroup("CVADAS_0001_00000000_000"))
    {
      DiagResponse * __resp;
      DiagRequest CVADAS_0001_00000000_000.Default_Session_Start __req;
      __diagService4h42sqi_82(__req, __resp);
    }
    else
    {
      DiagResponse CVADAS_0001_00000000_000.* __resp;
      DiagRequest CVADAS_0001_00000000_000.Default_Session_Start __req;
      __diagService4h42sqi_82(__req, __resp);
    }
  }
  TestCommandEnd();


  {
    CreateTTEIFFunction("Tt4h42sqi_F186_DID_with_PhysicalAdd_DefaultSession", __eFct, __eLocal);
    CallInterfaceFunction(__cEmpty, __cEmpty, "f479ea65-8c8c-4093-b3d8-2a8374608569");
  }


  {
    CreateTTEIFFunction("Tt4h42sqi_F187_DID_with_Physical_Address", __eFct, __eLocal);
    CallInterfaceFunction(__cEmpty, __cEmpty, "b05e2003-623e-462b-8517-99c2913c107e");
  }



}

  
void __diagService4h42sqi_82(DiagRequest * __req, DiagResponse * __resp )
{
  stack long __tableHandle;
  long __res, __paramLen, __bytePos;

   __bVerdict = __eVerdictPass;

  do {
    TestReportResetDiagObjectList();
    DiagSetReportDetailLevel("CVADAS_0001_00000000_000", EnumServiceDetails_onfail);
    // Request aspect
    {

      if (0 >= DiagSendReqAndWaitForResp("CVADAS_0001_00000000_000", __req, __resp, __res, -1, -1, -1, -1, -1, EnumResult_pos, EnumServiceDetails_onfail, EnumSendingMode_physical, EnumSuppressPosResBit_asconfigured, EnumVerdictOnInvalidValues_fail))
        break;
    }

    __res = DiagErrCodeTestStep(__res, "Can't retrieve last response for request! No check possible.") < 0;
    if(__res)
    {
	  __bVerdict = __eVerdictFail;
      break;
    }
    {
      __res = DiagInterpretAs(__resp, "DSC_PR");
      if(__res != 0)
      {
        __bVerdict = __eVerdictFail;
        DiagErrCodeTestStep(__res, "Can't interpret response as diagnostic primitive 'DSC_PR'.");
        break;
      }
      else
      {
        TestStepPass( "Received primitive can be interpreted as diagnostic primitive 'DSC_PR'.");
      }
    }
  }
  while(0);


  // Response, check & read aspect
  {
    __res = 1;
    __tableHandle = ReportTableHead5Columns(__cCheckCaption, __cTSym, __cTOp, __cRefVal, __cActual, __cRes);
    {
      __bDiagValueArrayCtr = DiagGetParameterErrorHandled(__resp, "DiagSessionType", __bDiagValueArray, elcount(__bDiagValueArray), __cDiagValueArray, elcount(__cDiagValueArray));
      {
        byte __bArray2[1] = { 0x01 };
        __bArrayCtr = __CopyBytes(__bDiagValueArray, __bDiagValueArrayCtr, __bArray);
        __bArrayCtr2 = elCount(__bArray2);
        __csr = CompareBytes(__bArray, __bArrayCtr, __bArray2, __bArrayCtr2) == 0;
        snprintf(__cArray, 8192, "%s", "Diagnostic parameter \'DiagSessionType\'");
        snprintf(__cArray2, 8192, "%s", __cArray);
        snprintf(__cArray3, 8192, "%s", "");
        ReportTableRow(__tableHandle, 0, __cArray2, "Bytes", __bArray2, __bArrayCtr2, __cArray3, __oneOfFlag, __bSetInCheckAlignment);
        ReportCell(__tableHandle, __bArray, __bArrayCtr);
        ReportCellResult(__tableHandle, __csr, __ePassFail);
      }
    
      __res = __res && __csr;
    
    }
    ReportTableEndVerdict(__tableHandle, __cEvaluateResponse, __res);
	__bVerdict = __bVerdict && __res;
  }
  if (__bVerdict == __eVerdictFail)
    TestReportWriteDiagObjectList();
}
void Tt4h42sqi_Tet_Tc156_Completion()
{
  stack long __tableHandle;
  TestCompletionBegin();
  {
    {
      CreateTTEIFFunction("Tt4h42sqi_General_Postconditions", __eFct, __eLocal);
      CallInterfaceFunction(__cEmpty, __cEmpty, "8c04fef4-3bbc-4cc8-b3ee-b62ec5ff47eb");
    }


  }
  TestCompletionEnd();
}

void Tt4h42sqi_Tet_Tc157()
{
  CreateTTEIFFunction("Tt4h42sqi_Tc157", __eTcDef, __eLocal);  
  AddIFParameterTestCaseAttribute("TC_ID", "");
  AddIFParameterTestCaseAttribute("Test Case ID", "");
  CallInterfaceFunction("TC_ID_20205357_Extended_Session_Physical_and_Standard_Addressing", __cEmpty , __cEmpty );
}
testcase Tt4h42sqi_Tc157()
{
  stack long __tableHandle;
  SetBreakOnFail(0);

  CreateTTEIFFunction("Tt4h42sqi_Tet_Tc157_Completion", __eFct, __eLocal);
  
  AddIFAsCleanUpFunction();

  TestPreparationBegin();
  {
    {
      CreateTTEIFFunction("Tt4h42sqi_General_Precondition", __eFct, __eLocal);
      CallInterfaceFunction(__cEmpty, __cEmpty, "74787266-8376-4866-a392-d0cc32109fae");
    }


  }
  TestPreparationEnd();

  TestCommandBegin(__eDiagService, __cDiagService, "", "2");
  {
    if (DiagIsFunctionalGroup("CVADAS_0001_00000000_000"))
    {
      DiagResponse * __resp;
      DiagRequest CVADAS_0001_00000000_000.Default_Session_Start __req;
      __diagService4h42sqi_83(__req, __resp);
    }
    else
    {
      DiagResponse CVADAS_0001_00000000_000.* __resp;
      DiagRequest CVADAS_0001_00000000_000.Default_Session_Start __req;
      __diagService4h42sqi_83(__req, __resp);
    }
  }
  TestCommandEnd();


  TestCommandBegin(__eDiagService, __cDiagService, "", "3");
  {
    if (DiagIsFunctionalGroup("CVADAS_0001_00000000_000"))
    {
      DiagResponse * __resp;
      DiagRequest CVADAS_0001_00000000_000.Extended_Diagnostic_Session_Start __req;
      __diagService4h42sqi_84(__req, __resp);
    }
    else
    {
      DiagResponse CVADAS_0001_00000000_000.* __resp;
      DiagRequest CVADAS_0001_00000000_000.Extended_Diagnostic_Session_Start __req;
      __diagService4h42sqi_84(__req, __resp);
    }
  }
  TestCommandEnd();


  {
    CreateTTEIFFunction("Tt4h42sqi_F186_DID_with_PhysicalAdd_ExtendedSession", __eFct, __eLocal);
    CallInterfaceFunction(__cEmpty, __cEmpty, "56d9e7a7-9216-4d5f-b776-c5e862f155cb");
  }


  {
    CreateTTEIFFunction("Tt4h42sqi_F187_DID_with_Physical_Address", __eFct, __eLocal);
    CallInterfaceFunction(__cEmpty, __cEmpty, "b05e2003-623e-462b-8517-99c2913c107e");
  }



}

  
void __diagService4h42sqi_83(DiagRequest * __req, DiagResponse * __resp )
{
  stack long __tableHandle;
  long __res, __paramLen, __bytePos;

   __bVerdict = __eVerdictPass;

  do {
    TestReportResetDiagObjectList();
    DiagSetReportDetailLevel("CVADAS_0001_00000000_000", EnumServiceDetails_onfail);
    // Request aspect
    {

      if (0 >= DiagSendReqAndWaitForResp("CVADAS_0001_00000000_000", __req, __resp, __res, -1, -1, -1, -1, -1, EnumResult_pos, EnumServiceDetails_onfail, EnumSendingMode_physical, EnumSuppressPosResBit_asconfigured, EnumVerdictOnInvalidValues_fail))
        break;
    }

    __res = DiagErrCodeTestStep(__res, "Can't retrieve last response for request! No check possible.") < 0;
    if(__res)
    {
	  __bVerdict = __eVerdictFail;
      break;
    }
    {
      __res = DiagInterpretAs(__resp, "DSC_PR");
      if(__res != 0)
      {
        __bVerdict = __eVerdictFail;
        DiagErrCodeTestStep(__res, "Can't interpret response as diagnostic primitive 'DSC_PR'.");
        break;
      }
      else
      {
        TestStepPass( "Received primitive can be interpreted as diagnostic primitive 'DSC_PR'.");
      }
    }
  }
  while(0);


  // Response, check & read aspect
  {
    __res = 1;
    __tableHandle = ReportTableHead5Columns(__cCheckCaption, __cTSym, __cTOp, __cRefVal, __cActual, __cRes);
    {
      __bDiagValueArrayCtr = DiagGetParameterErrorHandled(__resp, "DiagSessionType", __bDiagValueArray, elcount(__bDiagValueArray), __cDiagValueArray, elcount(__cDiagValueArray));
      {
        byte __bArray2[1] = { 0x01 };
        __bArrayCtr = __CopyBytes(__bDiagValueArray, __bDiagValueArrayCtr, __bArray);
        __bArrayCtr2 = elCount(__bArray2);
        __csr = CompareBytes(__bArray, __bArrayCtr, __bArray2, __bArrayCtr2) == 0;
        snprintf(__cArray, 8192, "%s", "Diagnostic parameter \'DiagSessionType\'");
        snprintf(__cArray2, 8192, "%s", __cArray);
        snprintf(__cArray3, 8192, "%s", "");
        ReportTableRow(__tableHandle, 0, __cArray2, "Bytes", __bArray2, __bArrayCtr2, __cArray3, __oneOfFlag, __bSetInCheckAlignment);
        ReportCell(__tableHandle, __bArray, __bArrayCtr);
        ReportCellResult(__tableHandle, __csr, __ePassFail);
      }
    
      __res = __res && __csr;
    
    }
    ReportTableEndVerdict(__tableHandle, __cEvaluateResponse, __res);
	__bVerdict = __bVerdict && __res;
  }
  if (__bVerdict == __eVerdictFail)
    TestReportWriteDiagObjectList();
}
  
void __diagService4h42sqi_84(DiagRequest * __req, DiagResponse * __resp )
{
  stack long __tableHandle;
  long __res, __paramLen, __bytePos;

   __bVerdict = __eVerdictPass;

  do {
    TestReportResetDiagObjectList();
    DiagSetReportDetailLevel("CVADAS_0001_00000000_000", EnumServiceDetails_onfail);
    // Request aspect
    {

      if (0 >= DiagSendReqAndWaitForResp("CVADAS_0001_00000000_000", __req, __resp, __res, -1, -1, -1, -1, -1, EnumResult_pos, EnumServiceDetails_onfail, EnumSendingMode_physical, EnumSuppressPosResBit_asconfigured, EnumVerdictOnInvalidValues_fail))
        break;
    }

    __res = DiagErrCodeTestStep(__res, "Can't retrieve last response for request! No check possible.") < 0;
    if(__res)
    {
	  __bVerdict = __eVerdictFail;
      break;
    }
    {
      __res = DiagInterpretAs(__resp, "DSC_PR");
      if(__res != 0)
      {
        __bVerdict = __eVerdictFail;
        DiagErrCodeTestStep(__res, "Can't interpret response as diagnostic primitive 'DSC_PR'.");
        break;
      }
      else
      {
        TestStepPass( "Received primitive can be interpreted as diagnostic primitive 'DSC_PR'.");
      }
    }
  }
  while(0);


  // Response, check & read aspect
  {
    __res = 1;
    __tableHandle = ReportTableHead5Columns(__cCheckCaption, __cTSym, __cTOp, __cRefVal, __cActual, __cRes);
    {
      __bDiagValueArrayCtr = DiagGetParameterErrorHandled(__resp, "DiagSessionType", __bDiagValueArray, elcount(__bDiagValueArray), __cDiagValueArray, elcount(__cDiagValueArray));
      {
        byte __bArray2[1] = { 0x03 };
        __bArrayCtr = __CopyBytes(__bDiagValueArray, __bDiagValueArrayCtr, __bArray);
        __bArrayCtr2 = elCount(__bArray2);
        __csr = CompareBytes(__bArray, __bArrayCtr, __bArray2, __bArrayCtr2) == 0;
        snprintf(__cArray, 8192, "%s", "Diagnostic parameter \'DiagSessionType\'");
        snprintf(__cArray2, 8192, "%s", __cArray);
        snprintf(__cArray3, 8192, "%s", "");
        ReportTableRow(__tableHandle, 0, __cArray2, "Bytes", __bArray2, __bArrayCtr2, __cArray3, __oneOfFlag, __bSetInCheckAlignment);
        ReportCell(__tableHandle, __bArray, __bArrayCtr);
        ReportCellResult(__tableHandle, __csr, __ePassFail);
      }
    
      __res = __res && __csr;
    
    }
    ReportTableEndVerdict(__tableHandle, __cEvaluateResponse, __res);
	__bVerdict = __bVerdict && __res;
  }
  if (__bVerdict == __eVerdictFail)
    TestReportWriteDiagObjectList();
}
void Tt4h42sqi_Tet_Tc157_Completion()
{
  stack long __tableHandle;
  TestCompletionBegin();
  {
    {
      CreateTTEIFFunction("Tt4h42sqi_General_Postconditions", __eFct, __eLocal);
      CallInterfaceFunction(__cEmpty, __cEmpty, "8c04fef4-3bbc-4cc8-b3ee-b62ec5ff47eb");
    }


  }
  TestCompletionEnd();
}

void Tt4h42sqi_Tet_Tc158()
{
  CreateTTEIFFunction("Tt4h42sqi_Tc158", __eTcDef, __eLocal);  
  AddIFParameterTestCaseAttribute("TC_ID", "");
  AddIFParameterTestCaseAttribute("Test Case ID", "");
  CallInterfaceFunction("TC_ID_20205159_Defaults_Session_Physical_and_Standard_Addressing", __cEmpty , __cEmpty );
}
testcase Tt4h42sqi_Tc158()
{
  stack long __tableHandle;
  SetBreakOnFail(0);

  CreateTTEIFFunction("Tt4h42sqi_Tet_Tc158_Completion", __eFct, __eLocal);
  
  AddIFAsCleanUpFunction();

  TestPreparationBegin();
  {
    {
      CreateTTEIFFunction("Tt4h42sqi_General_Precondition", __eFct, __eLocal);
      CallInterfaceFunction(__cEmpty, __cEmpty, "74787266-8376-4866-a392-d0cc32109fae");
    }


  }
  TestPreparationEnd();

  TestCommandBegin(__eDiagService, __cDiagService, "", "2");
  {
    if (DiagIsFunctionalGroup("CVADAS_0001_00000000_000"))
    {
      DiagResponse * __resp;
      DiagRequest CVADAS_0001_00000000_000.Default_Session_Start __req;
      __diagService4h42sqi_85(__req, __resp);
    }
    else
    {
      DiagResponse CVADAS_0001_00000000_000.* __resp;
      DiagRequest CVADAS_0001_00000000_000.Default_Session_Start __req;
      __diagService4h42sqi_85(__req, __resp);
    }
  }
  TestCommandEnd();


  {
    CreateTTEIFFunction("Tt4h42sqi_F186_DID_with_PhysicalAdd_DefaultSession", __eFct, __eLocal);
    CallInterfaceFunction(__cEmpty, __cEmpty, "f479ea65-8c8c-4093-b3d8-2a8374608569");
  }


  {
    CreateTTEIFFunction("Tt4h42sqi_F1A2_DID_with_Physical_Address", __eFct, __eLocal);
    CallInterfaceFunction(__cEmpty, __cEmpty, "01da1a29-1426-4f11-8025-d5ce4ebac225");
  }



}

  
void __diagService4h42sqi_85(DiagRequest * __req, DiagResponse * __resp )
{
  stack long __tableHandle;
  long __res, __paramLen, __bytePos;

   __bVerdict = __eVerdictPass;

  do {
    TestReportResetDiagObjectList();
    DiagSetReportDetailLevel("CVADAS_0001_00000000_000", EnumServiceDetails_onfail);
    // Request aspect
    {

      if (0 >= DiagSendReqAndWaitForResp("CVADAS_0001_00000000_000", __req, __resp, __res, -1, -1, -1, -1, -1, EnumResult_pos, EnumServiceDetails_onfail, EnumSendingMode_physical, EnumSuppressPosResBit_asconfigured, EnumVerdictOnInvalidValues_fail))
        break;
    }

    __res = DiagErrCodeTestStep(__res, "Can't retrieve last response for request! No check possible.") < 0;
    if(__res)
    {
	  __bVerdict = __eVerdictFail;
      break;
    }
    {
      __res = DiagInterpretAs(__resp, "DSC_PR");
      if(__res != 0)
      {
        __bVerdict = __eVerdictFail;
        DiagErrCodeTestStep(__res, "Can't interpret response as diagnostic primitive 'DSC_PR'.");
        break;
      }
      else
      {
        TestStepPass( "Received primitive can be interpreted as diagnostic primitive 'DSC_PR'.");
      }
    }
  }
  while(0);


  // Response, check & read aspect
  {
    __res = 1;
    __tableHandle = ReportTableHead5Columns(__cCheckCaption, __cTSym, __cTOp, __cRefVal, __cActual, __cRes);
    {
      __bDiagValueArrayCtr = DiagGetParameterErrorHandled(__resp, "DiagSessionType", __bDiagValueArray, elcount(__bDiagValueArray), __cDiagValueArray, elcount(__cDiagValueArray));
      {
        byte __bArray2[1] = { 0x01 };
        __bArrayCtr = __CopyBytes(__bDiagValueArray, __bDiagValueArrayCtr, __bArray);
        __bArrayCtr2 = elCount(__bArray2);
        __csr = CompareBytes(__bArray, __bArrayCtr, __bArray2, __bArrayCtr2) == 0;
        snprintf(__cArray, 8192, "%s", "Diagnostic parameter \'DiagSessionType\'");
        snprintf(__cArray2, 8192, "%s", __cArray);
        snprintf(__cArray3, 8192, "%s", "");
        ReportTableRow(__tableHandle, 0, __cArray2, "Bytes", __bArray2, __bArrayCtr2, __cArray3, __oneOfFlag, __bSetInCheckAlignment);
        ReportCell(__tableHandle, __bArray, __bArrayCtr);
        ReportCellResult(__tableHandle, __csr, __ePassFail);
      }
    
      __res = __res && __csr;
    
    }
    ReportTableEndVerdict(__tableHandle, __cEvaluateResponse, __res);
	__bVerdict = __bVerdict && __res;
  }
  if (__bVerdict == __eVerdictFail)
    TestReportWriteDiagObjectList();
}
void Tt4h42sqi_Tet_Tc158_Completion()
{
  stack long __tableHandle;
  TestCompletionBegin();
  {
    {
      CreateTTEIFFunction("Tt4h42sqi_General_Postconditions", __eFct, __eLocal);
      CallInterfaceFunction(__cEmpty, __cEmpty, "8c04fef4-3bbc-4cc8-b3ee-b62ec5ff47eb");
    }


  }
  TestCompletionEnd();
}

void Tt4h42sqi_Tet_Tc159()
{
  CreateTTEIFFunction("Tt4h42sqi_Tc159", __eTcDef, __eLocal);  
  AddIFParameterTestCaseAttribute("TC_ID", "");
  AddIFParameterTestCaseAttribute("Test Case ID", "");
  CallInterfaceFunction("TC_ID_20205175_Extended_Session_Physical_and_Standard_Addressing", __cEmpty , __cEmpty );
}
testcase Tt4h42sqi_Tc159()
{
  stack long __tableHandle;
  SetBreakOnFail(0);

  CreateTTEIFFunction("Tt4h42sqi_Tet_Tc159_Completion", __eFct, __eLocal);
  
  AddIFAsCleanUpFunction();

  TestPreparationBegin();
  {
    {
      CreateTTEIFFunction("Tt4h42sqi_General_Precondition", __eFct, __eLocal);
      CallInterfaceFunction(__cEmpty, __cEmpty, "74787266-8376-4866-a392-d0cc32109fae");
    }


  }
  TestPreparationEnd();

  TestCommandBegin(__eDiagService, __cDiagService, "", "2");
  {
    if (DiagIsFunctionalGroup("CVADAS_0001_00000000_000"))
    {
      DiagResponse * __resp;
      DiagRequest CVADAS_0001_00000000_000.Default_Session_Start __req;
      __diagService4h42sqi_86(__req, __resp);
    }
    else
    {
      DiagResponse CVADAS_0001_00000000_000.* __resp;
      DiagRequest CVADAS_0001_00000000_000.Default_Session_Start __req;
      __diagService4h42sqi_86(__req, __resp);
    }
  }
  TestCommandEnd();


  TestCommandBegin(__eDiagService, __cDiagService, "", "3");
  {
    if (DiagIsFunctionalGroup("CVADAS_0001_00000000_000"))
    {
      DiagResponse * __resp;
      DiagRequest CVADAS_0001_00000000_000.Extended_Diagnostic_Session_Start __req;
      __diagService4h42sqi_87(__req, __resp);
    }
    else
    {
      DiagResponse CVADAS_0001_00000000_000.* __resp;
      DiagRequest CVADAS_0001_00000000_000.Extended_Diagnostic_Session_Start __req;
      __diagService4h42sqi_87(__req, __resp);
    }
  }
  TestCommandEnd();


  {
    CreateTTEIFFunction("Tt4h42sqi_F186_DID_with_PhysicalAdd_ExtendedSession", __eFct, __eLocal);
    CallInterfaceFunction(__cEmpty, __cEmpty, "56d9e7a7-9216-4d5f-b776-c5e862f155cb");
  }


  {
    CreateTTEIFFunction("Tt4h42sqi_F1A2_DID_with_Physical_Address", __eFct, __eLocal);
    CallInterfaceFunction(__cEmpty, __cEmpty, "01da1a29-1426-4f11-8025-d5ce4ebac225");
  }



}

  
void __diagService4h42sqi_86(DiagRequest * __req, DiagResponse * __resp )
{
  stack long __tableHandle;
  long __res, __paramLen, __bytePos;

   __bVerdict = __eVerdictPass;

  do {
    TestReportResetDiagObjectList();
    DiagSetReportDetailLevel("CVADAS_0001_00000000_000", EnumServiceDetails_onfail);
    // Request aspect
    {

      if (0 >= DiagSendReqAndWaitForResp("CVADAS_0001_00000000_000", __req, __resp, __res, -1, -1, -1, -1, -1, EnumResult_pos, EnumServiceDetails_onfail, EnumSendingMode_physical, EnumSuppressPosResBit_asconfigured, EnumVerdictOnInvalidValues_fail))
        break;
    }

    __res = DiagErrCodeTestStep(__res, "Can't retrieve last response for request! No check possible.") < 0;
    if(__res)
    {
	  __bVerdict = __eVerdictFail;
      break;
    }
    {
      __res = DiagInterpretAs(__resp, "DSC_PR");
      if(__res != 0)
      {
        __bVerdict = __eVerdictFail;
        DiagErrCodeTestStep(__res, "Can't interpret response as diagnostic primitive 'DSC_PR'.");
        break;
      }
      else
      {
        TestStepPass( "Received primitive can be interpreted as diagnostic primitive 'DSC_PR'.");
      }
    }
  }
  while(0);


  // Response, check & read aspect
  {
    __res = 1;
    __tableHandle = ReportTableHead5Columns(__cCheckCaption, __cTSym, __cTOp, __cRefVal, __cActual, __cRes);
    {
      __bDiagValueArrayCtr = DiagGetParameterErrorHandled(__resp, "DiagSessionType", __bDiagValueArray, elcount(__bDiagValueArray), __cDiagValueArray, elcount(__cDiagValueArray));
      {
        byte __bArray2[1] = { 0x01 };
        __bArrayCtr = __CopyBytes(__bDiagValueArray, __bDiagValueArrayCtr, __bArray);
        __bArrayCtr2 = elCount(__bArray2);
        __csr = CompareBytes(__bArray, __bArrayCtr, __bArray2, __bArrayCtr2) == 0;
        snprintf(__cArray, 8192, "%s", "Diagnostic parameter \'DiagSessionType\'");
        snprintf(__cArray2, 8192, "%s", __cArray);
        snprintf(__cArray3, 8192, "%s", "");
        ReportTableRow(__tableHandle, 0, __cArray2, "Bytes", __bArray2, __bArrayCtr2, __cArray3, __oneOfFlag, __bSetInCheckAlignment);
        ReportCell(__tableHandle, __bArray, __bArrayCtr);
        ReportCellResult(__tableHandle, __csr, __ePassFail);
      }
    
      __res = __res && __csr;
    
    }
    ReportTableEndVerdict(__tableHandle, __cEvaluateResponse, __res);
	__bVerdict = __bVerdict && __res;
  }
  if (__bVerdict == __eVerdictFail)
    TestReportWriteDiagObjectList();
}
  
void __diagService4h42sqi_87(DiagRequest * __req, DiagResponse * __resp )
{
  stack long __tableHandle;
  long __res, __paramLen, __bytePos;

   __bVerdict = __eVerdictPass;

  do {
    TestReportResetDiagObjectList();
    DiagSetReportDetailLevel("CVADAS_0001_00000000_000", EnumServiceDetails_onfail);
    // Request aspect
    {

      if (0 >= DiagSendReqAndWaitForResp("CVADAS_0001_00000000_000", __req, __resp, __res, -1, -1, -1, -1, -1, EnumResult_pos, EnumServiceDetails_onfail, EnumSendingMode_physical, EnumSuppressPosResBit_asconfigured, EnumVerdictOnInvalidValues_fail))
        break;
    }

    __res = DiagErrCodeTestStep(__res, "Can't retrieve last response for request! No check possible.") < 0;
    if(__res)
    {
	  __bVerdict = __eVerdictFail;
      break;
    }
    {
      __res = DiagInterpretAs(__resp, "DSC_PR");
      if(__res != 0)
      {
        __bVerdict = __eVerdictFail;
        DiagErrCodeTestStep(__res, "Can't interpret response as diagnostic primitive 'DSC_PR'.");
        break;
      }
      else
      {
        TestStepPass( "Received primitive can be interpreted as diagnostic primitive 'DSC_PR'.");
      }
    }
  }
  while(0);


  // Response, check & read aspect
  {
    __res = 1;
    __tableHandle = ReportTableHead5Columns(__cCheckCaption, __cTSym, __cTOp, __cRefVal, __cActual, __cRes);
    {
      __bDiagValueArrayCtr = DiagGetParameterErrorHandled(__resp, "DiagSessionType", __bDiagValueArray, elcount(__bDiagValueArray), __cDiagValueArray, elcount(__cDiagValueArray));
      {
        byte __bArray2[1] = { 0x03 };
        __bArrayCtr = __CopyBytes(__bDiagValueArray, __bDiagValueArrayCtr, __bArray);
        __bArrayCtr2 = elCount(__bArray2);
        __csr = CompareBytes(__bArray, __bArrayCtr, __bArray2, __bArrayCtr2) == 0;
        snprintf(__cArray, 8192, "%s", "Diagnostic parameter \'DiagSessionType\'");
        snprintf(__cArray2, 8192, "%s", __cArray);
        snprintf(__cArray3, 8192, "%s", "");
        ReportTableRow(__tableHandle, 0, __cArray2, "Bytes", __bArray2, __bArrayCtr2, __cArray3, __oneOfFlag, __bSetInCheckAlignment);
        ReportCell(__tableHandle, __bArray, __bArrayCtr);
        ReportCellResult(__tableHandle, __csr, __ePassFail);
      }
    
      __res = __res && __csr;
    
    }
    ReportTableEndVerdict(__tableHandle, __cEvaluateResponse, __res);
	__bVerdict = __bVerdict && __res;
  }
  if (__bVerdict == __eVerdictFail)
    TestReportWriteDiagObjectList();
}
void Tt4h42sqi_Tet_Tc159_Completion()
{
  stack long __tableHandle;
  TestCompletionBegin();
  {
    {
      CreateTTEIFFunction("Tt4h42sqi_General_Postconditions", __eFct, __eLocal);
      CallInterfaceFunction(__cEmpty, __cEmpty, "8c04fef4-3bbc-4cc8-b3ee-b62ec5ff47eb");
    }


  }
  TestCompletionEnd();
}

void Tt4h42sqi_Tet_Tc160()
{
  CreateTTEIFFunction("Tt4h42sqi_Tc160", __eTcDef, __eLocal);  
  AddIFParameterTestCaseAttribute("TC_ID", "");
  AddIFParameterTestCaseAttribute("Test Case ID", "");
  CallInterfaceFunction("TC_ID_20205358_Defaults_Session_Physical_and_Standard_Physical_Address", __cEmpty , __cEmpty );
}
testcase Tt4h42sqi_Tc160()
{
  stack long __tableHandle;
  SetBreakOnFail(0);

  CreateTTEIFFunction("Tt4h42sqi_Tet_Tc160_Completion", __eFct, __eLocal);
  
  AddIFAsCleanUpFunction();

  TestPreparationBegin();
  {
    {
      CreateTTEIFFunction("Tt4h42sqi_General_Precondition", __eFct, __eLocal);
      CallInterfaceFunction(__cEmpty, __cEmpty, "74787266-8376-4866-a392-d0cc32109fae");
    }


  }
  TestPreparationEnd();

  TestCommandBegin(__eWait, __cWait, "", "2");
  {
    Wait("1", (40 * 1000000000LL), 1000000000, "");
  }
  TestCommandEnd();

  TestCommandBegin(__eDiagService, __cDiagService, "", "3");
  {
    if (DiagIsFunctionalGroup("CVADAS_0001_00000000_000"))
    {
      DiagResponse * __resp;
      DiagRequest CVADAS_0001_00000000_000.Default_Session_Start __req;
      __diagService4h42sqi_88(__req, __resp);
    }
    else
    {
      DiagResponse CVADAS_0001_00000000_000.* __resp;
      DiagRequest CVADAS_0001_00000000_000.Default_Session_Start __req;
      __diagService4h42sqi_88(__req, __resp);
    }
  }
  TestCommandEnd();


  TestCommandBegin(__eWait, __cWait, "", "4");
  {
    Wait("1", (1000 * 1000000LL), 1000000, "");
  }
  TestCommandEnd();

  {
    CreateTTEIFFunction("Tt4h42sqi_F186_DID_with_PhysicalAdd_DefaultSession", __eFct, __eLocal);
    CallInterfaceFunction(__cEmpty, __cEmpty, "f479ea65-8c8c-4093-b3d8-2a8374608569");
  }


  TestCommandBegin(__eWait, __cWait, "", "6");
  {
    Wait("1", (1000 * 1000000LL), 1000000, "");
  }
  TestCommandEnd();

  {
    CreateTTEIFFunction("Tt4h42sqi_FD13_DID_with_Physical_Address", __eFct, __eLocal);
    CallInterfaceFunction(__cEmpty, __cEmpty, "0c4a35d6-9152-451d-8fd4-e08c380f85f6");
  }


  TestCommandBegin(__eWait, __cWait, "", "8");
  {
    Wait("1", (5 * 1000000000LL), 1000000000, "");
  }
  TestCommandEnd();


}

  
void __diagService4h42sqi_88(DiagRequest * __req, DiagResponse * __resp )
{
  stack long __tableHandle;
  long __res, __paramLen, __bytePos;

   __bVerdict = __eVerdictPass;

  do {
    TestReportResetDiagObjectList();
    DiagSetReportDetailLevel("CVADAS_0001_00000000_000", EnumServiceDetails_onfail);
    // Request aspect
    {

      if (0 >= DiagSendReqAndWaitForResp("CVADAS_0001_00000000_000", __req, __resp, __res, -1, -1, -1, -1, -1, EnumResult_pos, EnumServiceDetails_onfail, EnumSendingMode_physical, EnumSuppressPosResBit_asconfigured, EnumVerdictOnInvalidValues_fail))
        break;
    }

    __res = DiagErrCodeTestStep(__res, "Can't retrieve last response for request! No check possible.") < 0;
    if(__res)
    {
	  __bVerdict = __eVerdictFail;
      break;
    }
    {
      __res = DiagInterpretAs(__resp, "DSC_PR");
      if(__res != 0)
      {
        __bVerdict = __eVerdictFail;
        DiagErrCodeTestStep(__res, "Can't interpret response as diagnostic primitive 'DSC_PR'.");
        break;
      }
      else
      {
        TestStepPass( "Received primitive can be interpreted as diagnostic primitive 'DSC_PR'.");
      }
    }
  }
  while(0);


  // Response, check & read aspect
  {
    __res = 1;
    __tableHandle = ReportTableHead5Columns(__cCheckCaption, __cTSym, __cTOp, __cRefVal, __cActual, __cRes);
    {
      __bDiagValueArrayCtr = DiagGetParameterErrorHandled(__resp, "DiagSessionType", __bDiagValueArray, elcount(__bDiagValueArray), __cDiagValueArray, elcount(__cDiagValueArray));
      {
        byte __bArray2[1] = { 0x01 };
        __bArrayCtr = __CopyBytes(__bDiagValueArray, __bDiagValueArrayCtr, __bArray);
        __bArrayCtr2 = elCount(__bArray2);
        __csr = CompareBytes(__bArray, __bArrayCtr, __bArray2, __bArrayCtr2) == 0;
        snprintf(__cArray, 8192, "%s", "Diagnostic parameter \'DiagSessionType\'");
        snprintf(__cArray2, 8192, "%s", __cArray);
        snprintf(__cArray3, 8192, "%s", "");
        ReportTableRow(__tableHandle, 0, __cArray2, "Bytes", __bArray2, __bArrayCtr2, __cArray3, __oneOfFlag, __bSetInCheckAlignment);
        ReportCell(__tableHandle, __bArray, __bArrayCtr);
        ReportCellResult(__tableHandle, __csr, __ePassFail);
      }
    
      __res = __res && __csr;
    
    }
    ReportTableEndVerdict(__tableHandle, __cEvaluateResponse, __res);
	__bVerdict = __bVerdict && __res;
  }
  if (__bVerdict == __eVerdictFail)
    TestReportWriteDiagObjectList();
}
void Tt4h42sqi_Tet_Tc160_Completion()
{
  stack long __tableHandle;
  TestCompletionBegin();
  {
    {
      CreateTTEIFFunction("Tt4h42sqi_General_Postconditions", __eFct, __eLocal);
      CallInterfaceFunction(__cEmpty, __cEmpty, "8c04fef4-3bbc-4cc8-b3ee-b62ec5ff47eb");
    }


  }
  TestCompletionEnd();
}

void Tt4h42sqi_Tet_Tc161()
{
  CreateTTEIFFunction("Tt4h42sqi_Tc161", __eTcDef, __eLocal);  
  AddIFParameterTestCaseAttribute("TC_ID", "");
  AddIFParameterTestCaseAttribute("Test Case ID", "");
  CallInterfaceFunction("TC_ID_20205356_Extended_Session", __cEmpty , __cEmpty );
}
testcase Tt4h42sqi_Tc161()
{
  stack long __tableHandle;
  SetBreakOnFail(0);

  CreateTTEIFFunction("Tt4h42sqi_Tet_Tc161_Completion", __eFct, __eLocal);
  
  AddIFAsCleanUpFunction();

  TestPreparationBegin();
  {
    {
      CreateTTEIFFunction("Tt4h42sqi_General_Precondition", __eFct, __eLocal);
      CallInterfaceFunction(__cEmpty, __cEmpty, "74787266-8376-4866-a392-d0cc32109fae");
    }


  }
  TestPreparationEnd();

  TestCommandBegin(__eWait, __cWait, "", "2");
  {
    Wait("1", (40 * 1000000000LL), 1000000000, "");
  }
  TestCommandEnd();

  TestCommandBegin(__eDiagService, __cDiagService, "", "3");
  {
    if (DiagIsFunctionalGroup("CVADAS_0001_00000000_000"))
    {
      DiagResponse * __resp;
      DiagRequest CVADAS_0001_00000000_000.Default_Session_Start __req;
      __diagService4h42sqi_89(__req, __resp);
    }
    else
    {
      DiagResponse CVADAS_0001_00000000_000.* __resp;
      DiagRequest CVADAS_0001_00000000_000.Default_Session_Start __req;
      __diagService4h42sqi_89(__req, __resp);
    }
  }
  TestCommandEnd();


  TestCommandBegin(__eWait, __cWait, "", "4");
  {
    Wait("1", (1000 * 1000000LL), 1000000, "");
  }
  TestCommandEnd();

  TestCommandBegin(__eDiagService, __cDiagService, "", "5");
  {
    if (DiagIsFunctionalGroup("CVADAS_0001_00000000_000"))
    {
      DiagResponse * __resp;
      DiagRequest CVADAS_0001_00000000_000.Extended_Diagnostic_Session_Start __req;
      __diagService4h42sqi_90(__req, __resp);
    }
    else
    {
      DiagResponse CVADAS_0001_00000000_000.* __resp;
      DiagRequest CVADAS_0001_00000000_000.Extended_Diagnostic_Session_Start __req;
      __diagService4h42sqi_90(__req, __resp);
    }
  }
  TestCommandEnd();


  TestCommandBegin(__eWait, __cWait, "", "6");
  {
    Wait("1", (1000 * 1000000LL), 1000000, "");
  }
  TestCommandEnd();

  {
    CreateCaplIFFunction("startTesterPresent", __eTestFct);
    CallInterfaceFunction("startTesterPresent ()", __cEmpty, "7");
  }


  TestCommandBegin(__eWait, __cWait, "", "8");
  {
    Wait("1", (1000 * 1000000LL), 1000000, "");
  }
  TestCommandEnd();

  {
    CreateTTEIFFunction("Tt4h42sqi_F186_DID_with_PhysicalAdd_ExtendedSession", __eFct, __eLocal);
    CallInterfaceFunction(__cEmpty, __cEmpty, "56d9e7a7-9216-4d5f-b776-c5e862f155cb");
  }


  TestCommandBegin(__eWait, __cWait, "", "10");
  {
    Wait("1", (1000 * 1000000LL), 1000000, "");
  }
  TestCommandEnd();

  {
    CreateTTEIFFunction("Tt4h42sqi_FD13_DID_with_Physical_Address", __eFct, __eLocal);
    CallInterfaceFunction(__cEmpty, __cEmpty, "0c4a35d6-9152-451d-8fd4-e08c380f85f6");
  }


  TestCommandBegin(__eWait, __cWait, "", "13");
  {
    Wait("1", (5 * 1000000000LL), 1000000000, "");
  }
  TestCommandEnd();


}

  
void __diagService4h42sqi_89(DiagRequest * __req, DiagResponse * __resp )
{
  stack long __tableHandle;
  long __res, __paramLen, __bytePos;

   __bVerdict = __eVerdictPass;

  do {
    TestReportResetDiagObjectList();
    DiagSetReportDetailLevel("CVADAS_0001_00000000_000", EnumServiceDetails_onfail);
    // Request aspect
    {

      if (0 >= DiagSendReqAndWaitForResp("CVADAS_0001_00000000_000", __req, __resp, __res, -1, -1, -1, -1, -1, EnumResult_pos, EnumServiceDetails_onfail, EnumSendingMode_physical, EnumSuppressPosResBit_asconfigured, EnumVerdictOnInvalidValues_fail))
        break;
    }

    __res = DiagErrCodeTestStep(__res, "Can't retrieve last response for request! No check possible.") < 0;
    if(__res)
    {
	  __bVerdict = __eVerdictFail;
      break;
    }
    {
      __res = DiagInterpretAs(__resp, "DSC_PR");
      if(__res != 0)
      {
        __bVerdict = __eVerdictFail;
        DiagErrCodeTestStep(__res, "Can't interpret response as diagnostic primitive 'DSC_PR'.");
        break;
      }
      else
      {
        TestStepPass( "Received primitive can be interpreted as diagnostic primitive 'DSC_PR'.");
      }
    }
  }
  while(0);


  // Response, check & read aspect
  {
    __res = 1;
    __tableHandle = ReportTableHead5Columns(__cCheckCaption, __cTSym, __cTOp, __cRefVal, __cActual, __cRes);
    {
      __bDiagValueArrayCtr = DiagGetParameterErrorHandled(__resp, "DiagSessionType", __bDiagValueArray, elcount(__bDiagValueArray), __cDiagValueArray, elcount(__cDiagValueArray));
      {
        byte __bArray2[1] = { 0x01 };
        __bArrayCtr = __CopyBytes(__bDiagValueArray, __bDiagValueArrayCtr, __bArray);
        __bArrayCtr2 = elCount(__bArray2);
        __csr = CompareBytes(__bArray, __bArrayCtr, __bArray2, __bArrayCtr2) == 0;
        snprintf(__cArray, 8192, "%s", "Diagnostic parameter \'DiagSessionType\'");
        snprintf(__cArray2, 8192, "%s", __cArray);
        snprintf(__cArray3, 8192, "%s", "");
        ReportTableRow(__tableHandle, 0, __cArray2, "Bytes", __bArray2, __bArrayCtr2, __cArray3, __oneOfFlag, __bSetInCheckAlignment);
        ReportCell(__tableHandle, __bArray, __bArrayCtr);
        ReportCellResult(__tableHandle, __csr, __ePassFail);
      }
    
      __res = __res && __csr;
    
    }
    ReportTableEndVerdict(__tableHandle, __cEvaluateResponse, __res);
	__bVerdict = __bVerdict && __res;
  }
  if (__bVerdict == __eVerdictFail)
    TestReportWriteDiagObjectList();
}
  
void __diagService4h42sqi_90(DiagRequest * __req, DiagResponse * __resp )
{
  stack long __tableHandle;
  long __res, __paramLen, __bytePos;

   __bVerdict = __eVerdictPass;

  do {
    TestReportResetDiagObjectList();
    DiagSetReportDetailLevel("CVADAS_0001_00000000_000", EnumServiceDetails_onfail);
    // Request aspect
    {

      if (0 >= DiagSendReqAndWaitForResp("CVADAS_0001_00000000_000", __req, __resp, __res, -1, -1, -1, -1, -1, EnumResult_pos, EnumServiceDetails_onfail, EnumSendingMode_physical, EnumSuppressPosResBit_asconfigured, EnumVerdictOnInvalidValues_fail))
        break;
    }

    __res = DiagErrCodeTestStep(__res, "Can't retrieve last response for request! No check possible.") < 0;
    if(__res)
    {
	  __bVerdict = __eVerdictFail;
      break;
    }
    {
      __res = DiagInterpretAs(__resp, "DSC_PR");
      if(__res != 0)
      {
        __bVerdict = __eVerdictFail;
        DiagErrCodeTestStep(__res, "Can't interpret response as diagnostic primitive 'DSC_PR'.");
        break;
      }
      else
      {
        TestStepPass( "Received primitive can be interpreted as diagnostic primitive 'DSC_PR'.");
      }
    }
  }
  while(0);


  // Response, check & read aspect
  {
    __res = 1;
    __tableHandle = ReportTableHead5Columns(__cCheckCaption, __cTSym, __cTOp, __cRefVal, __cActual, __cRes);
    {
      __bDiagValueArrayCtr = DiagGetParameterErrorHandled(__resp, "DiagSessionType", __bDiagValueArray, elcount(__bDiagValueArray), __cDiagValueArray, elcount(__cDiagValueArray));
      {
        byte __bArray2[1] = { 0x03 };
        __bArrayCtr = __CopyBytes(__bDiagValueArray, __bDiagValueArrayCtr, __bArray);
        __bArrayCtr2 = elCount(__bArray2);
        __csr = CompareBytes(__bArray, __bArrayCtr, __bArray2, __bArrayCtr2) == 0;
        snprintf(__cArray, 8192, "%s", "Diagnostic parameter \'DiagSessionType\'");
        snprintf(__cArray2, 8192, "%s", __cArray);
        snprintf(__cArray3, 8192, "%s", "");
        ReportTableRow(__tableHandle, 0, __cArray2, "Bytes", __bArray2, __bArrayCtr2, __cArray3, __oneOfFlag, __bSetInCheckAlignment);
        ReportCell(__tableHandle, __bArray, __bArrayCtr);
        ReportCellResult(__tableHandle, __csr, __ePassFail);
      }
    
      __res = __res && __csr;
    
    }
    ReportTableEndVerdict(__tableHandle, __cEvaluateResponse, __res);
	__bVerdict = __bVerdict && __res;
  }
  if (__bVerdict == __eVerdictFail)
    TestReportWriteDiagObjectList();
}
void Tt4h42sqi_Tet_Tc161_Completion()
{
  stack long __tableHandle;
  TestCompletionBegin();
  {
    {
      CreateTTEIFFunction("Tt4h42sqi_General_Postconditions", __eFct, __eLocal);
      CallInterfaceFunction(__cEmpty, __cEmpty, "8c04fef4-3bbc-4cc8-b3ee-b62ec5ff47eb");
    }


  }
  TestCompletionEnd();
}

void Tt4h42sqi_Tet_Tc162()
{
  CreateTTEIFFunction("Tt4h42sqi_Tc162", __eTcDef, __eLocal);  
  AddIFParameterTestCaseAttribute("TC_ID", "");
  AddIFParameterTestCaseAttribute("Test Case ID", "");
  CallInterfaceFunction("TC_ID_18404905_Defaults_Session_Physical_and_Standard_Addressing", __cEmpty , __cEmpty );
}
testcase Tt4h42sqi_Tc162()
{
  stack long __tableHandle;
  SetBreakOnFail(0);

  CreateTTEIFFunction("Tt4h42sqi_Tet_Tc162_Completion", __eFct, __eLocal);
  
  AddIFAsCleanUpFunction();

  TestPreparationBegin();
  {
    {
      CreateTTEIFFunction("Tt4h42sqi_General_Precondition", __eFct, __eLocal);
      CallInterfaceFunction(__cEmpty, __cEmpty, "74787266-8376-4866-a392-d0cc32109fae");
    }


  }
  TestPreparationEnd();

  TestCommandBegin(__eDiagService, __cDiagService, "", "2");
  {
    if (DiagIsFunctionalGroup("CVADAS_0001_00000000_000"))
    {
      DiagResponse * __resp;
      DiagRequest CVADAS_0001_00000000_000.Default_Session_Start __req;
      __diagService4h42sqi_91(__req, __resp);
    }
    else
    {
      DiagResponse CVADAS_0001_00000000_000.* __resp;
      DiagRequest CVADAS_0001_00000000_000.Default_Session_Start __req;
      __diagService4h42sqi_91(__req, __resp);
    }
  }
  TestCommandEnd();


  {
    CreateTTEIFFunction("Tt4h42sqi_F186_DID_with_PhysicalAdd_DefaultSession", __eFct, __eLocal);
    CallInterfaceFunction(__cEmpty, __cEmpty, "f479ea65-8c8c-4093-b3d8-2a8374608569");
  }


  {
    CreateTTEIFFunction("Tt4h42sqi_F18C_DID_with_Physical_Addressing", __eFct, __eLocal);
    CallInterfaceFunction(__cEmpty, __cEmpty, "7486d1d1-c748-460d-8de2-86a63e092c0d");
  }



}

  
void __diagService4h42sqi_91(DiagRequest * __req, DiagResponse * __resp )
{
  stack long __tableHandle;
  long __res, __paramLen, __bytePos;

   __bVerdict = __eVerdictPass;

  do {
    TestReportResetDiagObjectList();
    DiagSetReportDetailLevel("CVADAS_0001_00000000_000", EnumServiceDetails_onfail);
    // Request aspect
    {

      if (0 >= DiagSendReqAndWaitForResp("CVADAS_0001_00000000_000", __req, __resp, __res, -1, -1, -1, -1, -1, EnumResult_pos, EnumServiceDetails_onfail, EnumSendingMode_physical, EnumSuppressPosResBit_asconfigured, EnumVerdictOnInvalidValues_fail))
        break;
    }

    __res = DiagErrCodeTestStep(__res, "Can't retrieve last response for request! No check possible.") < 0;
    if(__res)
    {
	  __bVerdict = __eVerdictFail;
      break;
    }
    {
      __res = DiagInterpretAs(__resp, "DSC_PR");
      if(__res != 0)
      {
        __bVerdict = __eVerdictFail;
        DiagErrCodeTestStep(__res, "Can't interpret response as diagnostic primitive 'DSC_PR'.");
        break;
      }
      else
      {
        TestStepPass( "Received primitive can be interpreted as diagnostic primitive 'DSC_PR'.");
      }
    }
  }
  while(0);


  // Response, check & read aspect
  {
    __res = 1;
    __tableHandle = ReportTableHead5Columns(__cCheckCaption, __cTSym, __cTOp, __cRefVal, __cActual, __cRes);
    {
      __bDiagValueArrayCtr = DiagGetParameterErrorHandled(__resp, "DiagSessionType", __bDiagValueArray, elcount(__bDiagValueArray), __cDiagValueArray, elcount(__cDiagValueArray));
      {
        byte __bArray2[1] = { 0x01 };
        __bArrayCtr = __CopyBytes(__bDiagValueArray, __bDiagValueArrayCtr, __bArray);
        __bArrayCtr2 = elCount(__bArray2);
        __csr = CompareBytes(__bArray, __bArrayCtr, __bArray2, __bArrayCtr2) == 0;
        snprintf(__cArray, 8192, "%s", "Diagnostic parameter \'DiagSessionType\'");
        snprintf(__cArray2, 8192, "%s", __cArray);
        snprintf(__cArray3, 8192, "%s", "");
        ReportTableRow(__tableHandle, 0, __cArray2, "Bytes", __bArray2, __bArrayCtr2, __cArray3, __oneOfFlag, __bSetInCheckAlignment);
        ReportCell(__tableHandle, __bArray, __bArrayCtr);
        ReportCellResult(__tableHandle, __csr, __ePassFail);
      }
    
      __res = __res && __csr;
    
    }
    ReportTableEndVerdict(__tableHandle, __cEvaluateResponse, __res);
	__bVerdict = __bVerdict && __res;
  }
  if (__bVerdict == __eVerdictFail)
    TestReportWriteDiagObjectList();
}
void Tt4h42sqi_Tet_Tc162_Completion()
{
  stack long __tableHandle;
  TestCompletionBegin();
  {
    {
      CreateTTEIFFunction("Tt4h42sqi_General_Postconditions", __eFct, __eLocal);
      CallInterfaceFunction(__cEmpty, __cEmpty, "8c04fef4-3bbc-4cc8-b3ee-b62ec5ff47eb");
    }


  }
  TestCompletionEnd();
}

void Tt4h42sqi_Tet_Tc163()
{
  CreateTTEIFFunction("Tt4h42sqi_Tc163", __eTcDef, __eLocal);  
  AddIFParameterTestCaseAttribute("TC_ID", "");
  AddIFParameterTestCaseAttribute("Test Case ID", "");
  CallInterfaceFunction("TC_ID_18404907_Extended_Session", __cEmpty , __cEmpty );
}
testcase Tt4h42sqi_Tc163()
{
  stack long __tableHandle;
  SetBreakOnFail(0);

  CreateTTEIFFunction("Tt4h42sqi_Tet_Tc163_Completion", __eFct, __eLocal);
  
  AddIFAsCleanUpFunction();

  TestPreparationBegin();
  {
    {
      CreateTTEIFFunction("Tt4h42sqi_General_Precondition", __eFct, __eLocal);
      CallInterfaceFunction(__cEmpty, __cEmpty, "74787266-8376-4866-a392-d0cc32109fae");
    }


  }
  TestPreparationEnd();

  TestCommandBegin(__eDiagService, __cDiagService, "", "2");
  {
    if (DiagIsFunctionalGroup("CVADAS_0001_00000000_000"))
    {
      DiagResponse * __resp;
      DiagRequest CVADAS_0001_00000000_000.Default_Session_Start __req;
      __diagService4h42sqi_92(__req, __resp);
    }
    else
    {
      DiagResponse CVADAS_0001_00000000_000.* __resp;
      DiagRequest CVADAS_0001_00000000_000.Default_Session_Start __req;
      __diagService4h42sqi_92(__req, __resp);
    }
  }
  TestCommandEnd();


  TestCommandBegin(__eDiagService, __cDiagService, "", "3");
  {
    if (DiagIsFunctionalGroup("CVADAS_0001_00000000_000"))
    {
      DiagResponse * __resp;
      DiagRequest CVADAS_0001_00000000_000.Extended_Diagnostic_Session_Start __req;
      __diagService4h42sqi_93(__req, __resp);
    }
    else
    {
      DiagResponse CVADAS_0001_00000000_000.* __resp;
      DiagRequest CVADAS_0001_00000000_000.Extended_Diagnostic_Session_Start __req;
      __diagService4h42sqi_93(__req, __resp);
    }
  }
  TestCommandEnd();


  {
    CreateTTEIFFunction("Tt4h42sqi_F186_DID_with_PhysicalAdd_ExtendedSession", __eFct, __eLocal);
    CallInterfaceFunction(__cEmpty, __cEmpty, "56d9e7a7-9216-4d5f-b776-c5e862f155cb");
  }


  {
    CreateTTEIFFunction("Tt4h42sqi_F18C_DID_with_Physical_Addressing", __eFct, __eLocal);
    CallInterfaceFunction(__cEmpty, __cEmpty, "7486d1d1-c748-460d-8de2-86a63e092c0d");
  }



}

  
void __diagService4h42sqi_92(DiagRequest * __req, DiagResponse * __resp )
{
  stack long __tableHandle;
  long __res, __paramLen, __bytePos;

   __bVerdict = __eVerdictPass;

  do {
    TestReportResetDiagObjectList();
    DiagSetReportDetailLevel("CVADAS_0001_00000000_000", EnumServiceDetails_onfail);
    // Request aspect
    {

      if (0 >= DiagSendReqAndWaitForResp("CVADAS_0001_00000000_000", __req, __resp, __res, -1, -1, -1, -1, -1, EnumResult_pos, EnumServiceDetails_onfail, EnumSendingMode_physical, EnumSuppressPosResBit_asconfigured, EnumVerdictOnInvalidValues_fail))
        break;
    }

    __res = DiagErrCodeTestStep(__res, "Can't retrieve last response for request! No check possible.") < 0;
    if(__res)
    {
	  __bVerdict = __eVerdictFail;
      break;
    }
    {
      __res = DiagInterpretAs(__resp, "DSC_PR");
      if(__res != 0)
      {
        __bVerdict = __eVerdictFail;
        DiagErrCodeTestStep(__res, "Can't interpret response as diagnostic primitive 'DSC_PR'.");
        break;
      }
      else
      {
        TestStepPass( "Received primitive can be interpreted as diagnostic primitive 'DSC_PR'.");
      }
    }
  }
  while(0);


  // Response, check & read aspect
  {
    __res = 1;
    __tableHandle = ReportTableHead5Columns(__cCheckCaption, __cTSym, __cTOp, __cRefVal, __cActual, __cRes);
    {
      __bDiagValueArrayCtr = DiagGetParameterErrorHandled(__resp, "DiagSessionType", __bDiagValueArray, elcount(__bDiagValueArray), __cDiagValueArray, elcount(__cDiagValueArray));
      {
        byte __bArray2[1] = { 0x01 };
        __bArrayCtr = __CopyBytes(__bDiagValueArray, __bDiagValueArrayCtr, __bArray);
        __bArrayCtr2 = elCount(__bArray2);
        __csr = CompareBytes(__bArray, __bArrayCtr, __bArray2, __bArrayCtr2) == 0;
        snprintf(__cArray, 8192, "%s", "Diagnostic parameter \'DiagSessionType\'");
        snprintf(__cArray2, 8192, "%s", __cArray);
        snprintf(__cArray3, 8192, "%s", "");
        ReportTableRow(__tableHandle, 0, __cArray2, "Bytes", __bArray2, __bArrayCtr2, __cArray3, __oneOfFlag, __bSetInCheckAlignment);
        ReportCell(__tableHandle, __bArray, __bArrayCtr);
        ReportCellResult(__tableHandle, __csr, __ePassFail);
      }
    
      __res = __res && __csr;
    
    }
    ReportTableEndVerdict(__tableHandle, __cEvaluateResponse, __res);
	__bVerdict = __bVerdict && __res;
  }
  if (__bVerdict == __eVerdictFail)
    TestReportWriteDiagObjectList();
}
  
void __diagService4h42sqi_93(DiagRequest * __req, DiagResponse * __resp )
{
  stack long __tableHandle;
  long __res, __paramLen, __bytePos;

   __bVerdict = __eVerdictPass;

  do {
    TestReportResetDiagObjectList();
    DiagSetReportDetailLevel("CVADAS_0001_00000000_000", EnumServiceDetails_onfail);
    // Request aspect
    {

      if (0 >= DiagSendReqAndWaitForResp("CVADAS_0001_00000000_000", __req, __resp, __res, -1, -1, -1, -1, -1, EnumResult_pos, EnumServiceDetails_onfail, EnumSendingMode_physical, EnumSuppressPosResBit_asconfigured, EnumVerdictOnInvalidValues_fail))
        break;
    }

    __res = DiagErrCodeTestStep(__res, "Can't retrieve last response for request! No check possible.") < 0;
    if(__res)
    {
	  __bVerdict = __eVerdictFail;
      break;
    }
    {
      __res = DiagInterpretAs(__resp, "DSC_PR");
      if(__res != 0)
      {
        __bVerdict = __eVerdictFail;
        DiagErrCodeTestStep(__res, "Can't interpret response as diagnostic primitive 'DSC_PR'.");
        break;
      }
      else
      {
        TestStepPass( "Received primitive can be interpreted as diagnostic primitive 'DSC_PR'.");
      }
    }
  }
  while(0);


  // Response, check & read aspect
  {
    __res = 1;
    __tableHandle = ReportTableHead5Columns(__cCheckCaption, __cTSym, __cTOp, __cRefVal, __cActual, __cRes);
    {
      __bDiagValueArrayCtr = DiagGetParameterErrorHandled(__resp, "DiagSessionType", __bDiagValueArray, elcount(__bDiagValueArray), __cDiagValueArray, elcount(__cDiagValueArray));
      {
        byte __bArray2[1] = { 0x03 };
        __bArrayCtr = __CopyBytes(__bDiagValueArray, __bDiagValueArrayCtr, __bArray);
        __bArrayCtr2 = elCount(__bArray2);
        __csr = CompareBytes(__bArray, __bArrayCtr, __bArray2, __bArrayCtr2) == 0;
        snprintf(__cArray, 8192, "%s", "Diagnostic parameter \'DiagSessionType\'");
        snprintf(__cArray2, 8192, "%s", __cArray);
        snprintf(__cArray3, 8192, "%s", "");
        ReportTableRow(__tableHandle, 0, __cArray2, "Bytes", __bArray2, __bArrayCtr2, __cArray3, __oneOfFlag, __bSetInCheckAlignment);
        ReportCell(__tableHandle, __bArray, __bArrayCtr);
        ReportCellResult(__tableHandle, __csr, __ePassFail);
      }
    
      __res = __res && __csr;
    
    }
    ReportTableEndVerdict(__tableHandle, __cEvaluateResponse, __res);
	__bVerdict = __bVerdict && __res;
  }
  if (__bVerdict == __eVerdictFail)
    TestReportWriteDiagObjectList();
}
void Tt4h42sqi_Tet_Tc163_Completion()
{
  stack long __tableHandle;
  TestCompletionBegin();
  {
    {
      CreateTTEIFFunction("Tt4h42sqi_General_Postconditions", __eFct, __eLocal);
      CallInterfaceFunction(__cEmpty, __cEmpty, "8c04fef4-3bbc-4cc8-b3ee-b62ec5ff47eb");
    }


  }
  TestCompletionEnd();
}

void Tt4h42sqi_Tet_Tc164()
{
  CreateTTEIFFunction("Tt4h42sqi_Tc164", __eTcDef, __eLocal);  
  AddIFParameterTestCaseAttribute("TC_ID", "");
  AddIFParameterTestCaseAttribute("Test Case ID", "");
  CallInterfaceFunction("TC_ID_20205317_Extended_Session", __cEmpty , __cEmpty );
}
testcase Tt4h42sqi_Tc164()
{
  stack long __tableHandle;
  SetBreakOnFail(0);

  CreateTTEIFFunction("Tt4h42sqi_Tet_Tc164_Completion", __eFct, __eLocal);
  
  AddIFAsCleanUpFunction();

  TestPreparationBegin();
  {
    {
      CreateTTEIFFunction("Tt4h42sqi_General_Precondition", __eFct, __eLocal);
      CallInterfaceFunction(__cEmpty, __cEmpty, "74787266-8376-4866-a392-d0cc32109fae");
    }


  }
  TestPreparationEnd();

  TestCommandBegin(__eDiagService, __cDiagService, "", "2");
  {
    if (DiagIsFunctionalGroup("CVADAS_0001_00000000_000"))
    {
      DiagResponse * __resp;
      DiagRequest CVADAS_0001_00000000_000.Default_Session_Start __req;
      __diagService4h42sqi_94(__req, __resp);
    }
    else
    {
      DiagResponse CVADAS_0001_00000000_000.* __resp;
      DiagRequest CVADAS_0001_00000000_000.Default_Session_Start __req;
      __diagService4h42sqi_94(__req, __resp);
    }
  }
  TestCommandEnd();


  TestCommandBegin(__eDiagService, __cDiagService, "", "3");
  {
    if (DiagIsFunctionalGroup("CVADAS_0001_00000000_000"))
    {
      DiagResponse * __resp;
      DiagRequest CVADAS_0001_00000000_000.Extended_Diagnostic_Session_Start __req;
      __diagService4h42sqi_95(__req, __resp);
    }
    else
    {
      DiagResponse CVADAS_0001_00000000_000.* __resp;
      DiagRequest CVADAS_0001_00000000_000.Extended_Diagnostic_Session_Start __req;
      __diagService4h42sqi_95(__req, __resp);
    }
  }
  TestCommandEnd();


  {
    CreateTTEIFFunction("Tt4h42sqi_F186_DID_with_PhysicalAdd_ExtendedSession", __eFct, __eLocal);
    CallInterfaceFunction(__cEmpty, __cEmpty, "56d9e7a7-9216-4d5f-b776-c5e862f155cb");
  }



}

  
void __diagService4h42sqi_94(DiagRequest * __req, DiagResponse * __resp )
{
  stack long __tableHandle;
  long __res, __paramLen, __bytePos;

   __bVerdict = __eVerdictPass;

  do {
    TestReportResetDiagObjectList();
    DiagSetReportDetailLevel("CVADAS_0001_00000000_000", EnumServiceDetails_onfail);
    // Request aspect
    {

      if (0 >= DiagSendReqAndWaitForResp("CVADAS_0001_00000000_000", __req, __resp, __res, -1, -1, -1, -1, -1, EnumResult_pos, EnumServiceDetails_onfail, EnumSendingMode_physical, EnumSuppressPosResBit_asconfigured, EnumVerdictOnInvalidValues_fail))
        break;
    }

    __res = DiagErrCodeTestStep(__res, "Can't retrieve last response for request! No check possible.") < 0;
    if(__res)
    {
	  __bVerdict = __eVerdictFail;
      break;
    }
    {
      __res = DiagInterpretAs(__resp, "DSC_PR");
      if(__res != 0)
      {
        __bVerdict = __eVerdictFail;
        DiagErrCodeTestStep(__res, "Can't interpret response as diagnostic primitive 'DSC_PR'.");
        break;
      }
      else
      {
        TestStepPass( "Received primitive can be interpreted as diagnostic primitive 'DSC_PR'.");
      }
    }
  }
  while(0);


  // Response, check & read aspect
  {
    __res = 1;
    __tableHandle = ReportTableHead5Columns(__cCheckCaption, __cTSym, __cTOp, __cRefVal, __cActual, __cRes);
    {
      __bDiagValueArrayCtr = DiagGetParameterErrorHandled(__resp, "DiagSessionType", __bDiagValueArray, elcount(__bDiagValueArray), __cDiagValueArray, elcount(__cDiagValueArray));
      {
        byte __bArray2[1] = { 0x01 };
        __bArrayCtr = __CopyBytes(__bDiagValueArray, __bDiagValueArrayCtr, __bArray);
        __bArrayCtr2 = elCount(__bArray2);
        __csr = CompareBytes(__bArray, __bArrayCtr, __bArray2, __bArrayCtr2) == 0;
        snprintf(__cArray, 8192, "%s", "Diagnostic parameter \'DiagSessionType\'");
        snprintf(__cArray2, 8192, "%s", __cArray);
        snprintf(__cArray3, 8192, "%s", "");
        ReportTableRow(__tableHandle, 0, __cArray2, "Bytes", __bArray2, __bArrayCtr2, __cArray3, __oneOfFlag, __bSetInCheckAlignment);
        ReportCell(__tableHandle, __bArray, __bArrayCtr);
        ReportCellResult(__tableHandle, __csr, __ePassFail);
      }
    
      __res = __res && __csr;
    
    }
    ReportTableEndVerdict(__tableHandle, __cEvaluateResponse, __res);
	__bVerdict = __bVerdict && __res;
  }
  if (__bVerdict == __eVerdictFail)
    TestReportWriteDiagObjectList();
}
  
void __diagService4h42sqi_95(DiagRequest * __req, DiagResponse * __resp )
{
  stack long __tableHandle;
  long __res, __paramLen, __bytePos;

   __bVerdict = __eVerdictPass;

  do {
    TestReportResetDiagObjectList();
    DiagSetReportDetailLevel("CVADAS_0001_00000000_000", EnumServiceDetails_onfail);
    // Request aspect
    {

      if (0 >= DiagSendReqAndWaitForResp("CVADAS_0001_00000000_000", __req, __resp, __res, -1, -1, -1, -1, -1, EnumResult_pos, EnumServiceDetails_onfail, EnumSendingMode_physical, EnumSuppressPosResBit_asconfigured, EnumVerdictOnInvalidValues_fail))
        break;
    }

    __res = DiagErrCodeTestStep(__res, "Can't retrieve last response for request! No check possible.") < 0;
    if(__res)
    {
	  __bVerdict = __eVerdictFail;
      break;
    }
    {
      __res = DiagInterpretAs(__resp, "DSC_PR");
      if(__res != 0)
      {
        __bVerdict = __eVerdictFail;
        DiagErrCodeTestStep(__res, "Can't interpret response as diagnostic primitive 'DSC_PR'.");
        break;
      }
      else
      {
        TestStepPass( "Received primitive can be interpreted as diagnostic primitive 'DSC_PR'.");
      }
    }
  }
  while(0);


  // Response, check & read aspect
  {
    __res = 1;
    __tableHandle = ReportTableHead5Columns(__cCheckCaption, __cTSym, __cTOp, __cRefVal, __cActual, __cRes);
    {
      __bDiagValueArrayCtr = DiagGetParameterErrorHandled(__resp, "DiagSessionType", __bDiagValueArray, elcount(__bDiagValueArray), __cDiagValueArray, elcount(__cDiagValueArray));
      {
        byte __bArray2[1] = { 0x03 };
        __bArrayCtr = __CopyBytes(__bDiagValueArray, __bDiagValueArrayCtr, __bArray);
        __bArrayCtr2 = elCount(__bArray2);
        __csr = CompareBytes(__bArray, __bArrayCtr, __bArray2, __bArrayCtr2) == 0;
        snprintf(__cArray, 8192, "%s", "Diagnostic parameter \'DiagSessionType\'");
        snprintf(__cArray2, 8192, "%s", __cArray);
        snprintf(__cArray3, 8192, "%s", "");
        ReportTableRow(__tableHandle, 0, __cArray2, "Bytes", __bArray2, __bArrayCtr2, __cArray3, __oneOfFlag, __bSetInCheckAlignment);
        ReportCell(__tableHandle, __bArray, __bArrayCtr);
        ReportCellResult(__tableHandle, __csr, __ePassFail);
      }
    
      __res = __res && __csr;
    
    }
    ReportTableEndVerdict(__tableHandle, __cEvaluateResponse, __res);
	__bVerdict = __bVerdict && __res;
  }
  if (__bVerdict == __eVerdictFail)
    TestReportWriteDiagObjectList();
}
void Tt4h42sqi_Tet_Tc164_Completion()
{
  stack long __tableHandle;
  TestCompletionBegin();
  {
    {
      CreateTTEIFFunction("Tt4h42sqi_General_Postconditions", __eFct, __eLocal);
      CallInterfaceFunction(__cEmpty, __cEmpty, "8c04fef4-3bbc-4cc8-b3ee-b62ec5ff47eb");
    }


  }
  TestCompletionEnd();
}

void Tt4h42sqi_Tet_Tc165()
{
  CreateTTEIFFunction("Tt4h42sqi_Tc165", __eTcDef, __eLocal);  
  AddIFParameterTestCaseAttribute("TC_ID", "");
  AddIFParameterTestCaseAttribute("Test Case ID", "");
  CallInterfaceFunction("TC_ID_20205322_Default_Session", __cEmpty , __cEmpty );
}
testcase Tt4h42sqi_Tc165()
{
  stack long __tableHandle;
  SetBreakOnFail(0);

  CreateTTEIFFunction("Tt4h42sqi_Tet_Tc165_Completion", __eFct, __eLocal);
  
  AddIFAsCleanUpFunction();

  TestPreparationBegin();
  {
    {
      CreateTTEIFFunction("Tt4h42sqi_General_Precondition", __eFct, __eLocal);
      CallInterfaceFunction(__cEmpty, __cEmpty, "74787266-8376-4866-a392-d0cc32109fae");
    }


  }
  TestPreparationEnd();

  TestCommandBegin(__eDiagService, __cDiagService, "", "2");
  {
    if (DiagIsFunctionalGroup("CVADAS_0001_00000000_000"))
    {
      DiagResponse * __resp;
      DiagRequest CVADAS_0001_00000000_000.Default_Session_Start __req;
      __diagService4h42sqi_96(__req, __resp);
    }
    else
    {
      DiagResponse CVADAS_0001_00000000_000.* __resp;
      DiagRequest CVADAS_0001_00000000_000.Default_Session_Start __req;
      __diagService4h42sqi_96(__req, __resp);
    }
  }
  TestCommandEnd();


  {
    CreateTTEIFFunction("Tt4h42sqi_F186_DID_with_PhysicalAdd_DefaultSession", __eFct, __eLocal);
    CallInterfaceFunction(__cEmpty, __cEmpty, "f479ea65-8c8c-4093-b3d8-2a8374608569");
  }



}

  
void __diagService4h42sqi_96(DiagRequest * __req, DiagResponse * __resp )
{
  stack long __tableHandle;
  long __res, __paramLen, __bytePos;

   __bVerdict = __eVerdictPass;

  do {
    TestReportResetDiagObjectList();
    DiagSetReportDetailLevel("CVADAS_0001_00000000_000", EnumServiceDetails_onfail);
    // Request aspect
    {

      if (0 >= DiagSendReqAndWaitForResp("CVADAS_0001_00000000_000", __req, __resp, __res, -1, -1, -1, -1, -1, EnumResult_pos, EnumServiceDetails_onfail, EnumSendingMode_physical, EnumSuppressPosResBit_asconfigured, EnumVerdictOnInvalidValues_fail))
        break;
    }

    __res = DiagErrCodeTestStep(__res, "Can't retrieve last response for request! No check possible.") < 0;
    if(__res)
    {
	  __bVerdict = __eVerdictFail;
      break;
    }
    {
      __res = DiagInterpretAs(__resp, "DSC_PR");
      if(__res != 0)
      {
        __bVerdict = __eVerdictFail;
        DiagErrCodeTestStep(__res, "Can't interpret response as diagnostic primitive 'DSC_PR'.");
        break;
      }
      else
      {
        TestStepPass( "Received primitive can be interpreted as diagnostic primitive 'DSC_PR'.");
      }
    }
  }
  while(0);


  // Response, check & read aspect
  {
    __res = 1;
    __tableHandle = ReportTableHead5Columns(__cCheckCaption, __cTSym, __cTOp, __cRefVal, __cActual, __cRes);
    {
      __bDiagValueArrayCtr = DiagGetParameterErrorHandled(__resp, "DiagSessionType", __bDiagValueArray, elcount(__bDiagValueArray), __cDiagValueArray, elcount(__cDiagValueArray));
      {
        byte __bArray2[1] = { 0x01 };
        __bArrayCtr = __CopyBytes(__bDiagValueArray, __bDiagValueArrayCtr, __bArray);
        __bArrayCtr2 = elCount(__bArray2);
        __csr = CompareBytes(__bArray, __bArrayCtr, __bArray2, __bArrayCtr2) == 0;
        snprintf(__cArray, 8192, "%s", "Diagnostic parameter \'DiagSessionType\'");
        snprintf(__cArray2, 8192, "%s", __cArray);
        snprintf(__cArray3, 8192, "%s", "");
        ReportTableRow(__tableHandle, 0, __cArray2, "Bytes", __bArray2, __bArrayCtr2, __cArray3, __oneOfFlag, __bSetInCheckAlignment);
        ReportCell(__tableHandle, __bArray, __bArrayCtr);
        ReportCellResult(__tableHandle, __csr, __ePassFail);
      }
    
      __res = __res && __csr;
    
    }
    ReportTableEndVerdict(__tableHandle, __cEvaluateResponse, __res);
	__bVerdict = __bVerdict && __res;
  }
  if (__bVerdict == __eVerdictFail)
    TestReportWriteDiagObjectList();
}
void Tt4h42sqi_Tet_Tc165_Completion()
{
  stack long __tableHandle;
  TestCompletionBegin();
  {
    {
      CreateTTEIFFunction("Tt4h42sqi_General_Postconditions", __eFct, __eLocal);
      CallInterfaceFunction(__cEmpty, __cEmpty, "8c04fef4-3bbc-4cc8-b3ee-b62ec5ff47eb");
    }


  }
  TestCompletionEnd();
}

void Tt4h42sqi_Tet_Tc166()
{
  CreateTTEIFFunction("Tt4h42sqi_Tc166", __eTcDef, __eLocal);  
  AddIFParameterTestCaseAttribute("TC_ID", "");
  AddIFParameterTestCaseAttribute("Test Case ID", "");
  CallInterfaceFunction("TC_ID_20205307_Hard_Reset", __cEmpty , __cEmpty );
}
testcase Tt4h42sqi_Tc166()
{
  stack long __tableHandle;
  SetBreakOnFail(0);

  CreateTTEIFFunction("Tt4h42sqi_Tet_Tc166_Completion", __eFct, __eLocal);
  
  AddIFAsCleanUpFunction();

  TestPreparationBegin();
  {
    {
      CreateTTEIFFunction("Tt4h42sqi_General_Precondition", __eFct, __eLocal);
      CallInterfaceFunction(__cEmpty, __cEmpty, "74787266-8376-4866-a392-d0cc32109fae");
    }


  }
  TestPreparationEnd();

  {
    CreateCaplIFFunction("startTesterPresent", __eTestFct);
    CallInterfaceFunction("startTesterPresent ()", __cEmpty, "2");
  }


  TestCommandBegin(__eDiagService, __cDiagService, "", "3");
  {
    if (DiagIsFunctionalGroup("CVADAS_0001_00000000_000"))
    {
      DiagResponse * __resp;
      DiagRequest CVADAS_0001_00000000_000.Default_Session_Start __req;
      __diagService4h42sqi_97(__req, __resp);
    }
    else
    {
      DiagResponse CVADAS_0001_00000000_000.* __resp;
      DiagRequest CVADAS_0001_00000000_000.Default_Session_Start __req;
      __diagService4h42sqi_97(__req, __resp);
    }
  }
  TestCommandEnd();


  TestCommandBegin(__eDiagService, __cDiagService, "", "4");
  {
    if (DiagIsFunctionalGroup("CVADAS_0001_00000000_000"))
    {
      DiagResponse * __resp;
      DiagRequest CVADAS_0001_00000000_000.Extended_Diagnostic_Session_Start __req;
      __diagService4h42sqi_98(__req, __resp);
    }
    else
    {
      DiagResponse CVADAS_0001_00000000_000.* __resp;
      DiagRequest CVADAS_0001_00000000_000.Extended_Diagnostic_Session_Start __req;
      __diagService4h42sqi_98(__req, __resp);
    }
  }
  TestCommandEnd();


  {
    CreateTTEIFFunction("Tt4h42sqi_F186_DID_with_PhysicalAdd_ExtendedSession", __eFct, __eLocal);
    CallInterfaceFunction(__cEmpty, __cEmpty, "56d9e7a7-9216-4d5f-b776-c5e862f155cb");
  }


  {
    CreateTTEIFFunction("Tt4h42sqi_Hard_Reset_with_Physical_Address", __eFct, __eLocal);
    CallInterfaceFunction(__cEmpty, __cEmpty, "89dfe39a-bb1d-4a37-afea-34e7a683daba");
  }


  TestCommandBegin(__eWait, __cWait, "", "7");
  {
    Wait("1", (15 * 1000000000LL), 1000000000, "");
  }
  TestCommandEnd();

  {
    CreateTTEIFFunction("Tt4h42sqi_F186_DID_with_PhysicalAdd_DefaultSession", __eFct, __eLocal);
    CallInterfaceFunction(__cEmpty, __cEmpty, "f479ea65-8c8c-4093-b3d8-2a8374608569");
  }


  TestCommandBegin(__eWait, __cWait, "", "9");
  {
    Wait("1", (1000 * 1000000LL), 1000000, "");
  }
  TestCommandEnd();


}

  
void __diagService4h42sqi_97(DiagRequest * __req, DiagResponse * __resp )
{
  stack long __tableHandle;
  long __res, __paramLen, __bytePos;

   __bVerdict = __eVerdictPass;

  do {
    TestReportResetDiagObjectList();
    DiagSetReportDetailLevel("CVADAS_0001_00000000_000", EnumServiceDetails_onfail);
    // Request aspect
    {

      if (0 >= DiagSendReqAndWaitForResp("CVADAS_0001_00000000_000", __req, __resp, __res, -1, -1, -1, -1, -1, EnumResult_pos, EnumServiceDetails_onfail, EnumSendingMode_physical, EnumSuppressPosResBit_asconfigured, EnumVerdictOnInvalidValues_fail))
        break;
    }

    __res = DiagErrCodeTestStep(__res, "Can't retrieve last response for request! No check possible.") < 0;
    if(__res)
    {
	  __bVerdict = __eVerdictFail;
      break;
    }
    {
      __res = DiagInterpretAs(__resp, "DSC_PR");
      if(__res != 0)
      {
        __bVerdict = __eVerdictFail;
        DiagErrCodeTestStep(__res, "Can't interpret response as diagnostic primitive 'DSC_PR'.");
        break;
      }
      else
      {
        TestStepPass( "Received primitive can be interpreted as diagnostic primitive 'DSC_PR'.");
      }
    }
  }
  while(0);


  // Response, check & read aspect
  {
    __res = 1;
    __tableHandle = ReportTableHead5Columns(__cCheckCaption, __cTSym, __cTOp, __cRefVal, __cActual, __cRes);
    {
      __bDiagValueArrayCtr = DiagGetParameterErrorHandled(__resp, "DiagSessionType", __bDiagValueArray, elcount(__bDiagValueArray), __cDiagValueArray, elcount(__cDiagValueArray));
      {
        byte __bArray2[1] = { 0x01 };
        __bArrayCtr = __CopyBytes(__bDiagValueArray, __bDiagValueArrayCtr, __bArray);
        __bArrayCtr2 = elCount(__bArray2);
        __csr = CompareBytes(__bArray, __bArrayCtr, __bArray2, __bArrayCtr2) == 0;
        snprintf(__cArray, 8192, "%s", "Diagnostic parameter \'DiagSessionType\'");
        snprintf(__cArray2, 8192, "%s", __cArray);
        snprintf(__cArray3, 8192, "%s", "");
        ReportTableRow(__tableHandle, 0, __cArray2, "Bytes", __bArray2, __bArrayCtr2, __cArray3, __oneOfFlag, __bSetInCheckAlignment);
        ReportCell(__tableHandle, __bArray, __bArrayCtr);
        ReportCellResult(__tableHandle, __csr, __ePassFail);
      }
    
      __res = __res && __csr;
    
    }
    ReportTableEndVerdict(__tableHandle, __cEvaluateResponse, __res);
	__bVerdict = __bVerdict && __res;
  }
  if (__bVerdict == __eVerdictFail)
    TestReportWriteDiagObjectList();
}
  
void __diagService4h42sqi_98(DiagRequest * __req, DiagResponse * __resp )
{
  stack long __tableHandle;
  long __res, __paramLen, __bytePos;

   __bVerdict = __eVerdictPass;

  do {
    TestReportResetDiagObjectList();
    DiagSetReportDetailLevel("CVADAS_0001_00000000_000", EnumServiceDetails_onfail);
    // Request aspect
    {

      if (0 >= DiagSendReqAndWaitForResp("CVADAS_0001_00000000_000", __req, __resp, __res, -1, -1, -1, -1, -1, EnumResult_pos, EnumServiceDetails_onfail, EnumSendingMode_physical, EnumSuppressPosResBit_asconfigured, EnumVerdictOnInvalidValues_fail))
        break;
    }

    __res = DiagErrCodeTestStep(__res, "Can't retrieve last response for request! No check possible.") < 0;
    if(__res)
    {
	  __bVerdict = __eVerdictFail;
      break;
    }
    {
      __res = DiagInterpretAs(__resp, "DSC_PR");
      if(__res != 0)
      {
        __bVerdict = __eVerdictFail;
        DiagErrCodeTestStep(__res, "Can't interpret response as diagnostic primitive 'DSC_PR'.");
        break;
      }
      else
      {
        TestStepPass( "Received primitive can be interpreted as diagnostic primitive 'DSC_PR'.");
      }
    }
  }
  while(0);


  // Response, check & read aspect
  {
    __res = 1;
    __tableHandle = ReportTableHead5Columns(__cCheckCaption, __cTSym, __cTOp, __cRefVal, __cActual, __cRes);
    {
      __bDiagValueArrayCtr = DiagGetParameterErrorHandled(__resp, "DiagSessionType", __bDiagValueArray, elcount(__bDiagValueArray), __cDiagValueArray, elcount(__cDiagValueArray));
      {
        byte __bArray2[1] = { 0x03 };
        __bArrayCtr = __CopyBytes(__bDiagValueArray, __bDiagValueArrayCtr, __bArray);
        __bArrayCtr2 = elCount(__bArray2);
        __csr = CompareBytes(__bArray, __bArrayCtr, __bArray2, __bArrayCtr2) == 0;
        snprintf(__cArray, 8192, "%s", "Diagnostic parameter \'DiagSessionType\'");
        snprintf(__cArray2, 8192, "%s", __cArray);
        snprintf(__cArray3, 8192, "%s", "");
        ReportTableRow(__tableHandle, 0, __cArray2, "Bytes", __bArray2, __bArrayCtr2, __cArray3, __oneOfFlag, __bSetInCheckAlignment);
        ReportCell(__tableHandle, __bArray, __bArrayCtr);
        ReportCellResult(__tableHandle, __csr, __ePassFail);
      }
    
      __res = __res && __csr;
    
    }
    ReportTableEndVerdict(__tableHandle, __cEvaluateResponse, __res);
	__bVerdict = __bVerdict && __res;
  }
  if (__bVerdict == __eVerdictFail)
    TestReportWriteDiagObjectList();
}
void Tt4h42sqi_Tet_Tc166_Completion()
{
  stack long __tableHandle;
  TestCompletionBegin();
  {
    {
      CreateTTEIFFunction("Tt4h42sqi_General_Postconditions", __eFct, __eLocal);
      CallInterfaceFunction(__cEmpty, __cEmpty, "8c04fef4-3bbc-4cc8-b3ee-b62ec5ff47eb");
    }


  }
  TestCompletionEnd();
}

void Tt4h42sqi_Tet_Tc167()
{
  CreateTTEIFFunction("Tt4h42sqi_Tc167", __eTcDef, __eLocal);  
  AddIFParameterTestCaseAttribute("TC_ID", "");
  AddIFParameterTestCaseAttribute("Test Case ID", "");
  CallInterfaceFunction("TC_ID_20205310_Extended_Session", __cEmpty , __cEmpty );
}
testcase Tt4h42sqi_Tc167()
{
  stack long __tableHandle;
  SetBreakOnFail(0);

  CreateTTEIFFunction("Tt4h42sqi_Tet_Tc167_Completion", __eFct, __eLocal);
  
  AddIFAsCleanUpFunction();

  TestPreparationBegin();
  {
    {
      CreateTTEIFFunction("Tt4h42sqi_General_Precondition", __eFct, __eLocal);
      CallInterfaceFunction(__cEmpty, __cEmpty, "74787266-8376-4866-a392-d0cc32109fae");
    }


  }
  TestPreparationEnd();

  TestCommandBegin(__eDiagService, __cDiagService, "", "1");
  {
    if (DiagIsFunctionalGroup("CVADAS_0001_00000000_000"))
    {
      DiagResponse * __resp;
      DiagRequest CVADAS_0001_00000000_000.Extended_Diagnostic_Session_Start __req;
      __diagService4h42sqi_99(__req, __resp);
    }
    else
    {
      DiagResponse CVADAS_0001_00000000_000.* __resp;
      DiagRequest CVADAS_0001_00000000_000.Extended_Diagnostic_Session_Start __req;
      __diagService4h42sqi_99(__req, __resp);
    }
  }
  TestCommandEnd();


  {
    CreateTTEIFFunction("Tt4h42sqi__14_Clear_Diag_Info_Physical_Add", __eFct, __eLocal);
    CallInterfaceFunction(__cEmpty, __cEmpty, "40838b5f-11dc-4109-b8cf-d5b7edc39c35");
  }


  TestCommandBegin(__eWait, __cWait, "", "3");
  {
    Wait("1", (1000 * 1000000LL), 1000000, "");
  }
  TestCommandEnd();

  {
    CreateTTEIFFunction("Tt4h42sqi__19_02_Report_DTC_By_Status_Mask_Physical_Add", __eFct, __eLocal);
    CallInterfaceFunction(__cEmpty, __cEmpty, "80b4f264-ae49-4a22-969d-f9650a5d9f64");
  }



}

  
void __diagService4h42sqi_99(DiagRequest * __req, DiagResponse * __resp )
{
  stack long __tableHandle;
  long __res, __paramLen, __bytePos;

   __bVerdict = __eVerdictPass;

  do {
    TestReportResetDiagObjectList();
    DiagSetReportDetailLevel("CVADAS_0001_00000000_000", EnumServiceDetails_onfail);
    // Request aspect
    {

      if (0 >= DiagSendReqAndWaitForResp("CVADAS_0001_00000000_000", __req, __resp, __res, -1, -1, -1, -1, -1, EnumResult_pos, EnumServiceDetails_onfail, EnumSendingMode_physical, EnumSuppressPosResBit_asconfigured, EnumVerdictOnInvalidValues_fail))
        break;
    }

    __res = DiagErrCodeTestStep(__res, "Can't retrieve last response for request! No check possible.") < 0;
    if(__res)
    {
	  __bVerdict = __eVerdictFail;
      break;
    }
    {
      __res = DiagInterpretAs(__resp, "DSC_PR");
      if(__res != 0)
      {
        __bVerdict = __eVerdictFail;
        DiagErrCodeTestStep(__res, "Can't interpret response as diagnostic primitive 'DSC_PR'.");
        break;
      }
      else
      {
        TestStepPass( "Received primitive can be interpreted as diagnostic primitive 'DSC_PR'.");
      }
    }
  }
  while(0);


  // Response, check & read aspect
  {
    __res = 1;
    __tableHandle = ReportTableHead5Columns(__cCheckCaption, __cTSym, __cTOp, __cRefVal, __cActual, __cRes);
    {
      __bDiagValueArrayCtr = DiagGetParameterErrorHandled(__resp, "DiagSessionType", __bDiagValueArray, elcount(__bDiagValueArray), __cDiagValueArray, elcount(__cDiagValueArray));
      {
        byte __bArray2[1] = { 0x03 };
        __bArrayCtr = __CopyBytes(__bDiagValueArray, __bDiagValueArrayCtr, __bArray);
        __bArrayCtr2 = elCount(__bArray2);
        __csr = CompareBytes(__bArray, __bArrayCtr, __bArray2, __bArrayCtr2) == 0;
        snprintf(__cArray, 8192, "%s", "Diagnostic parameter \'DiagSessionType\'");
        snprintf(__cArray2, 8192, "%s", __cArray);
        snprintf(__cArray3, 8192, "%s", "");
        ReportTableRow(__tableHandle, 0, __cArray2, "Bytes", __bArray2, __bArrayCtr2, __cArray3, __oneOfFlag, __bSetInCheckAlignment);
        ReportCell(__tableHandle, __bArray, __bArrayCtr);
        ReportCellResult(__tableHandle, __csr, __ePassFail);
      }
    
      __res = __res && __csr;
    
    }
    ReportTableEndVerdict(__tableHandle, __cEvaluateResponse, __res);
	__bVerdict = __bVerdict && __res;
  }
  if (__bVerdict == __eVerdictFail)
    TestReportWriteDiagObjectList();
}
void Tt4h42sqi_Tet_Tc167_Completion()
{
  stack long __tableHandle;
  TestCompletionBegin();
  {
    {
      CreateTTEIFFunction("Tt4h42sqi_General_Postconditions", __eFct, __eLocal);
      CallInterfaceFunction(__cEmpty, __cEmpty, "8c04fef4-3bbc-4cc8-b3ee-b62ec5ff47eb");
    }


  }
  TestCompletionEnd();
}

void Tt4h42sqi_Tet_Tc168()
{
  CreateTTEIFFunction("Tt4h42sqi_Tc168", __eTcDef, __eLocal);  
  AddIFParameterTestCaseAttribute("TC_ID", "");
  AddIFParameterTestCaseAttribute("Test Case ID", "");
  CallInterfaceFunction("TC_ID_20205295_Hard_Reset", __cEmpty , __cEmpty );
}
testcase Tt4h42sqi_Tc168()
{
  stack long __tableHandle;
  SetBreakOnFail(0);

  CreateTTEIFFunction("Tt4h42sqi_Tet_Tc168_Completion", __eFct, __eLocal);
  
  AddIFAsCleanUpFunction();

  TestPreparationBegin();
  {
    {
      CreateTTEIFFunction("Tt4h42sqi_General_Precondition", __eFct, __eLocal);
      CallInterfaceFunction(__cEmpty, __cEmpty, "74787266-8376-4866-a392-d0cc32109fae");
    }


  }
  TestPreparationEnd();

  {
    CreateCaplIFFunction("startTesterPresent", __eTestFct);
    CallInterfaceFunction("startTesterPresent ()", __cEmpty, "2");
  }


  TestCommandBegin(__eDiagService, __cDiagService, "", "3");
  {
    if (DiagIsFunctionalGroup("CVADAS_0001_00000000_000"))
    {
      DiagResponse * __resp;
      DiagRequest CVADAS_0001_00000000_000.Default_Session_Start __req;
      __diagService4h42sqi_100(__req, __resp);
    }
    else
    {
      DiagResponse CVADAS_0001_00000000_000.* __resp;
      DiagRequest CVADAS_0001_00000000_000.Default_Session_Start __req;
      __diagService4h42sqi_100(__req, __resp);
    }
  }
  TestCommandEnd();


  TestCommandBegin(__eDiagService, __cDiagService, "", "4");
  {
    if (DiagIsFunctionalGroup("CVADAS_0001_00000000_000"))
    {
      DiagResponse * __resp;
      DiagRequest CVADAS_0001_00000000_000.Extended_Diagnostic_Session_Start __req;
      __diagService4h42sqi_101(__req, __resp);
    }
    else
    {
      DiagResponse CVADAS_0001_00000000_000.* __resp;
      DiagRequest CVADAS_0001_00000000_000.Extended_Diagnostic_Session_Start __req;
      __diagService4h42sqi_101(__req, __resp);
    }
  }
  TestCommandEnd();


  {
    CreateTTEIFFunction("Tt4h42sqi_Hard_Reset_with_Physical_Address", __eFct, __eLocal);
    CallInterfaceFunction(__cEmpty, __cEmpty, "89dfe39a-bb1d-4a37-afea-34e7a683daba");
  }


  TestCommandBegin(__eWait, __cWait, "", "6");
  {
    Wait("1", (15 * 1000000000LL), 1000000000, "");
  }
  TestCommandEnd();

  {
    CreateTTEIFFunction("Tt4h42sqi__14_Clear_Diag_Info_Physical_Add", __eFct, __eLocal);
    CallInterfaceFunction(__cEmpty, __cEmpty, "40838b5f-11dc-4109-b8cf-d5b7edc39c35");
  }


  TestCommandBegin(__eWait, __cWait, "", "8");
  {
    Wait("1", (1000 * 1000000LL), 1000000, "");
  }
  TestCommandEnd();

  {
    CreateTTEIFFunction("Tt4h42sqi__19_02_Report_DTC_By_Status_Mask_Physical_Add", __eFct, __eLocal);
    CallInterfaceFunction(__cEmpty, __cEmpty, "80b4f264-ae49-4a22-969d-f9650a5d9f64");
  }



}

  
void __diagService4h42sqi_100(DiagRequest * __req, DiagResponse * __resp )
{
  stack long __tableHandle;
  long __res, __paramLen, __bytePos;

   __bVerdict = __eVerdictPass;

  do {
    TestReportResetDiagObjectList();
    DiagSetReportDetailLevel("CVADAS_0001_00000000_000", EnumServiceDetails_onfail);
    // Request aspect
    {

      if (0 >= DiagSendReqAndWaitForResp("CVADAS_0001_00000000_000", __req, __resp, __res, -1, -1, -1, -1, -1, EnumResult_pos, EnumServiceDetails_onfail, EnumSendingMode_physical, EnumSuppressPosResBit_asconfigured, EnumVerdictOnInvalidValues_fail))
        break;
    }

    __res = DiagErrCodeTestStep(__res, "Can't retrieve last response for request! No check possible.") < 0;
    if(__res)
    {
	  __bVerdict = __eVerdictFail;
      break;
    }
    {
      __res = DiagInterpretAs(__resp, "DSC_PR");
      if(__res != 0)
      {
        __bVerdict = __eVerdictFail;
        DiagErrCodeTestStep(__res, "Can't interpret response as diagnostic primitive 'DSC_PR'.");
        break;
      }
      else
      {
        TestStepPass( "Received primitive can be interpreted as diagnostic primitive 'DSC_PR'.");
      }
    }
  }
  while(0);


  // Response, check & read aspect
  {
    __res = 1;
    __tableHandle = ReportTableHead5Columns(__cCheckCaption, __cTSym, __cTOp, __cRefVal, __cActual, __cRes);
    {
      __bDiagValueArrayCtr = DiagGetParameterErrorHandled(__resp, "DiagSessionType", __bDiagValueArray, elcount(__bDiagValueArray), __cDiagValueArray, elcount(__cDiagValueArray));
      {
        byte __bArray2[1] = { 0x01 };
        __bArrayCtr = __CopyBytes(__bDiagValueArray, __bDiagValueArrayCtr, __bArray);
        __bArrayCtr2 = elCount(__bArray2);
        __csr = CompareBytes(__bArray, __bArrayCtr, __bArray2, __bArrayCtr2) == 0;
        snprintf(__cArray, 8192, "%s", "Diagnostic parameter \'DiagSessionType\'");
        snprintf(__cArray2, 8192, "%s", __cArray);
        snprintf(__cArray3, 8192, "%s", "");
        ReportTableRow(__tableHandle, 0, __cArray2, "Bytes", __bArray2, __bArrayCtr2, __cArray3, __oneOfFlag, __bSetInCheckAlignment);
        ReportCell(__tableHandle, __bArray, __bArrayCtr);
        ReportCellResult(__tableHandle, __csr, __ePassFail);
      }
    
      __res = __res && __csr;
    
    }
    ReportTableEndVerdict(__tableHandle, __cEvaluateResponse, __res);
	__bVerdict = __bVerdict && __res;
  }
  if (__bVerdict == __eVerdictFail)
    TestReportWriteDiagObjectList();
}
  
void __diagService4h42sqi_101(DiagRequest * __req, DiagResponse * __resp )
{
  stack long __tableHandle;
  long __res, __paramLen, __bytePos;

   __bVerdict = __eVerdictPass;

  do {
    TestReportResetDiagObjectList();
    DiagSetReportDetailLevel("CVADAS_0001_00000000_000", EnumServiceDetails_onfail);
    // Request aspect
    {

      if (0 >= DiagSendReqAndWaitForResp("CVADAS_0001_00000000_000", __req, __resp, __res, -1, -1, -1, -1, -1, EnumResult_pos, EnumServiceDetails_onfail, EnumSendingMode_physical, EnumSuppressPosResBit_asconfigured, EnumVerdictOnInvalidValues_fail))
        break;
    }

    __res = DiagErrCodeTestStep(__res, "Can't retrieve last response for request! No check possible.") < 0;
    if(__res)
    {
	  __bVerdict = __eVerdictFail;
      break;
    }
    {
      __res = DiagInterpretAs(__resp, "DSC_PR");
      if(__res != 0)
      {
        __bVerdict = __eVerdictFail;
        DiagErrCodeTestStep(__res, "Can't interpret response as diagnostic primitive 'DSC_PR'.");
        break;
      }
      else
      {
        TestStepPass( "Received primitive can be interpreted as diagnostic primitive 'DSC_PR'.");
      }
    }
  }
  while(0);


  // Response, check & read aspect
  {
    __res = 1;
    __tableHandle = ReportTableHead5Columns(__cCheckCaption, __cTSym, __cTOp, __cRefVal, __cActual, __cRes);
    {
      __bDiagValueArrayCtr = DiagGetParameterErrorHandled(__resp, "DiagSessionType", __bDiagValueArray, elcount(__bDiagValueArray), __cDiagValueArray, elcount(__cDiagValueArray));
      {
        byte __bArray2[1] = { 0x03 };
        __bArrayCtr = __CopyBytes(__bDiagValueArray, __bDiagValueArrayCtr, __bArray);
        __bArrayCtr2 = elCount(__bArray2);
        __csr = CompareBytes(__bArray, __bArrayCtr, __bArray2, __bArrayCtr2) == 0;
        snprintf(__cArray, 8192, "%s", "Diagnostic parameter \'DiagSessionType\'");
        snprintf(__cArray2, 8192, "%s", __cArray);
        snprintf(__cArray3, 8192, "%s", "");
        ReportTableRow(__tableHandle, 0, __cArray2, "Bytes", __bArray2, __bArrayCtr2, __cArray3, __oneOfFlag, __bSetInCheckAlignment);
        ReportCell(__tableHandle, __bArray, __bArrayCtr);
        ReportCellResult(__tableHandle, __csr, __ePassFail);
      }
    
      __res = __res && __csr;
    
    }
    ReportTableEndVerdict(__tableHandle, __cEvaluateResponse, __res);
	__bVerdict = __bVerdict && __res;
  }
  if (__bVerdict == __eVerdictFail)
    TestReportWriteDiagObjectList();
}
void Tt4h42sqi_Tet_Tc168_Completion()
{
  stack long __tableHandle;
  TestCompletionBegin();
  {
    {
      CreateTTEIFFunction("Tt4h42sqi_General_Postconditions", __eFct, __eLocal);
      CallInterfaceFunction(__cEmpty, __cEmpty, "8c04fef4-3bbc-4cc8-b3ee-b62ec5ff47eb");
    }


  }
  TestCompletionEnd();
}

void Tt4h42sqi_Tet_Tc169()
{
  CreateTTEIFFunction("Tt4h42sqi_Tc169", __eTcDef, __eLocal);  
  AddIFParameterTestCaseAttribute("TC_ID", "");
  AddIFParameterTestCaseAttribute("Test Case ID", "");
  CallInterfaceFunction("TC_ID_20205287", __cEmpty , __cEmpty );
}
testcase Tt4h42sqi_Tc169()
{
  stack long __tableHandle;
  SetBreakOnFail(0);

  CreateTTEIFFunction("Tt4h42sqi_Tet_Tc169_Completion", __eFct, __eLocal);
  
  AddIFAsCleanUpFunction();

  TestPreparationBegin();
  {
    {
      CreateTTEIFFunction("Tt4h42sqi_General_Precondition", __eFct, __eLocal);
      CallInterfaceFunction(__cEmpty, __cEmpty, "74787266-8376-4866-a392-d0cc32109fae");
    }


  }
  TestPreparationEnd();

  {
    CreateCaplIFFunction("Power_Supply_OFF", __eFct);
    CallInterfaceFunction(__cEmpty, __cEmpty, "1");
  }


  TestCommandBegin(__eWait, __cWait, "", "2");
  {
    Wait("1", (2000 * 1000000LL), 1000000, "");
  }
  TestCommandEnd();

  {
    CreateCaplIFFunction("Power_Supply_ON", __eFct);
    CallInterfaceFunction(__cEmpty, __cEmpty, "3");
  }


  TestCommandBegin(__eWait, __cWait, "", "4");
  {
    Wait("1", (3500 * 1000000LL), 1000000, "");
  }
  TestCommandEnd();

  TestCommandBegin(__eSet, __cSet, "", "20");
  {
    __tableHandle = ReportTableHead3Columns(__cSetCaption , __cTSym, __cTOp, __cAssigned); 
    {
      @`MEnv_Default_SET_BOL_1 = 0;
      snprintf(__cArray, 8192, "%s", "MEnv_Default_SET_BOL_1");
      snprintf(__cArray2, 8192, "%s '%s'", __cEnvVar, __cArray);
      snprintf(__cArray3, 8192, "%s", "");
      
      ReportTableRow(__tableHandle, 0, __cArray2, __cAOp, 0, __cArray3, __oneOfFlag, __bSetInCheckAlignment);
      
  
    }
    ReportTableEndTestStep(__tableHandle, "1");
  }
  TestCommandEnd();


  TestCommandBegin(__eWait, __cWait, "", "21");
  {
    Wait("1", (200 * 1000000LL), 1000000, "");
  }
  TestCommandEnd();

  TestCommandBegin(__eSet, __cSet, "", "22");
  {
    __tableHandle = ReportTableHead3Columns(__cSetCaption , __cTSym, __cTOp, __cAssigned); 
    {
      @`MEnv_Default_SET_BOL_1 = 1;
      snprintf(__cArray, 8192, "%s", "MEnv_Default_SET_BOL_1");
      snprintf(__cArray2, 8192, "%s '%s'", __cEnvVar, __cArray);
      snprintf(__cArray3, 8192, "%s", "");
      
      ReportTableRow(__tableHandle, 0, __cArray2, __cAOp, 1, __cArray3, __oneOfFlag, __bSetInCheckAlignment);
      
  
    }
    ReportTableEndTestStep(__tableHandle, "1");
  }
  TestCommandEnd();


  TestCommandBegin(__eWait, __cWait, "", "23");
  {
    Wait("1", (3100 * 1000000LL), 1000000, "");
  }
  TestCommandEnd();

  {
    CreateCaplIFFunction("startTesterPresent", __eTestFct);
    CallInterfaceFunction("startTesterPresent ()", __cEmpty, "24");
  }


  TestCommandBegin(__eWait, __cWait, "", "25");
  {
    Wait("1", (50 * 1000000LL), 1000000, "");
  }
  TestCommandEnd();

  TestCommandBegin(__eDiagService, __cDiagService, "", "26");
  {
    if (DiagIsFunctionalGroup("CVADAS_0001_00000000_000"))
    {
      DiagResponse * __resp;
      DiagRequest CVADAS_0001_00000000_000.Extended_Diagnostic_Session_Start __req;
      __diagService4h42sqi_102(__req, __resp);
    }
    else
    {
      DiagResponse CVADAS_0001_00000000_000.* __resp;
      DiagRequest CVADAS_0001_00000000_000.Extended_Diagnostic_Session_Start __req;
      __diagService4h42sqi_102(__req, __resp);
    }
  }
  TestCommandEnd();


  {
    CreateCaplIFFunction("startTesterPresent", __eTestFct);
    CallInterfaceFunction("startTesterPresent ()", __cEmpty, "27");
  }


  TestCommandBegin(__eWait, __cWait, "", "28");
  {
    Wait("1", (50 * 1000000LL), 1000000, "");
  }
  TestCommandEnd();

  TestCommandBegin(__eDiagService, __cDiagService, "", "29");
  {
    if (DiagIsFunctionalGroup("CVADAS_0001_00000000_000"))
    {
      DiagResponse * __resp;
      DiagRequest CVADAS_0001_00000000_000._221004_Battery_Voltage __req;
      __diagService4h42sqi_103(__req, __resp);
    }
    else
    {
      DiagResponse CVADAS_0001_00000000_000.* __resp;
      DiagRequest CVADAS_0001_00000000_000._221004_Battery_Voltage __req;
      __diagService4h42sqi_103(__req, __resp);
    }
  }
  TestCommandEnd();


  TestCommandBegin(__eWait, __cWait, "", "30");
  {
    Wait("1", (50 * 1000000LL), 1000000, "");
  }
  TestCommandEnd();

  {
    CreateTTEIFFunction("Tt4h42sqi__14_Clear_Diag_Info_Physical_Add", __eFct, __eLocal);
    CallInterfaceFunction(__cEmpty, __cEmpty, "40838b5f-11dc-4109-b8cf-d5b7edc39c35");
  }


  TestCommandBegin(__eWait, __cWait, "", "32");
  {
    Wait("1", (1000 * 1000000LL), 1000000, "");
  }
  TestCommandEnd();

  {
    CreateTTEIFFunction("Tt4h42sqi__19_02_Report_DTC_By_Status_Mask_Physical_Add", __eFct, __eLocal);
    CallInterfaceFunction(__cEmpty, __cEmpty, "80b4f264-ae49-4a22-969d-f9650a5d9f64");
  }



}

  
void __diagService4h42sqi_102(DiagRequest * __req, DiagResponse * __resp )
{
  stack long __tableHandle;
  long __res, __paramLen, __bytePos;

   __bVerdict = __eVerdictPass;

  do {
    TestReportResetDiagObjectList();
    DiagSetReportDetailLevel("CVADAS_0001_00000000_000", EnumServiceDetails_onfail);
    // Request aspect
    {

      if (0 >= DiagSendReqAndWaitForResp("CVADAS_0001_00000000_000", __req, __resp, __res, -1, -1, -1, -1, -1, EnumResult_pos, EnumServiceDetails_onfail, EnumSendingMode_physical, EnumSuppressPosResBit_asconfigured, EnumVerdictOnInvalidValues_fail))
        break;
    }

    __res = DiagErrCodeTestStep(__res, "Can't retrieve last response for request! No check possible.") < 0;
    if(__res)
    {
	  __bVerdict = __eVerdictFail;
      break;
    }
    {
      __res = DiagInterpretAs(__resp, "DSC_PR");
      if(__res != 0)
      {
        __bVerdict = __eVerdictFail;
        DiagErrCodeTestStep(__res, "Can't interpret response as diagnostic primitive 'DSC_PR'.");
        break;
      }
      else
      {
        TestStepPass( "Received primitive can be interpreted as diagnostic primitive 'DSC_PR'.");
      }
    }
  }
  while(0);


  // Response, check & read aspect
  {
    __res = 1;
    __tableHandle = ReportTableHead5Columns(__cCheckCaption, __cTSym, __cTOp, __cRefVal, __cActual, __cRes);
    {
      __bDiagValueArrayCtr = DiagGetParameterErrorHandled(__resp, "DiagSessionType", __bDiagValueArray, elcount(__bDiagValueArray), __cDiagValueArray, elcount(__cDiagValueArray));
      {
        byte __bArray2[1] = { 0x03 };
        __bArrayCtr = __CopyBytes(__bDiagValueArray, __bDiagValueArrayCtr, __bArray);
        __bArrayCtr2 = elCount(__bArray2);
        __csr = CompareBytes(__bArray, __bArrayCtr, __bArray2, __bArrayCtr2) == 0;
        snprintf(__cArray, 8192, "%s", "Diagnostic parameter \'DiagSessionType\'");
        snprintf(__cArray2, 8192, "%s", __cArray);
        snprintf(__cArray3, 8192, "%s", "");
        ReportTableRow(__tableHandle, 0, __cArray2, "Bytes", __bArray2, __bArrayCtr2, __cArray3, __oneOfFlag, __bSetInCheckAlignment);
        ReportCell(__tableHandle, __bArray, __bArrayCtr);
        ReportCellResult(__tableHandle, __csr, __ePassFail);
      }
    
      __res = __res && __csr;
    
    }
    ReportTableEndVerdict(__tableHandle, __cEvaluateResponse, __res);
	__bVerdict = __bVerdict && __res;
  }
  if (__bVerdict == __eVerdictFail)
    TestReportWriteDiagObjectList();
}
  
void __diagService4h42sqi_103(DiagRequest * __req, DiagResponse * __resp )
{
  stack long __tableHandle;
  long __res, __paramLen, __bytePos;

   __bVerdict = __eVerdictPass;

  do {
    TestReportResetDiagObjectList();
    DiagSetReportDetailLevel("CVADAS_0001_00000000_000", EnumServiceDetails_onfail);
    // Request aspect
    {

      if (0 >= DiagSendReqAndWaitForResp("CVADAS_0001_00000000_000", __req, __resp, __res, -1, -1, -1, -1, -1, EnumResult_pos, EnumServiceDetails_onfail, EnumSendingMode_physical, EnumSuppressPosResBit_asconfigured, EnumVerdictOnInvalidValues_fail))
        break;
    }

  }
  while(0);


  if (__bVerdict == __eVerdictFail)
    TestReportWriteDiagObjectList();
}
void Tt4h42sqi_Tet_Tc169_Completion()
{
  stack long __tableHandle;
  TestCompletionBegin();
  {
    {
      CreateTTEIFFunction("Tt4h42sqi_General_Postconditions", __eFct, __eLocal);
      CallInterfaceFunction(__cEmpty, __cEmpty, "8c04fef4-3bbc-4cc8-b3ee-b62ec5ff47eb");
    }


  }
  TestCompletionEnd();
}

void Tt4h42sqi_Tet_Tc170()
{
  CreateTTEIFFunction("Tt4h42sqi_Tc170", __eTcDef, __eLocal);  
  AddIFParameterTestCaseAttribute("TC_ID", "");
  AddIFParameterTestCaseAttribute("Test Case ID", "");
  CallInterfaceFunction("TC_ID_20205161_Extended_Session", __cEmpty , __cEmpty );
}
testcase Tt4h42sqi_Tc170()
{
  stack long __tableHandle;
  SetBreakOnFail(0);

  CreateTTEIFFunction("Tt4h42sqi_Tet_Tc170_Completion", __eFct, __eLocal);
  
  AddIFAsCleanUpFunction();

  TestPreparationBegin();
  {
    {
      CreateTTEIFFunction("Tt4h42sqi_General_Precondition", __eFct, __eLocal);
      CallInterfaceFunction(__cEmpty, __cEmpty, "74787266-8376-4866-a392-d0cc32109fae");
    }


  }
  TestPreparationEnd();

  TestCommandBegin(__eDiagService, __cDiagService, "", "2");
  {
    if (DiagIsFunctionalGroup("CVADAS_0001_00000000_000"))
    {
      DiagResponse * __resp;
      DiagRequest CVADAS_0001_00000000_000.Default_Session_Start __req;
      __diagService4h42sqi_104(__req, __resp);
    }
    else
    {
      DiagResponse CVADAS_0001_00000000_000.* __resp;
      DiagRequest CVADAS_0001_00000000_000.Default_Session_Start __req;
      __diagService4h42sqi_104(__req, __resp);
    }
  }
  TestCommandEnd();


  TestCommandBegin(__eDiagService, __cDiagService, "", "3");
  {
    if (DiagIsFunctionalGroup("CVADAS_0001_00000000_000"))
    {
      DiagResponse * __resp;
      DiagRequest CVADAS_0001_00000000_000.Extended_Diagnostic_Session_Start __req;
      __diagService4h42sqi_105(__req, __resp);
    }
    else
    {
      DiagResponse CVADAS_0001_00000000_000.* __resp;
      DiagRequest CVADAS_0001_00000000_000.Extended_Diagnostic_Session_Start __req;
      __diagService4h42sqi_105(__req, __resp);
    }
  }
  TestCommandEnd();



}

  
void __diagService4h42sqi_104(DiagRequest * __req, DiagResponse * __resp )
{
  stack long __tableHandle;
  long __res, __paramLen, __bytePos;

   __bVerdict = __eVerdictPass;

  do {
    TestReportResetDiagObjectList();
    DiagSetReportDetailLevel("CVADAS_0001_00000000_000", EnumServiceDetails_onfail);
    // Request aspect
    {

      if (0 >= DiagSendReqAndWaitForResp("CVADAS_0001_00000000_000", __req, __resp, __res, -1, -1, -1, -1, -1, EnumResult_pos, EnumServiceDetails_onfail, EnumSendingMode_physical, EnumSuppressPosResBit_asconfigured, EnumVerdictOnInvalidValues_fail))
        break;
    }

    __res = DiagErrCodeTestStep(__res, "Can't retrieve last response for request! No check possible.") < 0;
    if(__res)
    {
	  __bVerdict = __eVerdictFail;
      break;
    }
    {
      __res = DiagInterpretAs(__resp, "DSC_PR");
      if(__res != 0)
      {
        __bVerdict = __eVerdictFail;
        DiagErrCodeTestStep(__res, "Can't interpret response as diagnostic primitive 'DSC_PR'.");
        break;
      }
      else
      {
        TestStepPass( "Received primitive can be interpreted as diagnostic primitive 'DSC_PR'.");
      }
    }
  }
  while(0);


  // Response, check & read aspect
  {
    __res = 1;
    __tableHandle = ReportTableHead5Columns(__cCheckCaption, __cTSym, __cTOp, __cRefVal, __cActual, __cRes);
    {
      __bDiagValueArrayCtr = DiagGetParameterErrorHandled(__resp, "DiagSessionType", __bDiagValueArray, elcount(__bDiagValueArray), __cDiagValueArray, elcount(__cDiagValueArray));
      {
        byte __bArray2[1] = { 0x01 };
        __bArrayCtr = __CopyBytes(__bDiagValueArray, __bDiagValueArrayCtr, __bArray);
        __bArrayCtr2 = elCount(__bArray2);
        __csr = CompareBytes(__bArray, __bArrayCtr, __bArray2, __bArrayCtr2) == 0;
        snprintf(__cArray, 8192, "%s", "Diagnostic parameter \'DiagSessionType\'");
        snprintf(__cArray2, 8192, "%s", __cArray);
        snprintf(__cArray3, 8192, "%s", "");
        ReportTableRow(__tableHandle, 0, __cArray2, "Bytes", __bArray2, __bArrayCtr2, __cArray3, __oneOfFlag, __bSetInCheckAlignment);
        ReportCell(__tableHandle, __bArray, __bArrayCtr);
        ReportCellResult(__tableHandle, __csr, __ePassFail);
      }
    
      __res = __res && __csr;
    
    }
    ReportTableEndVerdict(__tableHandle, __cEvaluateResponse, __res);
	__bVerdict = __bVerdict && __res;
  }
  if (__bVerdict == __eVerdictFail)
    TestReportWriteDiagObjectList();
}
  
void __diagService4h42sqi_105(DiagRequest * __req, DiagResponse * __resp )
{
  stack long __tableHandle;
  long __res, __paramLen, __bytePos;

   __bVerdict = __eVerdictPass;

  do {
    TestReportResetDiagObjectList();
    DiagSetReportDetailLevel("CVADAS_0001_00000000_000", EnumServiceDetails_onfail);
    // Request aspect
    {

      if (0 >= DiagSendReqAndWaitForResp("CVADAS_0001_00000000_000", __req, __resp, __res, -1, -1, -1, -1, -1, EnumResult_pos, EnumServiceDetails_onfail, EnumSendingMode_physical, EnumSuppressPosResBit_asconfigured, EnumVerdictOnInvalidValues_fail))
        break;
    }

    __res = DiagErrCodeTestStep(__res, "Can't retrieve last response for request! No check possible.") < 0;
    if(__res)
    {
	  __bVerdict = __eVerdictFail;
      break;
    }
    {
      __res = DiagInterpretAs(__resp, "DSC_PR");
      if(__res != 0)
      {
        __bVerdict = __eVerdictFail;
        DiagErrCodeTestStep(__res, "Can't interpret response as diagnostic primitive 'DSC_PR'.");
        break;
      }
      else
      {
        TestStepPass( "Received primitive can be interpreted as diagnostic primitive 'DSC_PR'.");
      }
    }
  }
  while(0);


  // Response, check & read aspect
  {
    __res = 1;
    __tableHandle = ReportTableHead5Columns(__cCheckCaption, __cTSym, __cTOp, __cRefVal, __cActual, __cRes);
    {
      __bDiagValueArrayCtr = DiagGetParameterErrorHandled(__resp, "DiagSessionType", __bDiagValueArray, elcount(__bDiagValueArray), __cDiagValueArray, elcount(__cDiagValueArray));
      {
        byte __bArray2[1] = { 0x03 };
        __bArrayCtr = __CopyBytes(__bDiagValueArray, __bDiagValueArrayCtr, __bArray);
        __bArrayCtr2 = elCount(__bArray2);
        __csr = CompareBytes(__bArray, __bArrayCtr, __bArray2, __bArrayCtr2) == 0;
        snprintf(__cArray, 8192, "%s", "Diagnostic parameter \'DiagSessionType\'");
        snprintf(__cArray2, 8192, "%s", __cArray);
        snprintf(__cArray3, 8192, "%s", "");
        ReportTableRow(__tableHandle, 0, __cArray2, "Bytes", __bArray2, __bArrayCtr2, __cArray3, __oneOfFlag, __bSetInCheckAlignment);
        ReportCell(__tableHandle, __bArray, __bArrayCtr);
        ReportCellResult(__tableHandle, __csr, __ePassFail);
      }
    
      __res = __res && __csr;
    
    }
    ReportTableEndVerdict(__tableHandle, __cEvaluateResponse, __res);
	__bVerdict = __bVerdict && __res;
  }
  if (__bVerdict == __eVerdictFail)
    TestReportWriteDiagObjectList();
}
void Tt4h42sqi_Tet_Tc170_Completion()
{
  stack long __tableHandle;
  TestCompletionBegin();
  {
    {
      CreateTTEIFFunction("Tt4h42sqi_General_Postconditions", __eFct, __eLocal);
      CallInterfaceFunction(__cEmpty, __cEmpty, "8c04fef4-3bbc-4cc8-b3ee-b62ec5ff47eb");
    }


  }
  TestCompletionEnd();
}

void Tt4h42sqi_Tet_Tc171()
{
  CreateTTEIFFunction("Tt4h42sqi_Tc171", __eTcDef, __eLocal);  
  AddIFParameterTestCaseAttribute("TC_ID", "18129218");
  AddIFParameterTestCaseAttribute("Test Case ID", "");
  CallInterfaceFunction("Test Case_20205066_ECU_Reset_Service_in_Default_Session", __cEmpty , __cEmpty );
}
testcase Tt4h42sqi_Tc171()
{
  stack long __tableHandle;
  SetBreakOnFail(1);

  CreateTTEIFFunction("Tt4h42sqi_Tet_Tc171_Completion", __eFct, __eLocal);
  
  AddIFAsCleanUpFunction();

  TestPreparationBegin();
  {
    {
      CreateTTEIFFunction("Tt4h42sqi_General_Precondition", __eFct, __eLocal);
      CallInterfaceFunction(__cEmpty, __cEmpty, "74787266-8376-4866-a392-d0cc32109fae");
    }


  }
  TestPreparationEnd();

  TestCaseDescription("$11 ECU Reset with Physical Address in Default Session");

  {
    CreateCaplIFFunction("startTesterPresent", __eTestFct);
    CallInterfaceFunction("startTesterPresent ()", __cEmpty, "1");
  }


  TestCommandBegin(__eDiagService, __cDiagService, "", "2");
  {
    if (DiagIsFunctionalGroup("CVADAS_0001_00000000_000"))
    {
      DiagResponse * __resp;
      DiagRequest CVADAS_0001_00000000_000.Default_Session_Start __req;
      __diagService4h42sqi_106(__req, __resp);
    }
    else
    {
      DiagResponse CVADAS_0001_00000000_000.* __resp;
      DiagRequest CVADAS_0001_00000000_000.Default_Session_Start __req;
      __diagService4h42sqi_106(__req, __resp);
    }
  }
  TestCommandEnd();


  {
    CreateTTEIFFunction("Tt4h42sqi_F186_DID_with_PhysicalAdd_DefaultSession", __eFct, __eLocal);
    CallInterfaceFunction(__cEmpty, __cEmpty, "f479ea65-8c8c-4093-b3d8-2a8374608569");
  }


  {
    CreateTTEIFFunction("Tt4h42sqi_Hard_Reset_with_Physical_Address", __eFct, __eLocal);
    CallInterfaceFunction(__cEmpty, __cEmpty, "89dfe39a-bb1d-4a37-afea-34e7a683daba");
  }


  TestCommandBegin(__eWait, __cWait, "", "5");
  {
    Wait("1", (15 * 1000000000LL), 1000000000, "");
  }
  TestCommandEnd();

  {
    CreateTTEIFFunction("Tt4h42sqi_F186_DID_with_PhysicalAdd_DefaultSession", __eFct, __eLocal);
    CallInterfaceFunction(__cEmpty, __cEmpty, "f479ea65-8c8c-4093-b3d8-2a8374608569");
  }



}

  
void __diagService4h42sqi_106(DiagRequest * __req, DiagResponse * __resp )
{
  stack long __tableHandle;
  long __res, __paramLen, __bytePos;

   __bVerdict = __eVerdictPass;

  do {
    TestReportResetDiagObjectList();
    DiagSetReportDetailLevel("CVADAS_0001_00000000_000", EnumServiceDetails_onfail);
    // Request aspect
    {

      if (0 >= DiagSendReqAndWaitForResp("CVADAS_0001_00000000_000", __req, __resp, __res, -1, -1, -1, -1, -1, EnumResult_pos, EnumServiceDetails_onfail, EnumSendingMode_physical, EnumSuppressPosResBit_asconfigured, EnumVerdictOnInvalidValues_fail))
        break;
    }

    __res = DiagErrCodeTestStep(__res, "Can't retrieve last response for request! No check possible.") < 0;
    if(__res)
    {
	  __bVerdict = __eVerdictFail;
      break;
    }
    {
      __res = DiagInterpretAs(__resp, "DSC_PR");
      if(__res != 0)
      {
        __bVerdict = __eVerdictFail;
        DiagErrCodeTestStep(__res, "Can't interpret response as diagnostic primitive 'DSC_PR'.");
        break;
      }
      else
      {
        TestStepPass( "Received primitive can be interpreted as diagnostic primitive 'DSC_PR'.");
      }
    }
  }
  while(0);


  // Response, check & read aspect
  {
    __res = 1;
    __tableHandle = ReportTableHead5Columns(__cCheckCaption, __cTSym, __cTOp, __cRefVal, __cActual, __cRes);
    {
      __bDiagValueArrayCtr = DiagGetParameterErrorHandled(__resp, "DiagSessionType", __bDiagValueArray, elcount(__bDiagValueArray), __cDiagValueArray, elcount(__cDiagValueArray));
      {
        byte __bArray2[1] = { 0x01 };
        __bArrayCtr = __CopyBytes(__bDiagValueArray, __bDiagValueArrayCtr, __bArray);
        __bArrayCtr2 = elCount(__bArray2);
        __csr = CompareBytes(__bArray, __bArrayCtr, __bArray2, __bArrayCtr2) == 0;
        snprintf(__cArray, 8192, "%s", "Diagnostic parameter \'DiagSessionType\'");
        snprintf(__cArray2, 8192, "%s", __cArray);
        snprintf(__cArray3, 8192, "%s", "");
        ReportTableRow(__tableHandle, 0, __cArray2, "Bytes", __bArray2, __bArrayCtr2, __cArray3, __oneOfFlag, __bSetInCheckAlignment);
        ReportCell(__tableHandle, __bArray, __bArrayCtr);
        ReportCellResult(__tableHandle, __csr, __ePassFail);
      }
    
      __res = __res && __csr;
    
    }
    ReportTableEndVerdict(__tableHandle, __cEvaluateResponse, __res);
	__bVerdict = __bVerdict && __res;
  }
  if (__bVerdict == __eVerdictFail)
    TestReportWriteDiagObjectList();
}
void Tt4h42sqi_Tet_Tc171_Completion()
{
  stack long __tableHandle;
  TestCompletionBegin();
  {
    {
      CreateTTEIFFunction("Tt4h42sqi_General_Postconditions", __eFct, __eLocal);
      CallInterfaceFunction(__cEmpty, __cEmpty, "8c04fef4-3bbc-4cc8-b3ee-b62ec5ff47eb");
    }


  }
  TestCompletionEnd();
}

void Tt4h42sqi_Tet_Tc172()
{
  CreateTTEIFFunction("Tt4h42sqi_Tc172", __eTcDef, __eLocal);  
  AddIFParameterTestCaseAttribute("TC_ID", "18137867");
  AddIFParameterTestCaseAttribute("Test Case ID", "");
  CallInterfaceFunction("Test Case_20205046_ECU_Reset_Service_in_Default_Session_Functional_Request", __cEmpty , __cEmpty );
}
testcase Tt4h42sqi_Tc172()
{
  stack long __tableHandle;
  SetBreakOnFail(1);

  CreateTTEIFFunction("Tt4h42sqi_Tet_Tc172_Completion", __eFct, __eLocal);
  
  AddIFAsCleanUpFunction();

  TestPreparationBegin();
  {
    {
      CreateTTEIFFunction("Tt4h42sqi_General_Precondition", __eFct, __eLocal);
      CallInterfaceFunction(__cEmpty, __cEmpty, "74787266-8376-4866-a392-d0cc32109fae");
    }


  }
  TestPreparationEnd();

  TestCaseDescription("$11 ECU Reset with Physical Address in Default Session");

  {
    CreateCaplIFFunction("startTesterPresent", __eTestFct);
    CallInterfaceFunction("startTesterPresent ()", __cEmpty, "1");
  }


  TestCommandBegin(__eDiagService, __cDiagService, "", "2");
  {
    if (DiagIsFunctionalGroup("CVADAS_0001_00000000_000"))
    {
      DiagResponse * __resp;
      DiagRequest CVADAS_0001_00000000_000.Default_Session_Start __req;
      __diagService4h42sqi_107(__req, __resp);
    }
    else
    {
      DiagResponse CVADAS_0001_00000000_000.* __resp;
      DiagRequest CVADAS_0001_00000000_000.Default_Session_Start __req;
      __diagService4h42sqi_107(__req, __resp);
    }
  }
  TestCommandEnd();


  {
    CreateTTEIFFunction("Tt4h42sqi_F186_DID_with_FunctionalAdd_DefaultSession", __eFct, __eLocal);
    CallInterfaceFunction(__cEmpty, __cEmpty, "7f56649c-31a8-40e2-91d8-6a45f0d55a04");
  }


  {
    CreateTTEIFFunction("Tt4h42sqi_Hard_Reset_with_Functional_Address", __eFct, __eLocal);
    CallInterfaceFunction(__cEmpty, __cEmpty, "70a054ee-692b-447c-9761-32bc0c5ba62c");
  }


  TestCommandBegin(__eWait, __cWait, "", "5");
  {
    Wait("1", (15 * 1000000000LL), 1000000000, "");
  }
  TestCommandEnd();

  {
    CreateTTEIFFunction("Tt4h42sqi_F186_DID_with_FunctionalAdd_DefaultSession", __eFct, __eLocal);
    CallInterfaceFunction(__cEmpty, __cEmpty, "7f56649c-31a8-40e2-91d8-6a45f0d55a04");
  }



}

  
void __diagService4h42sqi_107(DiagRequest * __req, DiagResponse * __resp )
{
  stack long __tableHandle;
  long __res, __paramLen, __bytePos;

   __bVerdict = __eVerdictPass;

  do {
    TestReportResetDiagObjectList();
    DiagSetReportDetailLevel("CVADAS_0001_00000000_000", EnumServiceDetails_onfail);
    // Request aspect
    {

      if (0 >= DiagSendReqAndWaitForResp("CVADAS_0001_00000000_000", __req, __resp, __res, -1, -1, -1, -1, -1, EnumResult_pos, EnumServiceDetails_onfail, EnumSendingMode_functional, EnumSuppressPosResBit_asconfigured, EnumVerdictOnInvalidValues_fail))
        break;
    }

    __res = DiagErrCodeTestStep(__res, "Can't retrieve last response for request! No check possible.") < 0;
    if(__res)
    {
	  __bVerdict = __eVerdictFail;
      break;
    }
    {
      __res = DiagInterpretAs(__resp, "DSC_PR");
      if(__res != 0)
      {
        __bVerdict = __eVerdictFail;
        DiagErrCodeTestStep(__res, "Can't interpret response as diagnostic primitive 'DSC_PR'.");
        break;
      }
      else
      {
        TestStepPass( "Received primitive can be interpreted as diagnostic primitive 'DSC_PR'.");
      }
    }
  }
  while(0);


  // Response, check & read aspect
  {
    __res = 1;
    __tableHandle = ReportTableHead5Columns(__cCheckCaption, __cTSym, __cTOp, __cRefVal, __cActual, __cRes);
    {
      __bDiagValueArrayCtr = DiagGetParameterErrorHandled(__resp, "DiagSessionType", __bDiagValueArray, elcount(__bDiagValueArray), __cDiagValueArray, elcount(__cDiagValueArray));
      {
        byte __bArray2[1] = { 0x01 };
        __bArrayCtr = __CopyBytes(__bDiagValueArray, __bDiagValueArrayCtr, __bArray);
        __bArrayCtr2 = elCount(__bArray2);
        __csr = CompareBytes(__bArray, __bArrayCtr, __bArray2, __bArrayCtr2) == 0;
        snprintf(__cArray, 8192, "%s", "Diagnostic parameter \'DiagSessionType\'");
        snprintf(__cArray2, 8192, "%s", __cArray);
        snprintf(__cArray3, 8192, "%s", "");
        ReportTableRow(__tableHandle, 0, __cArray2, "Bytes", __bArray2, __bArrayCtr2, __cArray3, __oneOfFlag, __bSetInCheckAlignment);
        ReportCell(__tableHandle, __bArray, __bArrayCtr);
        ReportCellResult(__tableHandle, __csr, __ePassFail);
      }
    
      __res = __res && __csr;
    
    }
    ReportTableEndVerdict(__tableHandle, __cEvaluateResponse, __res);
	__bVerdict = __bVerdict && __res;
  }
  if (__bVerdict == __eVerdictFail)
    TestReportWriteDiagObjectList();
}
void Tt4h42sqi_Tet_Tc172_Completion()
{
  stack long __tableHandle;
  TestCompletionBegin();
  {
    {
      CreateTTEIFFunction("Tt4h42sqi_General_Postconditions", __eFct, __eLocal);
      CallInterfaceFunction(__cEmpty, __cEmpty, "8c04fef4-3bbc-4cc8-b3ee-b62ec5ff47eb");
    }


  }
  TestCompletionEnd();
}

void Tt4h42sqi_Tet_Tc173()
{
  CreateTTEIFFunction("Tt4h42sqi_Tc173", __eTcDef, __eLocal);  
  AddIFParameterTestCaseAttribute("TC_ID", "18129233");
  AddIFParameterTestCaseAttribute("Test Case ID", "");
  CallInterfaceFunction("Test Case_20205060_ECU_Reset_Service_in_Extended_Session", __cEmpty , __cEmpty );
}
testcase Tt4h42sqi_Tc173()
{
  stack long __tableHandle;
  SetBreakOnFail(1);

  CreateTTEIFFunction("Tt4h42sqi_Tet_Tc173_Completion", __eFct, __eLocal);
  
  AddIFAsCleanUpFunction();

  TestPreparationBegin();
  {
    {
      CreateTTEIFFunction("Tt4h42sqi_General_Precondition", __eFct, __eLocal);
      CallInterfaceFunction(__cEmpty, __cEmpty, "74787266-8376-4866-a392-d0cc32109fae");
    }


  }
  TestPreparationEnd();

  TestCaseDescription("$11 ECU Reset with Physical Address in Programming Session ");

  {
    CreateCaplIFFunction("startTesterPresent", __eTestFct);
    CallInterfaceFunction("startTesterPresent ()", __cEmpty, "1");
  }


  TestCommandBegin(__eDiagService, __cDiagService, "", "2");
  {
    if (DiagIsFunctionalGroup("CVADAS_0001_00000000_000"))
    {
      DiagResponse * __resp;
      DiagRequest CVADAS_0001_00000000_000.Default_Session_Start __req;
      __diagService4h42sqi_108(__req, __resp);
    }
    else
    {
      DiagResponse CVADAS_0001_00000000_000.* __resp;
      DiagRequest CVADAS_0001_00000000_000.Default_Session_Start __req;
      __diagService4h42sqi_108(__req, __resp);
    }
  }
  TestCommandEnd();


  TestCommandBegin(__eDiagService, __cDiagService, "", "3");
  {
    if (DiagIsFunctionalGroup("CVADAS_0001_00000000_000"))
    {
      DiagResponse * __resp;
      DiagRequest CVADAS_0001_00000000_000.Extended_Diagnostic_Session_Start __req;
      __diagService4h42sqi_109(__req, __resp);
    }
    else
    {
      DiagResponse CVADAS_0001_00000000_000.* __resp;
      DiagRequest CVADAS_0001_00000000_000.Extended_Diagnostic_Session_Start __req;
      __diagService4h42sqi_109(__req, __resp);
    }
  }
  TestCommandEnd();


  {
    CreateTTEIFFunction("Tt4h42sqi_F186_DID_with_PhysicalAdd_ExtendedSession", __eFct, __eLocal);
    CallInterfaceFunction(__cEmpty, __cEmpty, "56d9e7a7-9216-4d5f-b776-c5e862f155cb");
  }


  {
    CreateTTEIFFunction("Tt4h42sqi_Hard_Reset_with_Physical_Address", __eFct, __eLocal);
    CallInterfaceFunction(__cEmpty, __cEmpty, "89dfe39a-bb1d-4a37-afea-34e7a683daba");
  }


  TestCommandBegin(__eWait, __cWait, "", "6");
  {
    Wait("1", (15 * 1000000000LL), 1000000000, "");
  }
  TestCommandEnd();

  {
    CreateTTEIFFunction("Tt4h42sqi_F186_DID_with_PhysicalAdd_DefaultSession", __eFct, __eLocal);
    CallInterfaceFunction(__cEmpty, __cEmpty, "f479ea65-8c8c-4093-b3d8-2a8374608569");
  }



}

  
void __diagService4h42sqi_108(DiagRequest * __req, DiagResponse * __resp )
{
  stack long __tableHandle;
  long __res, __paramLen, __bytePos;

   __bVerdict = __eVerdictPass;

  do {
    TestReportResetDiagObjectList();
    DiagSetReportDetailLevel("CVADAS_0001_00000000_000", EnumServiceDetails_onfail);
    // Request aspect
    {

      if (0 >= DiagSendReqAndWaitForResp("CVADAS_0001_00000000_000", __req, __resp, __res, -1, -1, -1, -1, -1, EnumResult_pos, EnumServiceDetails_onfail, EnumSendingMode_physical, EnumSuppressPosResBit_asconfigured, EnumVerdictOnInvalidValues_fail))
        break;
    }

    __res = DiagErrCodeTestStep(__res, "Can't retrieve last response for request! No check possible.") < 0;
    if(__res)
    {
	  __bVerdict = __eVerdictFail;
      break;
    }
    {
      __res = DiagInterpretAs(__resp, "DSC_PR");
      if(__res != 0)
      {
        __bVerdict = __eVerdictFail;
        DiagErrCodeTestStep(__res, "Can't interpret response as diagnostic primitive 'DSC_PR'.");
        break;
      }
      else
      {
        TestStepPass( "Received primitive can be interpreted as diagnostic primitive 'DSC_PR'.");
      }
    }
  }
  while(0);


  // Response, check & read aspect
  {
    __res = 1;
    __tableHandle = ReportTableHead5Columns(__cCheckCaption, __cTSym, __cTOp, __cRefVal, __cActual, __cRes);
    {
      __bDiagValueArrayCtr = DiagGetParameterErrorHandled(__resp, "DiagSessionType", __bDiagValueArray, elcount(__bDiagValueArray), __cDiagValueArray, elcount(__cDiagValueArray));
      {
        byte __bArray2[1] = { 0x01 };
        __bArrayCtr = __CopyBytes(__bDiagValueArray, __bDiagValueArrayCtr, __bArray);
        __bArrayCtr2 = elCount(__bArray2);
        __csr = CompareBytes(__bArray, __bArrayCtr, __bArray2, __bArrayCtr2) == 0;
        snprintf(__cArray, 8192, "%s", "Diagnostic parameter \'DiagSessionType\'");
        snprintf(__cArray2, 8192, "%s", __cArray);
        snprintf(__cArray3, 8192, "%s", "");
        ReportTableRow(__tableHandle, 0, __cArray2, "Bytes", __bArray2, __bArrayCtr2, __cArray3, __oneOfFlag, __bSetInCheckAlignment);
        ReportCell(__tableHandle, __bArray, __bArrayCtr);
        ReportCellResult(__tableHandle, __csr, __ePassFail);
      }
    
      __res = __res && __csr;
    
    }
    ReportTableEndVerdict(__tableHandle, __cEvaluateResponse, __res);
	__bVerdict = __bVerdict && __res;
  }
  if (__bVerdict == __eVerdictFail)
    TestReportWriteDiagObjectList();
}
  
void __diagService4h42sqi_109(DiagRequest * __req, DiagResponse * __resp )
{
  stack long __tableHandle;
  long __res, __paramLen, __bytePos;

   __bVerdict = __eVerdictPass;

  do {
    TestReportResetDiagObjectList();
    DiagSetReportDetailLevel("CVADAS_0001_00000000_000", EnumServiceDetails_onfail);
    // Request aspect
    {

      if (0 >= DiagSendReqAndWaitForResp("CVADAS_0001_00000000_000", __req, __resp, __res, -1, -1, -1, -1, -1, EnumResult_pos, EnumServiceDetails_onfail, EnumSendingMode_physical, EnumSuppressPosResBit_asconfigured, EnumVerdictOnInvalidValues_fail))
        break;
    }

    __res = DiagErrCodeTestStep(__res, "Can't retrieve last response for request! No check possible.") < 0;
    if(__res)
    {
	  __bVerdict = __eVerdictFail;
      break;
    }
    {
      __res = DiagInterpretAs(__resp, "DSC_PR");
      if(__res != 0)
      {
        __bVerdict = __eVerdictFail;
        DiagErrCodeTestStep(__res, "Can't interpret response as diagnostic primitive 'DSC_PR'.");
        break;
      }
      else
      {
        TestStepPass( "Received primitive can be interpreted as diagnostic primitive 'DSC_PR'.");
      }
    }
  }
  while(0);


  // Response, check & read aspect
  {
    __res = 1;
    __tableHandle = ReportTableHead5Columns(__cCheckCaption, __cTSym, __cTOp, __cRefVal, __cActual, __cRes);
    {
      __bDiagValueArrayCtr = DiagGetParameterErrorHandled(__resp, "DiagSessionType", __bDiagValueArray, elcount(__bDiagValueArray), __cDiagValueArray, elcount(__cDiagValueArray));
      {
        byte __bArray2[1] = { 0x03 };
        __bArrayCtr = __CopyBytes(__bDiagValueArray, __bDiagValueArrayCtr, __bArray);
        __bArrayCtr2 = elCount(__bArray2);
        __csr = CompareBytes(__bArray, __bArrayCtr, __bArray2, __bArrayCtr2) == 0;
        snprintf(__cArray, 8192, "%s", "Diagnostic parameter \'DiagSessionType\'");
        snprintf(__cArray2, 8192, "%s", __cArray);
        snprintf(__cArray3, 8192, "%s", "");
        ReportTableRow(__tableHandle, 0, __cArray2, "Bytes", __bArray2, __bArrayCtr2, __cArray3, __oneOfFlag, __bSetInCheckAlignment);
        ReportCell(__tableHandle, __bArray, __bArrayCtr);
        ReportCellResult(__tableHandle, __csr, __ePassFail);
      }
    
      __res = __res && __csr;
    
    }
    ReportTableEndVerdict(__tableHandle, __cEvaluateResponse, __res);
	__bVerdict = __bVerdict && __res;
  }
  if (__bVerdict == __eVerdictFail)
    TestReportWriteDiagObjectList();
}
void Tt4h42sqi_Tet_Tc173_Completion()
{
  stack long __tableHandle;
  TestCompletionBegin();
  {
    {
      CreateTTEIFFunction("Tt4h42sqi_General_Postconditions", __eFct, __eLocal);
      CallInterfaceFunction(__cEmpty, __cEmpty, "8c04fef4-3bbc-4cc8-b3ee-b62ec5ff47eb");
    }


  }
  TestCompletionEnd();
}

void Tt4h42sqi_Tet_Tc174()
{
  CreateTTEIFFunction("Tt4h42sqi_Tc174", __eTcDef, __eLocal);  
  AddIFParameterTestCaseAttribute("TC_ID", "18129239");
  AddIFParameterTestCaseAttribute("Test Case ID", "");
  CallInterfaceFunction("Test Case_20205058_ECU_Reset_Service_in_Extended_Session_Functional ", __cEmpty , __cEmpty );
}
testcase Tt4h42sqi_Tc174()
{
  stack long __tableHandle;
  SetBreakOnFail(1);

  CreateTTEIFFunction("Tt4h42sqi_Tet_Tc174_Completion", __eFct, __eLocal);
  
  AddIFAsCleanUpFunction();

  TestPreparationBegin();
  {
    {
      CreateTTEIFFunction("Tt4h42sqi_General_Precondition", __eFct, __eLocal);
      CallInterfaceFunction(__cEmpty, __cEmpty, "74787266-8376-4866-a392-d0cc32109fae");
    }


  }
  TestPreparationEnd();

  TestCaseDescription("$11 ECU Reset with Physical Address in Programming Session ");

  {
    CreateCaplIFFunction("startTesterPresent", __eTestFct);
    CallInterfaceFunction("startTesterPresent ()", __cEmpty, "1");
  }


  TestCommandBegin(__eDiagService, __cDiagService, "", "2");
  {
    if (DiagIsFunctionalGroup("CVADAS_0001_00000000_000"))
    {
      DiagResponse * __resp;
      DiagRequest CVADAS_0001_00000000_000.Default_Session_Start __req;
      __diagService4h42sqi_110(__req, __resp);
    }
    else
    {
      DiagResponse CVADAS_0001_00000000_000.* __resp;
      DiagRequest CVADAS_0001_00000000_000.Default_Session_Start __req;
      __diagService4h42sqi_110(__req, __resp);
    }
  }
  TestCommandEnd();


  TestCommandBegin(__eDiagService, __cDiagService, "", "3");
  {
    if (DiagIsFunctionalGroup("CVADAS_0001_00000000_000"))
    {
      DiagResponse * __resp;
      DiagRequest CVADAS_0001_00000000_000.Extended_Diagnostic_Session_Start __req;
      __diagService4h42sqi_111(__req, __resp);
    }
    else
    {
      DiagResponse CVADAS_0001_00000000_000.* __resp;
      DiagRequest CVADAS_0001_00000000_000.Extended_Diagnostic_Session_Start __req;
      __diagService4h42sqi_111(__req, __resp);
    }
  }
  TestCommandEnd();


  {
    CreateTTEIFFunction("Tt4h42sqi_F186_DID_with_FunctionalAdd_ExtendedSession", __eFct, __eLocal);
    CallInterfaceFunction(__cEmpty, __cEmpty, "5364fc25-012e-48d3-a1dd-13b74e77eac5");
  }


  {
    CreateTTEIFFunction("Tt4h42sqi_Hard_Reset_with_Functional_Address", __eFct, __eLocal);
    CallInterfaceFunction(__cEmpty, __cEmpty, "70a054ee-692b-447c-9761-32bc0c5ba62c");
  }


  TestCommandBegin(__eWait, __cWait, "", "6");
  {
    Wait("1", (15 * 1000000000LL), 1000000000, "");
  }
  TestCommandEnd();

  {
    CreateTTEIFFunction("Tt4h42sqi_F186_DID_with_FunctionalAdd_DefaultSession", __eFct, __eLocal);
    CallInterfaceFunction(__cEmpty, __cEmpty, "7f56649c-31a8-40e2-91d8-6a45f0d55a04");
  }



}

  
void __diagService4h42sqi_110(DiagRequest * __req, DiagResponse * __resp )
{
  stack long __tableHandle;
  long __res, __paramLen, __bytePos;

   __bVerdict = __eVerdictPass;

  do {
    TestReportResetDiagObjectList();
    DiagSetReportDetailLevel("CVADAS_0001_00000000_000", EnumServiceDetails_onfail);
    // Request aspect
    {

      if (0 >= DiagSendReqAndWaitForResp("CVADAS_0001_00000000_000", __req, __resp, __res, -1, -1, -1, -1, -1, EnumResult_pos, EnumServiceDetails_onfail, EnumSendingMode_functional, EnumSuppressPosResBit_asconfigured, EnumVerdictOnInvalidValues_fail))
        break;
    }

    __res = DiagErrCodeTestStep(__res, "Can't retrieve last response for request! No check possible.") < 0;
    if(__res)
    {
	  __bVerdict = __eVerdictFail;
      break;
    }
    {
      __res = DiagInterpretAs(__resp, "DSC_PR");
      if(__res != 0)
      {
        __bVerdict = __eVerdictFail;
        DiagErrCodeTestStep(__res, "Can't interpret response as diagnostic primitive 'DSC_PR'.");
        break;
      }
      else
      {
        TestStepPass( "Received primitive can be interpreted as diagnostic primitive 'DSC_PR'.");
      }
    }
  }
  while(0);


  // Response, check & read aspect
  {
    __res = 1;
    __tableHandle = ReportTableHead5Columns(__cCheckCaption, __cTSym, __cTOp, __cRefVal, __cActual, __cRes);
    {
      __bDiagValueArrayCtr = DiagGetParameterErrorHandled(__resp, "DiagSessionType", __bDiagValueArray, elcount(__bDiagValueArray), __cDiagValueArray, elcount(__cDiagValueArray));
      {
        byte __bArray2[1] = { 0x01 };
        __bArrayCtr = __CopyBytes(__bDiagValueArray, __bDiagValueArrayCtr, __bArray);
        __bArrayCtr2 = elCount(__bArray2);
        __csr = CompareBytes(__bArray, __bArrayCtr, __bArray2, __bArrayCtr2) == 0;
        snprintf(__cArray, 8192, "%s", "Diagnostic parameter \'DiagSessionType\'");
        snprintf(__cArray2, 8192, "%s", __cArray);
        snprintf(__cArray3, 8192, "%s", "");
        ReportTableRow(__tableHandle, 0, __cArray2, "Bytes", __bArray2, __bArrayCtr2, __cArray3, __oneOfFlag, __bSetInCheckAlignment);
        ReportCell(__tableHandle, __bArray, __bArrayCtr);
        ReportCellResult(__tableHandle, __csr, __ePassFail);
      }
    
      __res = __res && __csr;
    
    }
    ReportTableEndVerdict(__tableHandle, __cEvaluateResponse, __res);
	__bVerdict = __bVerdict && __res;
  }
  if (__bVerdict == __eVerdictFail)
    TestReportWriteDiagObjectList();
}
  
void __diagService4h42sqi_111(DiagRequest * __req, DiagResponse * __resp )
{
  stack long __tableHandle;
  long __res, __paramLen, __bytePos;

   __bVerdict = __eVerdictPass;

  do {
    TestReportResetDiagObjectList();
    DiagSetReportDetailLevel("CVADAS_0001_00000000_000", EnumServiceDetails_onfail);
    // Request aspect
    {

      if (0 >= DiagSendReqAndWaitForResp("CVADAS_0001_00000000_000", __req, __resp, __res, -1, -1, -1, -1, -1, EnumResult_pos, EnumServiceDetails_onfail, EnumSendingMode_functional, EnumSuppressPosResBit_asconfigured, EnumVerdictOnInvalidValues_fail))
        break;
    }

    __res = DiagErrCodeTestStep(__res, "Can't retrieve last response for request! No check possible.") < 0;
    if(__res)
    {
	  __bVerdict = __eVerdictFail;
      break;
    }
    {
      __res = DiagInterpretAs(__resp, "DSC_PR");
      if(__res != 0)
      {
        __bVerdict = __eVerdictFail;
        DiagErrCodeTestStep(__res, "Can't interpret response as diagnostic primitive 'DSC_PR'.");
        break;
      }
      else
      {
        TestStepPass( "Received primitive can be interpreted as diagnostic primitive 'DSC_PR'.");
      }
    }
  }
  while(0);


  // Response, check & read aspect
  {
    __res = 1;
    __tableHandle = ReportTableHead5Columns(__cCheckCaption, __cTSym, __cTOp, __cRefVal, __cActual, __cRes);
    {
      __bDiagValueArrayCtr = DiagGetParameterErrorHandled(__resp, "DiagSessionType", __bDiagValueArray, elcount(__bDiagValueArray), __cDiagValueArray, elcount(__cDiagValueArray));
      {
        byte __bArray2[1] = { 0x03 };
        __bArrayCtr = __CopyBytes(__bDiagValueArray, __bDiagValueArrayCtr, __bArray);
        __bArrayCtr2 = elCount(__bArray2);
        __csr = CompareBytes(__bArray, __bArrayCtr, __bArray2, __bArrayCtr2) == 0;
        snprintf(__cArray, 8192, "%s", "Diagnostic parameter \'DiagSessionType\'");
        snprintf(__cArray2, 8192, "%s", __cArray);
        snprintf(__cArray3, 8192, "%s", "");
        ReportTableRow(__tableHandle, 0, __cArray2, "Bytes", __bArray2, __bArrayCtr2, __cArray3, __oneOfFlag, __bSetInCheckAlignment);
        ReportCell(__tableHandle, __bArray, __bArrayCtr);
        ReportCellResult(__tableHandle, __csr, __ePassFail);
      }
    
      __res = __res && __csr;
    
    }
    ReportTableEndVerdict(__tableHandle, __cEvaluateResponse, __res);
	__bVerdict = __bVerdict && __res;
  }
  if (__bVerdict == __eVerdictFail)
    TestReportWriteDiagObjectList();
}
void Tt4h42sqi_Tet_Tc174_Completion()
{
  stack long __tableHandle;
  TestCompletionBegin();
  {
    {
      CreateTTEIFFunction("Tt4h42sqi_General_Postconditions", __eFct, __eLocal);
      CallInterfaceFunction(__cEmpty, __cEmpty, "8c04fef4-3bbc-4cc8-b3ee-b62ec5ff47eb");
    }


  }
  TestCompletionEnd();
}

