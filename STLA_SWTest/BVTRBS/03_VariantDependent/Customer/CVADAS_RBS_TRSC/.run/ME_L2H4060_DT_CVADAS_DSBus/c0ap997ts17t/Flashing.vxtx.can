/* !Encoding: 65001  */
includes
{
  #include "__VariablesLib.cin"
  #include "__CaplGeneratorLib.cin"
  #include "__CANoeReportFuntionsLib.cin"
}

variables
{
  // Global variables defined within this CAPL file
}

void Ttbrdtkrg_Tet_TtInit()
{
  stack long __tableHandle;
}

void Ttbrdtkrg_Tet_Tc0()
{
  CreateTTEIFFunction("Ttbrdtkrg_Tc0", __eTcDef, __eLocal);  
  AddIFParameterTestCaseAttribute("TC_ID", "");
  AddIFParameterTestCaseAttribute("Test Case ID", "");
  CallInterfaceFunction("Lauterbach_Flashing", __cEmpty , __cEmpty );
}
testcase Ttbrdtkrg_Tc0()
{
  stack long __tableHandle;
  SetBreakOnFail(1);

  TestCommandBegin(__eCAPLInline, __cCAPLInline, "Python Script Execution Flashing with Lauterbach", "0");
  {
    __cibrdtkrgCaplInline0();
  }
  TestCommandEnd();

  {
    CreateCaplIFFunction("Main_Precondition", __eFct);
    CallInterfaceFunction(__cEmpty, __cEmpty, "1");
  }


  
  TestCommandBegin(__eAwaitSignalsAvailable, __cAwaitSignalsAvailable, "", "2");
  {
    long __eventTable[1];
    int64 __time;
    __time = 120 * 1000000000LL;
    if(__time < 0)
    {
      testStepErrorInTestSystem(0, "1", "Unable to wait for %.3f %s. Please check input parameter.", __time / ((float)1000000000), "s");
    }
    else
    {
      __eventTable[0] = testJoinSignalAvailable(`FDCAN2::dbNode::`CVADAS::`CVPAM_FD_Info::`DisplayView2);
      __bVerdict = testWaitForAllJoinedEventsNS(__time) > 0;
      __tableHandle = ReportTableHead3Columns("Waited for availability of 1 signal.", "Signal/Node", "State", __cRes);
      snprintf(__cArray, 8192, "%s", "DisplayView2");
      snprintf(__cArray2, 8192, "%s '%s'", __cCANSignal, __cArray);
      __ReportAwaitSignalsAvailableRow(__tableHandle, 0, __eventTable[0], __cArray2);
      ReportTableEndVerdict(__tableHandle, "1", __bVerdict);
    }
  }
  TestCommandEnd();


  TestCommandBegin(__eCheck, __cCheck, "", "3");
  {
    __bVerdict = __eVerdictPass;
    __tableHandle = ReportTableHead5Columns(__cCheckCaption, __cTSym, __cTOp, __cRefVal, __cActual, __cRes);
    {
      __csr = CheckSignalMatch(`FDCAN2::dbNode::`CVADAS::`CVPAM_FD_Info::`DisplayView2, 0, ">") == 1;
      snprintf(__cArray, 8192, "%s", "DisplayView2");
      snprintf(__cArray2, 8192, "%s '%s'", __cCANSignal, __cArray);
      snprintf(__cArray3, 8192, "%s", "");
      ReportTableRow(__tableHandle, 0, __cArray2, ">", 0, __cArray3, __oneOfFlag, __bSetInCheckAlignment);
      ReportLValueOrSignalNotOnline(`FDCAN2::dbNode::`CVADAS::`CVPAM_FD_Info::`DisplayView2, __cArray5, 8192);
      ReportCell(__tableHandle, __cArray5);
      ReportCellResult(__tableHandle, __csr, __ePassFail);
  
      __bVerdict = __bVerdict && __csr;
    }
    ReportTableEndVerdict(__tableHandle, "1", __bVerdict);
  }
  TestCommandEnd();


}

void __cibrdtkrgCaplInline0()
{
  stack long __tableHandle;
  {
    dword response;
dword respcode;

response = testWaitForSyscall("","cmd /k python Flashing_Lauterbach_boot_app.py", respcode, 400000);

teststep("","Flashing Script Response Code: %d",respcode);
teststep("","CAPL Response: %d",response);
write("Flashing Script: %d",respcode);
write("CAPL Response: %d",response);

  }
}

