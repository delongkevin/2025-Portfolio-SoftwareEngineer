/* !Encoding: 65001  */
variables
{
  int __bSetInCheckAlignment = 0;}

void __ReportAwaitSignalsAvailableRow(long tableHandle, long indent, long eventId, char reportIdent[])
{
  testInfoRow(tableHandle, indent, reportIdent);
  if (eventId >= 0)
  {
    if (eventId == 0)
    {
      testInfoCell(tableHandle, "already online");
      ReportCellResult(tableHandle, 1, 1);
    }
    else
    {
      int64 time;
      long occurred;
      occurred = testGetJoinedEventOccured(eventId, time);
      if (occurred)
         testInfoCell(tableHandle, "online");
      else
        testInfoCell(tableHandle, __cNotOnlineYet);
      ReportCellResult(tableHandle, occurred, 1);
    }
  }
  else
  {
    testInfoCell(tableHandle, "-", 1);
    ReportCellResult(tableHandle, 0, 1);
  }
}

void __ReportRequestResponseResult(long res, long expectTimeout)
{
  char buffer[8192];
  
  if (res < 0)
  {
    switch (res)
    {
      case -1:
      default:
        testStepErrorInTestSystem(0, "Resp", "Error waiting for response parameter(s) (code: %d).", res);
        break;
      case -2:
        testStepFail(0, "Resp", "Constraint violation while waiting for response parameter(s) (code: %d).", res);
        break;
      case -999:
        testStepInconclusive(0, "Resp", "Condition aborted while waiting for response parameter(s) (code: %d).", res);
        break;
    }
    return;
  }
  if (res == 0)
    snprintf(buffer, elCount(buffer), "Timeout waiting for response parameter(s).");
  else
    snprintf(buffer, elCount(buffer), "Response received successfully.");
  if(expectTimeout ? (res == 0) : (res > 0))
    testStepPass(0, "Resp", buffer);
  else
    testStepFail(0, "Resp", buffer);
}
