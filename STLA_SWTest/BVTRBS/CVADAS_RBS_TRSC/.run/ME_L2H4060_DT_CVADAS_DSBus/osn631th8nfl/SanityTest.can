/*@!Encoding:1252*/
includes
{
}

variables
{
  int Rx_msg_CAN_1=0, Rx_msg_CAN_2=0, NM_msg_received=0;
  int FDCAN_2_Bus_Load, FDCAN_14_Bus_Load;
  message BCM_FD_2 msg;
  int NM_PAM_Status_1=0, NM_PAM_Status_2=0,PDC_INFO_FD_PAM_Status=0;
  long result;
  int results=0;
}


export long Hard_Reset()
{
  long response;
  diagRequest CVADAS_0001_00000000_000.HardReset_Reset hardReset;
  
  testStep("","ECU hard reset");
  hardReset.SendRequest();
  TestWaitForDiagRequestSent(hardReset, 1000);
  response = TestWaitForDiagResponse(hardReset, 5000);

  return response;
}

export long Write_Proxi(char proxi[])
{
  long response;
  diagRequest CVADAS_0001_00000000_000._2E2023_PROXI_Data proxiData;
  
  testStep("", "Write proxi data");
  proxiData.SetParameter("_Data_24", proxi);
  proxiData.SendRequest();
  response = TestWaitForDiagResponse(proxiData, 7000);
  if(response == 1)
  {
    response = diagGetLastResponseCode(proxiData);
    if(response == -1)
    {
      testStepPass("","Successfully Wrote Proxy!" );
      Hard_Reset();
      testWaitForTimeout(10000);
      return 1;
    }
    if(response == 1){
      testStepFail("","Failed to write proxy variant!");
      return -1;
    }

  }
  return response;
}


export testcase SetCalibrationData()
{
  diagRequest CVADAS_0001_00000000_000._22FD00_Plant_Camera_Calibration_Data_Write req;
  diagResponse CVADAS_0001_00000000_000._22FD00_Plant_Camera_Calibration_Data_Write resp;
  
  Hard_Reset();
}

export testcase variantProxy(int variant, char proxi[])
{
  diagRequest CVADAS_0001_00000000_000._22FD61_Vehicle_Variant_Coding_Data_Read FD61request;
  diagresponse CVADAS_0001_00000000_000._22FD61_Vehicle_Variant_Coding_Data_Read FD61response;
  int i, j, k;
  char tmp[500]; //buffer
  char out[500];
  byte response[500];
  
  out[0] = 0; //clear output string
  testStep("","Variant %d proxy is sent!",variant);
  Write_Proxi(proxi);
  Hard_Reset();
  testWaitForTimeout(35000);
  $DisplayView2 == 5;
  FD61request.SendRequest();
  testWaitForDiagRequestSent(FD61request, 10000); //send request
  testWaitForTimeout(5000);
  FD61response.GetLastResponse();  //get last response
  i = diagGetPrimitiveData(FD61response, response, elcount(response));
    for (k = 0; k<=i; k++)
    {
      tmp[k] = response[k];
      snprintf(tmp, elcount(tmp), "%.2X", response[k]); //convert to hex into string
      strncat(out, tmp, elcount(out));
      //teststep("","FD6: %.2X",out[k]); debugging
    }
    if ($DisplayView2 == 0)
    {
      testStepFail("","No HMI Views!");
    }
    testStepPass("","FD61 Readout: %s",out);
  
}


export testcase variantProxyTest()
{
  diagRequest CVADAS_0001_00000000_000._22FD61_Vehicle_Variant_Coding_Data_Read FD61request;
  diagresponse CVADAS_0001_00000000_000._22FD61_Vehicle_Variant_Coding_Data_Read FD61response;
  int i, j, k;
  char tmp[500]; //buffer
  char out[500];
  byte response[500];
  
  out[0] = 0; //clear output string
  testStep("","Sending HD Variant 5 proxi data");
  Write_Proxi("303030303030303236303245303032302D3032202020220317CF4DC6AD184124010AC018AC0302C151CF0DC62D184024F02ACC18640302815130F03DC1868009D2915B68105531580008000042043FE3290103C1384E0048080022000084010F500A50090C001004820002079560572C58661800D01C3A0087BFF9501AC00000220B014F1B813E0400000082000000061824008980A80F5066113C020000C1000020006E00730800006824009A1C349E2B6A8000CA24667F0940000000000000000F80000001040000004001000000000000FC0002000000000000000080000000001000000004000000000000");
  Hard_Reset();
  testWaitForTimeout(35000);
  $DisplayView2 == 5;
  FD61request.SendRequest();
  testWaitForDiagRequestSent(FD61request, 10000); //send request
  testWaitForTimeout(5000);
  FD61response.GetLastResponse();  //get last response
  i = diagGetPrimitiveData(FD61response, response, elcount(response));
    for (k = 0; k<=i; k++)
    {
      tmp[k] = response[k];
      snprintf(tmp, elcount(tmp), "%.2X", response[k]); //convert to hex into string
      strncat(out, tmp, elcount(out));
      //teststep("","FD6: %.2X",out[k]); debugging
    }
    if ($DisplayView2 == 0)
    {
      testStepFail("","No HMI Views!");
    }
    testStepPass("","FD61 Readout: %s",out);
}


export testcase Send_Proxi(char proxi[])
{
  long response;
  testStep("","Writing Proxy...");
  Write_Proxi(proxi);
  Hard_Reset();
  testStep("","Set to Default View: Rear View...");
  $CameraDisplaySts2=3;
  testWaitForTimeout(10000);
  
}
export testfunction startTesterPresent()
{
  diagStartTesterPresent();
  
}

export testfunction stopTesterPresent()
{
  diagStopTesterPresent();
  
}

// CAN NM 
on message CAN1.*
{
   if(this.dir == rx)
   {
      // Checking the status of FDCAN_2 Communication
      Rx_msg_CAN_1 = 1;
      
      // Checking the status of PDC_INFO_FD_PAM msessage
      if(this.id == 0x1E360018)
      {
        PDC_INFO_FD_PAM_Status = 1;
      }
      else
      {
        PDC_INFO_FD_PAM_Status = 0;
      }
      
      // Checking the status of NM_PAM msessage
      if(this.id == 0x1E384018)
      {
        NM_PAM_Status_1 = 1;
      }
      else
      {
        NM_PAM_Status_1 = 0;
      }
	 }
   else
	 {
      Rx_msg_CAN_1 = 0;
	 }
}

on message CAN2.*
{
   if(this.dir == rx)
   {
      // Checking the status of FDCAN_14 Communication
      Rx_msg_CAN_2 = 1;
    
      // Checking the status of NM_PAM msessage
      if(this.id == 0x1E384018)
      {
        NM_PAM_Status_2 = 0;
      }
      else
      {
        NM_PAM_Status_2 = 1;
      }
   }
   else
	 {
      Rx_msg_CAN_2 = 0;
	 }
}

export Check_FD_CAN_2_trace()
{
   if(testWaitForMessage(CVADAS::CVPAM_FD_Info,255))
   {
        Rx_msg_CAN_1 = 1;
   }
   else
   {
        Rx_msg_CAN_1 = 0;
   }
}

export Check_FD_CAN_14_trace()
{
   if( testWaitForMessage(CVPAM_FD_Control,15))
   {
        Rx_msg_CAN_2 = 1;
   }
   else
   {
        Rx_msg_CAN_2 = 0;
   }
}

export After_sending_NM_Message()
{
   if(testWaitForMessage(CVPAM_FD_Info,250) && testWaitForMessage(CVPAM_FD_Control,250))
   {
       Rx_msg_CAN_2 = 1;
   }
   else
   {
        Rx_msg_CAN_2 = 0;
   }
}

export CAN_1_Comm_Rx_Dis()
{
    if(Rx_msg_CAN_1 == 0)
    {
      testStepPass(" ","ECU not Transmitted CAN messages");
    }
    else
    {
      testStepFail(" ","ECU Transmitted CAN messages");
    }
}

export CAN_1_Comm_Rx_En()
{
  Check_FD_CAN_2_trace();
  
  if(Rx_msg_CAN_1 == 1)
  {
    testStepPass(" ","ECU Transmitted CAN messages");
  }
  else
  {
    testStepFail(" ","ECU not Transmitted CAN messages");
  }
}

export Check_CAN_Communication_After_Power_ON()
{  
  if(Rx_msg_CAN_1 == 1)
  {
      testStepPass(" ","ECU Transmitted CAN messages");
  }
  else
  {
      testStepFail(" ","ECU not Transmitted CAN messages");
  }
}

export CAN_2_Comm_Rx_Dis()
{
    if(Rx_msg_CAN_2 == 0)
    {
      testStepPass(" ","ECU not Transmitted CAN messages");
    }
    else
    {
      testStepFail(" ","ECU Transmitted CAN messages");
    }
}

export CAN_2_Comm_Rx_En()
{
  if(Rx_msg_CAN_2 == 1)
  {
    testStepPass(" ","ECU Transmitted CAN messages");
  }
  else
  {
    testStepFail(" ","ECU not Transmitted CAN messages");
  }
}

export Check_PDC_Info_FD_PAM_msg()
{
  if(PDC_INFO_FD_PAM_Status == 1)
  {
    testStepPass(" ","Observed PDC_IFO_FD_PAM mesage in CAN communication");
  }
  else
  {
    testStepFail(" ","Not observed PDC_IFO_FD_PAM mesage in CAN communication");
  }
} 

export Check_NM_PAM_msg()
{
  if(NM_PAM_Status_1 == 1)
  {
    testStepPass(" ","Observed NM_PAM mesage in CAN communication");
  }
  else
  {
    testStepFail(" ","Not observed NM_PAM mesage in CAN communication");
  }
}

export Cycle_Time_Difference_NM_PAM()
{
  result = ChkStart_MsgRelCycleTimeViolation(NM_PAM, 0.9, 1.1);
  if(result > 0)
  {
    testStepPass(" ","Observed time difference of 1000ms between two NM_PAM messages");
  }
  else
  {
    testStepFail(" ","Not observed time difference of 1000ms between two NM_PAM messages");
  }    
}

export CAN_communication_Stop()
{
  canSetChannelOutput(1,0);
  canSetChannelOutput(2,0);
}

export CAN_communication_Start()
{ 
  canSetChannelOutput(1,1);
  canSetChannelOutput(2,1);
}

export Communincation_Restart()
{  
  Check_FD_CAN_2_trace();
  testwaitfortimeout(500);
  if(Rx_msg_CAN_1 == 0)
  {
      do
      {
          Check_FD_CAN_2_trace();
          testwaitfortimeout(1000);
          CAN_communication_Stop();
          testwaitfortimeout(2000);
          Power_Supply_OFF();
          testwaitfortimeout(2000);
          Set_voltage(syspar::Power_Control::RS_232_Port_Number,syspar::Power_Control::Normal_Voltage);
          testwaitfortimeout(2000);
          Power_Supply_ON();
          testwaitfortimeout(500);
          CAN_communication_Start();
          testwaitfortimeout(500);
          setSignal(CmdIgnSts,0x4);
          testwaitfortimeout(2000);
          if(testWaitForMessage(CVADAS::CVPAM_FD_Info,15) && testWaitForMessage(PDC_INFO_FD_PAM,1100))
          {
              //
          }
          else
          {
              testwaitfortimeout(2000);
              if(testWaitForMessage(CVADAS::CVPAM_FD_Info,15) && testWaitForMessage(PDC_INFO_FD_PAM,1100))
              {
                  testwaitfortimeout(2500);
              }
              else
              {
                //
              }
          }
          
      }while(Rx_msg_CAN_1 == 0);
  }
  else
  {
    //
  }
  
  @MEnv_Default_SET_BOL_1 = 0;
  testwaitfortimeout(100);
  @MEnv_Default_SET_BOL_1 = 1;
  testwaitfortimeout(4000);
  
}

export Hard_Reset_Function()
{  
  Check_FD_CAN_2_trace();
  testwaitfortimeout(1000);
  if(Rx_msg_CAN_1 == 0)
  {
      do
      {
          Check_FD_CAN_2_trace();
          testwaitfortimeout(1000);
          Power_Supply_OFF();
          testwaitfortimeout(2000);
          Set_voltage(syspar::Power_Control::RS_232_Port_Number,syspar::Power_Control::Normal_Voltage);
          testwaitfortimeout(2000);
          Power_Supply_ON();
          testwaitfortimeout(2000);
      }while(Rx_msg_CAN_1 == 0);
  }
  else
  {
    //
  }
}

export Reset_CAN()
{
  resetCanEx(1);
  testwaitfortimeout(2000);
  resetCanEx(1);
  testwaitfortimeout(2000);
}