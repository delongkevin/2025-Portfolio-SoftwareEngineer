/* !Encoding: 65001  */
includes
{
  #include "__DiagLibrary.cin"
  #include "__VariablesLib.cin"
  #include "__CaplGeneratorLib.cin"
  #include "__CANoeReportFuntionsLib.cin"
}

variables
{
  // Global variables defined within this CAPL file
  int64 __tt0cnt_1;
  int64 __tt0cnt_3;
  int64 __tt0cnt_5;
  int64 __tt0cnt_7;
  int64 __tt0cnt_9;
  int64 __tt0cnt_11;
  int64 __tt0cnt_13;
  int64 __tt0cnt_15;
  int64 __tt0cnt_17;
  int64 __tt0cnt_19;
  int64 __tt0cnt_21;
  int64 __tt0cnt_23;
  int64 __tt0cnt_25;
  int64 __tt0cnt_27;
  int64 __tt0cnt_29;
  int64 __tt0cnt_31;
  int64 __tt0cnt_33;
  int64 __tt0cnt_35;
  int64 __tt0cnt_37;
  int64 __tt0cnt_39;
  int64 __tt0cnt_41;
  int64 __tt0cnt_43;
  int64 __tt0cnt_45;
  int64 __tt0cnt_47;
  int64 __tt0cnt_49;
  int64 __tt0cnt_51;
  int64 __tt0LoopVar1;
  double __tt0LoopVar2;
}

void Ttvccmce9_General_Precondition()
{
  stack long __tableHandle;
  TestCommandBegin(__eDiagService, __cDiagService, "", "0");
  {
    if (DiagIsFunctionalGroup("CVADAS_0001_00000000_000"))
    {
      DiagResponse * __resp;
      DiagRequest CVADAS_0001_00000000_000.Default_Session_Start __req;
      __diagServicevccmce9_0(__req, __resp);
    }
    else
    {
      DiagResponse CVADAS_0001_00000000_000.* __resp;
      DiagRequest CVADAS_0001_00000000_000.Default_Session_Start __req;
      __diagServicevccmce9_0(__req, __resp);
    }
  }
  TestCommandEnd();


  TestCommandBegin(__eWait, __cWait, "", "1");
  {
    Wait("1", (1000 * 1000000LL), 1000000, "");
  }
  TestCommandEnd();

  TestCommandBegin(__eDiagService, __cDiagService, "", "2");
  {
    if (DiagIsFunctionalGroup("CVADAS_0001_00000000_000"))
    {
      DiagResponse * __resp;
      DiagRequest CVADAS_0001_00000000_000.FaultMemory_Clear __req;
      __diagServicevccmce9_1(__req, __resp);
    }
    else
    {
      DiagResponse CVADAS_0001_00000000_000.* __resp;
      DiagRequest CVADAS_0001_00000000_000.FaultMemory_Clear __req;
      __diagServicevccmce9_1(__req, __resp);
    }
  }
  TestCommandEnd();


  TestCommandBegin(__eWait, __cWait, "", "3");
  {
    Wait("1", (1000 * 1000000LL), 1000000, "");
  }
  TestCommandEnd();

  TestCommandBegin(__eDiagService, __cDiagService, "", "4");
  {
    if (DiagIsFunctionalGroup("CVADAS_0001_00000000_000"))
    {
      DiagResponse * __resp;
      DiagRequest CVADAS_0001_00000000_000._22FDF2_Reset_Reason_Read __req;
      __diagServicevccmce9_2(__req, __resp);
    }
    else
    {
      DiagResponse CVADAS_0001_00000000_000.* __resp;
      DiagRequest CVADAS_0001_00000000_000._22FDF2_Reset_Reason_Read __req;
      __diagServicevccmce9_2(__req, __resp);
    }
  }
  TestCommandEnd();


  TestCommandBegin(__eWait, __cWait, "", "5");
  {
    Wait("1", (1000 * 1000000LL), 1000000, "");
  }
  TestCommandEnd();

  TestCommandBegin(__eDiagService, __cDiagService, "", "6");
  {
    if (DiagIsFunctionalGroup("CVADAS_0001_00000000_000"))
    {
      DiagResponse * __resp;
      DiagRequest CVADAS_0001_00000000_000._22FD44_Error_Flags_Read __req;
      __diagServicevccmce9_3(__req, __resp);
    }
    else
    {
      DiagResponse CVADAS_0001_00000000_000.* __resp;
      DiagRequest CVADAS_0001_00000000_000._22FD44_Error_Flags_Read __req;
      __diagServicevccmce9_3(__req, __resp);
    }
  }
  TestCommandEnd();


  TestCommandBegin(__eWait, __cWait, "", "7");
  {
    Wait("1", (1000 * 1000000LL), 1000000, "");
  }
  TestCommandEnd();

  TestCommandBegin(__eDiagService, __cDiagService, "", "8");
  {
    if (DiagIsFunctionalGroup("CVADAS_0001_00000000_000"))
    {
      DiagResponse * __resp;
      DiagRequest CVADAS_0001_00000000_000._22FD64_ASIL_B_Fault_Status_Read __req;
      __diagServicevccmce9_4(__req, __resp);
    }
    else
    {
      DiagResponse CVADAS_0001_00000000_000.* __resp;
      DiagRequest CVADAS_0001_00000000_000._22FD64_ASIL_B_Fault_Status_Read __req;
      __diagServicevccmce9_4(__req, __resp);
    }
  }
  TestCommandEnd();


  TestCommandBegin(__eWait, __cWait, "", "9");
  {
    Wait("1", (1000 * 1000000LL), 1000000, "");
  }
  TestCommandEnd();

  TestCommandBegin(__eDiagService, __cDiagService, "", "10");
  {
    if (DiagIsFunctionalGroup("CVADAS_0001_00000000_000"))
    {
      DiagResponse * __resp;
      DiagRequest CVADAS_0001_00000000_000._22FD62_ASIL_QM_Fault_Status_Read __req;
      __diagServicevccmce9_5(__req, __resp);
    }
    else
    {
      DiagResponse CVADAS_0001_00000000_000.* __resp;
      DiagRequest CVADAS_0001_00000000_000._22FD62_ASIL_QM_Fault_Status_Read __req;
      __diagServicevccmce9_5(__req, __resp);
    }
  }
  TestCommandEnd();


  TestCommandBegin(__eWait, __cWait, "", "11");
  {
    Wait("1", (1000 * 1000000LL), 1000000, "");
  }
  TestCommandEnd();

}

  
void __diagServicevccmce9_0(DiagRequest * __req, DiagResponse * __resp )
{
  stack long __tableHandle;
  long __res, __paramLen, __bytePos;

   __bVerdict = __eVerdictPass;

  do {
    TestReportResetDiagObjectList();
    DiagSetReportDetailLevel("CVADAS_0001_00000000_000", EnumServiceDetails_onfail);
    // Request aspect
    {
      {
        {
          byte __bArray[1] = { 0x01 };
          __bArrayCtr = elCount(__bArray);
          __bDiagValueArrayCtr = __CopyBytes(__bArray, __bArrayCtr, __bDiagValueArray);
        }
      
        __res = DiagSetParameterErrorHandled(__req, "DiagSessionType", __bDiagValueArray, __bDiagValueArrayCtr);
        if(__res < 0)
        {
          __bVerdict = __eVerdictFail;
          DiagErrCodeTestStep(__res, "Cannot set diagnostic parameter 'DiagSessionType'");
          break;
        }
      }

      if (0 >= DiagSendReqAndWaitForResp("CVADAS_0001_00000000_000", __req, __resp, __res, -1, -1, -1, -1, -1, EnumResult_pos, EnumServiceDetails_onfail, EnumSendingMode_physical, EnumSuppressPosResBit_asconfigured, EnumVerdictOnInvalidValues_fail))
        break;
    }

    __res = DiagErrCodeTestStep(__res, "Can't retrieve last response for request! No check possible.") < 0;
    if(__res)
    {
	  __bVerdict = __eVerdictFail;
      break;
    }
    {
      __res = DiagInterpretAs(__resp, "DSC_PR");
      if(__res != 0)
      {
        __bVerdict = __eVerdictFail;
        DiagErrCodeTestStep(__res, "Can't interpret response as diagnostic primitive 'DSC_PR'.");
        break;
      }
      else
      {
        TestStepPass( "Received primitive can be interpreted as diagnostic primitive 'DSC_PR'.");
      }
    }
  }
  while(0);


  // Response, check & read aspect
  {
    __res = 1;
    __tableHandle = ReportTableHead5Columns(__cCheckCaption, __cTSym, __cTOp, __cRefVal, __cActual, __cRes);
    {
      __bDiagValueArrayCtr = DiagGetParameterErrorHandled(__resp, "DiagSessionType", __bDiagValueArray, elcount(__bDiagValueArray), __cDiagValueArray, elcount(__cDiagValueArray));
      {
        byte __bArray2[1] = { 0x01 };
        __bArrayCtr = __CopyBytes(__bDiagValueArray, __bDiagValueArrayCtr, __bArray);
        __bArrayCtr2 = elCount(__bArray2);
        __csr = CompareBytes(__bArray, __bArrayCtr, __bArray2, __bArrayCtr2) == 0;
        snprintf(__cArray, 8192, "%s", "Diagnostic parameter \'DiagSessionType\'");
        snprintf(__cArray2, 8192, "%s", __cArray);
        snprintf(__cArray3, 8192, "%s", "");
        ReportTableRow(__tableHandle, 0, __cArray2, "Bytes", __bArray2, __bArrayCtr2, __cArray3, __oneOfFlag, __bSetInCheckAlignment);
        ReportCell(__tableHandle, __bArray, __bArrayCtr);
        ReportCellResult(__tableHandle, __csr, __ePassFail);
      }
    
      __res = __res && __csr;
    
    }
    ReportTableEndVerdict(__tableHandle, __cEvaluateResponse, __res);
	__bVerdict = __bVerdict && __res;
  }
  if (__bVerdict == __eVerdictFail)
    TestReportWriteDiagObjectList();
}
  
void __diagServicevccmce9_1(DiagRequest * __req, DiagResponse * __resp )
{
  stack long __tableHandle;
  long __res, __paramLen, __bytePos;

   __bVerdict = __eVerdictPass;

  do {
    TestReportResetDiagObjectList();
    DiagSetReportDetailLevel("CVADAS_0001_00000000_000", EnumServiceDetails_onfail);
    // Request aspect
    {
      {
        CheckLiteralGetStringBufferConsistency("FFFFFF", 8192);
      snprintf(__cDiagValueArray, 8192, "%s", "FFFFFF");
        __bDiagValueArrayCtr = __MapChar2ByteAtDiagSet(__cDiagValueArray, __bDiagValueArray);
        if (__bDiagValueArrayCtr >= 0)
        {
          __res = DiagSetParameterErrorHandled(__req, "GroupOfDtc", __bDiagValueArray, __bDiagValueArrayCtr);
          if(__res < 0)
          {
            __bVerdict = __eVerdictFail;
            DiagErrCodeTestStep(__res, "Cannot set diagnostic parameter 'GroupOfDtc'");
            break;
          }
        }
        else
        {
      	__bVerdict = __eVerdictFail;
          snprintf(__cArray2, 8192, "SetParameter: illegal byte sequence: '%s' (parameter %s). Use hex tuples like '01 AF ...'", __cDiagValueArray, "GroupOfDtc");
          DiagErrCodeTestStep(__bDiagValueArrayCtr, __cArray2);
          DiagErrCodeTestStep(-1, "Cannot set diagnostic parameter 'GroupOfDtc'");
      	break;
        }
      }

      if (0 >= DiagSendReqAndWaitForResp("CVADAS_0001_00000000_000", __req, __resp, __res, -1, -1, -1, -1, -1, EnumResult_pos, EnumServiceDetails_onfail, EnumSendingMode_physical, EnumSuppressPosResBit_asconfigured, EnumVerdictOnInvalidValues_fail))
        break;
    }

    __res = DiagErrCodeTestStep(__res, "Can't retrieve last response for request! No check possible.") < 0;
    if(__res)
    {
	  __bVerdict = __eVerdictFail;
      break;
    }
    {
      __res = DiagInterpretAs(__resp, "CDI_PR");
      if(__res != 0)
      {
        __bVerdict = __eVerdictFail;
        DiagErrCodeTestStep(__res, "Can't interpret response as diagnostic primitive 'CDI_PR'.");
        break;
      }
      else
      {
        TestStepPass( "Received primitive can be interpreted as diagnostic primitive 'CDI_PR'.");
      }
    }
  }
  while(0);


  if (__bVerdict == __eVerdictFail)
    TestReportWriteDiagObjectList();
}
  
void __diagServicevccmce9_2(DiagRequest * __req, DiagResponse * __resp )
{
  stack long __tableHandle;
  long __res, __paramLen, __bytePos;

   __bVerdict = __eVerdictPass;

  do {
    TestReportResetDiagObjectList();
    DiagSetReportDetailLevel("CVADAS_0001_00000000_000", EnumServiceDetails_onfail);
    // Request aspect
    {

      if (0 >= DiagSendReqAndWaitForResp("CVADAS_0001_00000000_000", __req, __resp, __res, -1, -1, -1, -1, -1, EnumResult_pos, EnumServiceDetails_onfail, EnumSendingMode_physical, EnumSuppressPosResBit_asconfigured, EnumVerdictOnInvalidValues_fail))
        break;
    }

    __res = DiagErrCodeTestStep(__res, "Can't retrieve last response for request! No check possible.") < 0;
    if(__res)
    {
	  __bVerdict = __eVerdictFail;
      break;
    }
    {
      __res = DiagInterpretAs(__resp, "RDBI_PR");
      if(__res != 0)
      {
        __bVerdict = __eVerdictFail;
        DiagErrCodeTestStep(__res, "Can't interpret response as diagnostic primitive 'RDBI_PR'.");
        break;
      }
      else
      {
        TestStepPass( "Received primitive can be interpreted as diagnostic primitive 'RDBI_PR'.");
      }
    }
  }
  while(0);


  // Response, check & read aspect
  {
    __res = 1;
    __tableHandle = ReportTableHead5Columns(__cCheckCaption, __cTSym, __cTOp, __cRefVal, __cActual, __cRes);
    {
      __bDiagValueArrayCtr = DiagGetParameterErrorHandled(__resp, "PMIC_Reset_Reason", __bDiagValueArray, elcount(__bDiagValueArray), __cDiagValueArray, elcount(__cDiagValueArray));
      {
        byte __bArray2[1] = { 0x00 };
        __bArrayCtr = __CopyBytes(__bDiagValueArray, __bDiagValueArrayCtr, __bArray);
        __bArrayCtr2 = elCount(__bArray2);
        __csr = CompareBytes(__bArray, __bArrayCtr, __bArray2, __bArrayCtr2) == 0;
        snprintf(__cArray, 8192, "%s", "Diagnostic parameter \'PMIC_Reset_Reason\'");
        snprintf(__cArray2, 8192, "%s", __cArray);
        snprintf(__cArray3, 8192, "%s", "");
        ReportTableRow(__tableHandle, 0, __cArray2, "Bytes", __bArray2, __bArrayCtr2, __cArray3, __oneOfFlag, __bSetInCheckAlignment);
        ReportCell(__tableHandle, __bArray, __bArrayCtr);
        ReportCellResult(__tableHandle, __csr, __ePassFail);
      }
    
      __res = __res && __csr;
    
    }
    {
      DiagGetParameterErrorHandled(__resp, "nvm_ResetReasonID", __nDouble);
      {
        __bSetInCheckAlignment = 1;	
        @sysvarInt::`Reset_Reason::`Reset_Reason = __nDouble;
        snprintf(__cArray, 8192, "%s", "Reset_Reason");
        snprintf(__cArray2, 8192, "%s '%s'", __cSysVar, __cArray);
        snprintf(__cArray3, 8192, "%s", "nvm_ResetReasonID");
        
        ReportTableRow(__tableHandle, 0, __cArray2, __cAOp, __nDouble, __cArray3, __oneOfFlag, __bSetInCheckAlignment);
        
    
        __bSetInCheckAlignment = 0;
      }
    }
    ReportTableEndVerdict(__tableHandle, __cEvaluateResponse, __res);
	__bVerdict = __bVerdict && __res;
  }
  if (__bVerdict == __eVerdictFail)
    TestReportWriteDiagObjectList();
}
  
void __diagServicevccmce9_3(DiagRequest * __req, DiagResponse * __resp )
{
  stack long __tableHandle;
  long __res, __paramLen, __bytePos;

   __bVerdict = __eVerdictPass;

  do {
    TestReportResetDiagObjectList();
    DiagSetReportDetailLevel("CVADAS_0001_00000000_000", EnumServiceDetails_onfail);
    // Request aspect
    {

      if (0 >= DiagSendReqAndWaitForResp("CVADAS_0001_00000000_000", __req, __resp, __res, -1, -1, -1, -1, -1, EnumResult_pos, EnumServiceDetails_onfail, EnumSendingMode_physical, EnumSuppressPosResBit_asconfigured, EnumVerdictOnInvalidValues_fail))
        break;
    }

    __res = DiagErrCodeTestStep(__res, "Can't retrieve last response for request! No check possible.") < 0;
    if(__res)
    {
	  __bVerdict = __eVerdictFail;
      break;
    }
    {
      __res = DiagInterpretAs(__resp, "RDBI_PR");
      if(__res != 0)
      {
        __bVerdict = __eVerdictFail;
        DiagErrCodeTestStep(__res, "Can't interpret response as diagnostic primitive 'RDBI_PR'.");
        break;
      }
      else
      {
        TestStepPass( "Received primitive can be interpreted as diagnostic primitive 'RDBI_PR'.");
      }
    }
  }
  while(0);


  // Response, check & read aspect
  {
    __res = 1;
    __tableHandle = ReportTableHead5Columns(__cCheckCaption, __cTSym, __cTOp, __cRefVal, __cActual, __cRes);
    {
      __bDiagValueArrayCtr = DiagGetParameterErrorHandled(__resp, "Error_Flags", __bDiagValueArray, elcount(__bDiagValueArray), __cDiagValueArray, elcount(__cDiagValueArray));
      {
        byte __bArray2[2] = { 0x00, 0x00 };
        __bArrayCtr = __CopyBytes(__bDiagValueArray, __bDiagValueArrayCtr, __bArray);
        __bArrayCtr2 = elCount(__bArray2);
        __csr = CompareBytes(__bArray, __bArrayCtr, __bArray2, __bArrayCtr2) == 0;
        snprintf(__cArray, 8192, "%s", "Diagnostic parameter \'Error_Flags\'");
        snprintf(__cArray2, 8192, "%s", __cArray);
        snprintf(__cArray3, 8192, "%s", "");
        ReportTableRow(__tableHandle, 0, __cArray2, "Bytes", __bArray2, __bArrayCtr2, __cArray3, __oneOfFlag, __bSetInCheckAlignment);
        ReportCell(__tableHandle, __bArray, __bArrayCtr);
        ReportCellResult(__tableHandle, __csr, __ePassFail);
      }
    
      __res = __res && __csr;
    
    }
    ReportTableEndVerdict(__tableHandle, __cEvaluateResponse, __res);
	__bVerdict = __bVerdict && __res;
  }
  if (__bVerdict == __eVerdictFail)
    TestReportWriteDiagObjectList();
}
  
void __diagServicevccmce9_4(DiagRequest * __req, DiagResponse * __resp )
{
  stack long __tableHandle;
  long __res, __paramLen, __bytePos;

   __bVerdict = __eVerdictPass;

  do {
    TestReportResetDiagObjectList();
    DiagSetReportDetailLevel("CVADAS_0001_00000000_000", EnumServiceDetails_always);
    // Request aspect
    {

      if (0 >= DiagSendReqAndWaitForResp("CVADAS_0001_00000000_000", __req, __resp, __res, -1, -1, -1, -1, -1, EnumResult_pos, EnumServiceDetails_always, EnumSendingMode_functional, EnumSuppressPosResBit_asconfigured, EnumVerdictOnInvalidValues_no_impact))
        break;
    }

    __res = DiagErrCodeTestStep(__res, "Can't retrieve last response for request! No check possible.") < 0;
    if(__res)
    {
	  __bVerdict = __eVerdictFail;
      break;
    }
    {
      __res = DiagInterpretAs(__resp, "RDBI_PR");
      if(__res != 0)
      {
        __bVerdict = __eVerdictFail;
        DiagErrCodeTestStep(__res, "Can't interpret response as diagnostic primitive 'RDBI_PR'.");
        break;
      }
      else
      {
        TestStepPass( "Received primitive can be interpreted as diagnostic primitive 'RDBI_PR'.");
      }
    }
  }
  while(0);


  if (__bVerdict == __eVerdictFail)
    TestReportWriteDiagObjectList();
}
  
void __diagServicevccmce9_5(DiagRequest * __req, DiagResponse * __resp )
{
  stack long __tableHandle;
  long __res, __paramLen, __bytePos;

   __bVerdict = __eVerdictPass;

  do {
    TestReportResetDiagObjectList();
    DiagSetReportDetailLevel("CVADAS_0001_00000000_000", EnumServiceDetails_always);
    // Request aspect
    {

      if (0 >= DiagSendReqAndWaitForResp("CVADAS_0001_00000000_000", __req, __resp, __res, -1, -1, -1, -1, -1, EnumResult_pos, EnumServiceDetails_always, EnumSendingMode_functional, EnumSuppressPosResBit_asconfigured, EnumVerdictOnInvalidValues_no_impact))
        break;
    }

    __res = DiagErrCodeTestStep(__res, "Can't retrieve last response for request! No check possible.") < 0;
    if(__res)
    {
	  __bVerdict = __eVerdictFail;
      break;
    }
    {
      __res = DiagInterpretAs(__resp, "RDBI_PR");
      if(__res != 0)
      {
        __bVerdict = __eVerdictFail;
        DiagErrCodeTestStep(__res, "Can't interpret response as diagnostic primitive 'RDBI_PR'.");
        break;
      }
      else
      {
        TestStepPass( "Received primitive can be interpreted as diagnostic primitive 'RDBI_PR'.");
      }
    }
  }
  while(0);


  if (__bVerdict == __eVerdictFail)
    TestReportWriteDiagObjectList();
}

void Ttvccmce9_HMI_General_Precondition()
{
  stack long __tableHandle;
  TestCommandBegin(__eSet, __cSet, "", "0");
  {
    __tableHandle = ReportTableHead3Columns(__cSetCaption , __cTSym, __cTOp, __cAssigned); 
    {
      $`FDCAN2::dbNode::`BCM::`TRANSM_FD_4::`ShiftLeverPosition.phys = 1;
      snprintf(__cArray, 8192, "%s", "ShiftLeverPosition");
      snprintf(__cArray2, 8192, "%s '%s'", __cCANSignal, __cArray);
      snprintf(__cArray3, 8192, "%s", "");
      
      ReportSetLValueOrSignalNotOnline(getSignalTime(`FDCAN2::dbNode::`BCM::`TRANSM_FD_4::`ShiftLeverPosition), __cArray2, __cArray4, 8192);
      ReportTableRow(__tableHandle, 0, __cArray4, __cAOp, 1, __cArray3, __oneOfFlag, __bSetInCheckAlignment);
      
  
    }
    ReportTableEndTestStep(__tableHandle, "1");
  }
  TestCommandEnd();


  TestCommandBegin(__eSet, __cSet, "", "1");
  {
    __tableHandle = ReportTableHead3Columns(__cSetCaption , __cTSym, __cTOp, __cAssigned); 
    {
      $`FDCAN2::dbNode::`SGW::`TELEMATIC_FD_5::`CameraDisplaySts2.phys = 0;
      snprintf(__cArray, 8192, "%s", "CameraDisplaySts2");
      snprintf(__cArray2, 8192, "%s '%s'", __cCANSignal, __cArray);
      snprintf(__cArray3, 8192, "%s", "");
      
      ReportSetLValueOrSignalNotOnline(getSignalTime(`FDCAN2::dbNode::`SGW::`TELEMATIC_FD_5::`CameraDisplaySts2), __cArray2, __cArray4, 8192);
      ReportTableRow(__tableHandle, 0, __cArray4, __cAOp, 0, __cArray3, __oneOfFlag, __bSetInCheckAlignment);
      
  
    }
    ReportTableEndTestStep(__tableHandle, "1");
  }
  TestCommandEnd();


  TestCommandBegin(__eSet, __cSet, "", "2");
  {
    __tableHandle = ReportTableHead3Columns(__cSetCaption , __cTSym, __cTOp, __cAssigned); 
    {
      $`FDCAN2::dbNode::`BCM::`TRANSM_FD_4::`ShiftLeverPosition.phys = 2;
      snprintf(__cArray, 8192, "%s", "ShiftLeverPosition");
      snprintf(__cArray2, 8192, "%s '%s'", __cCANSignal, __cArray);
      snprintf(__cArray3, 8192, "%s", "");
      
      ReportSetLValueOrSignalNotOnline(getSignalTime(`FDCAN2::dbNode::`BCM::`TRANSM_FD_4::`ShiftLeverPosition), __cArray2, __cArray4, 8192);
      ReportTableRow(__tableHandle, 0, __cArray4, __cAOp, 2, __cArray3, __oneOfFlag, __bSetInCheckAlignment);
      
  
    }
    ReportTableEndTestStep(__tableHandle, "1");
  }
  TestCommandEnd();


  TestCommandBegin(__eWait, __cWait, "", "3");
  {
    Wait("1", (500 * 1000000LL), 1000000, "");
  }
  TestCommandEnd();

  TestCommandBegin(__eSet, __cSet, "", "4");
  {
    __tableHandle = ReportTableHead3Columns(__cSetCaption , __cTSym, __cTOp, __cAssigned); 
    {
      $`FDCAN2::dbNode::`SGW::`TELEMATIC_FD_14::`TGW_CAMERA_DISP_STAT.phys = 0;
      snprintf(__cArray, 8192, "%s", "TGW_CAMERA_DISP_STAT");
      snprintf(__cArray2, 8192, "%s '%s'", __cCANSignal, __cArray);
      snprintf(__cArray3, 8192, "%s", "");
      
      ReportSetLValueOrSignalNotOnline(getSignalTime(`FDCAN2::dbNode::`SGW::`TELEMATIC_FD_14::`TGW_CAMERA_DISP_STAT), __cArray2, __cArray4, 8192);
      ReportTableRow(__tableHandle, 0, __cArray4, __cAOp, 0, __cArray3, __oneOfFlag, __bSetInCheckAlignment);
      
  
    }
    ReportTableEndTestStep(__tableHandle, "1");
  }
  TestCommandEnd();


  TestCommandBegin(__eWait, __cWait, "", "5");
  {
    Wait("1", (500 * 1000000LL), 1000000, "");
  }
  TestCommandEnd();

  TestCommandBegin(__eSet, __cSet, "", "6");
  {
    __tableHandle = ReportTableHead3Columns(__cSetCaption , __cTSym, __cTOp, __cAssigned); 
    {
      $`FDCAN2::dbNode::`SGW::`TELEMATIC_FD_5::`CameraDisplaySts2.phys = 0;
      snprintf(__cArray, 8192, "%s", "CameraDisplaySts2");
      snprintf(__cArray2, 8192, "%s '%s'", __cCANSignal, __cArray);
      snprintf(__cArray3, 8192, "%s", "");
      
      ReportSetLValueOrSignalNotOnline(getSignalTime(`FDCAN2::dbNode::`SGW::`TELEMATIC_FD_5::`CameraDisplaySts2), __cArray2, __cArray4, 8192);
      ReportTableRow(__tableHandle, 0, __cArray4, __cAOp, 0, __cArray3, __oneOfFlag, __bSetInCheckAlignment);
      
  
    }
    ReportTableEndTestStep(__tableHandle, "1");
  }
  TestCommandEnd();


  TestCommandBegin(__eWait, __cWait, "", "7");
  {
    Wait("1", (500 * 1000000LL), 1000000, "");
  }
  TestCommandEnd();

  TestCommandBegin(__eSet, __cSet, "", "8");
  {
    __tableHandle = ReportTableHead3Columns(__cSetCaption , __cTSym, __cTOp, __cAssigned); 
    {
      $`FDCAN2::dbNode::`BCM::`BRAKE_FD_2::`VehicleSpeedVSOSig.phys = 0;
      snprintf(__cArray, 8192, "%s", "BCM::BRAKE_FD_2::VehicleSpeedVSOSig");
      snprintf(__cArray2, 8192, "%s '%s'", __cCANSignal, __cArray);
      snprintf(__cArray3, 8192, "%s", "");
      
      ReportSetLValueOrSignalNotOnline(getSignalTime(`FDCAN2::dbNode::`BCM::`BRAKE_FD_2::`VehicleSpeedVSOSig), __cArray2, __cArray4, 8192);
      ReportTableRow(__tableHandle, 0, __cArray4, __cAOp, 0, __cArray3, __oneOfFlag, __bSetInCheckAlignment);
      
  
    }
    ReportTableEndTestStep(__tableHandle, "1");
  }
  TestCommandEnd();


  TestCommandBegin(__eWait, __cWait, "", "9");
  {
    Wait("1", (500 * 1000000LL), 1000000, "");
  }
  TestCommandEnd();

  TestCommandBegin(__eSet, __cSet, "", "10");
  {
    __tableHandle = ReportTableHead3Columns(__cSetCaption , __cTSym, __cTOp, __cAssigned); 
    {
      $`FDCAN2::dbNode::`BCM::`BRAKE_FD_2::`VehicleSpeedVSOSig.phys = 0;
      snprintf(__cArray, 8192, "%s", "BCM::BRAKE_FD_2::VehicleSpeedVSOSig");
      snprintf(__cArray2, 8192, "%s '%s'", __cCANSignal, __cArray);
      snprintf(__cArray3, 8192, "%s", "");
      
      ReportSetLValueOrSignalNotOnline(getSignalTime(`FDCAN2::dbNode::`BCM::`BRAKE_FD_2::`VehicleSpeedVSOSig), __cArray2, __cArray4, 8192);
      ReportTableRow(__tableHandle, 0, __cArray4, __cAOp, 0, __cArray3, __oneOfFlag, __bSetInCheckAlignment);
      
  
    }
    ReportTableEndTestStep(__tableHandle, "1");
  }
  TestCommandEnd();


  TestCommandBegin(__eWait, __cWait, "", "11");
  {
    Wait("1", (500 * 1000000LL), 1000000, "");
  }
  TestCommandEnd();

  TestCommandBegin(__eSet, __cSet, "", "12");
  {
    __tableHandle = ReportTableHead3Columns(__cSetCaption , __cTSym, __cTOp, __cAssigned); 
    {
      $`FDCAN2::dbNode::`BCM::`TRANSM_FD_4::`ShiftLeverPosition.phys = 2;
      snprintf(__cArray, 8192, "%s", "ShiftLeverPosition");
      snprintf(__cArray2, 8192, "%s '%s'", __cCANSignal, __cArray);
      snprintf(__cArray3, 8192, "%s", "");
      
      ReportSetLValueOrSignalNotOnline(getSignalTime(`FDCAN2::dbNode::`BCM::`TRANSM_FD_4::`ShiftLeverPosition), __cArray2, __cArray4, 8192);
      ReportTableRow(__tableHandle, 0, __cArray4, __cAOp, 2, __cArray3, __oneOfFlag, __bSetInCheckAlignment);
      
  
    }
    ReportTableEndTestStep(__tableHandle, "1");
  }
  TestCommandEnd();


  TestCommandBegin(__eWait, __cWait, "", "13");
  {
    Wait("1", (6000 * 1000000LL), 1000000, "");
  }
  TestCommandEnd();

}

void Ttvccmce9_General_Postconditions()
{
  stack long __tableHandle;
  TestCommandBegin(__eWait, __cWait, "", "0");
  {
    Wait("1", (200 * 1000000LL), 1000000, "");
  }
  TestCommandEnd();

  {
    CreateCaplIFFunction("Enable_CAN_Communication", __eFct);
    CallInterfaceFunction(__cEmpty, __cEmpty, "1");
  }


  TestCommandBegin(__eDiagService, __cDiagService, "", "2");
  {
    if (DiagIsFunctionalGroup("CVADAS_0001_00000000_000"))
    {
      DiagResponse * __resp;
      DiagRequest CVADAS_0001_00000000_000._22FDF2_Reset_Reason_Read __req;
      __diagServicevccmce9_6(__req, __resp);
    }
    else
    {
      DiagResponse CVADAS_0001_00000000_000.* __resp;
      DiagRequest CVADAS_0001_00000000_000._22FDF2_Reset_Reason_Read __req;
      __diagServicevccmce9_6(__req, __resp);
    }
  }
  TestCommandEnd();


}

  
void __diagServicevccmce9_6(DiagRequest * __req, DiagResponse * __resp )
{
  stack long __tableHandle;
  long __res, __paramLen, __bytePos;

   __bVerdict = __eVerdictPass;

  do {
    TestReportResetDiagObjectList();
    DiagSetReportDetailLevel("CVADAS_0001_00000000_000", EnumServiceDetails_onfail);
    // Request aspect
    {

      if (0 >= DiagSendReqAndWaitForResp("CVADAS_0001_00000000_000", __req, __resp, __res, -1, -1, -1, -1, -1, EnumResult_pos, EnumServiceDetails_onfail, EnumSendingMode_physical, EnumSuppressPosResBit_asconfigured, EnumVerdictOnInvalidValues_fail))
        break;
    }

    __res = DiagErrCodeTestStep(__res, "Can't retrieve last response for request! No check possible.") < 0;
    if(__res)
    {
	  __bVerdict = __eVerdictFail;
      break;
    }
    {
      __res = DiagInterpretAs(__resp, "RDBI_PR");
      if(__res != 0)
      {
        __bVerdict = __eVerdictFail;
        DiagErrCodeTestStep(__res, "Can't interpret response as diagnostic primitive 'RDBI_PR'.");
        break;
      }
      else
      {
        TestStepPass( "Received primitive can be interpreted as diagnostic primitive 'RDBI_PR'.");
      }
    }
  }
  while(0);


  // Response, check & read aspect
  {
    __res = 1;
    __tableHandle = ReportTableHead5Columns(__cCheckCaption, __cTSym, __cTOp, __cRefVal, __cActual, __cRes);
    {
      __bDiagValueArrayCtr = DiagGetParameterErrorHandled(__resp, "PMIC_Reset_Reason", __bDiagValueArray, elcount(__bDiagValueArray), __cDiagValueArray, elcount(__cDiagValueArray));
      {
        byte __bArray2[1] = { 0x00 };
        __bArrayCtr = __CopyBytes(__bDiagValueArray, __bDiagValueArrayCtr, __bArray);
        __bArrayCtr2 = elCount(__bArray2);
        __csr = CompareBytes(__bArray, __bArrayCtr, __bArray2, __bArrayCtr2) == 0;
        snprintf(__cArray, 8192, "%s", "Diagnostic parameter \'PMIC_Reset_Reason\'");
        snprintf(__cArray2, 8192, "%s", __cArray);
        snprintf(__cArray3, 8192, "%s", "");
        ReportTableRow(__tableHandle, 0, __cArray2, "Bytes", __bArray2, __bArrayCtr2, __cArray3, __oneOfFlag, __bSetInCheckAlignment);
        ReportCell(__tableHandle, __bArray, __bArrayCtr);
        ReportCellResult(__tableHandle, __csr, __ePassFail);
      }
    
      __res = __res && __csr;
    
    }
    {
      DiagGetParameterErrorHandled(__resp, "nvm_ResetReasonID", __nDouble);
      {
        __bSetInCheckAlignment = 1;	
        @sysvarInt::`Reset_Reason::`Reset_Reason = __nDouble;
        snprintf(__cArray, 8192, "%s", "Reset_Reason");
        snprintf(__cArray2, 8192, "%s '%s'", __cSysVar, __cArray);
        snprintf(__cArray3, 8192, "%s", "nvm_ResetReasonID");
        
        ReportTableRow(__tableHandle, 0, __cArray2, __cAOp, __nDouble, __cArray3, __oneOfFlag, __bSetInCheckAlignment);
        
    
        __bSetInCheckAlignment = 0;
      }
    }
    ReportTableEndVerdict(__tableHandle, __cEvaluateResponse, __res);
	__bVerdict = __bVerdict && __res;
  }
  if (__bVerdict == __eVerdictFail)
    TestReportWriteDiagObjectList();
}

void Ttvccmce9_Default_Session_Standard_Physical_Address()
{
  stack long __tableHandle;
  TestCommandBegin(__eRequestResponse, __cRequestResponse, "", "0");
  {
    message `FDCAN2::`DIAGNOSTIC_RESPONSE_PAM __tt0msg_0;
  
    long __res;
    int64 __timeout;
    __res = 0;
    __nInt64 = 1;
    __timeout = syspar::`P2_Server * 1000000LL;
    {
    
      long __testStepInitOk;
      message `FDCAN2::`DIAGNOSTIC_REQUEST_PAM __output;
      message `FDCAN2::`DIAGNOSTIC_REQUEST_PAM __msgOrig;
      __output = __msgOrig;
      __testStepInitOk = 1;
      {
        int64 __dlc;
        __dlc = 3;
        if (__dlc >= 0 && __dlc <= (__output.EDL ? 15 : 8))
          __output.DLC = __dlc;
        else
        {
          testStepErrorInTestSystem(0, __cEmpty, "Unable to set DLC=%lld in message. Please check input parameter.", __dlc);
          __testStepInitOk = 0;
        }
      }
      if (__testStepInitOk)
      {
        snprintf(__cArray, elCount(__cArray), "CAN message '%s' ID = 416981233x (0x18DAA0F1x) on bus FDCAN2", "DIAGNOSTIC_REQUEST_PAM");
        snprintf(__cArray2, elCount(__cArray2), "Send %s", __cArray);
        __tableHandle = ReportTableHead3Columns(__cArray2, "Byte", __cTOp, __cAssigned);
        ReportByteIndex("", 0, __cArray, elCount(__cArray));
        snprintf(__cArray2, 8192, "%s", __cArray);
        snprintf(__cArray3, 8192, "%s", "");
        
        ReportTableRow(__tableHandle, 0, __cArray2, __cAOp, 0x2, __cArray3, __oneOfFlag, __bSetInCheckAlignment);
        
        if (0 >= 0 && 0 < 64)
        {
          __output.byte((word)0) = 0x2;
        }
        else
        {
          testStepErrorInTestSystem(0, __cEmpty, "Index out of range. Unable to set byte %lld in message. Please check input parameter.", (int64)0);
          __testStepInitOk = 0;
        }
        ReportByteIndex("", 1, __cArray, elCount(__cArray));
        snprintf(__cArray2, 8192, "%s", __cArray);
        snprintf(__cArray3, 8192, "%s", "");
        
        ReportTableRow(__tableHandle, 0, __cArray2, __cAOp, 0x10, __cArray3, __oneOfFlag, __bSetInCheckAlignment);
        
        if (1 >= 0 && 1 < 64)
        {
          __output.byte((word)1) = 0x10;
        }
        else
        {
          testStepErrorInTestSystem(0, __cEmpty, "Index out of range. Unable to set byte %lld in message. Please check input parameter.", (int64)1);
          __testStepInitOk = 0;
        }
        ReportByteIndex("", 2, __cArray, elCount(__cArray));
        snprintf(__cArray2, 8192, "%s", __cArray);
        snprintf(__cArray3, 8192, "%s", "");
        
        ReportTableRow(__tableHandle, 0, __cArray2, __cAOp, 0x1, __cArray3, __oneOfFlag, __bSetInCheckAlignment);
        
        if (2 >= 0 && 2 < 64)
        {
          __output.byte((word)2) = 0x1;
        }
        else
        {
          testStepErrorInTestSystem(0, __cEmpty, "Index out of range. Unable to set byte %lld in message. Please check input parameter.", (int64)2);
          __testStepInitOk = 0;
        }
      
        ReportTableEndTestStep(__tableHandle, "Req1");
      }
      if (__testStepInitOk)
      {
        output(__output);
      }
    }
    if (__timeout <= 0)
    {
      testStepErrorInTestSystem(0, "1", "Unable to wait for %.3f %s. Please check input parameter.", __timeout / ((float)1000000), "ms");
    }
    else
    {
      if (0 < 0 || 64 <= 0)
      {
        testStepErrorInTestSystem(0, __cEmpty, "Index out of range. Unable to get byte %lld in message.", (int64) 0);
        __nInt64 = 0;
      }
      if (1 < 0 || 64 <= 1)
      {
        testStepErrorInTestSystem(0, __cEmpty, "Index out of range. Unable to get byte %lld in message.", (int64) 1);
        __nInt64 = 0;
      }
      if (2 < 0 || 64 <= 2)
      {
        testStepErrorInTestSystem(0, __cEmpty, "Index out of range. Unable to get byte %lld in message.", (int64) 2);
        __nInt64 = 0;
      }
      if (3 < 0 || 64 <= 3)
      {
        testStepErrorInTestSystem(0, __cEmpty, "Index out of range. Unable to get byte %lld in message.", (int64) 3);
        __nInt64 = 0;
      }
      if (4 < 0 || 64 <= 4)
      {
        testStepErrorInTestSystem(0, __cEmpty, "Index out of range. Unable to get byte %lld in message.", (int64) 4);
        __nInt64 = 0;
      }
      if (5 < 0 || 64 <= 5)
      {
        testStepErrorInTestSystem(0, __cEmpty, "Index out of range. Unable to get byte %lld in message.", (int64) 5);
        __nInt64 = 0;
      }
      if (6 < 0 || 64 <= 6)
      {
        testStepErrorInTestSystem(0, __cEmpty, "Index out of range. Unable to get byte %lld in message.", (int64) 6);
        __nInt64 = 0;
      }
      __tt0cnt_1 = 0;
      snprintf(__cArray, elCount(__cArray), "CAN message '%s' ID = 417001888x (0x18DAF1A0x) on bus FDCAN2", "DIAGNOSTIC_RESPONSE_PAM");
      if(SetBusContextByName("FDCAN2", __eSaveCurrent, __nBusContextNew, __nBusContextOld))
        testJoinMessageEvent(`FDCAN2::`DIAGNOSTIC_RESPONSE_PAM,  __cArray,
             delegate dword(message * __m)
             {
               dword __msg_callback_ret;
               byte __b0;
               byte __b1;
               byte __b2;
               byte __b3;
               byte __b4;
               byte __b5;
               byte __b6;
               if (__tt0cnt_1 == -1)
               {
                 return 1;
               }
               __tt0msg_0 = __m;
               __msg_callback_ret = 1;
               __tt0cnt_1++;
               if (0 < 0 || 64 <= 0) return 0;
               __csr = CheckSignalMatch(__tt0msg_0.byte((word)0), 0x6, "==") == 1;
               __msg_callback_ret &= __csr;
               if (1 < 0 || 64 <= 1) return 0;
               __csr = CheckSignalMatch(__tt0msg_0.byte((word)1), 0x50, "==") == 1;
               __msg_callback_ret &= __csr;
               if (2 < 0 || 64 <= 2) return 0;
               __csr = CheckSignalMatch(__tt0msg_0.byte((word)2), 0x1, "==") == 1;
               __msg_callback_ret &= __csr;
               if (3 < 0 || 64 <= 3) return 0;
               __csr = CheckSignalMatch(__tt0msg_0.byte((word)3), 0x0, "==") == 1;
               __msg_callback_ret &= __csr;
               if (4 < 0 || 64 <= 4) return 0;
               __csr = CheckSignalMatch(__tt0msg_0.byte((word)4), 0x32, "==") == 1;
               __msg_callback_ret &= __csr;
               if (5 < 0 || 64 <= 5) return 0;
               __csr = CheckSignalMatch(__tt0msg_0.byte((word)5), 0x1, "==") == 1;
               __msg_callback_ret &= __csr;
               if (6 < 0 || 64 <= 6) return 0;
               __csr = CheckSignalMatch(__tt0msg_0.byte((word)6), 0xF4, "==") == 1;
               __msg_callback_ret &= __csr;
               if (__msg_callback_ret)
               {
                 __tt0cnt_1 = -1;
                 return 1;
               }
               return 0;
             });
      __res = testWaitForAllJoinedEventsNS(__timeout);
      if (__nInt64 != 0)
      {
        snprintf(__cArray, elCount(__cArray), "CAN message '%s' ID = 417001888x (0x18DAF1A0x) on bus FDCAN2", "DIAGNOSTIC_RESPONSE_PAM");
        if(__tt0cnt_1 == -1)
        {
          snprintf(__cArray2, 8192, "Response of %s", __cArray);
        snprintf(__cArray, 8192, "%s", __cActual);
        }
        else
        {
          snprintf(__cArray2, 8192, "Response of %s (received %d times)", __cArray, __tt0cnt_1);
          snprintf(__cArray, 8192, "Last Received");
        }
        if (__tt0cnt_1 == 0)
        {
          testStepFail(0, "Resp1", __cArray2);
        }
        else
        {
          byte __b0;
          byte __b1;
          byte __b2;
          byte __b3;
          byte __b4;
          byte __b5;
          byte __b6;
          __bVerdict = __eVerdictPass;
          __tableHandle = ReportTableHead5Columns(__cArray2, "Signal/Byte", __cTOp, __cRefVal, __cArray, __cRes);
        __csr = CheckSignalMatch(__tt0msg_0.byte((word)0), 0x6, "==") == 1;
        ReportByteIndex("", 0, __cArray, elCount(__cArray));
        snprintf(__cArray2, 8192, "%s", __cArray);
        snprintf(__cArray3, 8192, "%s", "");
        ReportTableRow(__tableHandle, 0, __cArray2, "==", 0x6, __cArray3, __oneOfFlag, __bSetInCheckAlignment);
        ReportCell(__tableHandle, __tt0msg_0.byte((word)0));
        ReportCellResult(__tableHandle, __csr, __ePassFail);
          __bVerdict &= __csr;
        __csr = CheckSignalMatch(__tt0msg_0.byte((word)1), 0x50, "==") == 1;
        ReportByteIndex("", 1, __cArray, elCount(__cArray));
        snprintf(__cArray2, 8192, "%s", __cArray);
        snprintf(__cArray3, 8192, "%s", "");
        ReportTableRow(__tableHandle, 0, __cArray2, "==", 0x50, __cArray3, __oneOfFlag, __bSetInCheckAlignment);
        ReportCell(__tableHandle, __tt0msg_0.byte((word)1));
        ReportCellResult(__tableHandle, __csr, __ePassFail);
          __bVerdict &= __csr;
        __csr = CheckSignalMatch(__tt0msg_0.byte((word)2), 0x1, "==") == 1;
        ReportByteIndex("", 2, __cArray, elCount(__cArray));
        snprintf(__cArray2, 8192, "%s", __cArray);
        snprintf(__cArray3, 8192, "%s", "");
        ReportTableRow(__tableHandle, 0, __cArray2, "==", 0x1, __cArray3, __oneOfFlag, __bSetInCheckAlignment);
        ReportCell(__tableHandle, __tt0msg_0.byte((word)2));
        ReportCellResult(__tableHandle, __csr, __ePassFail);
          __bVerdict &= __csr;
        __csr = CheckSignalMatch(__tt0msg_0.byte((word)3), 0x0, "==") == 1;
        ReportByteIndex("", 3, __cArray, elCount(__cArray));
        snprintf(__cArray2, 8192, "%s", __cArray);
        snprintf(__cArray3, 8192, "%s", "");
        ReportTableRow(__tableHandle, 0, __cArray2, "==", 0x0, __cArray3, __oneOfFlag, __bSetInCheckAlignment);
        ReportCell(__tableHandle, __tt0msg_0.byte((word)3));
        ReportCellResult(__tableHandle, __csr, __ePassFail);
          __bVerdict &= __csr;
        __csr = CheckSignalMatch(__tt0msg_0.byte((word)4), 0x32, "==") == 1;
        ReportByteIndex("", 4, __cArray, elCount(__cArray));
        snprintf(__cArray2, 8192, "%s", __cArray);
        snprintf(__cArray3, 8192, "%s", "");
        ReportTableRow(__tableHandle, 0, __cArray2, "==", 0x32, __cArray3, __oneOfFlag, __bSetInCheckAlignment);
        ReportCell(__tableHandle, __tt0msg_0.byte((word)4));
        ReportCellResult(__tableHandle, __csr, __ePassFail);
          __bVerdict &= __csr;
        __csr = CheckSignalMatch(__tt0msg_0.byte((word)5), 0x1, "==") == 1;
        ReportByteIndex("", 5, __cArray, elCount(__cArray));
        snprintf(__cArray2, 8192, "%s", __cArray);
        snprintf(__cArray3, 8192, "%s", "");
        ReportTableRow(__tableHandle, 0, __cArray2, "==", 0x1, __cArray3, __oneOfFlag, __bSetInCheckAlignment);
        ReportCell(__tableHandle, __tt0msg_0.byte((word)5));
        ReportCellResult(__tableHandle, __csr, __ePassFail);
          __bVerdict &= __csr;
        __csr = CheckSignalMatch(__tt0msg_0.byte((word)6), 0xF4, "==") == 1;
        ReportByteIndex("", 6, __cArray, elCount(__cArray));
        snprintf(__cArray2, 8192, "%s", __cArray);
        snprintf(__cArray3, 8192, "%s", "");
        ReportTableRow(__tableHandle, 0, __cArray2, "==", 0xF4, __cArray3, __oneOfFlag, __bSetInCheckAlignment);
        ReportCell(__tableHandle, __tt0msg_0.byte((word)6));
        ReportCellResult(__tableHandle, __csr, __ePassFail);
          __bVerdict &= __csr;
          ReportTableEndVerdict(__tableHandle, "Resp1", __bVerdict);
        }
        __ReportRequestResponseResult(__res, 0);
      }
      ResetBusContext(__nBusContextNew, __nBusContextOld);
    }
  }
  TestCommandEnd();

}

void Ttvccmce9_Extended_Session_Standard_Physical_Address()
{
  stack long __tableHandle;
  TestCommandBegin(__eRequestResponse, __cRequestResponse, "", "0");
  {
    message `FDCAN2::`DIAGNOSTIC_RESPONSE_PAM __tt0msg_2;
  
    long __res;
    int64 __timeout;
    __res = 0;
    __nInt64 = 1;
    __timeout = syspar::`P2_Server * 1000000LL;
    {
    
      long __testStepInitOk;
      message `FDCAN2::`DIAGNOSTIC_REQUEST_PAM __output;
      message `FDCAN2::`DIAGNOSTIC_REQUEST_PAM __msgOrig;
      __output = __msgOrig;
      __testStepInitOk = 1;
      {
        int64 __dlc;
        __dlc = 3;
        if (__dlc >= 0 && __dlc <= (__output.EDL ? 15 : 8))
          __output.DLC = __dlc;
        else
        {
          testStepErrorInTestSystem(0, __cEmpty, "Unable to set DLC=%lld in message. Please check input parameter.", __dlc);
          __testStepInitOk = 0;
        }
      }
      if (__testStepInitOk)
      {
        snprintf(__cArray, elCount(__cArray), "CAN message '%s' ID = 416981233x (0x18DAA0F1x) on bus FDCAN2", "DIAGNOSTIC_REQUEST_PAM");
        snprintf(__cArray2, elCount(__cArray2), "Send %s", __cArray);
        __tableHandle = ReportTableHead3Columns(__cArray2, "Byte", __cTOp, __cAssigned);
        ReportByteIndex("", 0, __cArray, elCount(__cArray));
        snprintf(__cArray2, 8192, "%s", __cArray);
        snprintf(__cArray3, 8192, "%s", "");
        
        ReportTableRow(__tableHandle, 0, __cArray2, __cAOp, 0x2, __cArray3, __oneOfFlag, __bSetInCheckAlignment);
        
        if (0 >= 0 && 0 < 64)
        {
          __output.byte((word)0) = 0x2;
        }
        else
        {
          testStepErrorInTestSystem(0, __cEmpty, "Index out of range. Unable to set byte %lld in message. Please check input parameter.", (int64)0);
          __testStepInitOk = 0;
        }
        ReportByteIndex("", 1, __cArray, elCount(__cArray));
        snprintf(__cArray2, 8192, "%s", __cArray);
        snprintf(__cArray3, 8192, "%s", "");
        
        ReportTableRow(__tableHandle, 0, __cArray2, __cAOp, 0x10, __cArray3, __oneOfFlag, __bSetInCheckAlignment);
        
        if (1 >= 0 && 1 < 64)
        {
          __output.byte((word)1) = 0x10;
        }
        else
        {
          testStepErrorInTestSystem(0, __cEmpty, "Index out of range. Unable to set byte %lld in message. Please check input parameter.", (int64)1);
          __testStepInitOk = 0;
        }
        ReportByteIndex("", 2, __cArray, elCount(__cArray));
        snprintf(__cArray2, 8192, "%s", __cArray);
        snprintf(__cArray3, 8192, "%s", "");
        
        ReportTableRow(__tableHandle, 0, __cArray2, __cAOp, 0x3, __cArray3, __oneOfFlag, __bSetInCheckAlignment);
        
        if (2 >= 0 && 2 < 64)
        {
          __output.byte((word)2) = 0x3;
        }
        else
        {
          testStepErrorInTestSystem(0, __cEmpty, "Index out of range. Unable to set byte %lld in message. Please check input parameter.", (int64)2);
          __testStepInitOk = 0;
        }
      
        ReportTableEndTestStep(__tableHandle, "Req1");
      }
      if (__testStepInitOk)
      {
        output(__output);
      }
    }
    if (__timeout <= 0)
    {
      testStepErrorInTestSystem(0, "1", "Unable to wait for %.3f %s. Please check input parameter.", __timeout / ((float)1000000), "ms");
    }
    else
    {
      if (0 < 0 || 64 <= 0)
      {
        testStepErrorInTestSystem(0, __cEmpty, "Index out of range. Unable to get byte %lld in message.", (int64) 0);
        __nInt64 = 0;
      }
      if (1 < 0 || 64 <= 1)
      {
        testStepErrorInTestSystem(0, __cEmpty, "Index out of range. Unable to get byte %lld in message.", (int64) 1);
        __nInt64 = 0;
      }
      if (2 < 0 || 64 <= 2)
      {
        testStepErrorInTestSystem(0, __cEmpty, "Index out of range. Unable to get byte %lld in message.", (int64) 2);
        __nInt64 = 0;
      }
      if (3 < 0 || 64 <= 3)
      {
        testStepErrorInTestSystem(0, __cEmpty, "Index out of range. Unable to get byte %lld in message.", (int64) 3);
        __nInt64 = 0;
      }
      if (4 < 0 || 64 <= 4)
      {
        testStepErrorInTestSystem(0, __cEmpty, "Index out of range. Unable to get byte %lld in message.", (int64) 4);
        __nInt64 = 0;
      }
      if (5 < 0 || 64 <= 5)
      {
        testStepErrorInTestSystem(0, __cEmpty, "Index out of range. Unable to get byte %lld in message.", (int64) 5);
        __nInt64 = 0;
      }
      if (6 < 0 || 64 <= 6)
      {
        testStepErrorInTestSystem(0, __cEmpty, "Index out of range. Unable to get byte %lld in message.", (int64) 6);
        __nInt64 = 0;
      }
      __tt0cnt_3 = 0;
      snprintf(__cArray, elCount(__cArray), "CAN message '%s' ID = 417001888x (0x18DAF1A0x) on bus FDCAN2", "DIAGNOSTIC_RESPONSE_PAM");
      if(SetBusContextByName("FDCAN2", __eSaveCurrent, __nBusContextNew, __nBusContextOld))
        testJoinMessageEvent(`FDCAN2::`DIAGNOSTIC_RESPONSE_PAM,  __cArray,
             delegate dword(message * __m)
             {
               dword __msg_callback_ret;
               byte __b0;
               byte __b1;
               byte __b2;
               byte __b3;
               byte __b4;
               byte __b5;
               byte __b6;
               if (__tt0cnt_3 == -1)
               {
                 return 1;
               }
               __tt0msg_2 = __m;
               __msg_callback_ret = 1;
               __tt0cnt_3++;
               if (0 < 0 || 64 <= 0) return 0;
               __csr = CheckSignalMatch(__tt0msg_2.byte((word)0), 0x6, "==") == 1;
               __msg_callback_ret &= __csr;
               if (1 < 0 || 64 <= 1) return 0;
               __csr = CheckSignalMatch(__tt0msg_2.byte((word)1), 0x50, "==") == 1;
               __msg_callback_ret &= __csr;
               if (2 < 0 || 64 <= 2) return 0;
               __csr = CheckSignalMatch(__tt0msg_2.byte((word)2), 0x3, "==") == 1;
               __msg_callback_ret &= __csr;
               if (3 < 0 || 64 <= 3) return 0;
               __csr = CheckSignalMatch(__tt0msg_2.byte((word)3), 0x0, "==") == 1;
               __msg_callback_ret &= __csr;
               if (4 < 0 || 64 <= 4) return 0;
               __csr = CheckSignalMatch(__tt0msg_2.byte((word)4), 0x32, "==") == 1;
               __msg_callback_ret &= __csr;
               if (5 < 0 || 64 <= 5) return 0;
               __csr = CheckSignalMatch(__tt0msg_2.byte((word)5), 0x1, "==") == 1;
               __msg_callback_ret &= __csr;
               if (6 < 0 || 64 <= 6) return 0;
               __csr = CheckSignalMatch(__tt0msg_2.byte((word)6), 0xF4, "==") == 1;
               __msg_callback_ret &= __csr;
               if (__msg_callback_ret)
               {
                 __tt0cnt_3 = -1;
                 return 1;
               }
               return 0;
             });
      __res = testWaitForAllJoinedEventsNS(__timeout);
      if (__nInt64 != 0)
      {
        snprintf(__cArray, elCount(__cArray), "CAN message '%s' ID = 417001888x (0x18DAF1A0x) on bus FDCAN2", "DIAGNOSTIC_RESPONSE_PAM");
        if(__tt0cnt_3 == -1)
        {
          snprintf(__cArray2, 8192, "Response of %s", __cArray);
        snprintf(__cArray, 8192, "%s", __cActual);
        }
        else
        {
          snprintf(__cArray2, 8192, "Response of %s (received %d times)", __cArray, __tt0cnt_3);
          snprintf(__cArray, 8192, "Last Received");
        }
        if (__tt0cnt_3 == 0)
        {
          testStepFail(0, "Resp1", __cArray2);
        }
        else
        {
          byte __b0;
          byte __b1;
          byte __b2;
          byte __b3;
          byte __b4;
          byte __b5;
          byte __b6;
          __bVerdict = __eVerdictPass;
          __tableHandle = ReportTableHead5Columns(__cArray2, "Signal/Byte", __cTOp, __cRefVal, __cArray, __cRes);
        __csr = CheckSignalMatch(__tt0msg_2.byte((word)0), 0x6, "==") == 1;
        ReportByteIndex("", 0, __cArray, elCount(__cArray));
        snprintf(__cArray2, 8192, "%s", __cArray);
        snprintf(__cArray3, 8192, "%s", "");
        ReportTableRow(__tableHandle, 0, __cArray2, "==", 0x6, __cArray3, __oneOfFlag, __bSetInCheckAlignment);
        ReportCell(__tableHandle, __tt0msg_2.byte((word)0));
        ReportCellResult(__tableHandle, __csr, __ePassFail);
          __bVerdict &= __csr;
        __csr = CheckSignalMatch(__tt0msg_2.byte((word)1), 0x50, "==") == 1;
        ReportByteIndex("", 1, __cArray, elCount(__cArray));
        snprintf(__cArray2, 8192, "%s", __cArray);
        snprintf(__cArray3, 8192, "%s", "");
        ReportTableRow(__tableHandle, 0, __cArray2, "==", 0x50, __cArray3, __oneOfFlag, __bSetInCheckAlignment);
        ReportCell(__tableHandle, __tt0msg_2.byte((word)1));
        ReportCellResult(__tableHandle, __csr, __ePassFail);
          __bVerdict &= __csr;
        __csr = CheckSignalMatch(__tt0msg_2.byte((word)2), 0x3, "==") == 1;
        ReportByteIndex("", 2, __cArray, elCount(__cArray));
        snprintf(__cArray2, 8192, "%s", __cArray);
        snprintf(__cArray3, 8192, "%s", "");
        ReportTableRow(__tableHandle, 0, __cArray2, "==", 0x3, __cArray3, __oneOfFlag, __bSetInCheckAlignment);
        ReportCell(__tableHandle, __tt0msg_2.byte((word)2));
        ReportCellResult(__tableHandle, __csr, __ePassFail);
          __bVerdict &= __csr;
        __csr = CheckSignalMatch(__tt0msg_2.byte((word)3), 0x0, "==") == 1;
        ReportByteIndex("", 3, __cArray, elCount(__cArray));
        snprintf(__cArray2, 8192, "%s", __cArray);
        snprintf(__cArray3, 8192, "%s", "");
        ReportTableRow(__tableHandle, 0, __cArray2, "==", 0x0, __cArray3, __oneOfFlag, __bSetInCheckAlignment);
        ReportCell(__tableHandle, __tt0msg_2.byte((word)3));
        ReportCellResult(__tableHandle, __csr, __ePassFail);
          __bVerdict &= __csr;
        __csr = CheckSignalMatch(__tt0msg_2.byte((word)4), 0x32, "==") == 1;
        ReportByteIndex("", 4, __cArray, elCount(__cArray));
        snprintf(__cArray2, 8192, "%s", __cArray);
        snprintf(__cArray3, 8192, "%s", "");
        ReportTableRow(__tableHandle, 0, __cArray2, "==", 0x32, __cArray3, __oneOfFlag, __bSetInCheckAlignment);
        ReportCell(__tableHandle, __tt0msg_2.byte((word)4));
        ReportCellResult(__tableHandle, __csr, __ePassFail);
          __bVerdict &= __csr;
        __csr = CheckSignalMatch(__tt0msg_2.byte((word)5), 0x1, "==") == 1;
        ReportByteIndex("", 5, __cArray, elCount(__cArray));
        snprintf(__cArray2, 8192, "%s", __cArray);
        snprintf(__cArray3, 8192, "%s", "");
        ReportTableRow(__tableHandle, 0, __cArray2, "==", 0x1, __cArray3, __oneOfFlag, __bSetInCheckAlignment);
        ReportCell(__tableHandle, __tt0msg_2.byte((word)5));
        ReportCellResult(__tableHandle, __csr, __ePassFail);
          __bVerdict &= __csr;
        __csr = CheckSignalMatch(__tt0msg_2.byte((word)6), 0xF4, "==") == 1;
        ReportByteIndex("", 6, __cArray, elCount(__cArray));
        snprintf(__cArray2, 8192, "%s", __cArray);
        snprintf(__cArray3, 8192, "%s", "");
        ReportTableRow(__tableHandle, 0, __cArray2, "==", 0xF4, __cArray3, __oneOfFlag, __bSetInCheckAlignment);
        ReportCell(__tableHandle, __tt0msg_2.byte((word)6));
        ReportCellResult(__tableHandle, __csr, __ePassFail);
          __bVerdict &= __csr;
          ReportTableEndVerdict(__tableHandle, "Resp1", __bVerdict);
        }
        __ReportRequestResponseResult(__res, 0);
      }
      ResetBusContext(__nBusContextNew, __nBusContextOld);
    }
  }
  TestCommandEnd();

}

void Ttvccmce9_Programming_Session_Standard_Physical_Address()
{
  stack long __tableHandle;
  TestCommandBegin(__eRequestResponse, __cRequestResponse, "", "0");
  {
  
    long __res;
    int64 __timeout;
    __res = 0;
    __nInt64 = 1;
    __timeout = syspar::`P2_Server * 1000000LL;
    {
    
      long __testStepInitOk;
      message `FDCAN2::`DIAGNOSTIC_REQUEST_PAM __output;
      message `FDCAN2::`DIAGNOSTIC_REQUEST_PAM __msgOrig;
      __output = __msgOrig;
      __testStepInitOk = 1;
      {
        int64 __dlc;
        __dlc = 3;
        if (__dlc >= 0 && __dlc <= (__output.EDL ? 15 : 8))
          __output.DLC = __dlc;
        else
        {
          testStepErrorInTestSystem(0, __cEmpty, "Unable to set DLC=%lld in message. Please check input parameter.", __dlc);
          __testStepInitOk = 0;
        }
      }
      if (__testStepInitOk)
      {
        snprintf(__cArray, elCount(__cArray), "CAN message '%s' ID = 416981233x (0x18DAA0F1x) on bus FDCAN2", "DIAGNOSTIC_REQUEST_PAM");
        snprintf(__cArray2, elCount(__cArray2), "Send %s", __cArray);
        __tableHandle = ReportTableHead3Columns(__cArray2, "Byte", __cTOp, __cAssigned);
        ReportByteIndex("", 0, __cArray, elCount(__cArray));
        snprintf(__cArray2, 8192, "%s", __cArray);
        snprintf(__cArray3, 8192, "%s", "");
        
        ReportTableRow(__tableHandle, 0, __cArray2, __cAOp, 0x2, __cArray3, __oneOfFlag, __bSetInCheckAlignment);
        
        if (0 >= 0 && 0 < 64)
        {
          __output.byte((word)0) = 0x2;
        }
        else
        {
          testStepErrorInTestSystem(0, __cEmpty, "Index out of range. Unable to set byte %lld in message. Please check input parameter.", (int64)0);
          __testStepInitOk = 0;
        }
        ReportByteIndex("", 1, __cArray, elCount(__cArray));
        snprintf(__cArray2, 8192, "%s", __cArray);
        snprintf(__cArray3, 8192, "%s", "");
        
        ReportTableRow(__tableHandle, 0, __cArray2, __cAOp, 0x10, __cArray3, __oneOfFlag, __bSetInCheckAlignment);
        
        if (1 >= 0 && 1 < 64)
        {
          __output.byte((word)1) = 0x10;
        }
        else
        {
          testStepErrorInTestSystem(0, __cEmpty, "Index out of range. Unable to set byte %lld in message. Please check input parameter.", (int64)1);
          __testStepInitOk = 0;
        }
        ReportByteIndex("", 2, __cArray, elCount(__cArray));
        snprintf(__cArray2, 8192, "%s", __cArray);
        snprintf(__cArray3, 8192, "%s", "");
        
        ReportTableRow(__tableHandle, 0, __cArray2, __cAOp, 0x2, __cArray3, __oneOfFlag, __bSetInCheckAlignment);
        
        if (2 >= 0 && 2 < 64)
        {
          __output.byte((word)2) = 0x2;
        }
        else
        {
          testStepErrorInTestSystem(0, __cEmpty, "Index out of range. Unable to set byte %lld in message. Please check input parameter.", (int64)2);
          __testStepInitOk = 0;
        }
      
        ReportTableEndTestStep(__tableHandle, "Req1");
      }
      if (__testStepInitOk)
      {
        output(__output);
      }
    }
    if (__timeout <= 0)
    {
      testStepErrorInTestSystem(0, "1", "Unable to wait for %.3f %s. Please check input parameter.", __timeout / ((float)1000000), "ms");
    }
    else
    {
      __tt0cnt_5 = 0;
      snprintf(__cArray, elCount(__cArray), "CAN message '%s' ID = 417001888x (0x18DAF1A0x) on bus FDCAN2", "DIAGNOSTIC_RESPONSE_PAM");
      if(SetBusContextByName("FDCAN2", __eSaveCurrent, __nBusContextNew, __nBusContextOld))
        testJoinMessageEvent(`FDCAN2::`DIAGNOSTIC_RESPONSE_PAM,  __cArray,
             delegate dword(message * __m)
             {
               dword __msg_callback_ret;
               if (__tt0cnt_5 == -1)
               {
                 return 1;
               }
               __msg_callback_ret = 1;
               __tt0cnt_5++;
               if (__msg_callback_ret)
               {
                 __tt0cnt_5 = -1;
                 return 1;
               }
               return 0;
             });
      __res = testWaitForAllJoinedEventsNS(__timeout);
      if (__nInt64 != 0)
      {
        snprintf(__cArray, elCount(__cArray), "CAN message '%s' ID = 417001888x (0x18DAF1A0x) on bus FDCAN2", "DIAGNOSTIC_RESPONSE_PAM");
        if(__tt0cnt_5 == -1)
        {
          snprintf(__cArray2, 8192, "Response of %s", __cArray);
        }
        else
        {
          snprintf(__cArray2, 8192, "Response of %s (received %d times)", __cArray, __tt0cnt_5);
        }
        if (__tt0cnt_5 == 0)
        {
          testStepFail(0, "Resp1", __cArray2);
        }
        else
        {
          testStepPass(2, "Resp1", __cArray2);
        }
        __ReportRequestResponseResult(__res, 0);
      }
      ResetBusContext(__nBusContextNew, __nBusContextOld);
    }
  }
  TestCommandEnd();

}

void Ttvccmce9_F181_DID_with_Physical_Address()
{
  stack long __tableHandle;
  TestCommandBegin(__eDiagService, __cDiagService, "", "0");
  {
    if (DiagIsFunctionalGroup("CVADAS_0001_00000000_000"))
    {
      DiagResponse * __resp;
      DiagRequest CVADAS_0001_00000000_000._22F181_Application_Software_Identification __req;
      __diagServicevccmce9_7(__req, __resp);
    }
    else
    {
      DiagResponse CVADAS_0001_00000000_000.* __resp;
      DiagRequest CVADAS_0001_00000000_000._22F181_Application_Software_Identification __req;
      __diagServicevccmce9_7(__req, __resp);
    }
  }
  TestCommandEnd();


}

  
void __diagServicevccmce9_7(DiagRequest * __req, DiagResponse * __resp )
{
  stack long __tableHandle;
  long __res, __paramLen, __bytePos;

   __bVerdict = __eVerdictPass;

  do {
    TestReportResetDiagObjectList();
    DiagSetReportDetailLevel("CVADAS_0001_00000000_000", EnumServiceDetails_onfail);
    // Request aspect
    {

      if (0 >= DiagSendReqAndWaitForResp("CVADAS_0001_00000000_000", __req, __resp, __res, -1, -1, -1, -1, -1, EnumResult_pos, EnumServiceDetails_onfail, EnumSendingMode_physical, EnumSuppressPosResBit_asconfigured, EnumVerdictOnInvalidValues_fail))
        break;
    }

    __res = DiagErrCodeTestStep(__res, "Can't retrieve last response for request! No check possible.") < 0;
    if(__res)
    {
	  __bVerdict = __eVerdictFail;
      break;
    }
    {
      __res = DiagInterpretAs(__resp, "RDBI_PR");
      if(__res != 0)
      {
        __bVerdict = __eVerdictFail;
        DiagErrCodeTestStep(__res, "Can't interpret response as diagnostic primitive 'RDBI_PR'.");
        break;
      }
      else
      {
        TestStepPass( "Received primitive can be interpreted as diagnostic primitive 'RDBI_PR'.");
      }
    }
  }
  while(0);


  // Response, check & read aspect
  {
    __res = 1;
    __tableHandle = ReportTableHead5Columns(__cCheckCaption, __cTSym, __cTOp, __cRefVal, __cActual, __cRes);
    {
      __bDiagValueArrayCtr = DiagGetParameterErrorHandled(__resp, "Application_Software_Logical_Block_0_Version_Information_Ident_1", __bDiagValueArray, elcount(__bDiagValueArray), __cDiagValueArray, elcount(__cDiagValueArray));
      {
        __bSetInCheckAlignment = 1;	
        {
          __bArrayCtr = __CopyBytes(__bDiagValueArray, __bDiagValueArrayCtr, __bArray);
          {
            sysvar * __systemVariable;
            __systemVariable = sysvarData::`PartNumber::`Part_Number;
            CheckSysVarSetBufferConsistency(sysSetVariableData(sysvarData::`PartNumber::`Part_Number, __bArray, __bArrayCtr), __systemVariable.name);
          }
          snprintf(__cArray, 8192, "%s", "Part_Number");
          snprintf(__cArray2, 8192, "%s '%s'", __cSysVar, __cArray);
          snprintf(__cArray3, 8192, "%s", "Application_Software_Logical_Block_0_Version_Information_Ident_1");
          
          ReportTableRow(__tableHandle, 0, __cArray2, __cAOp, __bArray, __bArrayCtr, __cArray3, __oneOfFlag, __bSetInCheckAlignment);
        
        }
    
        __bSetInCheckAlignment = 0;
      }
    }
    {
      __bDiagValueArrayCtr = DiagGetParameterErrorHandled(__resp, "Application_Software_Logical_Block_0_Version_Information_Ident_2", __bDiagValueArray, elcount(__bDiagValueArray), __cDiagValueArray, elcount(__cDiagValueArray));
      {
        __bSetInCheckAlignment = 1;	
        {
          __bArrayCtr = __CopyBytes(__bDiagValueArray, __bDiagValueArrayCtr, __bArray);
          {
            sysvar * __systemVariable;
            __systemVariable = sysvarData::`PartNumber::`Part_Number;
            CheckSysVarSetBufferConsistency(sysSetVariableData(sysvarData::`PartNumber::`Part_Number, __bArray, __bArrayCtr), __systemVariable.name);
          }
          snprintf(__cArray, 8192, "%s", "Part_Number");
          snprintf(__cArray2, 8192, "%s '%s'", __cSysVar, __cArray);
          snprintf(__cArray3, 8192, "%s", "Application_Software_Logical_Block_0_Version_Information_Ident_2");
          
          ReportTableRow(__tableHandle, 0, __cArray2, __cAOp, __bArray, __bArrayCtr, __cArray3, __oneOfFlag, __bSetInCheckAlignment);
        
        }
    
        __bSetInCheckAlignment = 0;
      }
    }
    {
      __bDiagValueArrayCtr = DiagGetParameterErrorHandled(__resp, "Application_Software_Logical_Block_0_Version_Information_Patch_1", __bDiagValueArray, elcount(__bDiagValueArray), __cDiagValueArray, elcount(__cDiagValueArray));
      {
        __bSetInCheckAlignment = 1;	
        {
          __bArrayCtr = __CopyBytes(__bDiagValueArray, __bDiagValueArrayCtr, __bArray);
          {
            sysvar * __systemVariable;
            __systemVariable = sysvarData::`PartNumber::`Part_Number;
            CheckSysVarSetBufferConsistency(sysSetVariableData(sysvarData::`PartNumber::`Part_Number, __bArray, __bArrayCtr), __systemVariable.name);
          }
          snprintf(__cArray, 8192, "%s", "Part_Number");
          snprintf(__cArray2, 8192, "%s '%s'", __cSysVar, __cArray);
          snprintf(__cArray3, 8192, "%s", "Application_Software_Logical_Block_0_Version_Information_Patch_1");
          
          ReportTableRow(__tableHandle, 0, __cArray2, __cAOp, __bArray, __bArrayCtr, __cArray3, __oneOfFlag, __bSetInCheckAlignment);
        
        }
    
        __bSetInCheckAlignment = 0;
      }
    }
    {
      __bDiagValueArrayCtr = DiagGetParameterErrorHandled(__resp, "Application_Software_Logical_Block_0_Version_Information_Patch_2", __bDiagValueArray, elcount(__bDiagValueArray), __cDiagValueArray, elcount(__cDiagValueArray));
      {
        __bSetInCheckAlignment = 1;	
        {
          __bArrayCtr = __CopyBytes(__bDiagValueArray, __bDiagValueArrayCtr, __bArray);
          {
            sysvar * __systemVariable;
            __systemVariable = sysvarData::`PartNumber::`Part_Number;
            CheckSysVarSetBufferConsistency(sysSetVariableData(sysvarData::`PartNumber::`Part_Number, __bArray, __bArrayCtr), __systemVariable.name);
          }
          snprintf(__cArray, 8192, "%s", "Part_Number");
          snprintf(__cArray2, 8192, "%s '%s'", __cSysVar, __cArray);
          snprintf(__cArray3, 8192, "%s", "Application_Software_Logical_Block_0_Version_Information_Patch_2");
          
          ReportTableRow(__tableHandle, 0, __cArray2, __cAOp, __bArray, __bArrayCtr, __cArray3, __oneOfFlag, __bSetInCheckAlignment);
        
        }
    
        __bSetInCheckAlignment = 0;
      }
    }
    {
      __bDiagValueArrayCtr = DiagGetParameterErrorHandled(__resp, "Application_Software_Logical_Block_2_Week", __bDiagValueArray, elcount(__bDiagValueArray), __cDiagValueArray, elcount(__cDiagValueArray));
      {
        __bSetInCheckAlignment = 1;	
        {
          __bArrayCtr = __CopyBytes(__bDiagValueArray, __bDiagValueArrayCtr, __bArray);
          {
            sysvar * __systemVariable;
            __systemVariable = sysvarData::`PartNumber::`Part_Number;
            CheckSysVarSetBufferConsistency(sysSetVariableData(sysvarData::`PartNumber::`Part_Number, __bArray, __bArrayCtr), __systemVariable.name);
          }
          snprintf(__cArray, 8192, "%s", "Part_Number");
          snprintf(__cArray2, 8192, "%s '%s'", __cSysVar, __cArray);
          snprintf(__cArray3, 8192, "%s", "Application_Software_Logical_Block_2_Week");
          
          ReportTableRow(__tableHandle, 0, __cArray2, __cAOp, __bArray, __bArrayCtr, __cArray3, __oneOfFlag, __bSetInCheckAlignment);
        
        }
    
        __bSetInCheckAlignment = 0;
      }
    }
    {
      __bDiagValueArrayCtr = DiagGetParameterErrorHandled(__resp, "Application_Software_Logical_Block_2_Year", __bDiagValueArray, elcount(__bDiagValueArray), __cDiagValueArray, elcount(__cDiagValueArray));
      {
        __bSetInCheckAlignment = 1;	
        {
          __bArrayCtr = __CopyBytes(__bDiagValueArray, __bDiagValueArrayCtr, __bArray);
          {
            sysvar * __systemVariable;
            __systemVariable = sysvarData::`PartNumber::`Part_Number;
            CheckSysVarSetBufferConsistency(sysSetVariableData(sysvarData::`PartNumber::`Part_Number, __bArray, __bArrayCtr), __systemVariable.name);
          }
          snprintf(__cArray, 8192, "%s", "Part_Number");
          snprintf(__cArray2, 8192, "%s '%s'", __cSysVar, __cArray);
          snprintf(__cArray3, 8192, "%s", "Application_Software_Logical_Block_2_Year");
          
          ReportTableRow(__tableHandle, 0, __cArray2, __cAOp, __bArray, __bArrayCtr, __cArray3, __oneOfFlag, __bSetInCheckAlignment);
        
        }
    
        __bSetInCheckAlignment = 0;
      }
    }
    {
      __bDiagValueArrayCtr = DiagGetParameterErrorHandled(__resp, "Application_Software_Logical_Block_3_Week", __bDiagValueArray, elcount(__bDiagValueArray), __cDiagValueArray, elcount(__cDiagValueArray));
      {
        __bSetInCheckAlignment = 1;	
        {
          __bArrayCtr = __CopyBytes(__bDiagValueArray, __bDiagValueArrayCtr, __bArray);
          {
            sysvar * __systemVariable;
            __systemVariable = sysvarData::`PartNumber::`Part_Number;
            CheckSysVarSetBufferConsistency(sysSetVariableData(sysvarData::`PartNumber::`Part_Number, __bArray, __bArrayCtr), __systemVariable.name);
          }
          snprintf(__cArray, 8192, "%s", "Part_Number");
          snprintf(__cArray2, 8192, "%s '%s'", __cSysVar, __cArray);
          snprintf(__cArray3, 8192, "%s", "Application_Software_Logical_Block_3_Week");
          
          ReportTableRow(__tableHandle, 0, __cArray2, __cAOp, __bArray, __bArrayCtr, __cArray3, __oneOfFlag, __bSetInCheckAlignment);
        
        }
    
        __bSetInCheckAlignment = 0;
      }
    }
    {
      __bDiagValueArrayCtr = DiagGetParameterErrorHandled(__resp, "Application_Software_Logical_Block_3_Year", __bDiagValueArray, elcount(__bDiagValueArray), __cDiagValueArray, elcount(__cDiagValueArray));
      {
        __bSetInCheckAlignment = 1;	
        {
          __bArrayCtr = __CopyBytes(__bDiagValueArray, __bDiagValueArrayCtr, __bArray);
          {
            sysvar * __systemVariable;
            __systemVariable = sysvarData::`PartNumber::`Part_Number;
            CheckSysVarSetBufferConsistency(sysSetVariableData(sysvarData::`PartNumber::`Part_Number, __bArray, __bArrayCtr), __systemVariable.name);
          }
          snprintf(__cArray, 8192, "%s", "Part_Number");
          snprintf(__cArray2, 8192, "%s '%s'", __cSysVar, __cArray);
          snprintf(__cArray3, 8192, "%s", "Application_Software_Logical_Block_3_Year");
          
          ReportTableRow(__tableHandle, 0, __cArray2, __cAOp, __bArray, __bArrayCtr, __cArray3, __oneOfFlag, __bSetInCheckAlignment);
        
        }
    
        __bSetInCheckAlignment = 0;
      }
    }
    {
      __bDiagValueArrayCtr = DiagGetParameterErrorHandled(__resp, "Application_Software_Logical_Block_4_Identification", __bDiagValueArray, elcount(__bDiagValueArray), __cDiagValueArray, elcount(__cDiagValueArray));
      {
        __bSetInCheckAlignment = 1;	
        {
          __bArrayCtr = __CopyBytes(__bDiagValueArray, __bDiagValueArrayCtr, __bArray);
          {
            sysvar * __systemVariable;
            __systemVariable = sysvarData::`PartNumber::`Part_Number;
            CheckSysVarSetBufferConsistency(sysSetVariableData(sysvarData::`PartNumber::`Part_Number, __bArray, __bArrayCtr), __systemVariable.name);
          }
          snprintf(__cArray, 8192, "%s", "Part_Number");
          snprintf(__cArray2, 8192, "%s '%s'", __cSysVar, __cArray);
          snprintf(__cArray3, 8192, "%s", "Application_Software_Logical_Block_4_Identification");
          
          ReportTableRow(__tableHandle, 0, __cArray2, __cAOp, __bArray, __bArrayCtr, __cArray3, __oneOfFlag, __bSetInCheckAlignment);
        
        }
    
        __bSetInCheckAlignment = 0;
      }
    }
    {
      __bDiagValueArrayCtr = DiagGetParameterErrorHandled(__resp, "Application_Software_Logical_Block_4_Patch_Level", __bDiagValueArray, elcount(__bDiagValueArray), __cDiagValueArray, elcount(__cDiagValueArray));
      {
        __bSetInCheckAlignment = 1;	
        {
          __bArrayCtr = __CopyBytes(__bDiagValueArray, __bDiagValueArrayCtr, __bArray);
          {
            sysvar * __systemVariable;
            __systemVariable = sysvarData::`PartNumber::`Part_Number;
            CheckSysVarSetBufferConsistency(sysSetVariableData(sysvarData::`PartNumber::`Part_Number, __bArray, __bArrayCtr), __systemVariable.name);
          }
          snprintf(__cArray, 8192, "%s", "Part_Number");
          snprintf(__cArray2, 8192, "%s '%s'", __cSysVar, __cArray);
          snprintf(__cArray3, 8192, "%s", "Application_Software_Logical_Block_4_Patch_Level");
          
          ReportTableRow(__tableHandle, 0, __cArray2, __cAOp, __bArray, __bArrayCtr, __cArray3, __oneOfFlag, __bSetInCheckAlignment);
        
        }
    
        __bSetInCheckAlignment = 0;
      }
    }
    {
      __bDiagValueArrayCtr = DiagGetParameterErrorHandled(__resp, "Application_Software_Logical_Block_4_Week", __bDiagValueArray, elcount(__bDiagValueArray), __cDiagValueArray, elcount(__cDiagValueArray));
      {
        __bSetInCheckAlignment = 1;	
        {
          __bArrayCtr = __CopyBytes(__bDiagValueArray, __bDiagValueArrayCtr, __bArray);
          {
            sysvar * __systemVariable;
            __systemVariable = sysvarData::`PartNumber::`Part_Number;
            CheckSysVarSetBufferConsistency(sysSetVariableData(sysvarData::`PartNumber::`Part_Number, __bArray, __bArrayCtr), __systemVariable.name);
          }
          snprintf(__cArray, 8192, "%s", "Part_Number");
          snprintf(__cArray2, 8192, "%s '%s'", __cSysVar, __cArray);
          snprintf(__cArray3, 8192, "%s", "Application_Software_Logical_Block_4_Week");
          
          ReportTableRow(__tableHandle, 0, __cArray2, __cAOp, __bArray, __bArrayCtr, __cArray3, __oneOfFlag, __bSetInCheckAlignment);
        
        }
    
        __bSetInCheckAlignment = 0;
      }
    }
    {
      __bDiagValueArrayCtr = DiagGetParameterErrorHandled(__resp, "Application_Software_Logical_Block_4_Year", __bDiagValueArray, elcount(__bDiagValueArray), __cDiagValueArray, elcount(__cDiagValueArray));
      {
        __bSetInCheckAlignment = 1;	
        {
          __bArrayCtr = __CopyBytes(__bDiagValueArray, __bDiagValueArrayCtr, __bArray);
          {
            sysvar * __systemVariable;
            __systemVariable = sysvarData::`PartNumber::`Part_Number;
            CheckSysVarSetBufferConsistency(sysSetVariableData(sysvarData::`PartNumber::`Part_Number, __bArray, __bArrayCtr), __systemVariable.name);
          }
          snprintf(__cArray, 8192, "%s", "Part_Number");
          snprintf(__cArray2, 8192, "%s '%s'", __cSysVar, __cArray);
          snprintf(__cArray3, 8192, "%s", "Application_Software_Logical_Block_4_Year");
          
          ReportTableRow(__tableHandle, 0, __cArray2, __cAOp, __bArray, __bArrayCtr, __cArray3, __oneOfFlag, __bSetInCheckAlignment);
        
        }
    
        __bSetInCheckAlignment = 0;
      }
    }
    {
      __bDiagValueArrayCtr = DiagGetParameterErrorHandled(__resp, "Application_Software_Logical_Block_5_Identification", __bDiagValueArray, elcount(__bDiagValueArray), __cDiagValueArray, elcount(__cDiagValueArray));
      {
        __bSetInCheckAlignment = 1;	
        {
          __bArrayCtr = __CopyBytes(__bDiagValueArray, __bDiagValueArrayCtr, __bArray);
          {
            sysvar * __systemVariable;
            __systemVariable = sysvarData::`PartNumber::`Part_Number;
            CheckSysVarSetBufferConsistency(sysSetVariableData(sysvarData::`PartNumber::`Part_Number, __bArray, __bArrayCtr), __systemVariable.name);
          }
          snprintf(__cArray, 8192, "%s", "Part_Number");
          snprintf(__cArray2, 8192, "%s '%s'", __cSysVar, __cArray);
          snprintf(__cArray3, 8192, "%s", "Application_Software_Logical_Block_5_Identification");
          
          ReportTableRow(__tableHandle, 0, __cArray2, __cAOp, __bArray, __bArrayCtr, __cArray3, __oneOfFlag, __bSetInCheckAlignment);
        
        }
    
        __bSetInCheckAlignment = 0;
      }
    }
    {
      __bDiagValueArrayCtr = DiagGetParameterErrorHandled(__resp, "Application_Software_Logical_Block_5_Patch_Level", __bDiagValueArray, elcount(__bDiagValueArray), __cDiagValueArray, elcount(__cDiagValueArray));
      {
        __bSetInCheckAlignment = 1;	
        {
          __bArrayCtr = __CopyBytes(__bDiagValueArray, __bDiagValueArrayCtr, __bArray);
          {
            sysvar * __systemVariable;
            __systemVariable = sysvarData::`PartNumber::`Part_Number;
            CheckSysVarSetBufferConsistency(sysSetVariableData(sysvarData::`PartNumber::`Part_Number, __bArray, __bArrayCtr), __systemVariable.name);
          }
          snprintf(__cArray, 8192, "%s", "Part_Number");
          snprintf(__cArray2, 8192, "%s '%s'", __cSysVar, __cArray);
          snprintf(__cArray3, 8192, "%s", "Application_Software_Logical_Block_5_Patch_Level");
          
          ReportTableRow(__tableHandle, 0, __cArray2, __cAOp, __bArray, __bArrayCtr, __cArray3, __oneOfFlag, __bSetInCheckAlignment);
        
        }
    
        __bSetInCheckAlignment = 0;
      }
    }
    {
      __bDiagValueArrayCtr = DiagGetParameterErrorHandled(__resp, "Application_Software_Logical_Block_5_Week", __bDiagValueArray, elcount(__bDiagValueArray), __cDiagValueArray, elcount(__cDiagValueArray));
      {
        __bSetInCheckAlignment = 1;	
        {
          __bArrayCtr = __CopyBytes(__bDiagValueArray, __bDiagValueArrayCtr, __bArray);
          {
            sysvar * __systemVariable;
            __systemVariable = sysvarData::`PartNumber::`Part_Number;
            CheckSysVarSetBufferConsistency(sysSetVariableData(sysvarData::`PartNumber::`Part_Number, __bArray, __bArrayCtr), __systemVariable.name);
          }
          snprintf(__cArray, 8192, "%s", "Part_Number");
          snprintf(__cArray2, 8192, "%s '%s'", __cSysVar, __cArray);
          snprintf(__cArray3, 8192, "%s", "Application_Software_Logical_Block_5_Week");
          
          ReportTableRow(__tableHandle, 0, __cArray2, __cAOp, __bArray, __bArrayCtr, __cArray3, __oneOfFlag, __bSetInCheckAlignment);
        
        }
    
        __bSetInCheckAlignment = 0;
      }
    }
    {
      __bDiagValueArrayCtr = DiagGetParameterErrorHandled(__resp, "Application_Software_Logical_Block_5_Year", __bDiagValueArray, elcount(__bDiagValueArray), __cDiagValueArray, elcount(__cDiagValueArray));
      {
        __bSetInCheckAlignment = 1;	
        {
          __bArrayCtr = __CopyBytes(__bDiagValueArray, __bDiagValueArrayCtr, __bArray);
          {
            sysvar * __systemVariable;
            __systemVariable = sysvarData::`PartNumber::`Part_Number;
            CheckSysVarSetBufferConsistency(sysSetVariableData(sysvarData::`PartNumber::`Part_Number, __bArray, __bArrayCtr), __systemVariable.name);
          }
          snprintf(__cArray, 8192, "%s", "Part_Number");
          snprintf(__cArray2, 8192, "%s '%s'", __cSysVar, __cArray);
          snprintf(__cArray3, 8192, "%s", "Application_Software_Logical_Block_5_Year");
          
          ReportTableRow(__tableHandle, 0, __cArray2, __cAOp, __bArray, __bArrayCtr, __cArray3, __oneOfFlag, __bSetInCheckAlignment);
        
        }
    
        __bSetInCheckAlignment = 0;
      }
    }
    {
      __bDiagValueArrayCtr = DiagGetParameterErrorHandled(__resp, "_Application_Software_Logical_Block_1_Version_Information__Iden", __bDiagValueArray, elcount(__bDiagValueArray), __cDiagValueArray, elcount(__cDiagValueArray));
      {
        __bSetInCheckAlignment = 1;	
        {
          __bArrayCtr = __CopyBytes(__bDiagValueArray, __bDiagValueArrayCtr, __bArray);
          {
            sysvar * __systemVariable;
            __systemVariable = sysvarData::`PartNumber::`Part_Number;
            CheckSysVarSetBufferConsistency(sysSetVariableData(sysvarData::`PartNumber::`Part_Number, __bArray, __bArrayCtr), __systemVariable.name);
          }
          snprintf(__cArray, 8192, "%s", "Part_Number");
          snprintf(__cArray2, 8192, "%s '%s'", __cSysVar, __cArray);
          snprintf(__cArray3, 8192, "%s", "_Application_Software_Logical_Block_1_Version_Information__Iden");
          
          ReportTableRow(__tableHandle, 0, __cArray2, __cAOp, __bArray, __bArrayCtr, __cArray3, __oneOfFlag, __bSetInCheckAlignment);
        
        }
    
        __bSetInCheckAlignment = 0;
      }
    }
    {
      __bDiagValueArrayCtr = DiagGetParameterErrorHandled(__resp, "_Application_Software_Logical_Block_1_Version_Information__Patc", __bDiagValueArray, elcount(__bDiagValueArray), __cDiagValueArray, elcount(__cDiagValueArray));
      {
        __bSetInCheckAlignment = 1;	
        {
          __bArrayCtr = __CopyBytes(__bDiagValueArray, __bDiagValueArrayCtr, __bArray);
          {
            sysvar * __systemVariable;
            __systemVariable = sysvarData::`PartNumber::`Part_Number;
            CheckSysVarSetBufferConsistency(sysSetVariableData(sysvarData::`PartNumber::`Part_Number, __bArray, __bArrayCtr), __systemVariable.name);
          }
          snprintf(__cArray, 8192, "%s", "Part_Number");
          snprintf(__cArray2, 8192, "%s '%s'", __cSysVar, __cArray);
          snprintf(__cArray3, 8192, "%s", "_Application_Software_Logical_Block_1_Version_Information__Patc");
          
          ReportTableRow(__tableHandle, 0, __cArray2, __cAOp, __bArray, __bArrayCtr, __cArray3, __oneOfFlag, __bSetInCheckAlignment);
        
        }
    
        __bSetInCheckAlignment = 0;
      }
    }
    {
      __bDiagValueArrayCtr = DiagGetParameterErrorHandled(__resp, "_Application_Software_Logical_Block_1_Version_Information__Week", __bDiagValueArray, elcount(__bDiagValueArray), __cDiagValueArray, elcount(__cDiagValueArray));
      {
        __bSetInCheckAlignment = 1;	
        {
          __bArrayCtr = __CopyBytes(__bDiagValueArray, __bDiagValueArrayCtr, __bArray);
          {
            sysvar * __systemVariable;
            __systemVariable = sysvarData::`PartNumber::`Part_Number;
            CheckSysVarSetBufferConsistency(sysSetVariableData(sysvarData::`PartNumber::`Part_Number, __bArray, __bArrayCtr), __systemVariable.name);
          }
          snprintf(__cArray, 8192, "%s", "Part_Number");
          snprintf(__cArray2, 8192, "%s '%s'", __cSysVar, __cArray);
          snprintf(__cArray3, 8192, "%s", "_Application_Software_Logical_Block_1_Version_Information__Week");
          
          ReportTableRow(__tableHandle, 0, __cArray2, __cAOp, __bArray, __bArrayCtr, __cArray3, __oneOfFlag, __bSetInCheckAlignment);
        
        }
    
        __bSetInCheckAlignment = 0;
      }
    }
    {
      __bDiagValueArrayCtr = DiagGetParameterErrorHandled(__resp, "_Application_Software_Logical_Block_1_Version_Information__Year", __bDiagValueArray, elcount(__bDiagValueArray), __cDiagValueArray, elcount(__cDiagValueArray));
      {
        __bSetInCheckAlignment = 1;	
        {
          __bArrayCtr = __CopyBytes(__bDiagValueArray, __bDiagValueArrayCtr, __bArray);
          {
            sysvar * __systemVariable;
            __systemVariable = sysvarData::`PartNumber::`Part_Number;
            CheckSysVarSetBufferConsistency(sysSetVariableData(sysvarData::`PartNumber::`Part_Number, __bArray, __bArrayCtr), __systemVariable.name);
          }
          snprintf(__cArray, 8192, "%s", "Part_Number");
          snprintf(__cArray2, 8192, "%s '%s'", __cSysVar, __cArray);
          snprintf(__cArray3, 8192, "%s", "_Application_Software_Logical_Block_1_Version_Information__Year");
          
          ReportTableRow(__tableHandle, 0, __cArray2, __cAOp, __bArray, __bArrayCtr, __cArray3, __oneOfFlag, __bSetInCheckAlignment);
        
        }
    
        __bSetInCheckAlignment = 0;
      }
    }
    ReportTableEndVerdict(__tableHandle, __cEvaluateResponse, __res);
	__bVerdict = __bVerdict && __res;
  }
  if (__bVerdict == __eVerdictFail)
    TestReportWriteDiagObjectList();
}

void Ttvccmce9_F181_DID_with_Standard_Physical_Address()
{
  stack long __tableHandle;
  TestCommandBegin(__eRequestResponse, __cRequestResponse, "", "0");
  {
  
    long __res;
    int64 __timeout;
    __res = 0;
    __nInt64 = 1;
    __timeout = syspar::`P2_Server * 1000000LL;
    {
    
      long __testStepInitOk;
      message `FDCAN2::`DIAGNOSTIC_REQUEST_PAM __output;
      message `FDCAN2::`DIAGNOSTIC_REQUEST_PAM __msgOrig;
      __output = __msgOrig;
      __testStepInitOk = 1;
      {
        int64 __dlc;
        __dlc = 4;
        if (__dlc >= 0 && __dlc <= (__output.EDL ? 15 : 8))
          __output.DLC = __dlc;
        else
        {
          testStepErrorInTestSystem(0, __cEmpty, "Unable to set DLC=%lld in message. Please check input parameter.", __dlc);
          __testStepInitOk = 0;
        }
      }
      if (__testStepInitOk)
      {
        snprintf(__cArray, elCount(__cArray), "CAN message '%s' ID = 416981233x (0x18DAA0F1x) on bus FDCAN2", "DIAGNOSTIC_REQUEST_PAM");
        snprintf(__cArray2, elCount(__cArray2), "Send %s", __cArray);
        __tableHandle = ReportTableHead3Columns(__cArray2, "Byte", __cTOp, __cAssigned);
        ReportByteIndex("", 0, __cArray, elCount(__cArray));
        snprintf(__cArray2, 8192, "%s", __cArray);
        snprintf(__cArray3, 8192, "%s", "");
        
        ReportTableRow(__tableHandle, 0, __cArray2, __cAOp, 0x3, __cArray3, __oneOfFlag, __bSetInCheckAlignment);
        
        if (0 >= 0 && 0 < 64)
        {
          __output.byte((word)0) = 0x3;
        }
        else
        {
          testStepErrorInTestSystem(0, __cEmpty, "Index out of range. Unable to set byte %lld in message. Please check input parameter.", (int64)0);
          __testStepInitOk = 0;
        }
        ReportByteIndex("", 1, __cArray, elCount(__cArray));
        snprintf(__cArray2, 8192, "%s", __cArray);
        snprintf(__cArray3, 8192, "%s", "");
        
        ReportTableRow(__tableHandle, 0, __cArray2, __cAOp, 0x22, __cArray3, __oneOfFlag, __bSetInCheckAlignment);
        
        if (1 >= 0 && 1 < 64)
        {
          __output.byte((word)1) = 0x22;
        }
        else
        {
          testStepErrorInTestSystem(0, __cEmpty, "Index out of range. Unable to set byte %lld in message. Please check input parameter.", (int64)1);
          __testStepInitOk = 0;
        }
        ReportByteIndex("", 2, __cArray, elCount(__cArray));
        snprintf(__cArray2, 8192, "%s", __cArray);
        snprintf(__cArray3, 8192, "%s", "");
        
        ReportTableRow(__tableHandle, 0, __cArray2, __cAOp, 0xF1, __cArray3, __oneOfFlag, __bSetInCheckAlignment);
        
        if (2 >= 0 && 2 < 64)
        {
          __output.byte((word)2) = 0xF1;
        }
        else
        {
          testStepErrorInTestSystem(0, __cEmpty, "Index out of range. Unable to set byte %lld in message. Please check input parameter.", (int64)2);
          __testStepInitOk = 0;
        }
        ReportByteIndex("", 3, __cArray, elCount(__cArray));
        snprintf(__cArray2, 8192, "%s", __cArray);
        snprintf(__cArray3, 8192, "%s", "");
        
        ReportTableRow(__tableHandle, 0, __cArray2, __cAOp, 0x81, __cArray3, __oneOfFlag, __bSetInCheckAlignment);
        
        if (3 >= 0 && 3 < 64)
        {
          __output.byte((word)3) = 0x81;
        }
        else
        {
          testStepErrorInTestSystem(0, __cEmpty, "Index out of range. Unable to set byte %lld in message. Please check input parameter.", (int64)3);
          __testStepInitOk = 0;
        }
      
        ReportTableEndTestStep(__tableHandle, "Req1");
      }
      if (__testStepInitOk)
      {
        output(__output);
      }
    }
    if (__timeout <= 0)
    {
      testStepErrorInTestSystem(0, "1", "Unable to wait for %.3f %s. Please check input parameter.", __timeout / ((float)1000000), "ms");
    }
    else
    {
      __tt0cnt_7 = 0;
      snprintf(__cArray, elCount(__cArray), "CAN message '%s' ID = 417001888x (0x18DAF1A0x) on bus FDCAN2", "DIAGNOSTIC_RESPONSE_PAM");
      if(SetBusContextByName("FDCAN2", __eSaveCurrent, __nBusContextNew, __nBusContextOld))
        testJoinMessageEvent(`FDCAN2::`DIAGNOSTIC_RESPONSE_PAM,  __cArray,
             delegate dword(message * __m)
             {
               dword __msg_callback_ret;
               if (__tt0cnt_7 == -1)
               {
                 return 1;
               }
               __msg_callback_ret = 1;
               __tt0cnt_7++;
               if (__msg_callback_ret)
               {
                 __tt0cnt_7 = -1;
                 return 1;
               }
               return 0;
             });
      __res = testWaitForAllJoinedEventsNS(__timeout);
      if (__nInt64 != 0)
      {
        snprintf(__cArray, elCount(__cArray), "CAN message '%s' ID = 417001888x (0x18DAF1A0x) on bus FDCAN2", "DIAGNOSTIC_RESPONSE_PAM");
        if(__tt0cnt_7 == -1)
        {
          snprintf(__cArray2, 8192, "Response of %s", __cArray);
        }
        else
        {
          snprintf(__cArray2, 8192, "Response of %s (received %d times)", __cArray, __tt0cnt_7);
        }
        if (__tt0cnt_7 == 0)
        {
          testStepFail(0, "Resp1", __cArray2);
        }
        else
        {
          testStepPass(2, "Resp1", __cArray2);
        }
        __ReportRequestResponseResult(__res, 0);
      }
      ResetBusContext(__nBusContextNew, __nBusContextOld);
    }
  }
  TestCommandEnd();

}

void Ttvccmce9_F181_DID_with_Functional_Address()
{
  stack long __tableHandle;
  TestCommandBegin(__eDiagService, __cDiagService, "", "0");
  {
    if (DiagIsFunctionalGroup("CVADAS_0001_00000000_000"))
    {
      DiagResponse * __resp;
      DiagRequest CVADAS_0001_00000000_000._22F181_Application_Software_Identification __req;
      __diagServicevccmce9_8(__req, __resp);
    }
    else
    {
      DiagResponse CVADAS_0001_00000000_000.* __resp;
      DiagRequest CVADAS_0001_00000000_000._22F181_Application_Software_Identification __req;
      __diagServicevccmce9_8(__req, __resp);
    }
  }
  TestCommandEnd();


}

  
void __diagServicevccmce9_8(DiagRequest * __req, DiagResponse * __resp )
{
  stack long __tableHandle;
  long __res, __paramLen, __bytePos;

   __bVerdict = __eVerdictPass;

  do {
    TestReportResetDiagObjectList();
    DiagSetReportDetailLevel("CVADAS_0001_00000000_000", EnumServiceDetails_onfail);
    // Request aspect
    {

      if (0 >= DiagSendReqAndWaitForResp("CVADAS_0001_00000000_000", __req, __resp, __res, -1, -1, -1, -1, -1, EnumResult_pos, EnumServiceDetails_onfail, EnumSendingMode_physical, EnumSuppressPosResBit_asconfigured, EnumVerdictOnInvalidValues_fail))
        break;
    }

    __res = DiagErrCodeTestStep(__res, "Can't retrieve last response for request! No check possible.") < 0;
    if(__res)
    {
	  __bVerdict = __eVerdictFail;
      break;
    }
    {
      __res = DiagInterpretAs(__resp, "RDBI_PR");
      if(__res != 0)
      {
        __bVerdict = __eVerdictFail;
        DiagErrCodeTestStep(__res, "Can't interpret response as diagnostic primitive 'RDBI_PR'.");
        break;
      }
      else
      {
        TestStepPass( "Received primitive can be interpreted as diagnostic primitive 'RDBI_PR'.");
      }
    }
  }
  while(0);


  // Response, check & read aspect
  {
    __res = 1;
    __tableHandle = ReportTableHead5Columns(__cCheckCaption, __cTSym, __cTOp, __cRefVal, __cActual, __cRes);
    {
      __bDiagValueArrayCtr = DiagGetParameterErrorHandled(__resp, "Application_Software_Logical_Block_0_Version_Information_Ident_1", __bDiagValueArray, elcount(__bDiagValueArray), __cDiagValueArray, elcount(__cDiagValueArray));
      {
        __bSetInCheckAlignment = 1;	
        {
          __bArrayCtr = __CopyBytes(__bDiagValueArray, __bDiagValueArrayCtr, __bArray);
          {
            sysvar * __systemVariable;
            __systemVariable = sysvarData::`PartNumber::`Part_Number;
            CheckSysVarSetBufferConsistency(sysSetVariableData(sysvarData::`PartNumber::`Part_Number, __bArray, __bArrayCtr), __systemVariable.name);
          }
          snprintf(__cArray, 8192, "%s", "Part_Number");
          snprintf(__cArray2, 8192, "%s '%s'", __cSysVar, __cArray);
          snprintf(__cArray3, 8192, "%s", "Application_Software_Logical_Block_0_Version_Information_Ident_1");
          
          ReportTableRow(__tableHandle, 0, __cArray2, __cAOp, __bArray, __bArrayCtr, __cArray3, __oneOfFlag, __bSetInCheckAlignment);
        
        }
    
        __bSetInCheckAlignment = 0;
      }
    }
    {
      __bDiagValueArrayCtr = DiagGetParameterErrorHandled(__resp, "Application_Software_Logical_Block_0_Version_Information_Ident_2", __bDiagValueArray, elcount(__bDiagValueArray), __cDiagValueArray, elcount(__cDiagValueArray));
      {
        __bSetInCheckAlignment = 1;	
        {
          __bArrayCtr = __CopyBytes(__bDiagValueArray, __bDiagValueArrayCtr, __bArray);
          {
            sysvar * __systemVariable;
            __systemVariable = sysvarData::`PartNumber::`Part_Number;
            CheckSysVarSetBufferConsistency(sysSetVariableData(sysvarData::`PartNumber::`Part_Number, __bArray, __bArrayCtr), __systemVariable.name);
          }
          snprintf(__cArray, 8192, "%s", "Part_Number");
          snprintf(__cArray2, 8192, "%s '%s'", __cSysVar, __cArray);
          snprintf(__cArray3, 8192, "%s", "Application_Software_Logical_Block_0_Version_Information_Ident_2");
          
          ReportTableRow(__tableHandle, 0, __cArray2, __cAOp, __bArray, __bArrayCtr, __cArray3, __oneOfFlag, __bSetInCheckAlignment);
        
        }
    
        __bSetInCheckAlignment = 0;
      }
    }
    {
      __bDiagValueArrayCtr = DiagGetParameterErrorHandled(__resp, "Application_Software_Logical_Block_0_Version_Information_Patch_1", __bDiagValueArray, elcount(__bDiagValueArray), __cDiagValueArray, elcount(__cDiagValueArray));
      {
        __bSetInCheckAlignment = 1;	
        {
          __bArrayCtr = __CopyBytes(__bDiagValueArray, __bDiagValueArrayCtr, __bArray);
          {
            sysvar * __systemVariable;
            __systemVariable = sysvarData::`PartNumber::`Part_Number;
            CheckSysVarSetBufferConsistency(sysSetVariableData(sysvarData::`PartNumber::`Part_Number, __bArray, __bArrayCtr), __systemVariable.name);
          }
          snprintf(__cArray, 8192, "%s", "Part_Number");
          snprintf(__cArray2, 8192, "%s '%s'", __cSysVar, __cArray);
          snprintf(__cArray3, 8192, "%s", "Application_Software_Logical_Block_0_Version_Information_Patch_1");
          
          ReportTableRow(__tableHandle, 0, __cArray2, __cAOp, __bArray, __bArrayCtr, __cArray3, __oneOfFlag, __bSetInCheckAlignment);
        
        }
    
        __bSetInCheckAlignment = 0;
      }
    }
    {
      __bDiagValueArrayCtr = DiagGetParameterErrorHandled(__resp, "Application_Software_Logical_Block_0_Version_Information_Patch_2", __bDiagValueArray, elcount(__bDiagValueArray), __cDiagValueArray, elcount(__cDiagValueArray));
      {
        __bSetInCheckAlignment = 1;	
        {
          __bArrayCtr = __CopyBytes(__bDiagValueArray, __bDiagValueArrayCtr, __bArray);
          {
            sysvar * __systemVariable;
            __systemVariable = sysvarData::`PartNumber::`Part_Number;
            CheckSysVarSetBufferConsistency(sysSetVariableData(sysvarData::`PartNumber::`Part_Number, __bArray, __bArrayCtr), __systemVariable.name);
          }
          snprintf(__cArray, 8192, "%s", "Part_Number");
          snprintf(__cArray2, 8192, "%s '%s'", __cSysVar, __cArray);
          snprintf(__cArray3, 8192, "%s", "Application_Software_Logical_Block_0_Version_Information_Patch_2");
          
          ReportTableRow(__tableHandle, 0, __cArray2, __cAOp, __bArray, __bArrayCtr, __cArray3, __oneOfFlag, __bSetInCheckAlignment);
        
        }
    
        __bSetInCheckAlignment = 0;
      }
    }
    {
      __bDiagValueArrayCtr = DiagGetParameterErrorHandled(__resp, "Application_Software_Logical_Block_2_Week", __bDiagValueArray, elcount(__bDiagValueArray), __cDiagValueArray, elcount(__cDiagValueArray));
      {
        __bSetInCheckAlignment = 1;	
        {
          __bArrayCtr = __CopyBytes(__bDiagValueArray, __bDiagValueArrayCtr, __bArray);
          {
            sysvar * __systemVariable;
            __systemVariable = sysvarData::`PartNumber::`Part_Number;
            CheckSysVarSetBufferConsistency(sysSetVariableData(sysvarData::`PartNumber::`Part_Number, __bArray, __bArrayCtr), __systemVariable.name);
          }
          snprintf(__cArray, 8192, "%s", "Part_Number");
          snprintf(__cArray2, 8192, "%s '%s'", __cSysVar, __cArray);
          snprintf(__cArray3, 8192, "%s", "Application_Software_Logical_Block_2_Week");
          
          ReportTableRow(__tableHandle, 0, __cArray2, __cAOp, __bArray, __bArrayCtr, __cArray3, __oneOfFlag, __bSetInCheckAlignment);
        
        }
    
        __bSetInCheckAlignment = 0;
      }
    }
    {
      __bDiagValueArrayCtr = DiagGetParameterErrorHandled(__resp, "Application_Software_Logical_Block_2_Year", __bDiagValueArray, elcount(__bDiagValueArray), __cDiagValueArray, elcount(__cDiagValueArray));
      {
        __bSetInCheckAlignment = 1;	
        {
          __bArrayCtr = __CopyBytes(__bDiagValueArray, __bDiagValueArrayCtr, __bArray);
          {
            sysvar * __systemVariable;
            __systemVariable = sysvarData::`PartNumber::`Part_Number;
            CheckSysVarSetBufferConsistency(sysSetVariableData(sysvarData::`PartNumber::`Part_Number, __bArray, __bArrayCtr), __systemVariable.name);
          }
          snprintf(__cArray, 8192, "%s", "Part_Number");
          snprintf(__cArray2, 8192, "%s '%s'", __cSysVar, __cArray);
          snprintf(__cArray3, 8192, "%s", "Application_Software_Logical_Block_2_Year");
          
          ReportTableRow(__tableHandle, 0, __cArray2, __cAOp, __bArray, __bArrayCtr, __cArray3, __oneOfFlag, __bSetInCheckAlignment);
        
        }
    
        __bSetInCheckAlignment = 0;
      }
    }
    {
      __bDiagValueArrayCtr = DiagGetParameterErrorHandled(__resp, "Application_Software_Logical_Block_3_Week", __bDiagValueArray, elcount(__bDiagValueArray), __cDiagValueArray, elcount(__cDiagValueArray));
      {
        __bSetInCheckAlignment = 1;	
        {
          __bArrayCtr = __CopyBytes(__bDiagValueArray, __bDiagValueArrayCtr, __bArray);
          {
            sysvar * __systemVariable;
            __systemVariable = sysvarData::`PartNumber::`Part_Number;
            CheckSysVarSetBufferConsistency(sysSetVariableData(sysvarData::`PartNumber::`Part_Number, __bArray, __bArrayCtr), __systemVariable.name);
          }
          snprintf(__cArray, 8192, "%s", "Part_Number");
          snprintf(__cArray2, 8192, "%s '%s'", __cSysVar, __cArray);
          snprintf(__cArray3, 8192, "%s", "Application_Software_Logical_Block_3_Week");
          
          ReportTableRow(__tableHandle, 0, __cArray2, __cAOp, __bArray, __bArrayCtr, __cArray3, __oneOfFlag, __bSetInCheckAlignment);
        
        }
    
        __bSetInCheckAlignment = 0;
      }
    }
    {
      __bDiagValueArrayCtr = DiagGetParameterErrorHandled(__resp, "Application_Software_Logical_Block_3_Year", __bDiagValueArray, elcount(__bDiagValueArray), __cDiagValueArray, elcount(__cDiagValueArray));
      {
        __bSetInCheckAlignment = 1;	
        {
          __bArrayCtr = __CopyBytes(__bDiagValueArray, __bDiagValueArrayCtr, __bArray);
          {
            sysvar * __systemVariable;
            __systemVariable = sysvarData::`PartNumber::`Part_Number;
            CheckSysVarSetBufferConsistency(sysSetVariableData(sysvarData::`PartNumber::`Part_Number, __bArray, __bArrayCtr), __systemVariable.name);
          }
          snprintf(__cArray, 8192, "%s", "Part_Number");
          snprintf(__cArray2, 8192, "%s '%s'", __cSysVar, __cArray);
          snprintf(__cArray3, 8192, "%s", "Application_Software_Logical_Block_3_Year");
          
          ReportTableRow(__tableHandle, 0, __cArray2, __cAOp, __bArray, __bArrayCtr, __cArray3, __oneOfFlag, __bSetInCheckAlignment);
        
        }
    
        __bSetInCheckAlignment = 0;
      }
    }
    {
      __bDiagValueArrayCtr = DiagGetParameterErrorHandled(__resp, "Application_Software_Logical_Block_4_Identification", __bDiagValueArray, elcount(__bDiagValueArray), __cDiagValueArray, elcount(__cDiagValueArray));
      {
        __bSetInCheckAlignment = 1;	
        {
          __bArrayCtr = __CopyBytes(__bDiagValueArray, __bDiagValueArrayCtr, __bArray);
          {
            sysvar * __systemVariable;
            __systemVariable = sysvarData::`PartNumber::`Part_Number;
            CheckSysVarSetBufferConsistency(sysSetVariableData(sysvarData::`PartNumber::`Part_Number, __bArray, __bArrayCtr), __systemVariable.name);
          }
          snprintf(__cArray, 8192, "%s", "Part_Number");
          snprintf(__cArray2, 8192, "%s '%s'", __cSysVar, __cArray);
          snprintf(__cArray3, 8192, "%s", "Application_Software_Logical_Block_4_Identification");
          
          ReportTableRow(__tableHandle, 0, __cArray2, __cAOp, __bArray, __bArrayCtr, __cArray3, __oneOfFlag, __bSetInCheckAlignment);
        
        }
    
        __bSetInCheckAlignment = 0;
      }
    }
    {
      __bDiagValueArrayCtr = DiagGetParameterErrorHandled(__resp, "Application_Software_Logical_Block_4_Patch_Level", __bDiagValueArray, elcount(__bDiagValueArray), __cDiagValueArray, elcount(__cDiagValueArray));
      {
        __bSetInCheckAlignment = 1;	
        {
          __bArrayCtr = __CopyBytes(__bDiagValueArray, __bDiagValueArrayCtr, __bArray);
          {
            sysvar * __systemVariable;
            __systemVariable = sysvarData::`PartNumber::`Part_Number;
            CheckSysVarSetBufferConsistency(sysSetVariableData(sysvarData::`PartNumber::`Part_Number, __bArray, __bArrayCtr), __systemVariable.name);
          }
          snprintf(__cArray, 8192, "%s", "Part_Number");
          snprintf(__cArray2, 8192, "%s '%s'", __cSysVar, __cArray);
          snprintf(__cArray3, 8192, "%s", "Application_Software_Logical_Block_4_Patch_Level");
          
          ReportTableRow(__tableHandle, 0, __cArray2, __cAOp, __bArray, __bArrayCtr, __cArray3, __oneOfFlag, __bSetInCheckAlignment);
        
        }
    
        __bSetInCheckAlignment = 0;
      }
    }
    {
      __bDiagValueArrayCtr = DiagGetParameterErrorHandled(__resp, "Application_Software_Logical_Block_4_Week", __bDiagValueArray, elcount(__bDiagValueArray), __cDiagValueArray, elcount(__cDiagValueArray));
      {
        __bSetInCheckAlignment = 1;	
        {
          __bArrayCtr = __CopyBytes(__bDiagValueArray, __bDiagValueArrayCtr, __bArray);
          {
            sysvar * __systemVariable;
            __systemVariable = sysvarData::`PartNumber::`Part_Number;
            CheckSysVarSetBufferConsistency(sysSetVariableData(sysvarData::`PartNumber::`Part_Number, __bArray, __bArrayCtr), __systemVariable.name);
          }
          snprintf(__cArray, 8192, "%s", "Part_Number");
          snprintf(__cArray2, 8192, "%s '%s'", __cSysVar, __cArray);
          snprintf(__cArray3, 8192, "%s", "Application_Software_Logical_Block_4_Week");
          
          ReportTableRow(__tableHandle, 0, __cArray2, __cAOp, __bArray, __bArrayCtr, __cArray3, __oneOfFlag, __bSetInCheckAlignment);
        
        }
    
        __bSetInCheckAlignment = 0;
      }
    }
    {
      __bDiagValueArrayCtr = DiagGetParameterErrorHandled(__resp, "Application_Software_Logical_Block_4_Year", __bDiagValueArray, elcount(__bDiagValueArray), __cDiagValueArray, elcount(__cDiagValueArray));
      {
        __bSetInCheckAlignment = 1;	
        {
          __bArrayCtr = __CopyBytes(__bDiagValueArray, __bDiagValueArrayCtr, __bArray);
          {
            sysvar * __systemVariable;
            __systemVariable = sysvarData::`PartNumber::`Part_Number;
            CheckSysVarSetBufferConsistency(sysSetVariableData(sysvarData::`PartNumber::`Part_Number, __bArray, __bArrayCtr), __systemVariable.name);
          }
          snprintf(__cArray, 8192, "%s", "Part_Number");
          snprintf(__cArray2, 8192, "%s '%s'", __cSysVar, __cArray);
          snprintf(__cArray3, 8192, "%s", "Application_Software_Logical_Block_4_Year");
          
          ReportTableRow(__tableHandle, 0, __cArray2, __cAOp, __bArray, __bArrayCtr, __cArray3, __oneOfFlag, __bSetInCheckAlignment);
        
        }
    
        __bSetInCheckAlignment = 0;
      }
    }
    {
      __bDiagValueArrayCtr = DiagGetParameterErrorHandled(__resp, "Application_Software_Logical_Block_5_Identification", __bDiagValueArray, elcount(__bDiagValueArray), __cDiagValueArray, elcount(__cDiagValueArray));
      {
        __bSetInCheckAlignment = 1;	
        {
          __bArrayCtr = __CopyBytes(__bDiagValueArray, __bDiagValueArrayCtr, __bArray);
          {
            sysvar * __systemVariable;
            __systemVariable = sysvarData::`PartNumber::`Part_Number;
            CheckSysVarSetBufferConsistency(sysSetVariableData(sysvarData::`PartNumber::`Part_Number, __bArray, __bArrayCtr), __systemVariable.name);
          }
          snprintf(__cArray, 8192, "%s", "Part_Number");
          snprintf(__cArray2, 8192, "%s '%s'", __cSysVar, __cArray);
          snprintf(__cArray3, 8192, "%s", "Application_Software_Logical_Block_5_Identification");
          
          ReportTableRow(__tableHandle, 0, __cArray2, __cAOp, __bArray, __bArrayCtr, __cArray3, __oneOfFlag, __bSetInCheckAlignment);
        
        }
    
        __bSetInCheckAlignment = 0;
      }
    }
    {
      __bDiagValueArrayCtr = DiagGetParameterErrorHandled(__resp, "Application_Software_Logical_Block_5_Patch_Level", __bDiagValueArray, elcount(__bDiagValueArray), __cDiagValueArray, elcount(__cDiagValueArray));
      {
        __bSetInCheckAlignment = 1;	
        {
          __bArrayCtr = __CopyBytes(__bDiagValueArray, __bDiagValueArrayCtr, __bArray);
          {
            sysvar * __systemVariable;
            __systemVariable = sysvarData::`PartNumber::`Part_Number;
            CheckSysVarSetBufferConsistency(sysSetVariableData(sysvarData::`PartNumber::`Part_Number, __bArray, __bArrayCtr), __systemVariable.name);
          }
          snprintf(__cArray, 8192, "%s", "Part_Number");
          snprintf(__cArray2, 8192, "%s '%s'", __cSysVar, __cArray);
          snprintf(__cArray3, 8192, "%s", "Application_Software_Logical_Block_5_Patch_Level");
          
          ReportTableRow(__tableHandle, 0, __cArray2, __cAOp, __bArray, __bArrayCtr, __cArray3, __oneOfFlag, __bSetInCheckAlignment);
        
        }
    
        __bSetInCheckAlignment = 0;
      }
    }
    {
      __bDiagValueArrayCtr = DiagGetParameterErrorHandled(__resp, "Application_Software_Logical_Block_5_Week", __bDiagValueArray, elcount(__bDiagValueArray), __cDiagValueArray, elcount(__cDiagValueArray));
      {
        __bSetInCheckAlignment = 1;	
        {
          __bArrayCtr = __CopyBytes(__bDiagValueArray, __bDiagValueArrayCtr, __bArray);
          {
            sysvar * __systemVariable;
            __systemVariable = sysvarData::`PartNumber::`Part_Number;
            CheckSysVarSetBufferConsistency(sysSetVariableData(sysvarData::`PartNumber::`Part_Number, __bArray, __bArrayCtr), __systemVariable.name);
          }
          snprintf(__cArray, 8192, "%s", "Part_Number");
          snprintf(__cArray2, 8192, "%s '%s'", __cSysVar, __cArray);
          snprintf(__cArray3, 8192, "%s", "Application_Software_Logical_Block_5_Week");
          
          ReportTableRow(__tableHandle, 0, __cArray2, __cAOp, __bArray, __bArrayCtr, __cArray3, __oneOfFlag, __bSetInCheckAlignment);
        
        }
    
        __bSetInCheckAlignment = 0;
      }
    }
    {
      __bDiagValueArrayCtr = DiagGetParameterErrorHandled(__resp, "Application_Software_Logical_Block_5_Year", __bDiagValueArray, elcount(__bDiagValueArray), __cDiagValueArray, elcount(__cDiagValueArray));
      {
        __bSetInCheckAlignment = 1;	
        {
          __bArrayCtr = __CopyBytes(__bDiagValueArray, __bDiagValueArrayCtr, __bArray);
          {
            sysvar * __systemVariable;
            __systemVariable = sysvarData::`PartNumber::`Part_Number;
            CheckSysVarSetBufferConsistency(sysSetVariableData(sysvarData::`PartNumber::`Part_Number, __bArray, __bArrayCtr), __systemVariable.name);
          }
          snprintf(__cArray, 8192, "%s", "Part_Number");
          snprintf(__cArray2, 8192, "%s '%s'", __cSysVar, __cArray);
          snprintf(__cArray3, 8192, "%s", "Application_Software_Logical_Block_5_Year");
          
          ReportTableRow(__tableHandle, 0, __cArray2, __cAOp, __bArray, __bArrayCtr, __cArray3, __oneOfFlag, __bSetInCheckAlignment);
        
        }
    
        __bSetInCheckAlignment = 0;
      }
    }
    {
      __bDiagValueArrayCtr = DiagGetParameterErrorHandled(__resp, "_Application_Software_Logical_Block_1_Version_Information__Iden", __bDiagValueArray, elcount(__bDiagValueArray), __cDiagValueArray, elcount(__cDiagValueArray));
      {
        __bSetInCheckAlignment = 1;	
        {
          __bArrayCtr = __CopyBytes(__bDiagValueArray, __bDiagValueArrayCtr, __bArray);
          {
            sysvar * __systemVariable;
            __systemVariable = sysvarData::`PartNumber::`Part_Number;
            CheckSysVarSetBufferConsistency(sysSetVariableData(sysvarData::`PartNumber::`Part_Number, __bArray, __bArrayCtr), __systemVariable.name);
          }
          snprintf(__cArray, 8192, "%s", "Part_Number");
          snprintf(__cArray2, 8192, "%s '%s'", __cSysVar, __cArray);
          snprintf(__cArray3, 8192, "%s", "_Application_Software_Logical_Block_1_Version_Information__Iden");
          
          ReportTableRow(__tableHandle, 0, __cArray2, __cAOp, __bArray, __bArrayCtr, __cArray3, __oneOfFlag, __bSetInCheckAlignment);
        
        }
    
        __bSetInCheckAlignment = 0;
      }
    }
    {
      __bDiagValueArrayCtr = DiagGetParameterErrorHandled(__resp, "_Application_Software_Logical_Block_1_Version_Information__Patc", __bDiagValueArray, elcount(__bDiagValueArray), __cDiagValueArray, elcount(__cDiagValueArray));
      {
        __bSetInCheckAlignment = 1;	
        {
          __bArrayCtr = __CopyBytes(__bDiagValueArray, __bDiagValueArrayCtr, __bArray);
          {
            sysvar * __systemVariable;
            __systemVariable = sysvarData::`PartNumber::`Part_Number;
            CheckSysVarSetBufferConsistency(sysSetVariableData(sysvarData::`PartNumber::`Part_Number, __bArray, __bArrayCtr), __systemVariable.name);
          }
          snprintf(__cArray, 8192, "%s", "Part_Number");
          snprintf(__cArray2, 8192, "%s '%s'", __cSysVar, __cArray);
          snprintf(__cArray3, 8192, "%s", "_Application_Software_Logical_Block_1_Version_Information__Patc");
          
          ReportTableRow(__tableHandle, 0, __cArray2, __cAOp, __bArray, __bArrayCtr, __cArray3, __oneOfFlag, __bSetInCheckAlignment);
        
        }
    
        __bSetInCheckAlignment = 0;
      }
    }
    {
      __bDiagValueArrayCtr = DiagGetParameterErrorHandled(__resp, "_Application_Software_Logical_Block_1_Version_Information__Week", __bDiagValueArray, elcount(__bDiagValueArray), __cDiagValueArray, elcount(__cDiagValueArray));
      {
        __bSetInCheckAlignment = 1;	
        {
          __bArrayCtr = __CopyBytes(__bDiagValueArray, __bDiagValueArrayCtr, __bArray);
          {
            sysvar * __systemVariable;
            __systemVariable = sysvarData::`PartNumber::`Part_Number;
            CheckSysVarSetBufferConsistency(sysSetVariableData(sysvarData::`PartNumber::`Part_Number, __bArray, __bArrayCtr), __systemVariable.name);
          }
          snprintf(__cArray, 8192, "%s", "Part_Number");
          snprintf(__cArray2, 8192, "%s '%s'", __cSysVar, __cArray);
          snprintf(__cArray3, 8192, "%s", "_Application_Software_Logical_Block_1_Version_Information__Week");
          
          ReportTableRow(__tableHandle, 0, __cArray2, __cAOp, __bArray, __bArrayCtr, __cArray3, __oneOfFlag, __bSetInCheckAlignment);
        
        }
    
        __bSetInCheckAlignment = 0;
      }
    }
    {
      __bDiagValueArrayCtr = DiagGetParameterErrorHandled(__resp, "_Application_Software_Logical_Block_1_Version_Information__Year", __bDiagValueArray, elcount(__bDiagValueArray), __cDiagValueArray, elcount(__cDiagValueArray));
      {
        __bSetInCheckAlignment = 1;	
        {
          __bArrayCtr = __CopyBytes(__bDiagValueArray, __bDiagValueArrayCtr, __bArray);
          {
            sysvar * __systemVariable;
            __systemVariable = sysvarData::`PartNumber::`Part_Number;
            CheckSysVarSetBufferConsistency(sysSetVariableData(sysvarData::`PartNumber::`Part_Number, __bArray, __bArrayCtr), __systemVariable.name);
          }
          snprintf(__cArray, 8192, "%s", "Part_Number");
          snprintf(__cArray2, 8192, "%s '%s'", __cSysVar, __cArray);
          snprintf(__cArray3, 8192, "%s", "_Application_Software_Logical_Block_1_Version_Information__Year");
          
          ReportTableRow(__tableHandle, 0, __cArray2, __cAOp, __bArray, __bArrayCtr, __cArray3, __oneOfFlag, __bSetInCheckAlignment);
        
        }
    
        __bSetInCheckAlignment = 0;
      }
    }
    ReportTableEndVerdict(__tableHandle, __cEvaluateResponse, __res);
	__bVerdict = __bVerdict && __res;
  }
  if (__bVerdict == __eVerdictFail)
    TestReportWriteDiagObjectList();
}

void Ttvccmce9_F182_DID_with_Physical_Address()
{
  stack long __tableHandle;
  TestCommandBegin(__eDiagService, __cDiagService, "", "0");
  {
    if (DiagIsFunctionalGroup("CVADAS_0001_00000000_000"))
    {
      DiagResponse * __resp;
      DiagRequest CVADAS_0001_00000000_000._22F182_Application_Data_Identification __req;
      __diagServicevccmce9_9(__req, __resp);
    }
    else
    {
      DiagResponse CVADAS_0001_00000000_000.* __resp;
      DiagRequest CVADAS_0001_00000000_000._22F182_Application_Data_Identification __req;
      __diagServicevccmce9_9(__req, __resp);
    }
  }
  TestCommandEnd();


}

  
void __diagServicevccmce9_9(DiagRequest * __req, DiagResponse * __resp )
{
  stack long __tableHandle;
  long __res, __paramLen, __bytePos;

   __bVerdict = __eVerdictPass;

  do {
    TestReportResetDiagObjectList();
    DiagSetReportDetailLevel("CVADAS_0001_00000000_000", EnumServiceDetails_onfail);
    // Request aspect
    {

      if (0 >= DiagSendReqAndWaitForResp("CVADAS_0001_00000000_000", __req, __resp, __res, -1, -1, -1, -1, -1, EnumResult_pos, EnumServiceDetails_onfail, EnumSendingMode_physical, EnumSuppressPosResBit_asconfigured, EnumVerdictOnInvalidValues_fail))
        break;
    }

    __res = DiagErrCodeTestStep(__res, "Can't retrieve last response for request! No check possible.") < 0;
    if(__res)
    {
	  __bVerdict = __eVerdictFail;
      break;
    }
    {
      __res = DiagInterpretAs(__resp, "RDBI_PR");
      if(__res != 0)
      {
        __bVerdict = __eVerdictFail;
        DiagErrCodeTestStep(__res, "Can't interpret response as diagnostic primitive 'RDBI_PR'.");
        break;
      }
      else
      {
        TestStepPass( "Received primitive can be interpreted as diagnostic primitive 'RDBI_PR'.");
      }
    }
  }
  while(0);


  // Response, check & read aspect
  {
    __res = 1;
    __tableHandle = ReportTableHead5Columns(__cCheckCaption, __cTSym, __cTOp, __cRefVal, __cActual, __cRes);
    {
      __bDiagValueArrayCtr = DiagGetParameterErrorHandled(__resp, "Application_Data_Logical_Block_7_SwIdentification", __bDiagValueArray, elcount(__bDiagValueArray), __cDiagValueArray, elcount(__cDiagValueArray));
      {
        __bSetInCheckAlignment = 1;	
        {
          __bArrayCtr = __CopyBytes(__bDiagValueArray, __bDiagValueArrayCtr, __bArray);
          {
            sysvar * __systemVariable;
            __systemVariable = sysvarData::`PartNumber::`Part_Number;
            CheckSysVarSetBufferConsistency(sysSetVariableData(sysvarData::`PartNumber::`Part_Number, __bArray, __bArrayCtr), __systemVariable.name);
          }
          snprintf(__cArray, 8192, "%s", "Part_Number");
          snprintf(__cArray2, 8192, "%s '%s'", __cSysVar, __cArray);
          snprintf(__cArray3, 8192, "%s", "Application_Data_Logical_Block_7_SwIdentification");
          
          ReportTableRow(__tableHandle, 0, __cArray2, __cAOp, __bArray, __bArrayCtr, __cArray3, __oneOfFlag, __bSetInCheckAlignment);
        
        }
    
        __bSetInCheckAlignment = 0;
      }
    }
    {
      __bDiagValueArrayCtr = DiagGetParameterErrorHandled(__resp, "Application_Data_Logical_Block_7_SwPatch_Level", __bDiagValueArray, elcount(__bDiagValueArray), __cDiagValueArray, elcount(__cDiagValueArray));
      {
        __bSetInCheckAlignment = 1;	
        {
          __bArrayCtr = __CopyBytes(__bDiagValueArray, __bDiagValueArrayCtr, __bArray);
          {
            sysvar * __systemVariable;
            __systemVariable = sysvarData::`PartNumber::`Part_Number;
            CheckSysVarSetBufferConsistency(sysSetVariableData(sysvarData::`PartNumber::`Part_Number, __bArray, __bArrayCtr), __systemVariable.name);
          }
          snprintf(__cArray, 8192, "%s", "Part_Number");
          snprintf(__cArray2, 8192, "%s '%s'", __cSysVar, __cArray);
          snprintf(__cArray3, 8192, "%s", "Application_Data_Logical_Block_7_SwPatch_Level");
          
          ReportTableRow(__tableHandle, 0, __cArray2, __cAOp, __bArray, __bArrayCtr, __cArray3, __oneOfFlag, __bSetInCheckAlignment);
        
        }
    
        __bSetInCheckAlignment = 0;
      }
    }
    {
      __bDiagValueArrayCtr = DiagGetParameterErrorHandled(__resp, "Application_Data_Logical_Block_7_SwWeek", __bDiagValueArray, elcount(__bDiagValueArray), __cDiagValueArray, elcount(__cDiagValueArray));
      {
        __bSetInCheckAlignment = 1;	
        {
          __bArrayCtr = __CopyBytes(__bDiagValueArray, __bDiagValueArrayCtr, __bArray);
          {
            sysvar * __systemVariable;
            __systemVariable = sysvarData::`PartNumber::`Part_Number;
            CheckSysVarSetBufferConsistency(sysSetVariableData(sysvarData::`PartNumber::`Part_Number, __bArray, __bArrayCtr), __systemVariable.name);
          }
          snprintf(__cArray, 8192, "%s", "Part_Number");
          snprintf(__cArray2, 8192, "%s '%s'", __cSysVar, __cArray);
          snprintf(__cArray3, 8192, "%s", "Application_Data_Logical_Block_7_SwWeek");
          
          ReportTableRow(__tableHandle, 0, __cArray2, __cAOp, __bArray, __bArrayCtr, __cArray3, __oneOfFlag, __bSetInCheckAlignment);
        
        }
    
        __bSetInCheckAlignment = 0;
      }
    }
    {
      __bDiagValueArrayCtr = DiagGetParameterErrorHandled(__resp, "Application_Data_Logical_Block_7_SwYear", __bDiagValueArray, elcount(__bDiagValueArray), __cDiagValueArray, elcount(__cDiagValueArray));
      {
        __bSetInCheckAlignment = 1;	
        {
          __bArrayCtr = __CopyBytes(__bDiagValueArray, __bDiagValueArrayCtr, __bArray);
          {
            sysvar * __systemVariable;
            __systemVariable = sysvarData::`PartNumber::`Part_Number;
            CheckSysVarSetBufferConsistency(sysSetVariableData(sysvarData::`PartNumber::`Part_Number, __bArray, __bArrayCtr), __systemVariable.name);
          }
          snprintf(__cArray, 8192, "%s", "Part_Number");
          snprintf(__cArray2, 8192, "%s '%s'", __cSysVar, __cArray);
          snprintf(__cArray3, 8192, "%s", "Application_Data_Logical_Block_7_SwYear");
          
          ReportTableRow(__tableHandle, 0, __cArray2, __cAOp, __bArray, __bArrayCtr, __cArray3, __oneOfFlag, __bSetInCheckAlignment);
        
        }
    
        __bSetInCheckAlignment = 0;
      }
    }
    {
      __bDiagValueArrayCtr = DiagGetParameterErrorHandled(__resp, "Application_Data_Logical_Block_8_SwIdentification", __bDiagValueArray, elcount(__bDiagValueArray), __cDiagValueArray, elcount(__cDiagValueArray));
      {
        __bSetInCheckAlignment = 1;	
        {
          __bArrayCtr = __CopyBytes(__bDiagValueArray, __bDiagValueArrayCtr, __bArray);
          {
            sysvar * __systemVariable;
            __systemVariable = sysvarData::`PartNumber::`Part_Number;
            CheckSysVarSetBufferConsistency(sysSetVariableData(sysvarData::`PartNumber::`Part_Number, __bArray, __bArrayCtr), __systemVariable.name);
          }
          snprintf(__cArray, 8192, "%s", "Part_Number");
          snprintf(__cArray2, 8192, "%s '%s'", __cSysVar, __cArray);
          snprintf(__cArray3, 8192, "%s", "Application_Data_Logical_Block_8_SwIdentification");
          
          ReportTableRow(__tableHandle, 0, __cArray2, __cAOp, __bArray, __bArrayCtr, __cArray3, __oneOfFlag, __bSetInCheckAlignment);
        
        }
    
        __bSetInCheckAlignment = 0;
      }
    }
    {
      __bDiagValueArrayCtr = DiagGetParameterErrorHandled(__resp, "Application_Data_Logical_Block_8_SwPatch_Level", __bDiagValueArray, elcount(__bDiagValueArray), __cDiagValueArray, elcount(__cDiagValueArray));
      {
        __bSetInCheckAlignment = 1;	
        {
          __bArrayCtr = __CopyBytes(__bDiagValueArray, __bDiagValueArrayCtr, __bArray);
          {
            sysvar * __systemVariable;
            __systemVariable = sysvarData::`PartNumber::`Part_Number;
            CheckSysVarSetBufferConsistency(sysSetVariableData(sysvarData::`PartNumber::`Part_Number, __bArray, __bArrayCtr), __systemVariable.name);
          }
          snprintf(__cArray, 8192, "%s", "Part_Number");
          snprintf(__cArray2, 8192, "%s '%s'", __cSysVar, __cArray);
          snprintf(__cArray3, 8192, "%s", "Application_Data_Logical_Block_8_SwPatch_Level");
          
          ReportTableRow(__tableHandle, 0, __cArray2, __cAOp, __bArray, __bArrayCtr, __cArray3, __oneOfFlag, __bSetInCheckAlignment);
        
        }
    
        __bSetInCheckAlignment = 0;
      }
    }
    {
      __bDiagValueArrayCtr = DiagGetParameterErrorHandled(__resp, "Application_Data_Logical_Block_8_SwWeek", __bDiagValueArray, elcount(__bDiagValueArray), __cDiagValueArray, elcount(__cDiagValueArray));
      {
        __bSetInCheckAlignment = 1;	
        {
          __bArrayCtr = __CopyBytes(__bDiagValueArray, __bDiagValueArrayCtr, __bArray);
          {
            sysvar * __systemVariable;
            __systemVariable = sysvarData::`PartNumber::`Part_Number;
            CheckSysVarSetBufferConsistency(sysSetVariableData(sysvarData::`PartNumber::`Part_Number, __bArray, __bArrayCtr), __systemVariable.name);
          }
          snprintf(__cArray, 8192, "%s", "Part_Number");
          snprintf(__cArray2, 8192, "%s '%s'", __cSysVar, __cArray);
          snprintf(__cArray3, 8192, "%s", "Application_Data_Logical_Block_8_SwWeek");
          
          ReportTableRow(__tableHandle, 0, __cArray2, __cAOp, __bArray, __bArrayCtr, __cArray3, __oneOfFlag, __bSetInCheckAlignment);
        
        }
    
        __bSetInCheckAlignment = 0;
      }
    }
    {
      __bDiagValueArrayCtr = DiagGetParameterErrorHandled(__resp, "Application_Data_Logical_Block_8_SwYear", __bDiagValueArray, elcount(__bDiagValueArray), __cDiagValueArray, elcount(__cDiagValueArray));
      {
        __bSetInCheckAlignment = 1;	
        {
          __bArrayCtr = __CopyBytes(__bDiagValueArray, __bDiagValueArrayCtr, __bArray);
          {
            sysvar * __systemVariable;
            __systemVariable = sysvarData::`PartNumber::`Part_Number;
            CheckSysVarSetBufferConsistency(sysSetVariableData(sysvarData::`PartNumber::`Part_Number, __bArray, __bArrayCtr), __systemVariable.name);
          }
          snprintf(__cArray, 8192, "%s", "Part_Number");
          snprintf(__cArray2, 8192, "%s '%s'", __cSysVar, __cArray);
          snprintf(__cArray3, 8192, "%s", "Application_Data_Logical_Block_8_SwYear");
          
          ReportTableRow(__tableHandle, 0, __cArray2, __cAOp, __bArray, __bArrayCtr, __cArray3, __oneOfFlag, __bSetInCheckAlignment);
        
        }
    
        __bSetInCheckAlignment = 0;
      }
    }
    {
      __bDiagValueArrayCtr = DiagGetParameterErrorHandled(__resp, "_Number_of_Application_Data_Logical_Blocks_24", __bDiagValueArray, elcount(__bDiagValueArray), __cDiagValueArray, elcount(__cDiagValueArray));
      {
        __bSetInCheckAlignment = 1;	
        {
          __bArrayCtr = __CopyBytes(__bDiagValueArray, __bDiagValueArrayCtr, __bArray);
          {
            sysvar * __systemVariable;
            __systemVariable = sysvarData::`PartNumber::`Part_Number;
            CheckSysVarSetBufferConsistency(sysSetVariableData(sysvarData::`PartNumber::`Part_Number, __bArray, __bArrayCtr), __systemVariable.name);
          }
          snprintf(__cArray, 8192, "%s", "Part_Number");
          snprintf(__cArray2, 8192, "%s '%s'", __cSysVar, __cArray);
          snprintf(__cArray3, 8192, "%s", "_Number_of_Application_Data_Logical_Blocks_24");
          
          ReportTableRow(__tableHandle, 0, __cArray2, __cAOp, __bArray, __bArrayCtr, __cArray3, __oneOfFlag, __bSetInCheckAlignment);
        
        }
    
        __bSetInCheckAlignment = 0;
      }
    }
    {
      __bDiagValueArrayCtr = DiagGetParameterErrorHandled(__resp, "_SW_Year_32", __bDiagValueArray, elcount(__bDiagValueArray), __cDiagValueArray, elcount(__cDiagValueArray));
      {
        __bSetInCheckAlignment = 1;	
        {
          __bArrayCtr = __CopyBytes(__bDiagValueArray, __bDiagValueArrayCtr, __bArray);
          {
            sysvar * __systemVariable;
            __systemVariable = sysvarData::`PartNumber::`Part_Number;
            CheckSysVarSetBufferConsistency(sysSetVariableData(sysvarData::`PartNumber::`Part_Number, __bArray, __bArrayCtr), __systemVariable.name);
          }
          snprintf(__cArray, 8192, "%s", "Part_Number");
          snprintf(__cArray2, 8192, "%s '%s'", __cSysVar, __cArray);
          snprintf(__cArray3, 8192, "%s", "_SW_Year_32");
          
          ReportTableRow(__tableHandle, 0, __cArray2, __cAOp, __bArray, __bArrayCtr, __cArray3, __oneOfFlag, __bSetInCheckAlignment);
        
        }
    
        __bSetInCheckAlignment = 0;
      }
    }
    {
      __bDiagValueArrayCtr = DiagGetParameterErrorHandled(__resp, "_SW__Identification_56", __bDiagValueArray, elcount(__bDiagValueArray), __cDiagValueArray, elcount(__cDiagValueArray));
      {
        __bSetInCheckAlignment = 1;	
        {
          __bArrayCtr = __CopyBytes(__bDiagValueArray, __bDiagValueArrayCtr, __bArray);
          {
            sysvar * __systemVariable;
            __systemVariable = sysvarData::`PartNumber::`Part_Number;
            CheckSysVarSetBufferConsistency(sysSetVariableData(sysvarData::`PartNumber::`Part_Number, __bArray, __bArrayCtr), __systemVariable.name);
          }
          snprintf(__cArray, 8192, "%s", "Part_Number");
          snprintf(__cArray2, 8192, "%s '%s'", __cSysVar, __cArray);
          snprintf(__cArray3, 8192, "%s", "_SW__Identification_56");
          
          ReportTableRow(__tableHandle, 0, __cArray2, __cAOp, __bArray, __bArrayCtr, __cArray3, __oneOfFlag, __bSetInCheckAlignment);
        
        }
    
        __bSetInCheckAlignment = 0;
      }
    }
    {
      __bDiagValueArrayCtr = DiagGetParameterErrorHandled(__resp, "_SW__Patch_Level_48", __bDiagValueArray, elcount(__bDiagValueArray), __cDiagValueArray, elcount(__cDiagValueArray));
      {
        __bSetInCheckAlignment = 1;	
        {
          __bArrayCtr = __CopyBytes(__bDiagValueArray, __bDiagValueArrayCtr, __bArray);
          {
            sysvar * __systemVariable;
            __systemVariable = sysvarData::`PartNumber::`Part_Number;
            CheckSysVarSetBufferConsistency(sysSetVariableData(sysvarData::`PartNumber::`Part_Number, __bArray, __bArrayCtr), __systemVariable.name);
          }
          snprintf(__cArray, 8192, "%s", "Part_Number");
          snprintf(__cArray2, 8192, "%s '%s'", __cSysVar, __cArray);
          snprintf(__cArray3, 8192, "%s", "_SW__Patch_Level_48");
          
          ReportTableRow(__tableHandle, 0, __cArray2, __cAOp, __bArray, __bArrayCtr, __cArray3, __oneOfFlag, __bSetInCheckAlignment);
        
        }
    
        __bSetInCheckAlignment = 0;
      }
    }
    {
      __bDiagValueArrayCtr = DiagGetParameterErrorHandled(__resp, "_SW__Week_40", __bDiagValueArray, elcount(__bDiagValueArray), __cDiagValueArray, elcount(__cDiagValueArray));
      {
        __bSetInCheckAlignment = 1;	
        {
          __bArrayCtr = __CopyBytes(__bDiagValueArray, __bDiagValueArrayCtr, __bArray);
          {
            sysvar * __systemVariable;
            __systemVariable = sysvarData::`PartNumber::`Part_Number;
            CheckSysVarSetBufferConsistency(sysSetVariableData(sysvarData::`PartNumber::`Part_Number, __bArray, __bArrayCtr), __systemVariable.name);
          }
          snprintf(__cArray, 8192, "%s", "Part_Number");
          snprintf(__cArray2, 8192, "%s '%s'", __cSysVar, __cArray);
          snprintf(__cArray3, 8192, "%s", "_SW__Week_40");
          
          ReportTableRow(__tableHandle, 0, __cArray2, __cAOp, __bArray, __bArrayCtr, __cArray3, __oneOfFlag, __bSetInCheckAlignment);
        
        }
    
        __bSetInCheckAlignment = 0;
      }
    }
    ReportTableEndVerdict(__tableHandle, __cEvaluateResponse, __res);
	__bVerdict = __bVerdict && __res;
  }
  if (__bVerdict == __eVerdictFail)
    TestReportWriteDiagObjectList();
}

void Ttvccmce9_F182_DID_with_Functional_Address()
{
  stack long __tableHandle;
  TestCommandBegin(__eDiagService, __cDiagService, "", "0");
  {
    if (DiagIsFunctionalGroup("CVADAS_0001_00000000_000"))
    {
      DiagResponse * __resp;
      DiagRequest CVADAS_0001_00000000_000._22F182_Application_Data_Identification __req;
      __diagServicevccmce9_10(__req, __resp);
    }
    else
    {
      DiagResponse CVADAS_0001_00000000_000.* __resp;
      DiagRequest CVADAS_0001_00000000_000._22F182_Application_Data_Identification __req;
      __diagServicevccmce9_10(__req, __resp);
    }
  }
  TestCommandEnd();


}

  
void __diagServicevccmce9_10(DiagRequest * __req, DiagResponse * __resp )
{
  stack long __tableHandle;
  long __res, __paramLen, __bytePos;

   __bVerdict = __eVerdictPass;

  do {
    TestReportResetDiagObjectList();
    DiagSetReportDetailLevel("CVADAS_0001_00000000_000", EnumServiceDetails_onfail);
    // Request aspect
    {

      if (0 >= DiagSendReqAndWaitForResp("CVADAS_0001_00000000_000", __req, __resp, __res, -1, -1, -1, -1, -1, EnumResult_pos, EnumServiceDetails_onfail, EnumSendingMode_physical, EnumSuppressPosResBit_asconfigured, EnumVerdictOnInvalidValues_fail))
        break;
    }

    __res = DiagErrCodeTestStep(__res, "Can't retrieve last response for request! No check possible.") < 0;
    if(__res)
    {
	  __bVerdict = __eVerdictFail;
      break;
    }
    {
      __res = DiagInterpretAs(__resp, "RDBI_PR");
      if(__res != 0)
      {
        __bVerdict = __eVerdictFail;
        DiagErrCodeTestStep(__res, "Can't interpret response as diagnostic primitive 'RDBI_PR'.");
        break;
      }
      else
      {
        TestStepPass( "Received primitive can be interpreted as diagnostic primitive 'RDBI_PR'.");
      }
    }
  }
  while(0);


  // Response, check & read aspect
  {
    __res = 1;
    __tableHandle = ReportTableHead5Columns(__cCheckCaption, __cTSym, __cTOp, __cRefVal, __cActual, __cRes);
    {
      __bDiagValueArrayCtr = DiagGetParameterErrorHandled(__resp, "Application_Data_Logical_Block_7_SwIdentification", __bDiagValueArray, elcount(__bDiagValueArray), __cDiagValueArray, elcount(__cDiagValueArray));
      {
        __bSetInCheckAlignment = 1;	
        {
          __bArrayCtr = __CopyBytes(__bDiagValueArray, __bDiagValueArrayCtr, __bArray);
          {
            sysvar * __systemVariable;
            __systemVariable = sysvarData::`PartNumber::`Part_Number;
            CheckSysVarSetBufferConsistency(sysSetVariableData(sysvarData::`PartNumber::`Part_Number, __bArray, __bArrayCtr), __systemVariable.name);
          }
          snprintf(__cArray, 8192, "%s", "Part_Number");
          snprintf(__cArray2, 8192, "%s '%s'", __cSysVar, __cArray);
          snprintf(__cArray3, 8192, "%s", "Application_Data_Logical_Block_7_SwIdentification");
          
          ReportTableRow(__tableHandle, 0, __cArray2, __cAOp, __bArray, __bArrayCtr, __cArray3, __oneOfFlag, __bSetInCheckAlignment);
        
        }
    
        __bSetInCheckAlignment = 0;
      }
    }
    {
      __bDiagValueArrayCtr = DiagGetParameterErrorHandled(__resp, "Application_Data_Logical_Block_7_SwPatch_Level", __bDiagValueArray, elcount(__bDiagValueArray), __cDiagValueArray, elcount(__cDiagValueArray));
      {
        __bSetInCheckAlignment = 1;	
        {
          __bArrayCtr = __CopyBytes(__bDiagValueArray, __bDiagValueArrayCtr, __bArray);
          {
            sysvar * __systemVariable;
            __systemVariable = sysvarData::`PartNumber::`Part_Number;
            CheckSysVarSetBufferConsistency(sysSetVariableData(sysvarData::`PartNumber::`Part_Number, __bArray, __bArrayCtr), __systemVariable.name);
          }
          snprintf(__cArray, 8192, "%s", "Part_Number");
          snprintf(__cArray2, 8192, "%s '%s'", __cSysVar, __cArray);
          snprintf(__cArray3, 8192, "%s", "Application_Data_Logical_Block_7_SwPatch_Level");
          
          ReportTableRow(__tableHandle, 0, __cArray2, __cAOp, __bArray, __bArrayCtr, __cArray3, __oneOfFlag, __bSetInCheckAlignment);
        
        }
    
        __bSetInCheckAlignment = 0;
      }
    }
    {
      __bDiagValueArrayCtr = DiagGetParameterErrorHandled(__resp, "Application_Data_Logical_Block_7_SwWeek", __bDiagValueArray, elcount(__bDiagValueArray), __cDiagValueArray, elcount(__cDiagValueArray));
      {
        __bSetInCheckAlignment = 1;	
        {
          __bArrayCtr = __CopyBytes(__bDiagValueArray, __bDiagValueArrayCtr, __bArray);
          {
            sysvar * __systemVariable;
            __systemVariable = sysvarData::`PartNumber::`Part_Number;
            CheckSysVarSetBufferConsistency(sysSetVariableData(sysvarData::`PartNumber::`Part_Number, __bArray, __bArrayCtr), __systemVariable.name);
          }
          snprintf(__cArray, 8192, "%s", "Part_Number");
          snprintf(__cArray2, 8192, "%s '%s'", __cSysVar, __cArray);
          snprintf(__cArray3, 8192, "%s", "Application_Data_Logical_Block_7_SwWeek");
          
          ReportTableRow(__tableHandle, 0, __cArray2, __cAOp, __bArray, __bArrayCtr, __cArray3, __oneOfFlag, __bSetInCheckAlignment);
        
        }
    
        __bSetInCheckAlignment = 0;
      }
    }
    {
      __bDiagValueArrayCtr = DiagGetParameterErrorHandled(__resp, "Application_Data_Logical_Block_7_SwYear", __bDiagValueArray, elcount(__bDiagValueArray), __cDiagValueArray, elcount(__cDiagValueArray));
      {
        __bSetInCheckAlignment = 1;	
        {
          __bArrayCtr = __CopyBytes(__bDiagValueArray, __bDiagValueArrayCtr, __bArray);
          {
            sysvar * __systemVariable;
            __systemVariable = sysvarData::`PartNumber::`Part_Number;
            CheckSysVarSetBufferConsistency(sysSetVariableData(sysvarData::`PartNumber::`Part_Number, __bArray, __bArrayCtr), __systemVariable.name);
          }
          snprintf(__cArray, 8192, "%s", "Part_Number");
          snprintf(__cArray2, 8192, "%s '%s'", __cSysVar, __cArray);
          snprintf(__cArray3, 8192, "%s", "Application_Data_Logical_Block_7_SwYear");
          
          ReportTableRow(__tableHandle, 0, __cArray2, __cAOp, __bArray, __bArrayCtr, __cArray3, __oneOfFlag, __bSetInCheckAlignment);
        
        }
    
        __bSetInCheckAlignment = 0;
      }
    }
    {
      __bDiagValueArrayCtr = DiagGetParameterErrorHandled(__resp, "Application_Data_Logical_Block_8_SwIdentification", __bDiagValueArray, elcount(__bDiagValueArray), __cDiagValueArray, elcount(__cDiagValueArray));
      {
        __bSetInCheckAlignment = 1;	
        {
          __bArrayCtr = __CopyBytes(__bDiagValueArray, __bDiagValueArrayCtr, __bArray);
          {
            sysvar * __systemVariable;
            __systemVariable = sysvarData::`PartNumber::`Part_Number;
            CheckSysVarSetBufferConsistency(sysSetVariableData(sysvarData::`PartNumber::`Part_Number, __bArray, __bArrayCtr), __systemVariable.name);
          }
          snprintf(__cArray, 8192, "%s", "Part_Number");
          snprintf(__cArray2, 8192, "%s '%s'", __cSysVar, __cArray);
          snprintf(__cArray3, 8192, "%s", "Application_Data_Logical_Block_8_SwIdentification");
          
          ReportTableRow(__tableHandle, 0, __cArray2, __cAOp, __bArray, __bArrayCtr, __cArray3, __oneOfFlag, __bSetInCheckAlignment);
        
        }
    
        __bSetInCheckAlignment = 0;
      }
    }
    {
      __bDiagValueArrayCtr = DiagGetParameterErrorHandled(__resp, "Application_Data_Logical_Block_8_SwPatch_Level", __bDiagValueArray, elcount(__bDiagValueArray), __cDiagValueArray, elcount(__cDiagValueArray));
      {
        __bSetInCheckAlignment = 1;	
        {
          __bArrayCtr = __CopyBytes(__bDiagValueArray, __bDiagValueArrayCtr, __bArray);
          {
            sysvar * __systemVariable;
            __systemVariable = sysvarData::`PartNumber::`Part_Number;
            CheckSysVarSetBufferConsistency(sysSetVariableData(sysvarData::`PartNumber::`Part_Number, __bArray, __bArrayCtr), __systemVariable.name);
          }
          snprintf(__cArray, 8192, "%s", "Part_Number");
          snprintf(__cArray2, 8192, "%s '%s'", __cSysVar, __cArray);
          snprintf(__cArray3, 8192, "%s", "Application_Data_Logical_Block_8_SwPatch_Level");
          
          ReportTableRow(__tableHandle, 0, __cArray2, __cAOp, __bArray, __bArrayCtr, __cArray3, __oneOfFlag, __bSetInCheckAlignment);
        
        }
    
        __bSetInCheckAlignment = 0;
      }
    }
    {
      __bDiagValueArrayCtr = DiagGetParameterErrorHandled(__resp, "Application_Data_Logical_Block_8_SwWeek", __bDiagValueArray, elcount(__bDiagValueArray), __cDiagValueArray, elcount(__cDiagValueArray));
      {
        __bSetInCheckAlignment = 1;	
        {
          __bArrayCtr = __CopyBytes(__bDiagValueArray, __bDiagValueArrayCtr, __bArray);
          {
            sysvar * __systemVariable;
            __systemVariable = sysvarData::`PartNumber::`Part_Number;
            CheckSysVarSetBufferConsistency(sysSetVariableData(sysvarData::`PartNumber::`Part_Number, __bArray, __bArrayCtr), __systemVariable.name);
          }
          snprintf(__cArray, 8192, "%s", "Part_Number");
          snprintf(__cArray2, 8192, "%s '%s'", __cSysVar, __cArray);
          snprintf(__cArray3, 8192, "%s", "Application_Data_Logical_Block_8_SwWeek");
          
          ReportTableRow(__tableHandle, 0, __cArray2, __cAOp, __bArray, __bArrayCtr, __cArray3, __oneOfFlag, __bSetInCheckAlignment);
        
        }
    
        __bSetInCheckAlignment = 0;
      }
    }
    {
      __bDiagValueArrayCtr = DiagGetParameterErrorHandled(__resp, "Application_Data_Logical_Block_8_SwYear", __bDiagValueArray, elcount(__bDiagValueArray), __cDiagValueArray, elcount(__cDiagValueArray));
      {
        __bSetInCheckAlignment = 1;	
        {
          __bArrayCtr = __CopyBytes(__bDiagValueArray, __bDiagValueArrayCtr, __bArray);
          {
            sysvar * __systemVariable;
            __systemVariable = sysvarData::`PartNumber::`Part_Number;
            CheckSysVarSetBufferConsistency(sysSetVariableData(sysvarData::`PartNumber::`Part_Number, __bArray, __bArrayCtr), __systemVariable.name);
          }
          snprintf(__cArray, 8192, "%s", "Part_Number");
          snprintf(__cArray2, 8192, "%s '%s'", __cSysVar, __cArray);
          snprintf(__cArray3, 8192, "%s", "Application_Data_Logical_Block_8_SwYear");
          
          ReportTableRow(__tableHandle, 0, __cArray2, __cAOp, __bArray, __bArrayCtr, __cArray3, __oneOfFlag, __bSetInCheckAlignment);
        
        }
    
        __bSetInCheckAlignment = 0;
      }
    }
    {
      __bDiagValueArrayCtr = DiagGetParameterErrorHandled(__resp, "_Number_of_Application_Data_Logical_Blocks_24", __bDiagValueArray, elcount(__bDiagValueArray), __cDiagValueArray, elcount(__cDiagValueArray));
      {
        __bSetInCheckAlignment = 1;	
        {
          __bArrayCtr = __CopyBytes(__bDiagValueArray, __bDiagValueArrayCtr, __bArray);
          {
            sysvar * __systemVariable;
            __systemVariable = sysvarData::`PartNumber::`Part_Number;
            CheckSysVarSetBufferConsistency(sysSetVariableData(sysvarData::`PartNumber::`Part_Number, __bArray, __bArrayCtr), __systemVariable.name);
          }
          snprintf(__cArray, 8192, "%s", "Part_Number");
          snprintf(__cArray2, 8192, "%s '%s'", __cSysVar, __cArray);
          snprintf(__cArray3, 8192, "%s", "_Number_of_Application_Data_Logical_Blocks_24");
          
          ReportTableRow(__tableHandle, 0, __cArray2, __cAOp, __bArray, __bArrayCtr, __cArray3, __oneOfFlag, __bSetInCheckAlignment);
        
        }
    
        __bSetInCheckAlignment = 0;
      }
    }
    {
      __bDiagValueArrayCtr = DiagGetParameterErrorHandled(__resp, "_SW_Year_32", __bDiagValueArray, elcount(__bDiagValueArray), __cDiagValueArray, elcount(__cDiagValueArray));
      {
        __bSetInCheckAlignment = 1;	
        {
          __bArrayCtr = __CopyBytes(__bDiagValueArray, __bDiagValueArrayCtr, __bArray);
          {
            sysvar * __systemVariable;
            __systemVariable = sysvarData::`PartNumber::`Part_Number;
            CheckSysVarSetBufferConsistency(sysSetVariableData(sysvarData::`PartNumber::`Part_Number, __bArray, __bArrayCtr), __systemVariable.name);
          }
          snprintf(__cArray, 8192, "%s", "Part_Number");
          snprintf(__cArray2, 8192, "%s '%s'", __cSysVar, __cArray);
          snprintf(__cArray3, 8192, "%s", "_SW_Year_32");
          
          ReportTableRow(__tableHandle, 0, __cArray2, __cAOp, __bArray, __bArrayCtr, __cArray3, __oneOfFlag, __bSetInCheckAlignment);
        
        }
    
        __bSetInCheckAlignment = 0;
      }
    }
    {
      __bDiagValueArrayCtr = DiagGetParameterErrorHandled(__resp, "_SW__Identification_56", __bDiagValueArray, elcount(__bDiagValueArray), __cDiagValueArray, elcount(__cDiagValueArray));
      {
        __bSetInCheckAlignment = 1;	
        {
          __bArrayCtr = __CopyBytes(__bDiagValueArray, __bDiagValueArrayCtr, __bArray);
          {
            sysvar * __systemVariable;
            __systemVariable = sysvarData::`PartNumber::`Part_Number;
            CheckSysVarSetBufferConsistency(sysSetVariableData(sysvarData::`PartNumber::`Part_Number, __bArray, __bArrayCtr), __systemVariable.name);
          }
          snprintf(__cArray, 8192, "%s", "Part_Number");
          snprintf(__cArray2, 8192, "%s '%s'", __cSysVar, __cArray);
          snprintf(__cArray3, 8192, "%s", "_SW__Identification_56");
          
          ReportTableRow(__tableHandle, 0, __cArray2, __cAOp, __bArray, __bArrayCtr, __cArray3, __oneOfFlag, __bSetInCheckAlignment);
        
        }
    
        __bSetInCheckAlignment = 0;
      }
    }
    {
      __bDiagValueArrayCtr = DiagGetParameterErrorHandled(__resp, "_SW__Patch_Level_48", __bDiagValueArray, elcount(__bDiagValueArray), __cDiagValueArray, elcount(__cDiagValueArray));
      {
        __bSetInCheckAlignment = 1;	
        {
          __bArrayCtr = __CopyBytes(__bDiagValueArray, __bDiagValueArrayCtr, __bArray);
          {
            sysvar * __systemVariable;
            __systemVariable = sysvarData::`PartNumber::`Part_Number;
            CheckSysVarSetBufferConsistency(sysSetVariableData(sysvarData::`PartNumber::`Part_Number, __bArray, __bArrayCtr), __systemVariable.name);
          }
          snprintf(__cArray, 8192, "%s", "Part_Number");
          snprintf(__cArray2, 8192, "%s '%s'", __cSysVar, __cArray);
          snprintf(__cArray3, 8192, "%s", "_SW__Patch_Level_48");
          
          ReportTableRow(__tableHandle, 0, __cArray2, __cAOp, __bArray, __bArrayCtr, __cArray3, __oneOfFlag, __bSetInCheckAlignment);
        
        }
    
        __bSetInCheckAlignment = 0;
      }
    }
    {
      __bDiagValueArrayCtr = DiagGetParameterErrorHandled(__resp, "_SW__Week_40", __bDiagValueArray, elcount(__bDiagValueArray), __cDiagValueArray, elcount(__cDiagValueArray));
      {
        __bSetInCheckAlignment = 1;	
        {
          __bArrayCtr = __CopyBytes(__bDiagValueArray, __bDiagValueArrayCtr, __bArray);
          {
            sysvar * __systemVariable;
            __systemVariable = sysvarData::`PartNumber::`Part_Number;
            CheckSysVarSetBufferConsistency(sysSetVariableData(sysvarData::`PartNumber::`Part_Number, __bArray, __bArrayCtr), __systemVariable.name);
          }
          snprintf(__cArray, 8192, "%s", "Part_Number");
          snprintf(__cArray2, 8192, "%s '%s'", __cSysVar, __cArray);
          snprintf(__cArray3, 8192, "%s", "_SW__Week_40");
          
          ReportTableRow(__tableHandle, 0, __cArray2, __cAOp, __bArray, __bArrayCtr, __cArray3, __oneOfFlag, __bSetInCheckAlignment);
        
        }
    
        __bSetInCheckAlignment = 0;
      }
    }
    ReportTableEndVerdict(__tableHandle, __cEvaluateResponse, __res);
	__bVerdict = __bVerdict && __res;
  }
  if (__bVerdict == __eVerdictFail)
    TestReportWriteDiagObjectList();
}

void Ttvccmce9_F182_DID_with_Standard_Physical_Address()
{
  stack long __tableHandle;
  TestCommandBegin(__eRequestResponse, __cRequestResponse, "", "0");
  {
  
    long __res;
    int64 __timeout;
    __res = 0;
    __nInt64 = 1;
    __timeout = syspar::`P2_Server * 1000000LL;
    {
    
      long __testStepInitOk;
      message `FDCAN2::`DIAGNOSTIC_REQUEST_PAM __output;
      message `FDCAN2::`DIAGNOSTIC_REQUEST_PAM __msgOrig;
      __output = __msgOrig;
      __testStepInitOk = 1;
      {
        int64 __dlc;
        __dlc = 4;
        if (__dlc >= 0 && __dlc <= (__output.EDL ? 15 : 8))
          __output.DLC = __dlc;
        else
        {
          testStepErrorInTestSystem(0, __cEmpty, "Unable to set DLC=%lld in message. Please check input parameter.", __dlc);
          __testStepInitOk = 0;
        }
      }
      if (__testStepInitOk)
      {
        snprintf(__cArray, elCount(__cArray), "CAN message '%s' ID = 416981233x (0x18DAA0F1x) on bus FDCAN2", "DIAGNOSTIC_REQUEST_PAM");
        snprintf(__cArray2, elCount(__cArray2), "Send %s", __cArray);
        __tableHandle = ReportTableHead3Columns(__cArray2, "Byte", __cTOp, __cAssigned);
        ReportByteIndex("", 0, __cArray, elCount(__cArray));
        snprintf(__cArray2, 8192, "%s", __cArray);
        snprintf(__cArray3, 8192, "%s", "");
        
        ReportTableRow(__tableHandle, 0, __cArray2, __cAOp, 0x3, __cArray3, __oneOfFlag, __bSetInCheckAlignment);
        
        if (0 >= 0 && 0 < 64)
        {
          __output.byte((word)0) = 0x3;
        }
        else
        {
          testStepErrorInTestSystem(0, __cEmpty, "Index out of range. Unable to set byte %lld in message. Please check input parameter.", (int64)0);
          __testStepInitOk = 0;
        }
        ReportByteIndex("", 1, __cArray, elCount(__cArray));
        snprintf(__cArray2, 8192, "%s", __cArray);
        snprintf(__cArray3, 8192, "%s", "");
        
        ReportTableRow(__tableHandle, 0, __cArray2, __cAOp, 0x22, __cArray3, __oneOfFlag, __bSetInCheckAlignment);
        
        if (1 >= 0 && 1 < 64)
        {
          __output.byte((word)1) = 0x22;
        }
        else
        {
          testStepErrorInTestSystem(0, __cEmpty, "Index out of range. Unable to set byte %lld in message. Please check input parameter.", (int64)1);
          __testStepInitOk = 0;
        }
        ReportByteIndex("", 2, __cArray, elCount(__cArray));
        snprintf(__cArray2, 8192, "%s", __cArray);
        snprintf(__cArray3, 8192, "%s", "");
        
        ReportTableRow(__tableHandle, 0, __cArray2, __cAOp, 0xF1, __cArray3, __oneOfFlag, __bSetInCheckAlignment);
        
        if (2 >= 0 && 2 < 64)
        {
          __output.byte((word)2) = 0xF1;
        }
        else
        {
          testStepErrorInTestSystem(0, __cEmpty, "Index out of range. Unable to set byte %lld in message. Please check input parameter.", (int64)2);
          __testStepInitOk = 0;
        }
        ReportByteIndex("", 3, __cArray, elCount(__cArray));
        snprintf(__cArray2, 8192, "%s", __cArray);
        snprintf(__cArray3, 8192, "%s", "");
        
        ReportTableRow(__tableHandle, 0, __cArray2, __cAOp, 0x82, __cArray3, __oneOfFlag, __bSetInCheckAlignment);
        
        if (3 >= 0 && 3 < 64)
        {
          __output.byte((word)3) = 0x82;
        }
        else
        {
          testStepErrorInTestSystem(0, __cEmpty, "Index out of range. Unable to set byte %lld in message. Please check input parameter.", (int64)3);
          __testStepInitOk = 0;
        }
      
        ReportTableEndTestStep(__tableHandle, "Req1");
      }
      if (__testStepInitOk)
      {
        output(__output);
      }
    }
    if (__timeout <= 0)
    {
      testStepErrorInTestSystem(0, "1", "Unable to wait for %.3f %s. Please check input parameter.", __timeout / ((float)1000000), "ms");
    }
    else
    {
      __tt0cnt_9 = 0;
      snprintf(__cArray, elCount(__cArray), "CAN message '%s' ID = 417001888x (0x18DAF1A0x) on bus FDCAN2", "DIAGNOSTIC_RESPONSE_PAM");
      if(SetBusContextByName("FDCAN2", __eSaveCurrent, __nBusContextNew, __nBusContextOld))
        testJoinMessageEvent(`FDCAN2::`DIAGNOSTIC_RESPONSE_PAM,  __cArray,
             delegate dword(message * __m)
             {
               dword __msg_callback_ret;
               if (__tt0cnt_9 == -1)
               {
                 return 1;
               }
               __msg_callback_ret = 1;
               __tt0cnt_9++;
               if (__msg_callback_ret)
               {
                 __tt0cnt_9 = -1;
                 return 1;
               }
               return 0;
             });
      __res = testWaitForAllJoinedEventsNS(__timeout);
      if (__nInt64 != 0)
      {
        snprintf(__cArray, elCount(__cArray), "CAN message '%s' ID = 417001888x (0x18DAF1A0x) on bus FDCAN2", "DIAGNOSTIC_RESPONSE_PAM");
        if(__tt0cnt_9 == -1)
        {
          snprintf(__cArray2, 8192, "Response of %s", __cArray);
        }
        else
        {
          snprintf(__cArray2, 8192, "Response of %s (received %d times)", __cArray, __tt0cnt_9);
        }
        if (__tt0cnt_9 == 0)
        {
          testStepFail(0, "Resp1", __cArray2);
        }
        else
        {
          testStepPass(2, "Resp1", __cArray2);
        }
        __ReportRequestResponseResult(__res, 0);
      }
      ResetBusContext(__nBusContextNew, __nBusContextOld);
    }
  }
  TestCommandEnd();

}

void Ttvccmce9_F122_DID_with_Physical_Address()
{
  stack long __tableHandle;
  TestCommandBegin(__eDiagService, __cDiagService, "", "0");
  {
    if (DiagIsFunctionalGroup("CVADAS_0001_00000000_000"))
    {
      DiagResponse * __resp;
      DiagRequest CVADAS_0001_00000000_000._22F122_Software_EBOM_Part_Number __req;
      __diagServicevccmce9_11(__req, __resp);
    }
    else
    {
      DiagResponse CVADAS_0001_00000000_000.* __resp;
      DiagRequest CVADAS_0001_00000000_000._22F122_Software_EBOM_Part_Number __req;
      __diagServicevccmce9_11(__req, __resp);
    }
  }
  TestCommandEnd();


}

  
void __diagServicevccmce9_11(DiagRequest * __req, DiagResponse * __resp )
{
  stack long __tableHandle;
  long __res, __paramLen, __bytePos;

   __bVerdict = __eVerdictPass;

  do {
    TestReportResetDiagObjectList();
    DiagSetReportDetailLevel("CVADAS_0001_00000000_000", EnumServiceDetails_onfail);
    // Request aspect
    {

      if (0 >= DiagSendReqAndWaitForResp("CVADAS_0001_00000000_000", __req, __resp, __res, -1, -1, -1, -1, -1, EnumResult_pos, EnumServiceDetails_onfail, EnumSendingMode_physical, EnumSuppressPosResBit_asconfigured, EnumVerdictOnInvalidValues_fail))
        break;
    }

    __res = DiagErrCodeTestStep(__res, "Can't retrieve last response for request! No check possible.") < 0;
    if(__res)
    {
	  __bVerdict = __eVerdictFail;
      break;
    }
    {
      __res = DiagInterpretAs(__resp, "RDBI_PR");
      if(__res != 0)
      {
        __bVerdict = __eVerdictFail;
        DiagErrCodeTestStep(__res, "Can't interpret response as diagnostic primitive 'RDBI_PR'.");
        break;
      }
      else
      {
        TestStepPass( "Received primitive can be interpreted as diagnostic primitive 'RDBI_PR'.");
      }
    }
  }
  while(0);


  // Response, check & read aspect
  {
    __res = 1;
    __tableHandle = ReportTableHead5Columns(__cCheckCaption, __cTSym, __cTOp, __cRefVal, __cActual, __cRes);
    {
      __bDiagValueArrayCtr = DiagGetParameterErrorHandled(__resp, "_Software_Logical_Block_1_Part_Number_24", __bDiagValueArray, elcount(__bDiagValueArray), __cDiagValueArray, elcount(__cDiagValueArray));
      {
        __bSetInCheckAlignment = 1;	
        {
          __bArrayCtr = __CopyBytes(__bDiagValueArray, __bDiagValueArrayCtr, __bArray);
          {
            sysvar * __systemVariable;
            __systemVariable = sysvarData::`PartNumber::`Part_Number;
            CheckSysVarSetBufferConsistency(sysSetVariableData(sysvarData::`PartNumber::`Part_Number, __bArray, __bArrayCtr), __systemVariable.name);
          }
          snprintf(__cArray, 8192, "%s", "Part_Number");
          snprintf(__cArray2, 8192, "%s '%s'", __cSysVar, __cArray);
          snprintf(__cArray3, 8192, "%s", "_Software_Logical_Block_1_Part_Number_24");
          
          ReportTableRow(__tableHandle, 0, __cArray2, __cAOp, __bArray, __bArrayCtr, __cArray3, __oneOfFlag, __bSetInCheckAlignment);
        
        }
    
        __bSetInCheckAlignment = 0;
      }
    }
    {
      __bDiagValueArrayCtr = DiagGetParameterErrorHandled(__resp, "Software_Logical_Block_2_Part_Number", __bDiagValueArray, elcount(__bDiagValueArray), __cDiagValueArray, elcount(__cDiagValueArray));
      {
        __bSetInCheckAlignment = 1;	
        {
          __bArrayCtr = __CopyBytes(__bDiagValueArray, __bDiagValueArrayCtr, __bArray);
          {
            sysvar * __systemVariable;
            __systemVariable = sysvarData::`PartNumber::`Part_Number;
            CheckSysVarSetBufferConsistency(sysSetVariableData(sysvarData::`PartNumber::`Part_Number, __bArray, __bArrayCtr), __systemVariable.name);
          }
          snprintf(__cArray, 8192, "%s", "Part_Number");
          snprintf(__cArray2, 8192, "%s '%s'", __cSysVar, __cArray);
          snprintf(__cArray3, 8192, "%s", "Software_Logical_Block_2_Part_Number");
          
          ReportTableRow(__tableHandle, 0, __cArray2, __cAOp, __bArray, __bArrayCtr, __cArray3, __oneOfFlag, __bSetInCheckAlignment);
        
        }
    
        __bSetInCheckAlignment = 0;
      }
    }
    {
      __bDiagValueArrayCtr = DiagGetParameterErrorHandled(__resp, "Software_Logical_Block_3_Part_Number", __bDiagValueArray, elcount(__bDiagValueArray), __cDiagValueArray, elcount(__cDiagValueArray));
      {
        __bSetInCheckAlignment = 1;	
        {
          __bArrayCtr = __CopyBytes(__bDiagValueArray, __bDiagValueArrayCtr, __bArray);
          {
            sysvar * __systemVariable;
            __systemVariable = sysvarData::`PartNumber::`Part_Number;
            CheckSysVarSetBufferConsistency(sysSetVariableData(sysvarData::`PartNumber::`Part_Number, __bArray, __bArrayCtr), __systemVariable.name);
          }
          snprintf(__cArray, 8192, "%s", "Part_Number");
          snprintf(__cArray2, 8192, "%s '%s'", __cSysVar, __cArray);
          snprintf(__cArray3, 8192, "%s", "Software_Logical_Block_3_Part_Number");
          
          ReportTableRow(__tableHandle, 0, __cArray2, __cAOp, __bArray, __bArrayCtr, __cArray3, __oneOfFlag, __bSetInCheckAlignment);
        
        }
    
        __bSetInCheckAlignment = 0;
      }
    }
    {
      __bDiagValueArrayCtr = DiagGetParameterErrorHandled(__resp, "Software_Logical_Block_4_Part_Number", __bDiagValueArray, elcount(__bDiagValueArray), __cDiagValueArray, elcount(__cDiagValueArray));
      {
        __bSetInCheckAlignment = 1;	
        {
          __bArrayCtr = __CopyBytes(__bDiagValueArray, __bDiagValueArrayCtr, __bArray);
          {
            sysvar * __systemVariable;
            __systemVariable = sysvarData::`PartNumber::`Part_Number;
            CheckSysVarSetBufferConsistency(sysSetVariableData(sysvarData::`PartNumber::`Part_Number, __bArray, __bArrayCtr), __systemVariable.name);
          }
          snprintf(__cArray, 8192, "%s", "Part_Number");
          snprintf(__cArray2, 8192, "%s '%s'", __cSysVar, __cArray);
          snprintf(__cArray3, 8192, "%s", "Software_Logical_Block_4_Part_Number");
          
          ReportTableRow(__tableHandle, 0, __cArray2, __cAOp, __bArray, __bArrayCtr, __cArray3, __oneOfFlag, __bSetInCheckAlignment);
        
        }
    
        __bSetInCheckAlignment = 0;
      }
    }
    {
      __bDiagValueArrayCtr = DiagGetParameterErrorHandled(__resp, "Software_Logical_Block_5_Part_Number", __bDiagValueArray, elcount(__bDiagValueArray), __cDiagValueArray, elcount(__cDiagValueArray));
      {
        __bSetInCheckAlignment = 1;	
        {
          __bArrayCtr = __CopyBytes(__bDiagValueArray, __bDiagValueArrayCtr, __bArray);
          {
            sysvar * __systemVariable;
            __systemVariable = sysvarData::`PartNumber::`Part_Number;
            CheckSysVarSetBufferConsistency(sysSetVariableData(sysvarData::`PartNumber::`Part_Number, __bArray, __bArrayCtr), __systemVariable.name);
          }
          snprintf(__cArray, 8192, "%s", "Part_Number");
          snprintf(__cArray2, 8192, "%s '%s'", __cSysVar, __cArray);
          snprintf(__cArray3, 8192, "%s", "Software_Logical_Block_5_Part_Number");
          
          ReportTableRow(__tableHandle, 0, __cArray2, __cAOp, __bArray, __bArrayCtr, __cArray3, __oneOfFlag, __bSetInCheckAlignment);
        
        }
    
        __bSetInCheckAlignment = 0;
      }
    }
    {
      __bDiagValueArrayCtr = DiagGetParameterErrorHandled(__resp, "Software_Logical_Block_6_Part_Number", __bDiagValueArray, elcount(__bDiagValueArray), __cDiagValueArray, elcount(__cDiagValueArray));
      {
        __bSetInCheckAlignment = 1;	
        {
          __bArrayCtr = __CopyBytes(__bDiagValueArray, __bDiagValueArrayCtr, __bArray);
          {
            sysvar * __systemVariable;
            __systemVariable = sysvarData::`PartNumber::`Part_Number;
            CheckSysVarSetBufferConsistency(sysSetVariableData(sysvarData::`PartNumber::`Part_Number, __bArray, __bArrayCtr), __systemVariable.name);
          }
          snprintf(__cArray, 8192, "%s", "Part_Number");
          snprintf(__cArray2, 8192, "%s '%s'", __cSysVar, __cArray);
          snprintf(__cArray3, 8192, "%s", "Software_Logical_Block_6_Part_Number");
          
          ReportTableRow(__tableHandle, 0, __cArray2, __cAOp, __bArray, __bArrayCtr, __cArray3, __oneOfFlag, __bSetInCheckAlignment);
        
        }
    
        __bSetInCheckAlignment = 0;
      }
    }
    {
      __bDiagValueArrayCtr = DiagGetParameterErrorHandled(__resp, "Software_Logical_Block_7_Part_Number", __bDiagValueArray, elcount(__bDiagValueArray), __cDiagValueArray, elcount(__cDiagValueArray));
      {
        __bSetInCheckAlignment = 1;	
        {
          __bArrayCtr = __CopyBytes(__bDiagValueArray, __bDiagValueArrayCtr, __bArray);
          {
            sysvar * __systemVariable;
            __systemVariable = sysvarData::`PartNumber::`Part_Number;
            CheckSysVarSetBufferConsistency(sysSetVariableData(sysvarData::`PartNumber::`Part_Number, __bArray, __bArrayCtr), __systemVariable.name);
          }
          snprintf(__cArray, 8192, "%s", "Part_Number");
          snprintf(__cArray2, 8192, "%s '%s'", __cSysVar, __cArray);
          snprintf(__cArray3, 8192, "%s", "Software_Logical_Block_7_Part_Number");
          
          ReportTableRow(__tableHandle, 0, __cArray2, __cAOp, __bArray, __bArrayCtr, __cArray3, __oneOfFlag, __bSetInCheckAlignment);
        
        }
    
        __bSetInCheckAlignment = 0;
      }
    }
    {
      __bDiagValueArrayCtr = DiagGetParameterErrorHandled(__resp, "Software_Logical_Block_8_Part_Number", __bDiagValueArray, elcount(__bDiagValueArray), __cDiagValueArray, elcount(__cDiagValueArray));
      {
        __bSetInCheckAlignment = 1;	
        {
          __bArrayCtr = __CopyBytes(__bDiagValueArray, __bDiagValueArrayCtr, __bArray);
          {
            sysvar * __systemVariable;
            __systemVariable = sysvarData::`PartNumber::`Part_Number;
            CheckSysVarSetBufferConsistency(sysSetVariableData(sysvarData::`PartNumber::`Part_Number, __bArray, __bArrayCtr), __systemVariable.name);
          }
          snprintf(__cArray, 8192, "%s", "Part_Number");
          snprintf(__cArray2, 8192, "%s '%s'", __cSysVar, __cArray);
          snprintf(__cArray3, 8192, "%s", "Software_Logical_Block_8_Part_Number");
          
          ReportTableRow(__tableHandle, 0, __cArray2, __cAOp, __bArray, __bArrayCtr, __cArray3, __oneOfFlag, __bSetInCheckAlignment);
        
        }
    
        __bSetInCheckAlignment = 0;
      }
    }
    ReportTableEndVerdict(__tableHandle, __cEvaluateResponse, __res);
	__bVerdict = __bVerdict && __res;
  }
  if (__bVerdict == __eVerdictFail)
    TestReportWriteDiagObjectList();
}

void Ttvccmce9_F122_DID_with_Functional_Address()
{
  stack long __tableHandle;
  TestCommandBegin(__eDiagService, __cDiagService, "", "0");
  {
    if (DiagIsFunctionalGroup("CVADAS_0001_00000000_000"))
    {
      DiagResponse * __resp;
      DiagRequest CVADAS_0001_00000000_000._22F122_Software_EBOM_Part_Number __req;
      __diagServicevccmce9_12(__req, __resp);
    }
    else
    {
      DiagResponse CVADAS_0001_00000000_000.* __resp;
      DiagRequest CVADAS_0001_00000000_000._22F122_Software_EBOM_Part_Number __req;
      __diagServicevccmce9_12(__req, __resp);
    }
  }
  TestCommandEnd();


}

  
void __diagServicevccmce9_12(DiagRequest * __req, DiagResponse * __resp )
{
  stack long __tableHandle;
  long __res, __paramLen, __bytePos;

   __bVerdict = __eVerdictPass;

  do {
    TestReportResetDiagObjectList();
    DiagSetReportDetailLevel("CVADAS_0001_00000000_000", EnumServiceDetails_onfail);
    // Request aspect
    {

      if (0 >= DiagSendReqAndWaitForResp("CVADAS_0001_00000000_000", __req, __resp, __res, -1, -1, -1, -1, -1, EnumResult_pos, EnumServiceDetails_onfail, EnumSendingMode_physical, EnumSuppressPosResBit_asconfigured, EnumVerdictOnInvalidValues_fail))
        break;
    }

    __res = DiagErrCodeTestStep(__res, "Can't retrieve last response for request! No check possible.") < 0;
    if(__res)
    {
	  __bVerdict = __eVerdictFail;
      break;
    }
    {
      __res = DiagInterpretAs(__resp, "RDBI_PR");
      if(__res != 0)
      {
        __bVerdict = __eVerdictFail;
        DiagErrCodeTestStep(__res, "Can't interpret response as diagnostic primitive 'RDBI_PR'.");
        break;
      }
      else
      {
        TestStepPass( "Received primitive can be interpreted as diagnostic primitive 'RDBI_PR'.");
      }
    }
  }
  while(0);


  // Response, check & read aspect
  {
    __res = 1;
    __tableHandle = ReportTableHead5Columns(__cCheckCaption, __cTSym, __cTOp, __cRefVal, __cActual, __cRes);
    {
      __bDiagValueArrayCtr = DiagGetParameterErrorHandled(__resp, "_Software_Logical_Block_1_Part_Number_24", __bDiagValueArray, elcount(__bDiagValueArray), __cDiagValueArray, elcount(__cDiagValueArray));
      {
        __bSetInCheckAlignment = 1;	
        {
          __bArrayCtr = __CopyBytes(__bDiagValueArray, __bDiagValueArrayCtr, __bArray);
          {
            sysvar * __systemVariable;
            __systemVariable = sysvarData::`PartNumber::`Part_Number;
            CheckSysVarSetBufferConsistency(sysSetVariableData(sysvarData::`PartNumber::`Part_Number, __bArray, __bArrayCtr), __systemVariable.name);
          }
          snprintf(__cArray, 8192, "%s", "Part_Number");
          snprintf(__cArray2, 8192, "%s '%s'", __cSysVar, __cArray);
          snprintf(__cArray3, 8192, "%s", "_Software_Logical_Block_1_Part_Number_24");
          
          ReportTableRow(__tableHandle, 0, __cArray2, __cAOp, __bArray, __bArrayCtr, __cArray3, __oneOfFlag, __bSetInCheckAlignment);
        
        }
    
        __bSetInCheckAlignment = 0;
      }
    }
    {
      __bDiagValueArrayCtr = DiagGetParameterErrorHandled(__resp, "Software_Logical_Block_2_Part_Number", __bDiagValueArray, elcount(__bDiagValueArray), __cDiagValueArray, elcount(__cDiagValueArray));
      {
        __bSetInCheckAlignment = 1;	
        {
          __bArrayCtr = __CopyBytes(__bDiagValueArray, __bDiagValueArrayCtr, __bArray);
          {
            sysvar * __systemVariable;
            __systemVariable = sysvarData::`PartNumber::`Part_Number;
            CheckSysVarSetBufferConsistency(sysSetVariableData(sysvarData::`PartNumber::`Part_Number, __bArray, __bArrayCtr), __systemVariable.name);
          }
          snprintf(__cArray, 8192, "%s", "Part_Number");
          snprintf(__cArray2, 8192, "%s '%s'", __cSysVar, __cArray);
          snprintf(__cArray3, 8192, "%s", "Software_Logical_Block_2_Part_Number");
          
          ReportTableRow(__tableHandle, 0, __cArray2, __cAOp, __bArray, __bArrayCtr, __cArray3, __oneOfFlag, __bSetInCheckAlignment);
        
        }
    
        __bSetInCheckAlignment = 0;
      }
    }
    {
      __bDiagValueArrayCtr = DiagGetParameterErrorHandled(__resp, "Software_Logical_Block_3_Part_Number", __bDiagValueArray, elcount(__bDiagValueArray), __cDiagValueArray, elcount(__cDiagValueArray));
      {
        __bSetInCheckAlignment = 1;	
        {
          __bArrayCtr = __CopyBytes(__bDiagValueArray, __bDiagValueArrayCtr, __bArray);
          {
            sysvar * __systemVariable;
            __systemVariable = sysvarData::`PartNumber::`Part_Number;
            CheckSysVarSetBufferConsistency(sysSetVariableData(sysvarData::`PartNumber::`Part_Number, __bArray, __bArrayCtr), __systemVariable.name);
          }
          snprintf(__cArray, 8192, "%s", "Part_Number");
          snprintf(__cArray2, 8192, "%s '%s'", __cSysVar, __cArray);
          snprintf(__cArray3, 8192, "%s", "Software_Logical_Block_3_Part_Number");
          
          ReportTableRow(__tableHandle, 0, __cArray2, __cAOp, __bArray, __bArrayCtr, __cArray3, __oneOfFlag, __bSetInCheckAlignment);
        
        }
    
        __bSetInCheckAlignment = 0;
      }
    }
    {
      __bDiagValueArrayCtr = DiagGetParameterErrorHandled(__resp, "Software_Logical_Block_4_Part_Number", __bDiagValueArray, elcount(__bDiagValueArray), __cDiagValueArray, elcount(__cDiagValueArray));
      {
        __bSetInCheckAlignment = 1;	
        {
          __bArrayCtr = __CopyBytes(__bDiagValueArray, __bDiagValueArrayCtr, __bArray);
          {
            sysvar * __systemVariable;
            __systemVariable = sysvarData::`PartNumber::`Part_Number;
            CheckSysVarSetBufferConsistency(sysSetVariableData(sysvarData::`PartNumber::`Part_Number, __bArray, __bArrayCtr), __systemVariable.name);
          }
          snprintf(__cArray, 8192, "%s", "Part_Number");
          snprintf(__cArray2, 8192, "%s '%s'", __cSysVar, __cArray);
          snprintf(__cArray3, 8192, "%s", "Software_Logical_Block_4_Part_Number");
          
          ReportTableRow(__tableHandle, 0, __cArray2, __cAOp, __bArray, __bArrayCtr, __cArray3, __oneOfFlag, __bSetInCheckAlignment);
        
        }
    
        __bSetInCheckAlignment = 0;
      }
    }
    {
      __bDiagValueArrayCtr = DiagGetParameterErrorHandled(__resp, "Software_Logical_Block_5_Part_Number", __bDiagValueArray, elcount(__bDiagValueArray), __cDiagValueArray, elcount(__cDiagValueArray));
      {
        __bSetInCheckAlignment = 1;	
        {
          __bArrayCtr = __CopyBytes(__bDiagValueArray, __bDiagValueArrayCtr, __bArray);
          {
            sysvar * __systemVariable;
            __systemVariable = sysvarData::`PartNumber::`Part_Number;
            CheckSysVarSetBufferConsistency(sysSetVariableData(sysvarData::`PartNumber::`Part_Number, __bArray, __bArrayCtr), __systemVariable.name);
          }
          snprintf(__cArray, 8192, "%s", "Part_Number");
          snprintf(__cArray2, 8192, "%s '%s'", __cSysVar, __cArray);
          snprintf(__cArray3, 8192, "%s", "Software_Logical_Block_5_Part_Number");
          
          ReportTableRow(__tableHandle, 0, __cArray2, __cAOp, __bArray, __bArrayCtr, __cArray3, __oneOfFlag, __bSetInCheckAlignment);
        
        }
    
        __bSetInCheckAlignment = 0;
      }
    }
    {
      __bDiagValueArrayCtr = DiagGetParameterErrorHandled(__resp, "Software_Logical_Block_6_Part_Number", __bDiagValueArray, elcount(__bDiagValueArray), __cDiagValueArray, elcount(__cDiagValueArray));
      {
        __bSetInCheckAlignment = 1;	
        {
          __bArrayCtr = __CopyBytes(__bDiagValueArray, __bDiagValueArrayCtr, __bArray);
          {
            sysvar * __systemVariable;
            __systemVariable = sysvarData::`PartNumber::`Part_Number;
            CheckSysVarSetBufferConsistency(sysSetVariableData(sysvarData::`PartNumber::`Part_Number, __bArray, __bArrayCtr), __systemVariable.name);
          }
          snprintf(__cArray, 8192, "%s", "Part_Number");
          snprintf(__cArray2, 8192, "%s '%s'", __cSysVar, __cArray);
          snprintf(__cArray3, 8192, "%s", "Software_Logical_Block_6_Part_Number");
          
          ReportTableRow(__tableHandle, 0, __cArray2, __cAOp, __bArray, __bArrayCtr, __cArray3, __oneOfFlag, __bSetInCheckAlignment);
        
        }
    
        __bSetInCheckAlignment = 0;
      }
    }
    {
      __bDiagValueArrayCtr = DiagGetParameterErrorHandled(__resp, "Software_Logical_Block_7_Part_Number", __bDiagValueArray, elcount(__bDiagValueArray), __cDiagValueArray, elcount(__cDiagValueArray));
      {
        __bSetInCheckAlignment = 1;	
        {
          __bArrayCtr = __CopyBytes(__bDiagValueArray, __bDiagValueArrayCtr, __bArray);
          {
            sysvar * __systemVariable;
            __systemVariable = sysvarData::`PartNumber::`Part_Number;
            CheckSysVarSetBufferConsistency(sysSetVariableData(sysvarData::`PartNumber::`Part_Number, __bArray, __bArrayCtr), __systemVariable.name);
          }
          snprintf(__cArray, 8192, "%s", "Part_Number");
          snprintf(__cArray2, 8192, "%s '%s'", __cSysVar, __cArray);
          snprintf(__cArray3, 8192, "%s", "Software_Logical_Block_7_Part_Number");
          
          ReportTableRow(__tableHandle, 0, __cArray2, __cAOp, __bArray, __bArrayCtr, __cArray3, __oneOfFlag, __bSetInCheckAlignment);
        
        }
    
        __bSetInCheckAlignment = 0;
      }
    }
    {
      __bDiagValueArrayCtr = DiagGetParameterErrorHandled(__resp, "Software_Logical_Block_8_Part_Number", __bDiagValueArray, elcount(__bDiagValueArray), __cDiagValueArray, elcount(__cDiagValueArray));
      {
        __bSetInCheckAlignment = 1;	
        {
          __bArrayCtr = __CopyBytes(__bDiagValueArray, __bDiagValueArrayCtr, __bArray);
          {
            sysvar * __systemVariable;
            __systemVariable = sysvarData::`PartNumber::`Part_Number;
            CheckSysVarSetBufferConsistency(sysSetVariableData(sysvarData::`PartNumber::`Part_Number, __bArray, __bArrayCtr), __systemVariable.name);
          }
          snprintf(__cArray, 8192, "%s", "Part_Number");
          snprintf(__cArray2, 8192, "%s '%s'", __cSysVar, __cArray);
          snprintf(__cArray3, 8192, "%s", "Software_Logical_Block_8_Part_Number");
          
          ReportTableRow(__tableHandle, 0, __cArray2, __cAOp, __bArray, __bArrayCtr, __cArray3, __oneOfFlag, __bSetInCheckAlignment);
        
        }
    
        __bSetInCheckAlignment = 0;
      }
    }
    ReportTableEndVerdict(__tableHandle, __cEvaluateResponse, __res);
	__bVerdict = __bVerdict && __res;
  }
  if (__bVerdict == __eVerdictFail)
    TestReportWriteDiagObjectList();
}

void Ttvccmce9_F122_DID_with_Standard_Physical_Address()
{
  stack long __tableHandle;
  TestCommandBegin(__eRequestResponse, __cRequestResponse, "", "0");
  {
  
    long __res;
    int64 __timeout;
    __res = 0;
    __nInt64 = 1;
    __timeout = syspar::`P2_Server * 1000000LL;
    {
    
      long __testStepInitOk;
      message `FDCAN2::`DIAGNOSTIC_REQUEST_PAM __output;
      message `FDCAN2::`DIAGNOSTIC_REQUEST_PAM __msgOrig;
      __output = __msgOrig;
      __testStepInitOk = 1;
      {
        int64 __dlc;
        __dlc = 4;
        if (__dlc >= 0 && __dlc <= (__output.EDL ? 15 : 8))
          __output.DLC = __dlc;
        else
        {
          testStepErrorInTestSystem(0, __cEmpty, "Unable to set DLC=%lld in message. Please check input parameter.", __dlc);
          __testStepInitOk = 0;
        }
      }
      if (__testStepInitOk)
      {
        snprintf(__cArray, elCount(__cArray), "CAN message '%s' ID = 416981233x (0x18DAA0F1x) on bus FDCAN2", "DIAGNOSTIC_REQUEST_PAM");
        snprintf(__cArray2, elCount(__cArray2), "Send %s", __cArray);
        __tableHandle = ReportTableHead3Columns(__cArray2, "Byte", __cTOp, __cAssigned);
        ReportByteIndex("", 0, __cArray, elCount(__cArray));
        snprintf(__cArray2, 8192, "%s", __cArray);
        snprintf(__cArray3, 8192, "%s", "");
        
        ReportTableRow(__tableHandle, 0, __cArray2, __cAOp, 0x3, __cArray3, __oneOfFlag, __bSetInCheckAlignment);
        
        if (0 >= 0 && 0 < 64)
        {
          __output.byte((word)0) = 0x3;
        }
        else
        {
          testStepErrorInTestSystem(0, __cEmpty, "Index out of range. Unable to set byte %lld in message. Please check input parameter.", (int64)0);
          __testStepInitOk = 0;
        }
        ReportByteIndex("", 1, __cArray, elCount(__cArray));
        snprintf(__cArray2, 8192, "%s", __cArray);
        snprintf(__cArray3, 8192, "%s", "");
        
        ReportTableRow(__tableHandle, 0, __cArray2, __cAOp, 0x22, __cArray3, __oneOfFlag, __bSetInCheckAlignment);
        
        if (1 >= 0 && 1 < 64)
        {
          __output.byte((word)1) = 0x22;
        }
        else
        {
          testStepErrorInTestSystem(0, __cEmpty, "Index out of range. Unable to set byte %lld in message. Please check input parameter.", (int64)1);
          __testStepInitOk = 0;
        }
        ReportByteIndex("", 2, __cArray, elCount(__cArray));
        snprintf(__cArray2, 8192, "%s", __cArray);
        snprintf(__cArray3, 8192, "%s", "");
        
        ReportTableRow(__tableHandle, 0, __cArray2, __cAOp, 0xF1, __cArray3, __oneOfFlag, __bSetInCheckAlignment);
        
        if (2 >= 0 && 2 < 64)
        {
          __output.byte((word)2) = 0xF1;
        }
        else
        {
          testStepErrorInTestSystem(0, __cEmpty, "Index out of range. Unable to set byte %lld in message. Please check input parameter.", (int64)2);
          __testStepInitOk = 0;
        }
        ReportByteIndex("", 3, __cArray, elCount(__cArray));
        snprintf(__cArray2, 8192, "%s", __cArray);
        snprintf(__cArray3, 8192, "%s", "");
        
        ReportTableRow(__tableHandle, 0, __cArray2, __cAOp, 0x22, __cArray3, __oneOfFlag, __bSetInCheckAlignment);
        
        if (3 >= 0 && 3 < 64)
        {
          __output.byte((word)3) = 0x22;
        }
        else
        {
          testStepErrorInTestSystem(0, __cEmpty, "Index out of range. Unable to set byte %lld in message. Please check input parameter.", (int64)3);
          __testStepInitOk = 0;
        }
      
        ReportTableEndTestStep(__tableHandle, "Req1");
      }
      if (__testStepInitOk)
      {
        output(__output);
      }
    }
    if (__timeout <= 0)
    {
      testStepErrorInTestSystem(0, "1", "Unable to wait for %.3f %s. Please check input parameter.", __timeout / ((float)1000000), "ms");
    }
    else
    {
      __tt0cnt_11 = 0;
      snprintf(__cArray, elCount(__cArray), "CAN message '%s' ID = 417001888x (0x18DAF1A0x) on bus FDCAN2", "DIAGNOSTIC_RESPONSE_PAM");
      if(SetBusContextByName("FDCAN2", __eSaveCurrent, __nBusContextNew, __nBusContextOld))
        testJoinMessageEvent(`FDCAN2::`DIAGNOSTIC_RESPONSE_PAM,  __cArray,
             delegate dword(message * __m)
             {
               dword __msg_callback_ret;
               if (__tt0cnt_11 == -1)
               {
                 return 1;
               }
               __msg_callback_ret = 1;
               __tt0cnt_11++;
               if (__msg_callback_ret)
               {
                 __tt0cnt_11 = -1;
                 return 1;
               }
               return 0;
             });
      __res = testWaitForAllJoinedEventsNS(__timeout);
      if (__nInt64 != 0)
      {
        snprintf(__cArray, elCount(__cArray), "CAN message '%s' ID = 417001888x (0x18DAF1A0x) on bus FDCAN2", "DIAGNOSTIC_RESPONSE_PAM");
        if(__tt0cnt_11 == -1)
        {
          snprintf(__cArray2, 8192, "Response of %s", __cArray);
        }
        else
        {
          snprintf(__cArray2, 8192, "Response of %s (received %d times)", __cArray, __tt0cnt_11);
        }
        if (__tt0cnt_11 == 0)
        {
          testStepFail(0, "Resp1", __cArray2);
        }
        else
        {
          testStepPass(2, "Resp1", __cArray2);
        }
        __ReportRequestResponseResult(__res, 0);
      }
      ResetBusContext(__nBusContextNew, __nBusContextOld);
    }
  }
  TestCommandEnd();

}

void Ttvccmce9_F180_DID_with_Physical_Address()
{
  stack long __tableHandle;
  TestCommandBegin(__eDiagService, __cDiagService, "", "0");
  {
    if (DiagIsFunctionalGroup("CVADAS_0001_00000000_000"))
    {
      DiagResponse * __resp;
      DiagRequest CVADAS_0001_00000000_000._22F180_Boot_Software_Version_Information __req;
      __diagServicevccmce9_13(__req, __resp);
    }
    else
    {
      DiagResponse CVADAS_0001_00000000_000.* __resp;
      DiagRequest CVADAS_0001_00000000_000._22F180_Boot_Software_Version_Information __req;
      __diagServicevccmce9_13(__req, __resp);
    }
  }
  TestCommandEnd();


}

  
void __diagServicevccmce9_13(DiagRequest * __req, DiagResponse * __resp )
{
  stack long __tableHandle;
  long __res, __paramLen, __bytePos;

   __bVerdict = __eVerdictPass;

  do {
    TestReportResetDiagObjectList();
    DiagSetReportDetailLevel("CVADAS_0001_00000000_000", EnumServiceDetails_onfail);
    // Request aspect
    {

      if (0 >= DiagSendReqAndWaitForResp("CVADAS_0001_00000000_000", __req, __resp, __res, -1, -1, -1, -1, -1, EnumResult_pos, EnumServiceDetails_onfail, EnumSendingMode_physical, EnumSuppressPosResBit_asconfigured, EnumVerdictOnInvalidValues_fail))
        break;
    }

    __res = DiagErrCodeTestStep(__res, "Can't retrieve last response for request! No check possible.") < 0;
    if(__res)
    {
	  __bVerdict = __eVerdictFail;
      break;
    }
    {
      __res = DiagInterpretAs(__resp, "RDBI_PR");
      if(__res != 0)
      {
        __bVerdict = __eVerdictFail;
        DiagErrCodeTestStep(__res, "Can't interpret response as diagnostic primitive 'RDBI_PR'.");
        break;
      }
      else
      {
        TestStepPass( "Received primitive can be interpreted as diagnostic primitive 'RDBI_PR'.");
      }
    }
  }
  while(0);


  // Response, check & read aspect
  {
    __res = 1;
    __tableHandle = ReportTableHead5Columns(__cCheckCaption, __cTSym, __cTOp, __cRefVal, __cActual, __cRes);
    {
      __bDiagValueArrayCtr = DiagGetParameterErrorHandled(__resp, "_SW_Year_32", __bDiagValueArray, elcount(__bDiagValueArray), __cDiagValueArray, elcount(__cDiagValueArray));
      {
        __bSetInCheckAlignment = 1;	
        {
          __bArrayCtr = __CopyBytes(__bDiagValueArray, __bDiagValueArrayCtr, __bArray);
          {
            sysvar * __systemVariable;
            __systemVariable = sysvarData::`PartNumber::`Part_Number;
            CheckSysVarSetBufferConsistency(sysSetVariableData(sysvarData::`PartNumber::`Part_Number, __bArray, __bArrayCtr), __systemVariable.name);
          }
          snprintf(__cArray, 8192, "%s", "Part_Number");
          snprintf(__cArray2, 8192, "%s '%s'", __cSysVar, __cArray);
          snprintf(__cArray3, 8192, "%s", "_SW_Year_32");
          
          ReportTableRow(__tableHandle, 0, __cArray2, __cAOp, __bArray, __bArrayCtr, __cArray3, __oneOfFlag, __bSetInCheckAlignment);
        
        }
    
        __bSetInCheckAlignment = 0;
      }
    }
    {
      __bDiagValueArrayCtr = DiagGetParameterErrorHandled(__resp, "_SW__Identification_56", __bDiagValueArray, elcount(__bDiagValueArray), __cDiagValueArray, elcount(__cDiagValueArray));
      {
        __bSetInCheckAlignment = 1;	
        {
          __bArrayCtr = __CopyBytes(__bDiagValueArray, __bDiagValueArrayCtr, __bArray);
          {
            sysvar * __systemVariable;
            __systemVariable = sysvarData::`PartNumber::`Part_Number;
            CheckSysVarSetBufferConsistency(sysSetVariableData(sysvarData::`PartNumber::`Part_Number, __bArray, __bArrayCtr), __systemVariable.name);
          }
          snprintf(__cArray, 8192, "%s", "Part_Number");
          snprintf(__cArray2, 8192, "%s '%s'", __cSysVar, __cArray);
          snprintf(__cArray3, 8192, "%s", "_SW__Identification_56");
          
          ReportTableRow(__tableHandle, 0, __cArray2, __cAOp, __bArray, __bArrayCtr, __cArray3, __oneOfFlag, __bSetInCheckAlignment);
        
        }
    
        __bSetInCheckAlignment = 0;
      }
    }
    {
      __bDiagValueArrayCtr = DiagGetParameterErrorHandled(__resp, "_SW__Patch_Level_48", __bDiagValueArray, elcount(__bDiagValueArray), __cDiagValueArray, elcount(__cDiagValueArray));
      {
        __bSetInCheckAlignment = 1;	
        {
          __bArrayCtr = __CopyBytes(__bDiagValueArray, __bDiagValueArrayCtr, __bArray);
          {
            sysvar * __systemVariable;
            __systemVariable = sysvarData::`PartNumber::`Part_Number;
            CheckSysVarSetBufferConsistency(sysSetVariableData(sysvarData::`PartNumber::`Part_Number, __bArray, __bArrayCtr), __systemVariable.name);
          }
          snprintf(__cArray, 8192, "%s", "Part_Number");
          snprintf(__cArray2, 8192, "%s '%s'", __cSysVar, __cArray);
          snprintf(__cArray3, 8192, "%s", "_SW__Patch_Level_48");
          
          ReportTableRow(__tableHandle, 0, __cArray2, __cAOp, __bArray, __bArrayCtr, __cArray3, __oneOfFlag, __bSetInCheckAlignment);
        
        }
    
        __bSetInCheckAlignment = 0;
      }
    }
    {
      __bDiagValueArrayCtr = DiagGetParameterErrorHandled(__resp, "_SW__Week_40", __bDiagValueArray, elcount(__bDiagValueArray), __cDiagValueArray, elcount(__cDiagValueArray));
      {
        __bSetInCheckAlignment = 1;	
        {
          __bArrayCtr = __CopyBytes(__bDiagValueArray, __bDiagValueArrayCtr, __bArray);
          {
            sysvar * __systemVariable;
            __systemVariable = sysvarData::`PartNumber::`Part_Number;
            CheckSysVarSetBufferConsistency(sysSetVariableData(sysvarData::`PartNumber::`Part_Number, __bArray, __bArrayCtr), __systemVariable.name);
          }
          snprintf(__cArray, 8192, "%s", "Part_Number");
          snprintf(__cArray2, 8192, "%s '%s'", __cSysVar, __cArray);
          snprintf(__cArray3, 8192, "%s", "_SW__Week_40");
          
          ReportTableRow(__tableHandle, 0, __cArray2, __cAOp, __bArray, __bArrayCtr, __cArray3, __oneOfFlag, __bSetInCheckAlignment);
        
        }
    
        __bSetInCheckAlignment = 0;
      }
    }
    {
      __bDiagValueArrayCtr = DiagGetParameterErrorHandled(__resp, "_Number_of_Boot_Software_Logical_Blocks_24", __bDiagValueArray, elcount(__bDiagValueArray), __cDiagValueArray, elcount(__cDiagValueArray));
      {
        __bSetInCheckAlignment = 1;	
        {
          __bArrayCtr = __CopyBytes(__bDiagValueArray, __bDiagValueArrayCtr, __bArray);
          {
            sysvar * __systemVariable;
            __systemVariable = sysvarData::`PartNumber::`Part_Number;
            CheckSysVarSetBufferConsistency(sysSetVariableData(sysvarData::`PartNumber::`Part_Number, __bArray, __bArrayCtr), __systemVariable.name);
          }
          snprintf(__cArray, 8192, "%s", "Part_Number");
          snprintf(__cArray2, 8192, "%s '%s'", __cSysVar, __cArray);
          snprintf(__cArray3, 8192, "%s", "_Number_of_Boot_Software_Logical_Blocks_24");
          
          ReportTableRow(__tableHandle, 0, __cArray2, __cAOp, __bArray, __bArrayCtr, __cArray3, __oneOfFlag, __bSetInCheckAlignment);
        
        }
    
        __bSetInCheckAlignment = 0;
      }
    }
    ReportTableEndVerdict(__tableHandle, __cEvaluateResponse, __res);
	__bVerdict = __bVerdict && __res;
  }
  if (__bVerdict == __eVerdictFail)
    TestReportWriteDiagObjectList();
}

void Ttvccmce9_F180_DID_with_Functional_Address()
{
  stack long __tableHandle;
  TestCommandBegin(__eDiagService, __cDiagService, "", "0");
  {
    if (DiagIsFunctionalGroup("CVADAS_0001_00000000_000"))
    {
      DiagResponse * __resp;
      DiagRequest CVADAS_0001_00000000_000._22F180_Boot_Software_Version_Information __req;
      __diagServicevccmce9_14(__req, __resp);
    }
    else
    {
      DiagResponse CVADAS_0001_00000000_000.* __resp;
      DiagRequest CVADAS_0001_00000000_000._22F180_Boot_Software_Version_Information __req;
      __diagServicevccmce9_14(__req, __resp);
    }
  }
  TestCommandEnd();


}

  
void __diagServicevccmce9_14(DiagRequest * __req, DiagResponse * __resp )
{
  stack long __tableHandle;
  long __res, __paramLen, __bytePos;

   __bVerdict = __eVerdictPass;

  do {
    TestReportResetDiagObjectList();
    DiagSetReportDetailLevel("CVADAS_0001_00000000_000", EnumServiceDetails_onfail);
    // Request aspect
    {

      if (0 >= DiagSendReqAndWaitForResp("CVADAS_0001_00000000_000", __req, __resp, __res, -1, -1, -1, -1, -1, EnumResult_pos, EnumServiceDetails_onfail, EnumSendingMode_physical, EnumSuppressPosResBit_asconfigured, EnumVerdictOnInvalidValues_fail))
        break;
    }

    __res = DiagErrCodeTestStep(__res, "Can't retrieve last response for request! No check possible.") < 0;
    if(__res)
    {
	  __bVerdict = __eVerdictFail;
      break;
    }
    {
      __res = DiagInterpretAs(__resp, "RDBI_PR");
      if(__res != 0)
      {
        __bVerdict = __eVerdictFail;
        DiagErrCodeTestStep(__res, "Can't interpret response as diagnostic primitive 'RDBI_PR'.");
        break;
      }
      else
      {
        TestStepPass( "Received primitive can be interpreted as diagnostic primitive 'RDBI_PR'.");
      }
    }
  }
  while(0);


  // Response, check & read aspect
  {
    __res = 1;
    __tableHandle = ReportTableHead5Columns(__cCheckCaption, __cTSym, __cTOp, __cRefVal, __cActual, __cRes);
    {
      __bDiagValueArrayCtr = DiagGetParameterErrorHandled(__resp, "_SW_Year_32", __bDiagValueArray, elcount(__bDiagValueArray), __cDiagValueArray, elcount(__cDiagValueArray));
      {
        __bSetInCheckAlignment = 1;	
        {
          __bArrayCtr = __CopyBytes(__bDiagValueArray, __bDiagValueArrayCtr, __bArray);
          {
            sysvar * __systemVariable;
            __systemVariable = sysvarData::`PartNumber::`Part_Number;
            CheckSysVarSetBufferConsistency(sysSetVariableData(sysvarData::`PartNumber::`Part_Number, __bArray, __bArrayCtr), __systemVariable.name);
          }
          snprintf(__cArray, 8192, "%s", "Part_Number");
          snprintf(__cArray2, 8192, "%s '%s'", __cSysVar, __cArray);
          snprintf(__cArray3, 8192, "%s", "_SW_Year_32");
          
          ReportTableRow(__tableHandle, 0, __cArray2, __cAOp, __bArray, __bArrayCtr, __cArray3, __oneOfFlag, __bSetInCheckAlignment);
        
        }
    
        __bSetInCheckAlignment = 0;
      }
    }
    {
      __bDiagValueArrayCtr = DiagGetParameterErrorHandled(__resp, "_SW__Identification_56", __bDiagValueArray, elcount(__bDiagValueArray), __cDiagValueArray, elcount(__cDiagValueArray));
      {
        __bSetInCheckAlignment = 1;	
        {
          __bArrayCtr = __CopyBytes(__bDiagValueArray, __bDiagValueArrayCtr, __bArray);
          {
            sysvar * __systemVariable;
            __systemVariable = sysvarData::`PartNumber::`Part_Number;
            CheckSysVarSetBufferConsistency(sysSetVariableData(sysvarData::`PartNumber::`Part_Number, __bArray, __bArrayCtr), __systemVariable.name);
          }
          snprintf(__cArray, 8192, "%s", "Part_Number");
          snprintf(__cArray2, 8192, "%s '%s'", __cSysVar, __cArray);
          snprintf(__cArray3, 8192, "%s", "_SW__Identification_56");
          
          ReportTableRow(__tableHandle, 0, __cArray2, __cAOp, __bArray, __bArrayCtr, __cArray3, __oneOfFlag, __bSetInCheckAlignment);
        
        }
    
        __bSetInCheckAlignment = 0;
      }
    }
    {
      __bDiagValueArrayCtr = DiagGetParameterErrorHandled(__resp, "_SW__Patch_Level_48", __bDiagValueArray, elcount(__bDiagValueArray), __cDiagValueArray, elcount(__cDiagValueArray));
      {
        __bSetInCheckAlignment = 1;	
        {
          __bArrayCtr = __CopyBytes(__bDiagValueArray, __bDiagValueArrayCtr, __bArray);
          {
            sysvar * __systemVariable;
            __systemVariable = sysvarData::`PartNumber::`Part_Number;
            CheckSysVarSetBufferConsistency(sysSetVariableData(sysvarData::`PartNumber::`Part_Number, __bArray, __bArrayCtr), __systemVariable.name);
          }
          snprintf(__cArray, 8192, "%s", "Part_Number");
          snprintf(__cArray2, 8192, "%s '%s'", __cSysVar, __cArray);
          snprintf(__cArray3, 8192, "%s", "_SW__Patch_Level_48");
          
          ReportTableRow(__tableHandle, 0, __cArray2, __cAOp, __bArray, __bArrayCtr, __cArray3, __oneOfFlag, __bSetInCheckAlignment);
        
        }
    
        __bSetInCheckAlignment = 0;
      }
    }
    {
      __bDiagValueArrayCtr = DiagGetParameterErrorHandled(__resp, "_SW__Week_40", __bDiagValueArray, elcount(__bDiagValueArray), __cDiagValueArray, elcount(__cDiagValueArray));
      {
        __bSetInCheckAlignment = 1;	
        {
          __bArrayCtr = __CopyBytes(__bDiagValueArray, __bDiagValueArrayCtr, __bArray);
          {
            sysvar * __systemVariable;
            __systemVariable = sysvarData::`PartNumber::`Part_Number;
            CheckSysVarSetBufferConsistency(sysSetVariableData(sysvarData::`PartNumber::`Part_Number, __bArray, __bArrayCtr), __systemVariable.name);
          }
          snprintf(__cArray, 8192, "%s", "Part_Number");
          snprintf(__cArray2, 8192, "%s '%s'", __cSysVar, __cArray);
          snprintf(__cArray3, 8192, "%s", "_SW__Week_40");
          
          ReportTableRow(__tableHandle, 0, __cArray2, __cAOp, __bArray, __bArrayCtr, __cArray3, __oneOfFlag, __bSetInCheckAlignment);
        
        }
    
        __bSetInCheckAlignment = 0;
      }
    }
    {
      __bDiagValueArrayCtr = DiagGetParameterErrorHandled(__resp, "_Number_of_Boot_Software_Logical_Blocks_24", __bDiagValueArray, elcount(__bDiagValueArray), __cDiagValueArray, elcount(__cDiagValueArray));
      {
        __bSetInCheckAlignment = 1;	
        {
          __bArrayCtr = __CopyBytes(__bDiagValueArray, __bDiagValueArrayCtr, __bArray);
          {
            sysvar * __systemVariable;
            __systemVariable = sysvarData::`PartNumber::`Part_Number;
            CheckSysVarSetBufferConsistency(sysSetVariableData(sysvarData::`PartNumber::`Part_Number, __bArray, __bArrayCtr), __systemVariable.name);
          }
          snprintf(__cArray, 8192, "%s", "Part_Number");
          snprintf(__cArray2, 8192, "%s '%s'", __cSysVar, __cArray);
          snprintf(__cArray3, 8192, "%s", "_Number_of_Boot_Software_Logical_Blocks_24");
          
          ReportTableRow(__tableHandle, 0, __cArray2, __cAOp, __bArray, __bArrayCtr, __cArray3, __oneOfFlag, __bSetInCheckAlignment);
        
        }
    
        __bSetInCheckAlignment = 0;
      }
    }
    ReportTableEndVerdict(__tableHandle, __cEvaluateResponse, __res);
	__bVerdict = __bVerdict && __res;
  }
  if (__bVerdict == __eVerdictFail)
    TestReportWriteDiagObjectList();
}

void Ttvccmce9_F180_DID_with_Standard_Physical_Address()
{
  stack long __tableHandle;
  TestCommandBegin(__eRequestResponse, __cRequestResponse, "", "0");
  {
  
    long __res;
    int64 __timeout;
    __res = 0;
    __nInt64 = 1;
    __timeout = syspar::`P2_Server * 1000000LL;
    {
    
      long __testStepInitOk;
      message `FDCAN2::`DIAGNOSTIC_REQUEST_PAM __output;
      message `FDCAN2::`DIAGNOSTIC_REQUEST_PAM __msgOrig;
      __output = __msgOrig;
      __testStepInitOk = 1;
      {
        int64 __dlc;
        __dlc = 4;
        if (__dlc >= 0 && __dlc <= (__output.EDL ? 15 : 8))
          __output.DLC = __dlc;
        else
        {
          testStepErrorInTestSystem(0, __cEmpty, "Unable to set DLC=%lld in message. Please check input parameter.", __dlc);
          __testStepInitOk = 0;
        }
      }
      if (__testStepInitOk)
      {
        snprintf(__cArray, elCount(__cArray), "CAN message '%s' ID = 416981233x (0x18DAA0F1x) on bus FDCAN2", "DIAGNOSTIC_REQUEST_PAM");
        snprintf(__cArray2, elCount(__cArray2), "Send %s", __cArray);
        __tableHandle = ReportTableHead3Columns(__cArray2, "Byte", __cTOp, __cAssigned);
        ReportByteIndex("", 0, __cArray, elCount(__cArray));
        snprintf(__cArray2, 8192, "%s", __cArray);
        snprintf(__cArray3, 8192, "%s", "");
        
        ReportTableRow(__tableHandle, 0, __cArray2, __cAOp, 0x3, __cArray3, __oneOfFlag, __bSetInCheckAlignment);
        
        if (0 >= 0 && 0 < 64)
        {
          __output.byte((word)0) = 0x3;
        }
        else
        {
          testStepErrorInTestSystem(0, __cEmpty, "Index out of range. Unable to set byte %lld in message. Please check input parameter.", (int64)0);
          __testStepInitOk = 0;
        }
        ReportByteIndex("", 1, __cArray, elCount(__cArray));
        snprintf(__cArray2, 8192, "%s", __cArray);
        snprintf(__cArray3, 8192, "%s", "");
        
        ReportTableRow(__tableHandle, 0, __cArray2, __cAOp, 0x22, __cArray3, __oneOfFlag, __bSetInCheckAlignment);
        
        if (1 >= 0 && 1 < 64)
        {
          __output.byte((word)1) = 0x22;
        }
        else
        {
          testStepErrorInTestSystem(0, __cEmpty, "Index out of range. Unable to set byte %lld in message. Please check input parameter.", (int64)1);
          __testStepInitOk = 0;
        }
        ReportByteIndex("", 2, __cArray, elCount(__cArray));
        snprintf(__cArray2, 8192, "%s", __cArray);
        snprintf(__cArray3, 8192, "%s", "");
        
        ReportTableRow(__tableHandle, 0, __cArray2, __cAOp, 0xF1, __cArray3, __oneOfFlag, __bSetInCheckAlignment);
        
        if (2 >= 0 && 2 < 64)
        {
          __output.byte((word)2) = 0xF1;
        }
        else
        {
          testStepErrorInTestSystem(0, __cEmpty, "Index out of range. Unable to set byte %lld in message. Please check input parameter.", (int64)2);
          __testStepInitOk = 0;
        }
        ReportByteIndex("", 3, __cArray, elCount(__cArray));
        snprintf(__cArray2, 8192, "%s", __cArray);
        snprintf(__cArray3, 8192, "%s", "");
        
        ReportTableRow(__tableHandle, 0, __cArray2, __cAOp, 0x80, __cArray3, __oneOfFlag, __bSetInCheckAlignment);
        
        if (3 >= 0 && 3 < 64)
        {
          __output.byte((word)3) = 0x80;
        }
        else
        {
          testStepErrorInTestSystem(0, __cEmpty, "Index out of range. Unable to set byte %lld in message. Please check input parameter.", (int64)3);
          __testStepInitOk = 0;
        }
      
        ReportTableEndTestStep(__tableHandle, "Req1");
      }
      if (__testStepInitOk)
      {
        output(__output);
      }
    }
    if (__timeout <= 0)
    {
      testStepErrorInTestSystem(0, "1", "Unable to wait for %.3f %s. Please check input parameter.", __timeout / ((float)1000000), "ms");
    }
    else
    {
      __tt0cnt_13 = 0;
      snprintf(__cArray, elCount(__cArray), "CAN message '%s' ID = 417001888x (0x18DAF1A0x) on bus FDCAN2", "DIAGNOSTIC_RESPONSE_PAM");
      if(SetBusContextByName("FDCAN2", __eSaveCurrent, __nBusContextNew, __nBusContextOld))
        testJoinMessageEvent(`FDCAN2::`DIAGNOSTIC_RESPONSE_PAM,  __cArray,
             delegate dword(message * __m)
             {
               dword __msg_callback_ret;
               if (__tt0cnt_13 == -1)
               {
                 return 1;
               }
               __msg_callback_ret = 1;
               __tt0cnt_13++;
               if (__msg_callback_ret)
               {
                 __tt0cnt_13 = -1;
                 return 1;
               }
               return 0;
             });
      __res = testWaitForAllJoinedEventsNS(__timeout);
      if (__nInt64 != 0)
      {
        snprintf(__cArray, elCount(__cArray), "CAN message '%s' ID = 417001888x (0x18DAF1A0x) on bus FDCAN2", "DIAGNOSTIC_RESPONSE_PAM");
        if(__tt0cnt_13 == -1)
        {
          snprintf(__cArray2, 8192, "Response of %s", __cArray);
        }
        else
        {
          snprintf(__cArray2, 8192, "Response of %s (received %d times)", __cArray, __tt0cnt_13);
        }
        if (__tt0cnt_13 == 0)
        {
          testStepFail(0, "Resp1", __cArray2);
        }
        else
        {
          testStepPass(2, "Resp1", __cArray2);
        }
        __ReportRequestResponseResult(__res, 0);
      }
      ResetBusContext(__nBusContextNew, __nBusContextOld);
    }
  }
  TestCommandEnd();

}

void Ttvccmce9_F132_DID_with_Physical_Address()
{
  stack long __tableHandle;
  TestCommandBegin(__eDiagService, __cDiagService, "", "0");
  {
    if (DiagIsFunctionalGroup("CVADAS_0001_00000000_000"))
    {
      DiagResponse * __resp;
      DiagRequest CVADAS_0001_00000000_000._22F132_EBOM_ECU_Part_Number __req;
      __diagServicevccmce9_15(__req, __resp);
    }
    else
    {
      DiagResponse CVADAS_0001_00000000_000.* __resp;
      DiagRequest CVADAS_0001_00000000_000._22F132_EBOM_ECU_Part_Number __req;
      __diagServicevccmce9_15(__req, __resp);
    }
  }
  TestCommandEnd();


}

  
void __diagServicevccmce9_15(DiagRequest * __req, DiagResponse * __resp )
{
  stack long __tableHandle;
  long __res, __paramLen, __bytePos;

   __bVerdict = __eVerdictPass;

  do {
    TestReportResetDiagObjectList();
    DiagSetReportDetailLevel("CVADAS_0001_00000000_000", EnumServiceDetails_onfail);
    // Request aspect
    {

      if (0 >= DiagSendReqAndWaitForResp("CVADAS_0001_00000000_000", __req, __resp, __res, -1, -1, -1, -1, -1, EnumResult_pos, EnumServiceDetails_onfail, EnumSendingMode_physical, EnumSuppressPosResBit_asconfigured, EnumVerdictOnInvalidValues_fail))
        break;
    }

    __res = DiagErrCodeTestStep(__res, "Can't retrieve last response for request! No check possible.") < 0;
    if(__res)
    {
	  __bVerdict = __eVerdictFail;
      break;
    }
    {
      __res = DiagInterpretAs(__resp, "RDBI_PR");
      if(__res != 0)
      {
        __bVerdict = __eVerdictFail;
        DiagErrCodeTestStep(__res, "Can't interpret response as diagnostic primitive 'RDBI_PR'.");
        break;
      }
      else
      {
        TestStepPass( "Received primitive can be interpreted as diagnostic primitive 'RDBI_PR'.");
      }
    }
  }
  while(0);


  // Response, check & read aspect
  {
    __res = 1;
    __tableHandle = ReportTableHead5Columns(__cCheckCaption, __cTSym, __cTOp, __cRefVal, __cActual, __cRes);
    {
      __bDiagValueArrayCtr = DiagGetParameterErrorHandled(__resp, "_EBOM_ECU_Part_Number_24", __bDiagValueArray, elcount(__bDiagValueArray), __cDiagValueArray, elcount(__cDiagValueArray));
      {
        __bSetInCheckAlignment = 1;	
        {
          __bArrayCtr = __CopyBytes(__bDiagValueArray, __bDiagValueArrayCtr, __bArray);
          {
            sysvar * __systemVariable;
            __systemVariable = sysvarData::`PartNumber::`Part_Number;
            CheckSysVarSetBufferConsistency(sysSetVariableData(sysvarData::`PartNumber::`Part_Number, __bArray, __bArrayCtr), __systemVariable.name);
          }
          snprintf(__cArray, 8192, "%s", "Part_Number");
          snprintf(__cArray2, 8192, "%s '%s'", __cSysVar, __cArray);
          snprintf(__cArray3, 8192, "%s", "_EBOM_ECU_Part_Number_24");
          
          ReportTableRow(__tableHandle, 0, __cArray2, __cAOp, __bArray, __bArrayCtr, __cArray3, __oneOfFlag, __bSetInCheckAlignment);
        
        }
    
        __bSetInCheckAlignment = 0;
      }
    }
    ReportTableEndVerdict(__tableHandle, __cEvaluateResponse, __res);
	__bVerdict = __bVerdict && __res;
  }
  if (__bVerdict == __eVerdictFail)
    TestReportWriteDiagObjectList();
}

void Ttvccmce9_F132_DID_with_Functional_Address()
{
  stack long __tableHandle;
  TestCommandBegin(__eDiagService, __cDiagService, "", "0");
  {
    if (DiagIsFunctionalGroup("CVADAS_0001_00000000_000"))
    {
      DiagResponse * __resp;
      DiagRequest CVADAS_0001_00000000_000._22F132_EBOM_ECU_Part_Number __req;
      __diagServicevccmce9_16(__req, __resp);
    }
    else
    {
      DiagResponse CVADAS_0001_00000000_000.* __resp;
      DiagRequest CVADAS_0001_00000000_000._22F132_EBOM_ECU_Part_Number __req;
      __diagServicevccmce9_16(__req, __resp);
    }
  }
  TestCommandEnd();


}

  
void __diagServicevccmce9_16(DiagRequest * __req, DiagResponse * __resp )
{
  stack long __tableHandle;
  long __res, __paramLen, __bytePos;

   __bVerdict = __eVerdictPass;

  do {
    TestReportResetDiagObjectList();
    DiagSetReportDetailLevel("CVADAS_0001_00000000_000", EnumServiceDetails_onfail);
    // Request aspect
    {

      if (0 >= DiagSendReqAndWaitForResp("CVADAS_0001_00000000_000", __req, __resp, __res, -1, -1, -1, -1, -1, EnumResult_pos, EnumServiceDetails_onfail, EnumSendingMode_functional, EnumSuppressPosResBit_asconfigured, EnumVerdictOnInvalidValues_fail))
        break;
    }

    __res = DiagErrCodeTestStep(__res, "Can't retrieve last response for request! No check possible.") < 0;
    if(__res)
    {
	  __bVerdict = __eVerdictFail;
      break;
    }
    {
      __res = DiagInterpretAs(__resp, "RDBI_PR");
      if(__res != 0)
      {
        __bVerdict = __eVerdictFail;
        DiagErrCodeTestStep(__res, "Can't interpret response as diagnostic primitive 'RDBI_PR'.");
        break;
      }
      else
      {
        TestStepPass( "Received primitive can be interpreted as diagnostic primitive 'RDBI_PR'.");
      }
    }
  }
  while(0);


  // Response, check & read aspect
  {
    __res = 1;
    __tableHandle = ReportTableHead5Columns(__cCheckCaption, __cTSym, __cTOp, __cRefVal, __cActual, __cRes);
    {
      __bDiagValueArrayCtr = DiagGetParameterErrorHandled(__resp, "_EBOM_ECU_Part_Number_24", __bDiagValueArray, elcount(__bDiagValueArray), __cDiagValueArray, elcount(__cDiagValueArray));
      {
        __bSetInCheckAlignment = 1;	
        {
          __bArrayCtr = __CopyBytes(__bDiagValueArray, __bDiagValueArrayCtr, __bArray);
          {
            sysvar * __systemVariable;
            __systemVariable = sysvarData::`PartNumber::`Part_Number;
            CheckSysVarSetBufferConsistency(sysSetVariableData(sysvarData::`PartNumber::`Part_Number, __bArray, __bArrayCtr), __systemVariable.name);
          }
          snprintf(__cArray, 8192, "%s", "Part_Number");
          snprintf(__cArray2, 8192, "%s '%s'", __cSysVar, __cArray);
          snprintf(__cArray3, 8192, "%s", "_EBOM_ECU_Part_Number_24");
          
          ReportTableRow(__tableHandle, 0, __cArray2, __cAOp, __bArray, __bArrayCtr, __cArray3, __oneOfFlag, __bSetInCheckAlignment);
        
        }
    
        __bSetInCheckAlignment = 0;
      }
    }
    ReportTableEndVerdict(__tableHandle, __cEvaluateResponse, __res);
	__bVerdict = __bVerdict && __res;
  }
  if (__bVerdict == __eVerdictFail)
    TestReportWriteDiagObjectList();
}

void Ttvccmce9_F132_DID_with_Standard_Physical_Address()
{
  stack long __tableHandle;
  TestCommandBegin(__eRequestResponse, __cRequestResponse, "", "0");
  {
  
    long __res;
    int64 __timeout;
    __res = 0;
    __nInt64 = 1;
    __timeout = syspar::`P2_Server * 1000000LL;
    {
    
      long __testStepInitOk;
      message `FDCAN2::`DIAGNOSTIC_REQUEST_PAM __output;
      message `FDCAN2::`DIAGNOSTIC_REQUEST_PAM __msgOrig;
      __output = __msgOrig;
      __testStepInitOk = 1;
      {
        int64 __dlc;
        __dlc = 4;
        if (__dlc >= 0 && __dlc <= (__output.EDL ? 15 : 8))
          __output.DLC = __dlc;
        else
        {
          testStepErrorInTestSystem(0, __cEmpty, "Unable to set DLC=%lld in message. Please check input parameter.", __dlc);
          __testStepInitOk = 0;
        }
      }
      if (__testStepInitOk)
      {
        snprintf(__cArray, elCount(__cArray), "CAN message '%s' ID = 416981233x (0x18DAA0F1x) on bus FDCAN2", "DIAGNOSTIC_REQUEST_PAM");
        snprintf(__cArray2, elCount(__cArray2), "Send %s", __cArray);
        __tableHandle = ReportTableHead3Columns(__cArray2, "Byte", __cTOp, __cAssigned);
        ReportByteIndex("", 0, __cArray, elCount(__cArray));
        snprintf(__cArray2, 8192, "%s", __cArray);
        snprintf(__cArray3, 8192, "%s", "");
        
        ReportTableRow(__tableHandle, 0, __cArray2, __cAOp, 0x3, __cArray3, __oneOfFlag, __bSetInCheckAlignment);
        
        if (0 >= 0 && 0 < 64)
        {
          __output.byte((word)0) = 0x3;
        }
        else
        {
          testStepErrorInTestSystem(0, __cEmpty, "Index out of range. Unable to set byte %lld in message. Please check input parameter.", (int64)0);
          __testStepInitOk = 0;
        }
        ReportByteIndex("", 1, __cArray, elCount(__cArray));
        snprintf(__cArray2, 8192, "%s", __cArray);
        snprintf(__cArray3, 8192, "%s", "");
        
        ReportTableRow(__tableHandle, 0, __cArray2, __cAOp, 0x22, __cArray3, __oneOfFlag, __bSetInCheckAlignment);
        
        if (1 >= 0 && 1 < 64)
        {
          __output.byte((word)1) = 0x22;
        }
        else
        {
          testStepErrorInTestSystem(0, __cEmpty, "Index out of range. Unable to set byte %lld in message. Please check input parameter.", (int64)1);
          __testStepInitOk = 0;
        }
        ReportByteIndex("", 2, __cArray, elCount(__cArray));
        snprintf(__cArray2, 8192, "%s", __cArray);
        snprintf(__cArray3, 8192, "%s", "");
        
        ReportTableRow(__tableHandle, 0, __cArray2, __cAOp, 0xF1, __cArray3, __oneOfFlag, __bSetInCheckAlignment);
        
        if (2 >= 0 && 2 < 64)
        {
          __output.byte((word)2) = 0xF1;
        }
        else
        {
          testStepErrorInTestSystem(0, __cEmpty, "Index out of range. Unable to set byte %lld in message. Please check input parameter.", (int64)2);
          __testStepInitOk = 0;
        }
        ReportByteIndex("", 3, __cArray, elCount(__cArray));
        snprintf(__cArray2, 8192, "%s", __cArray);
        snprintf(__cArray3, 8192, "%s", "");
        
        ReportTableRow(__tableHandle, 0, __cArray2, __cAOp, 0x32, __cArray3, __oneOfFlag, __bSetInCheckAlignment);
        
        if (3 >= 0 && 3 < 64)
        {
          __output.byte((word)3) = 0x32;
        }
        else
        {
          testStepErrorInTestSystem(0, __cEmpty, "Index out of range. Unable to set byte %lld in message. Please check input parameter.", (int64)3);
          __testStepInitOk = 0;
        }
      
        ReportTableEndTestStep(__tableHandle, "Req1");
      }
      if (__testStepInitOk)
      {
        output(__output);
      }
    }
    if (__timeout <= 0)
    {
      testStepErrorInTestSystem(0, "1", "Unable to wait for %.3f %s. Please check input parameter.", __timeout / ((float)1000000), "ms");
    }
    else
    {
      __tt0cnt_15 = 0;
      snprintf(__cArray, elCount(__cArray), "CAN message '%s' ID = 417001888x (0x18DAF1A0x) on bus FDCAN2", "DIAGNOSTIC_RESPONSE_PAM");
      if(SetBusContextByName("FDCAN2", __eSaveCurrent, __nBusContextNew, __nBusContextOld))
        testJoinMessageEvent(`FDCAN2::`DIAGNOSTIC_RESPONSE_PAM,  __cArray,
             delegate dword(message * __m)
             {
               dword __msg_callback_ret;
               if (__tt0cnt_15 == -1)
               {
                 return 1;
               }
               __msg_callback_ret = 1;
               __tt0cnt_15++;
               if (__msg_callback_ret)
               {
                 __tt0cnt_15 = -1;
                 return 1;
               }
               return 0;
             });
      __res = testWaitForAllJoinedEventsNS(__timeout);
      if (__nInt64 != 0)
      {
        snprintf(__cArray, elCount(__cArray), "CAN message '%s' ID = 417001888x (0x18DAF1A0x) on bus FDCAN2", "DIAGNOSTIC_RESPONSE_PAM");
        if(__tt0cnt_15 == -1)
        {
          snprintf(__cArray2, 8192, "Response of %s", __cArray);
        }
        else
        {
          snprintf(__cArray2, 8192, "Response of %s (received %d times)", __cArray, __tt0cnt_15);
        }
        if (__tt0cnt_15 == 0)
        {
          testStepFail(0, "Resp1", __cArray2);
        }
        else
        {
          testStepPass(2, "Resp1", __cArray2);
        }
        __ReportRequestResponseResult(__res, 0);
      }
      ResetBusContext(__nBusContextNew, __nBusContextOld);
    }
  }
  TestCommandEnd();

}

void Ttvccmce9_F1A2_DID_with_Physical_Address()
{
  stack long __tableHandle;
  TestCommandBegin(__eDiagService, __cDiagService, "", "0");
  {
    if (DiagIsFunctionalGroup("CVADAS_0001_00000000_000"))
    {
      DiagResponse * __resp;
      DiagRequest CVADAS_0001_00000000_000._22F1A2_Vector_Delivery_ID __req;
      __diagServicevccmce9_17(__req, __resp);
    }
    else
    {
      DiagResponse CVADAS_0001_00000000_000.* __resp;
      DiagRequest CVADAS_0001_00000000_000._22F1A2_Vector_Delivery_ID __req;
      __diagServicevccmce9_17(__req, __resp);
    }
  }
  TestCommandEnd();


}

  
void __diagServicevccmce9_17(DiagRequest * __req, DiagResponse * __resp )
{
  stack long __tableHandle;
  long __res, __paramLen, __bytePos;

   __bVerdict = __eVerdictPass;

  do {
    TestReportResetDiagObjectList();
    DiagSetReportDetailLevel("CVADAS_0001_00000000_000", EnumServiceDetails_onfail);
    // Request aspect
    {

      if (0 >= DiagSendReqAndWaitForResp("CVADAS_0001_00000000_000", __req, __resp, __res, -1, -1, -1, -1, -1, EnumResult_pos, EnumServiceDetails_onfail, EnumSendingMode_physical, EnumSuppressPosResBit_asconfigured, EnumVerdictOnInvalidValues_fail))
        break;
    }

    __res = DiagErrCodeTestStep(__res, "Can't retrieve last response for request! No check possible.") < 0;
    if(__res)
    {
	  __bVerdict = __eVerdictFail;
      break;
    }
    {
      __res = DiagInterpretAs(__resp, "RDBI_PR");
      if(__res != 0)
      {
        __bVerdict = __eVerdictFail;
        DiagErrCodeTestStep(__res, "Can't interpret response as diagnostic primitive 'RDBI_PR'.");
        break;
      }
      else
      {
        TestStepPass( "Received primitive can be interpreted as diagnostic primitive 'RDBI_PR'.");
      }
    }
  }
  while(0);


  // Response, check & read aspect
  {
    __res = 1;
    __tableHandle = ReportTableHead5Columns(__cCheckCaption, __cTSym, __cTOp, __cRefVal, __cActual, __cRes);
    {
      __bDiagValueArrayCtr = DiagGetParameterErrorHandled(__resp, "_Autosar_Revision_ASR_Major_Release_88", __bDiagValueArray, elcount(__bDiagValueArray), __cDiagValueArray, elcount(__cDiagValueArray));
      {
        __bSetInCheckAlignment = 1;	
        {
          __bArrayCtr = __CopyBytes(__bDiagValueArray, __bDiagValueArrayCtr, __bArray);
          {
            sysvar * __systemVariable;
            __systemVariable = sysvarData::`PartNumber::`Part_Number;
            CheckSysVarSetBufferConsistency(sysSetVariableData(sysvarData::`PartNumber::`Part_Number, __bArray, __bArrayCtr), __systemVariable.name);
          }
          snprintf(__cArray, 8192, "%s", "Part_Number");
          snprintf(__cArray2, 8192, "%s '%s'", __cSysVar, __cArray);
          snprintf(__cArray3, 8192, "%s", "_Autosar_Revision_ASR_Major_Release_88");
          
          ReportTableRow(__tableHandle, 0, __cArray2, __cAOp, __bArray, __bArrayCtr, __cArray3, __oneOfFlag, __bSetInCheckAlignment);
        
        }
    
        __bSetInCheckAlignment = 0;
      }
    }
    {
      __bDiagValueArrayCtr = DiagGetParameterErrorHandled(__resp, "_Software_License_Package_SLP_96", __bDiagValueArray, elcount(__bDiagValueArray), __cDiagValueArray, elcount(__cDiagValueArray));
      {
        __bSetInCheckAlignment = 1;	
        {
          __bArrayCtr = __CopyBytes(__bDiagValueArray, __bDiagValueArrayCtr, __bArray);
          {
            sysvar * __systemVariable;
            __systemVariable = sysvarData::`PartNumber::`Part_Number;
            CheckSysVarSetBufferConsistency(sysSetVariableData(sysvarData::`PartNumber::`Part_Number, __bArray, __bArrayCtr), __systemVariable.name);
          }
          snprintf(__cArray, 8192, "%s", "Part_Number");
          snprintf(__cArray2, 8192, "%s '%s'", __cSysVar, __cArray);
          snprintf(__cArray3, 8192, "%s", "_Software_License_Package_SLP_96");
          
          ReportTableRow(__tableHandle, 0, __cArray2, __cAOp, __bArray, __bArrayCtr, __cArray3, __oneOfFlag, __bSetInCheckAlignment);
        
        }
    
        __bSetInCheckAlignment = 0;
      }
    }
    {
      __bDiagValueArrayCtr = DiagGetParameterErrorHandled(__resp, "_Vector_Delivery_Number_80", __bDiagValueArray, elcount(__bDiagValueArray), __cDiagValueArray, elcount(__cDiagValueArray));
      {
        __bSetInCheckAlignment = 1;	
        {
          __bArrayCtr = __CopyBytes(__bDiagValueArray, __bDiagValueArrayCtr, __bArray);
          {
            sysvar * __systemVariable;
            __systemVariable = sysvarData::`PartNumber::`Part_Number;
            CheckSysVarSetBufferConsistency(sysSetVariableData(sysvarData::`PartNumber::`Part_Number, __bArray, __bArrayCtr), __systemVariable.name);
          }
          snprintf(__cArray, 8192, "%s", "Part_Number");
          snprintf(__cArray2, 8192, "%s '%s'", __cSysVar, __cArray);
          snprintf(__cArray3, 8192, "%s", "_Vector_Delivery_Number_80");
          
          ReportTableRow(__tableHandle, 0, __cArray2, __cAOp, __bArray, __bArrayCtr, __cArray3, __oneOfFlag, __bSetInCheckAlignment);
        
        }
    
        __bSetInCheckAlignment = 0;
      }
    }
    {
      __bDiagValueArrayCtr = DiagGetParameterErrorHandled(__resp, "_Vector_License_Number_CBD_Number_48", __bDiagValueArray, elcount(__bDiagValueArray), __cDiagValueArray, elcount(__cDiagValueArray));
      {
        __bSetInCheckAlignment = 1;	
        {
          __bArrayCtr = __CopyBytes(__bDiagValueArray, __bDiagValueArrayCtr, __bArray);
          {
            sysvar * __systemVariable;
            __systemVariable = sysvarData::`PartNumber::`Part_Number;
            CheckSysVarSetBufferConsistency(sysSetVariableData(sysvarData::`PartNumber::`Part_Number, __bArray, __bArrayCtr), __systemVariable.name);
          }
          snprintf(__cArray, 8192, "%s", "Part_Number");
          snprintf(__cArray2, 8192, "%s '%s'", __cSysVar, __cArray);
          snprintf(__cArray3, 8192, "%s", "_Vector_License_Number_CBD_Number_48");
          
          ReportTableRow(__tableHandle, 0, __cArray2, __cAOp, __bArray, __bArrayCtr, __cArray3, __oneOfFlag, __bSetInCheckAlignment);
        
        }
    
        __bSetInCheckAlignment = 0;
      }
    }
    {
      __bDiagValueArrayCtr = DiagGetParameterErrorHandled(__resp, "_Vector_Release_Version_Basic_Software_BSW_24", __bDiagValueArray, elcount(__bDiagValueArray), __cDiagValueArray, elcount(__cDiagValueArray));
      {
        __bSetInCheckAlignment = 1;	
        {
          __bArrayCtr = __CopyBytes(__bDiagValueArray, __bDiagValueArrayCtr, __bArray);
          {
            sysvar * __systemVariable;
            __systemVariable = sysvarData::`PartNumber::`Part_Number;
            CheckSysVarSetBufferConsistency(sysSetVariableData(sysvarData::`PartNumber::`Part_Number, __bArray, __bArrayCtr), __systemVariable.name);
          }
          snprintf(__cArray, 8192, "%s", "Part_Number");
          snprintf(__cArray2, 8192, "%s '%s'", __cSysVar, __cArray);
          snprintf(__cArray3, 8192, "%s", "_Vector_Release_Version_Basic_Software_BSW_24");
          
          ReportTableRow(__tableHandle, 0, __cArray2, __cAOp, __bArray, __bArrayCtr, __cArray3, __oneOfFlag, __bSetInCheckAlignment);
        
        }
    
        __bSetInCheckAlignment = 0;
      }
    }
    ReportTableEndVerdict(__tableHandle, __cEvaluateResponse, __res);
	__bVerdict = __bVerdict && __res;
  }
  if (__bVerdict == __eVerdictFail)
    TestReportWriteDiagObjectList();
}

void Ttvccmce9_F1A2_DID_with_Functional_Address()
{
  stack long __tableHandle;
  TestCommandBegin(__eDiagService, __cDiagService, "", "0");
  {
    if (DiagIsFunctionalGroup("CVADAS_0001_00000000_000"))
    {
      DiagResponse * __resp;
      DiagRequest CVADAS_0001_00000000_000._22F1A2_Vector_Delivery_ID __req;
      __diagServicevccmce9_18(__req, __resp);
    }
    else
    {
      DiagResponse CVADAS_0001_00000000_000.* __resp;
      DiagRequest CVADAS_0001_00000000_000._22F1A2_Vector_Delivery_ID __req;
      __diagServicevccmce9_18(__req, __resp);
    }
  }
  TestCommandEnd();


}

  
void __diagServicevccmce9_18(DiagRequest * __req, DiagResponse * __resp )
{
  stack long __tableHandle;
  long __res, __paramLen, __bytePos;

   __bVerdict = __eVerdictPass;

  do {
    TestReportResetDiagObjectList();
    DiagSetReportDetailLevel("CVADAS_0001_00000000_000", EnumServiceDetails_onfail);
    // Request aspect
    {

      if (0 >= DiagSendReqAndWaitForResp("CVADAS_0001_00000000_000", __req, __resp, __res, -1, -1, -1, -1, -1, EnumResult_pos, EnumServiceDetails_onfail, EnumSendingMode_physical, EnumSuppressPosResBit_asconfigured, EnumVerdictOnInvalidValues_fail))
        break;
    }

    __res = DiagErrCodeTestStep(__res, "Can't retrieve last response for request! No check possible.") < 0;
    if(__res)
    {
	  __bVerdict = __eVerdictFail;
      break;
    }
    {
      __res = DiagInterpretAs(__resp, "RDBI_PR");
      if(__res != 0)
      {
        __bVerdict = __eVerdictFail;
        DiagErrCodeTestStep(__res, "Can't interpret response as diagnostic primitive 'RDBI_PR'.");
        break;
      }
      else
      {
        TestStepPass( "Received primitive can be interpreted as diagnostic primitive 'RDBI_PR'.");
      }
    }
  }
  while(0);


  // Response, check & read aspect
  {
    __res = 1;
    __tableHandle = ReportTableHead5Columns(__cCheckCaption, __cTSym, __cTOp, __cRefVal, __cActual, __cRes);
    {
      __bDiagValueArrayCtr = DiagGetParameterErrorHandled(__resp, "_Autosar_Revision_ASR_Major_Release_88", __bDiagValueArray, elcount(__bDiagValueArray), __cDiagValueArray, elcount(__cDiagValueArray));
      {
        __bSetInCheckAlignment = 1;	
        {
          __bArrayCtr = __CopyBytes(__bDiagValueArray, __bDiagValueArrayCtr, __bArray);
          {
            sysvar * __systemVariable;
            __systemVariable = sysvarData::`PartNumber::`Part_Number;
            CheckSysVarSetBufferConsistency(sysSetVariableData(sysvarData::`PartNumber::`Part_Number, __bArray, __bArrayCtr), __systemVariable.name);
          }
          snprintf(__cArray, 8192, "%s", "Part_Number");
          snprintf(__cArray2, 8192, "%s '%s'", __cSysVar, __cArray);
          snprintf(__cArray3, 8192, "%s", "_Autosar_Revision_ASR_Major_Release_88");
          
          ReportTableRow(__tableHandle, 0, __cArray2, __cAOp, __bArray, __bArrayCtr, __cArray3, __oneOfFlag, __bSetInCheckAlignment);
        
        }
    
        __bSetInCheckAlignment = 0;
      }
    }
    {
      __bDiagValueArrayCtr = DiagGetParameterErrorHandled(__resp, "_Software_License_Package_SLP_96", __bDiagValueArray, elcount(__bDiagValueArray), __cDiagValueArray, elcount(__cDiagValueArray));
      {
        __bSetInCheckAlignment = 1;	
        {
          __bArrayCtr = __CopyBytes(__bDiagValueArray, __bDiagValueArrayCtr, __bArray);
          {
            sysvar * __systemVariable;
            __systemVariable = sysvarData::`PartNumber::`Part_Number;
            CheckSysVarSetBufferConsistency(sysSetVariableData(sysvarData::`PartNumber::`Part_Number, __bArray, __bArrayCtr), __systemVariable.name);
          }
          snprintf(__cArray, 8192, "%s", "Part_Number");
          snprintf(__cArray2, 8192, "%s '%s'", __cSysVar, __cArray);
          snprintf(__cArray3, 8192, "%s", "_Software_License_Package_SLP_96");
          
          ReportTableRow(__tableHandle, 0, __cArray2, __cAOp, __bArray, __bArrayCtr, __cArray3, __oneOfFlag, __bSetInCheckAlignment);
        
        }
    
        __bSetInCheckAlignment = 0;
      }
    }
    {
      __bDiagValueArrayCtr = DiagGetParameterErrorHandled(__resp, "_Vector_Delivery_Number_80", __bDiagValueArray, elcount(__bDiagValueArray), __cDiagValueArray, elcount(__cDiagValueArray));
      {
        __bSetInCheckAlignment = 1;	
        {
          __bArrayCtr = __CopyBytes(__bDiagValueArray, __bDiagValueArrayCtr, __bArray);
          {
            sysvar * __systemVariable;
            __systemVariable = sysvarData::`PartNumber::`Part_Number;
            CheckSysVarSetBufferConsistency(sysSetVariableData(sysvarData::`PartNumber::`Part_Number, __bArray, __bArrayCtr), __systemVariable.name);
          }
          snprintf(__cArray, 8192, "%s", "Part_Number");
          snprintf(__cArray2, 8192, "%s '%s'", __cSysVar, __cArray);
          snprintf(__cArray3, 8192, "%s", "_Vector_Delivery_Number_80");
          
          ReportTableRow(__tableHandle, 0, __cArray2, __cAOp, __bArray, __bArrayCtr, __cArray3, __oneOfFlag, __bSetInCheckAlignment);
        
        }
    
        __bSetInCheckAlignment = 0;
      }
    }
    {
      __bDiagValueArrayCtr = DiagGetParameterErrorHandled(__resp, "_Vector_License_Number_CBD_Number_48", __bDiagValueArray, elcount(__bDiagValueArray), __cDiagValueArray, elcount(__cDiagValueArray));
      {
        __bSetInCheckAlignment = 1;	
        {
          __bArrayCtr = __CopyBytes(__bDiagValueArray, __bDiagValueArrayCtr, __bArray);
          {
            sysvar * __systemVariable;
            __systemVariable = sysvarData::`PartNumber::`Part_Number;
            CheckSysVarSetBufferConsistency(sysSetVariableData(sysvarData::`PartNumber::`Part_Number, __bArray, __bArrayCtr), __systemVariable.name);
          }
          snprintf(__cArray, 8192, "%s", "Part_Number");
          snprintf(__cArray2, 8192, "%s '%s'", __cSysVar, __cArray);
          snprintf(__cArray3, 8192, "%s", "_Vector_License_Number_CBD_Number_48");
          
          ReportTableRow(__tableHandle, 0, __cArray2, __cAOp, __bArray, __bArrayCtr, __cArray3, __oneOfFlag, __bSetInCheckAlignment);
        
        }
    
        __bSetInCheckAlignment = 0;
      }
    }
    {
      __bDiagValueArrayCtr = DiagGetParameterErrorHandled(__resp, "_Vector_Release_Version_Basic_Software_BSW_24", __bDiagValueArray, elcount(__bDiagValueArray), __cDiagValueArray, elcount(__cDiagValueArray));
      {
        __bSetInCheckAlignment = 1;	
        {
          __bArrayCtr = __CopyBytes(__bDiagValueArray, __bDiagValueArrayCtr, __bArray);
          {
            sysvar * __systemVariable;
            __systemVariable = sysvarData::`PartNumber::`Part_Number;
            CheckSysVarSetBufferConsistency(sysSetVariableData(sysvarData::`PartNumber::`Part_Number, __bArray, __bArrayCtr), __systemVariable.name);
          }
          snprintf(__cArray, 8192, "%s", "Part_Number");
          snprintf(__cArray2, 8192, "%s '%s'", __cSysVar, __cArray);
          snprintf(__cArray3, 8192, "%s", "_Vector_Release_Version_Basic_Software_BSW_24");
          
          ReportTableRow(__tableHandle, 0, __cArray2, __cAOp, __bArray, __bArrayCtr, __cArray3, __oneOfFlag, __bSetInCheckAlignment);
        
        }
    
        __bSetInCheckAlignment = 0;
      }
    }
    ReportTableEndVerdict(__tableHandle, __cEvaluateResponse, __res);
	__bVerdict = __bVerdict && __res;
  }
  if (__bVerdict == __eVerdictFail)
    TestReportWriteDiagObjectList();
}

void Ttvccmce9_F1A2_DID_with_Standard_Physical_Address()
{
  stack long __tableHandle;
  TestCommandBegin(__eRequestResponse, __cRequestResponse, "", "0");
  {
  
    long __res;
    int64 __timeout;
    __res = 0;
    __nInt64 = 1;
    __timeout = syspar::`P2_Server * 1000000LL;
    {
    
      long __testStepInitOk;
      message `FDCAN2::`DIAGNOSTIC_REQUEST_PAM __output;
      message `FDCAN2::`DIAGNOSTIC_REQUEST_PAM __msgOrig;
      __output = __msgOrig;
      __testStepInitOk = 1;
      {
        int64 __dlc;
        __dlc = 4;
        if (__dlc >= 0 && __dlc <= (__output.EDL ? 15 : 8))
          __output.DLC = __dlc;
        else
        {
          testStepErrorInTestSystem(0, __cEmpty, "Unable to set DLC=%lld in message. Please check input parameter.", __dlc);
          __testStepInitOk = 0;
        }
      }
      if (__testStepInitOk)
      {
        snprintf(__cArray, elCount(__cArray), "CAN message '%s' ID = 416981233x (0x18DAA0F1x) on bus FDCAN2", "DIAGNOSTIC_REQUEST_PAM");
        snprintf(__cArray2, elCount(__cArray2), "Send %s", __cArray);
        __tableHandle = ReportTableHead3Columns(__cArray2, "Byte", __cTOp, __cAssigned);
        ReportByteIndex("", 0, __cArray, elCount(__cArray));
        snprintf(__cArray2, 8192, "%s", __cArray);
        snprintf(__cArray3, 8192, "%s", "");
        
        ReportTableRow(__tableHandle, 0, __cArray2, __cAOp, 0x3, __cArray3, __oneOfFlag, __bSetInCheckAlignment);
        
        if (0 >= 0 && 0 < 64)
        {
          __output.byte((word)0) = 0x3;
        }
        else
        {
          testStepErrorInTestSystem(0, __cEmpty, "Index out of range. Unable to set byte %lld in message. Please check input parameter.", (int64)0);
          __testStepInitOk = 0;
        }
        ReportByteIndex("", 1, __cArray, elCount(__cArray));
        snprintf(__cArray2, 8192, "%s", __cArray);
        snprintf(__cArray3, 8192, "%s", "");
        
        ReportTableRow(__tableHandle, 0, __cArray2, __cAOp, 0x22, __cArray3, __oneOfFlag, __bSetInCheckAlignment);
        
        if (1 >= 0 && 1 < 64)
        {
          __output.byte((word)1) = 0x22;
        }
        else
        {
          testStepErrorInTestSystem(0, __cEmpty, "Index out of range. Unable to set byte %lld in message. Please check input parameter.", (int64)1);
          __testStepInitOk = 0;
        }
        ReportByteIndex("", 2, __cArray, elCount(__cArray));
        snprintf(__cArray2, 8192, "%s", __cArray);
        snprintf(__cArray3, 8192, "%s", "");
        
        ReportTableRow(__tableHandle, 0, __cArray2, __cAOp, 0xF1, __cArray3, __oneOfFlag, __bSetInCheckAlignment);
        
        if (2 >= 0 && 2 < 64)
        {
          __output.byte((word)2) = 0xF1;
        }
        else
        {
          testStepErrorInTestSystem(0, __cEmpty, "Index out of range. Unable to set byte %lld in message. Please check input parameter.", (int64)2);
          __testStepInitOk = 0;
        }
        ReportByteIndex("", 3, __cArray, elCount(__cArray));
        snprintf(__cArray2, 8192, "%s", __cArray);
        snprintf(__cArray3, 8192, "%s", "");
        
        ReportTableRow(__tableHandle, 0, __cArray2, __cAOp, 0xA2, __cArray3, __oneOfFlag, __bSetInCheckAlignment);
        
        if (3 >= 0 && 3 < 64)
        {
          __output.byte((word)3) = 0xA2;
        }
        else
        {
          testStepErrorInTestSystem(0, __cEmpty, "Index out of range. Unable to set byte %lld in message. Please check input parameter.", (int64)3);
          __testStepInitOk = 0;
        }
      
        ReportTableEndTestStep(__tableHandle, "Req1");
      }
      if (__testStepInitOk)
      {
        output(__output);
      }
    }
    if (__timeout <= 0)
    {
      testStepErrorInTestSystem(0, "1", "Unable to wait for %.3f %s. Please check input parameter.", __timeout / ((float)1000000), "ms");
    }
    else
    {
      __tt0cnt_17 = 0;
      snprintf(__cArray, elCount(__cArray), "CAN message '%s' ID = 417001888x (0x18DAF1A0x) on bus FDCAN2", "DIAGNOSTIC_RESPONSE_PAM");
      if(SetBusContextByName("FDCAN2", __eSaveCurrent, __nBusContextNew, __nBusContextOld))
        testJoinMessageEvent(`FDCAN2::`DIAGNOSTIC_RESPONSE_PAM,  __cArray,
             delegate dword(message * __m)
             {
               dword __msg_callback_ret;
               if (__tt0cnt_17 == -1)
               {
                 return 1;
               }
               __msg_callback_ret = 1;
               __tt0cnt_17++;
               if (__msg_callback_ret)
               {
                 __tt0cnt_17 = -1;
                 return 1;
               }
               return 0;
             });
      __res = testWaitForAllJoinedEventsNS(__timeout);
      if (__nInt64 != 0)
      {
        snprintf(__cArray, elCount(__cArray), "CAN message '%s' ID = 417001888x (0x18DAF1A0x) on bus FDCAN2", "DIAGNOSTIC_RESPONSE_PAM");
        if(__tt0cnt_17 == -1)
        {
          snprintf(__cArray2, 8192, "Response of %s", __cArray);
        }
        else
        {
          snprintf(__cArray2, 8192, "Response of %s (received %d times)", __cArray, __tt0cnt_17);
        }
        if (__tt0cnt_17 == 0)
        {
          testStepFail(0, "Resp1", __cArray2);
        }
        else
        {
          testStepPass(2, "Resp1", __cArray2);
        }
        __ReportRequestResponseResult(__res, 0);
      }
      ResetBusContext(__nBusContextNew, __nBusContextOld);
    }
  }
  TestCommandEnd();

}

void Ttvccmce9_F154_DID_with_Physical_Address()
{
  stack long __tableHandle;
  TestCommandBegin(__eDiagService, __cDiagService, "", "0");
  {
    if (DiagIsFunctionalGroup("CVADAS_0001_00000000_000"))
    {
      DiagResponse * __resp;
      DiagRequest CVADAS_0001_00000000_000._22F154_Hardware_Supplier_Identification __req;
      __diagServicevccmce9_19(__req, __resp);
    }
    else
    {
      DiagResponse CVADAS_0001_00000000_000.* __resp;
      DiagRequest CVADAS_0001_00000000_000._22F154_Hardware_Supplier_Identification __req;
      __diagServicevccmce9_19(__req, __resp);
    }
  }
  TestCommandEnd();


}

  
void __diagServicevccmce9_19(DiagRequest * __req, DiagResponse * __resp )
{
  stack long __tableHandle;
  long __res, __paramLen, __bytePos;

   __bVerdict = __eVerdictPass;

  do {
    TestReportResetDiagObjectList();
    DiagSetReportDetailLevel("CVADAS_0001_00000000_000", EnumServiceDetails_onfail);
    // Request aspect
    {

      if (0 >= DiagSendReqAndWaitForResp("CVADAS_0001_00000000_000", __req, __resp, __res, -1, -1, -1, -1, -1, EnumResult_pos, EnumServiceDetails_onfail, EnumSendingMode_physical, EnumSuppressPosResBit_asconfigured, EnumVerdictOnInvalidValues_fail))
        break;
    }

    __res = DiagErrCodeTestStep(__res, "Can't retrieve last response for request! No check possible.") < 0;
    if(__res)
    {
	  __bVerdict = __eVerdictFail;
      break;
    }
    {
      __res = DiagInterpretAs(__resp, "RDBI_PR");
      if(__res != 0)
      {
        __bVerdict = __eVerdictFail;
        DiagErrCodeTestStep(__res, "Can't interpret response as diagnostic primitive 'RDBI_PR'.");
        break;
      }
      else
      {
        TestStepPass( "Received primitive can be interpreted as diagnostic primitive 'RDBI_PR'.");
      }
    }
  }
  while(0);


  // Response, check & read aspect
  {
    __res = 1;
    __tableHandle = ReportTableHead5Columns(__cCheckCaption, __cTSym, __cTOp, __cRefVal, __cActual, __cRes);
    {
      __bDiagValueArrayCtr = DiagGetParameterErrorHandled(__resp, "_Hardware_Supplier_Identification_24", __bDiagValueArray, elcount(__bDiagValueArray), __cDiagValueArray, elcount(__cDiagValueArray));
      {
        __bSetInCheckAlignment = 1;	
        {
          __bArrayCtr = __CopyBytes(__bDiagValueArray, __bDiagValueArrayCtr, __bArray);
          {
            sysvar * __systemVariable;
            __systemVariable = sysvarData::`PartNumber::`Part_Number;
            CheckSysVarSetBufferConsistency(sysSetVariableData(sysvarData::`PartNumber::`Part_Number, __bArray, __bArrayCtr), __systemVariable.name);
          }
          snprintf(__cArray, 8192, "%s", "Part_Number");
          snprintf(__cArray2, 8192, "%s '%s'", __cSysVar, __cArray);
          snprintf(__cArray3, 8192, "%s", "_Hardware_Supplier_Identification_24");
          
          ReportTableRow(__tableHandle, 0, __cArray2, __cAOp, __bArray, __bArrayCtr, __cArray3, __oneOfFlag, __bSetInCheckAlignment);
        
        }
    
        __bSetInCheckAlignment = 0;
      }
    }
    ReportTableEndVerdict(__tableHandle, __cEvaluateResponse, __res);
	__bVerdict = __bVerdict && __res;
  }
  if (__bVerdict == __eVerdictFail)
    TestReportWriteDiagObjectList();
}

void Ttvccmce9_F154_DID_with_Functional_Address()
{
  stack long __tableHandle;
  TestCommandBegin(__eDiagService, __cDiagService, "", "0");
  {
    if (DiagIsFunctionalGroup("CVADAS_0001_00000000_000"))
    {
      DiagResponse * __resp;
      DiagRequest CVADAS_0001_00000000_000._22F154_Hardware_Supplier_Identification __req;
      __diagServicevccmce9_20(__req, __resp);
    }
    else
    {
      DiagResponse CVADAS_0001_00000000_000.* __resp;
      DiagRequest CVADAS_0001_00000000_000._22F154_Hardware_Supplier_Identification __req;
      __diagServicevccmce9_20(__req, __resp);
    }
  }
  TestCommandEnd();


}

  
void __diagServicevccmce9_20(DiagRequest * __req, DiagResponse * __resp )
{
  stack long __tableHandle;
  long __res, __paramLen, __bytePos;

   __bVerdict = __eVerdictPass;

  do {
    TestReportResetDiagObjectList();
    DiagSetReportDetailLevel("CVADAS_0001_00000000_000", EnumServiceDetails_onfail);
    // Request aspect
    {

      if (0 >= DiagSendReqAndWaitForResp("CVADAS_0001_00000000_000", __req, __resp, __res, -1, -1, -1, -1, -1, EnumResult_pos, EnumServiceDetails_onfail, EnumSendingMode_physical, EnumSuppressPosResBit_asconfigured, EnumVerdictOnInvalidValues_fail))
        break;
    }

    __res = DiagErrCodeTestStep(__res, "Can't retrieve last response for request! No check possible.") < 0;
    if(__res)
    {
	  __bVerdict = __eVerdictFail;
      break;
    }
    {
      __res = DiagInterpretAs(__resp, "RDBI_PR");
      if(__res != 0)
      {
        __bVerdict = __eVerdictFail;
        DiagErrCodeTestStep(__res, "Can't interpret response as diagnostic primitive 'RDBI_PR'.");
        break;
      }
      else
      {
        TestStepPass( "Received primitive can be interpreted as diagnostic primitive 'RDBI_PR'.");
      }
    }
  }
  while(0);


  // Response, check & read aspect
  {
    __res = 1;
    __tableHandle = ReportTableHead5Columns(__cCheckCaption, __cTSym, __cTOp, __cRefVal, __cActual, __cRes);
    {
      __bDiagValueArrayCtr = DiagGetParameterErrorHandled(__resp, "_Hardware_Supplier_Identification_24", __bDiagValueArray, elcount(__bDiagValueArray), __cDiagValueArray, elcount(__cDiagValueArray));
      {
        __bSetInCheckAlignment = 1;	
        {
          __bArrayCtr = __CopyBytes(__bDiagValueArray, __bDiagValueArrayCtr, __bArray);
          {
            sysvar * __systemVariable;
            __systemVariable = sysvarData::`PartNumber::`Part_Number;
            CheckSysVarSetBufferConsistency(sysSetVariableData(sysvarData::`PartNumber::`Part_Number, __bArray, __bArrayCtr), __systemVariable.name);
          }
          snprintf(__cArray, 8192, "%s", "Part_Number");
          snprintf(__cArray2, 8192, "%s '%s'", __cSysVar, __cArray);
          snprintf(__cArray3, 8192, "%s", "_Hardware_Supplier_Identification_24");
          
          ReportTableRow(__tableHandle, 0, __cArray2, __cAOp, __bArray, __bArrayCtr, __cArray3, __oneOfFlag, __bSetInCheckAlignment);
        
        }
    
        __bSetInCheckAlignment = 0;
      }
    }
    ReportTableEndVerdict(__tableHandle, __cEvaluateResponse, __res);
	__bVerdict = __bVerdict && __res;
  }
  if (__bVerdict == __eVerdictFail)
    TestReportWriteDiagObjectList();
}

void Ttvccmce9_F154_DID_with_Standard_Physical_Address()
{
  stack long __tableHandle;
  TestCommandBegin(__eRequestResponse, __cRequestResponse, "", "0");
  {
  
    long __res;
    int64 __timeout;
    __res = 0;
    __nInt64 = 1;
    __timeout = syspar::`P2_Server * 1000000LL;
    {
    
      long __testStepInitOk;
      message `FDCAN2::`DIAGNOSTIC_REQUEST_PAM __output;
      message `FDCAN2::`DIAGNOSTIC_REQUEST_PAM __msgOrig;
      __output = __msgOrig;
      __testStepInitOk = 1;
      snprintf(__cArray, elCount(__cArray), "CAN message '%s' ID = 416981233x (0x18DAA0F1x) on bus FDCAN2", "DIAGNOSTIC_REQUEST_PAM");
      snprintf(__cArray2, elCount(__cArray2), "Send %s", __cArray);
      __tableHandle = ReportTableHead3Columns(__cArray2, "Byte", __cTOp, __cAssigned);
      ReportByteIndex("", 0, __cArray, elCount(__cArray));
      snprintf(__cArray2, 8192, "%s", __cArray);
      snprintf(__cArray3, 8192, "%s", "");
      
      ReportTableRow(__tableHandle, 0, __cArray2, __cAOp, 0x3, __cArray3, __oneOfFlag, __bSetInCheckAlignment);
      
      if (0 >= 0 && 0 < 64)
      {
        __output.byte((word)0) = 0x3;
      }
      else
      {
        testStepErrorInTestSystem(0, __cEmpty, "Index out of range. Unable to set byte %lld in message. Please check input parameter.", (int64)0);
        __testStepInitOk = 0;
      }
      ReportByteIndex("", 1, __cArray, elCount(__cArray));
      snprintf(__cArray2, 8192, "%s", __cArray);
      snprintf(__cArray3, 8192, "%s", "");
      
      ReportTableRow(__tableHandle, 0, __cArray2, __cAOp, 0x22, __cArray3, __oneOfFlag, __bSetInCheckAlignment);
      
      if (1 >= 0 && 1 < 64)
      {
        __output.byte((word)1) = 0x22;
      }
      else
      {
        testStepErrorInTestSystem(0, __cEmpty, "Index out of range. Unable to set byte %lld in message. Please check input parameter.", (int64)1);
        __testStepInitOk = 0;
      }
      ReportByteIndex("", 2, __cArray, elCount(__cArray));
      snprintf(__cArray2, 8192, "%s", __cArray);
      snprintf(__cArray3, 8192, "%s", "");
      
      ReportTableRow(__tableHandle, 0, __cArray2, __cAOp, 0xF1, __cArray3, __oneOfFlag, __bSetInCheckAlignment);
      
      if (2 >= 0 && 2 < 64)
      {
        __output.byte((word)2) = 0xF1;
      }
      else
      {
        testStepErrorInTestSystem(0, __cEmpty, "Index out of range. Unable to set byte %lld in message. Please check input parameter.", (int64)2);
        __testStepInitOk = 0;
      }
      ReportByteIndex("", 3, __cArray, elCount(__cArray));
      snprintf(__cArray2, 8192, "%s", __cArray);
      snprintf(__cArray3, 8192, "%s", "");
      
      ReportTableRow(__tableHandle, 0, __cArray2, __cAOp, 0x54, __cArray3, __oneOfFlag, __bSetInCheckAlignment);
      
      if (3 >= 0 && 3 < 64)
      {
        __output.byte((word)3) = 0x54;
      }
      else
      {
        testStepErrorInTestSystem(0, __cEmpty, "Index out of range. Unable to set byte %lld in message. Please check input parameter.", (int64)3);
        __testStepInitOk = 0;
      }
    
      ReportTableEndTestStep(__tableHandle, "Req1");
      if (__testStepInitOk)
      {
        output(__output);
      }
    }
    if (__timeout <= 0)
    {
      testStepErrorInTestSystem(0, "1", "Unable to wait for %.3f %s. Please check input parameter.", __timeout / ((float)1000000), "ms");
    }
    else
    {
      __tt0cnt_19 = 0;
      snprintf(__cArray, elCount(__cArray), "CAN message '%s' ID = 417001888x (0x18DAF1A0x) on bus FDCAN2", "DIAGNOSTIC_RESPONSE_PAM");
      if(SetBusContextByName("FDCAN2", __eSaveCurrent, __nBusContextNew, __nBusContextOld))
        testJoinMessageEvent(`FDCAN2::`DIAGNOSTIC_RESPONSE_PAM,  __cArray,
             delegate dword(message * __m)
             {
               dword __msg_callback_ret;
               if (__tt0cnt_19 == -1)
               {
                 return 1;
               }
               __msg_callback_ret = 1;
               __tt0cnt_19++;
               if (__msg_callback_ret)
               {
                 __tt0cnt_19 = -1;
                 return 1;
               }
               return 0;
             });
      __res = testWaitForAllJoinedEventsNS(__timeout);
      if (__nInt64 != 0)
      {
        snprintf(__cArray, elCount(__cArray), "CAN message '%s' ID = 417001888x (0x18DAF1A0x) on bus FDCAN2", "DIAGNOSTIC_RESPONSE_PAM");
        if(__tt0cnt_19 == -1)
        {
          snprintf(__cArray2, 8192, "Response of %s", __cArray);
        }
        else
        {
          snprintf(__cArray2, 8192, "Response of %s (received %d times)", __cArray, __tt0cnt_19);
        }
        if (__tt0cnt_19 == 0)
        {
          testStepFail(0, "Resp1", __cArray2);
        }
        else
        {
          testStepPass(2, "Resp1", __cArray2);
        }
        __ReportRequestResponseResult(__res, 0);
      }
      ResetBusContext(__nBusContextNew, __nBusContextOld);
    }
  }
  TestCommandEnd();

}

void Ttvccmce9_F155_DID_with_Physical_Address()
{
  stack long __tableHandle;
  TestCommandBegin(__eDiagService, __cDiagService, "", "0");
  {
    if (DiagIsFunctionalGroup("CVADAS_0001_00000000_000"))
    {
      DiagResponse * __resp;
      DiagRequest CVADAS_0001_00000000_000._22F155_Software_Supplier_Identification __req;
      __diagServicevccmce9_21(__req, __resp);
    }
    else
    {
      DiagResponse CVADAS_0001_00000000_000.* __resp;
      DiagRequest CVADAS_0001_00000000_000._22F155_Software_Supplier_Identification __req;
      __diagServicevccmce9_21(__req, __resp);
    }
  }
  TestCommandEnd();


}

  
void __diagServicevccmce9_21(DiagRequest * __req, DiagResponse * __resp )
{
  stack long __tableHandle;
  long __res, __paramLen, __bytePos;

   __bVerdict = __eVerdictPass;

  do {
    TestReportResetDiagObjectList();
    DiagSetReportDetailLevel("CVADAS_0001_00000000_000", EnumServiceDetails_onfail);
    // Request aspect
    {

      if (0 >= DiagSendReqAndWaitForResp("CVADAS_0001_00000000_000", __req, __resp, __res, -1, -1, -1, -1, -1, EnumResult_pos, EnumServiceDetails_onfail, EnumSendingMode_functional, EnumSuppressPosResBit_asconfigured, EnumVerdictOnInvalidValues_fail))
        break;
    }

    __res = DiagErrCodeTestStep(__res, "Can't retrieve last response for request! No check possible.") < 0;
    if(__res)
    {
	  __bVerdict = __eVerdictFail;
      break;
    }
    {
      __res = DiagInterpretAs(__resp, "RDBI_PR");
      if(__res != 0)
      {
        __bVerdict = __eVerdictFail;
        DiagErrCodeTestStep(__res, "Can't interpret response as diagnostic primitive 'RDBI_PR'.");
        break;
      }
      else
      {
        TestStepPass( "Received primitive can be interpreted as diagnostic primitive 'RDBI_PR'.");
      }
    }
  }
  while(0);


  // Response, check & read aspect
  {
    __res = 1;
    __tableHandle = ReportTableHead5Columns(__cCheckCaption, __cTSym, __cTOp, __cRefVal, __cActual, __cRes);
    {
      __bDiagValueArrayCtr = DiagGetParameterErrorHandled(__resp, "_Software_Supplier_Identification_24", __bDiagValueArray, elcount(__bDiagValueArray), __cDiagValueArray, elcount(__cDiagValueArray));
      {
        __bSetInCheckAlignment = 1;	
        {
          __bArrayCtr = __CopyBytes(__bDiagValueArray, __bDiagValueArrayCtr, __bArray);
          {
            sysvar * __systemVariable;
            __systemVariable = sysvarData::`PartNumber::`Part_Number;
            CheckSysVarSetBufferConsistency(sysSetVariableData(sysvarData::`PartNumber::`Part_Number, __bArray, __bArrayCtr), __systemVariable.name);
          }
          snprintf(__cArray, 8192, "%s", "Part_Number");
          snprintf(__cArray2, 8192, "%s '%s'", __cSysVar, __cArray);
          snprintf(__cArray3, 8192, "%s", "_Software_Supplier_Identification_24");
          
          ReportTableRow(__tableHandle, 0, __cArray2, __cAOp, __bArray, __bArrayCtr, __cArray3, __oneOfFlag, __bSetInCheckAlignment);
        
        }
    
        __bSetInCheckAlignment = 0;
      }
    }
    ReportTableEndVerdict(__tableHandle, __cEvaluateResponse, __res);
	__bVerdict = __bVerdict && __res;
  }
  if (__bVerdict == __eVerdictFail)
    TestReportWriteDiagObjectList();
}

void Ttvccmce9_F155_DID_with_Functional_Address()
{
  stack long __tableHandle;
  TestCommandBegin(__eDiagService, __cDiagService, "", "0");
  {
    if (DiagIsFunctionalGroup("CVADAS_0001_00000000_000"))
    {
      DiagResponse * __resp;
      DiagRequest CVADAS_0001_00000000_000._22F155_Software_Supplier_Identification __req;
      __diagServicevccmce9_22(__req, __resp);
    }
    else
    {
      DiagResponse CVADAS_0001_00000000_000.* __resp;
      DiagRequest CVADAS_0001_00000000_000._22F155_Software_Supplier_Identification __req;
      __diagServicevccmce9_22(__req, __resp);
    }
  }
  TestCommandEnd();


}

  
void __diagServicevccmce9_22(DiagRequest * __req, DiagResponse * __resp )
{
  stack long __tableHandle;
  long __res, __paramLen, __bytePos;

   __bVerdict = __eVerdictPass;

  do {
    TestReportResetDiagObjectList();
    DiagSetReportDetailLevel("CVADAS_0001_00000000_000", EnumServiceDetails_onfail);
    // Request aspect
    {

      if (0 >= DiagSendReqAndWaitForResp("CVADAS_0001_00000000_000", __req, __resp, __res, -1, -1, -1, -1, -1, EnumResult_pos, EnumServiceDetails_onfail, EnumSendingMode_physical, EnumSuppressPosResBit_asconfigured, EnumVerdictOnInvalidValues_fail))
        break;
    }

    __res = DiagErrCodeTestStep(__res, "Can't retrieve last response for request! No check possible.") < 0;
    if(__res)
    {
	  __bVerdict = __eVerdictFail;
      break;
    }
    {
      __res = DiagInterpretAs(__resp, "RDBI_PR");
      if(__res != 0)
      {
        __bVerdict = __eVerdictFail;
        DiagErrCodeTestStep(__res, "Can't interpret response as diagnostic primitive 'RDBI_PR'.");
        break;
      }
      else
      {
        TestStepPass( "Received primitive can be interpreted as diagnostic primitive 'RDBI_PR'.");
      }
    }
  }
  while(0);


  // Response, check & read aspect
  {
    __res = 1;
    __tableHandle = ReportTableHead5Columns(__cCheckCaption, __cTSym, __cTOp, __cRefVal, __cActual, __cRes);
    {
      __bDiagValueArrayCtr = DiagGetParameterErrorHandled(__resp, "_Software_Supplier_Identification_24", __bDiagValueArray, elcount(__bDiagValueArray), __cDiagValueArray, elcount(__cDiagValueArray));
      {
        __bSetInCheckAlignment = 1;	
        {
          __bArrayCtr = __CopyBytes(__bDiagValueArray, __bDiagValueArrayCtr, __bArray);
          {
            sysvar * __systemVariable;
            __systemVariable = sysvarData::`PartNumber::`Part_Number;
            CheckSysVarSetBufferConsistency(sysSetVariableData(sysvarData::`PartNumber::`Part_Number, __bArray, __bArrayCtr), __systemVariable.name);
          }
          snprintf(__cArray, 8192, "%s", "Part_Number");
          snprintf(__cArray2, 8192, "%s '%s'", __cSysVar, __cArray);
          snprintf(__cArray3, 8192, "%s", "_Software_Supplier_Identification_24");
          
          ReportTableRow(__tableHandle, 0, __cArray2, __cAOp, __bArray, __bArrayCtr, __cArray3, __oneOfFlag, __bSetInCheckAlignment);
        
        }
    
        __bSetInCheckAlignment = 0;
      }
    }
    ReportTableEndVerdict(__tableHandle, __cEvaluateResponse, __res);
	__bVerdict = __bVerdict && __res;
  }
  if (__bVerdict == __eVerdictFail)
    TestReportWriteDiagObjectList();
}

void Ttvccmce9_F155_DID_with_Standard_Physical_Address()
{
  stack long __tableHandle;
  TestCommandBegin(__eRequestResponse, __cRequestResponse, "", "0");
  {
  
    long __res;
    int64 __timeout;
    __res = 0;
    __nInt64 = 1;
    __timeout = syspar::`P2_Server * 1000000LL;
    {
    
      long __testStepInitOk;
      message `FDCAN2::`DIAGNOSTIC_REQUEST_PAM __output;
      message `FDCAN2::`DIAGNOSTIC_REQUEST_PAM __msgOrig;
      __output = __msgOrig;
      __testStepInitOk = 1;
      {
        int64 __dlc;
        __dlc = 4;
        if (__dlc >= 0 && __dlc <= (__output.EDL ? 15 : 8))
          __output.DLC = __dlc;
        else
        {
          testStepErrorInTestSystem(0, __cEmpty, "Unable to set DLC=%lld in message. Please check input parameter.", __dlc);
          __testStepInitOk = 0;
        }
      }
      if (__testStepInitOk)
      {
        snprintf(__cArray, elCount(__cArray), "CAN message '%s' ID = 416981233x (0x18DAA0F1x) on bus FDCAN2", "DIAGNOSTIC_REQUEST_PAM");
        snprintf(__cArray2, elCount(__cArray2), "Send %s", __cArray);
        __tableHandle = ReportTableHead3Columns(__cArray2, "Byte", __cTOp, __cAssigned);
        ReportByteIndex("", 0, __cArray, elCount(__cArray));
        snprintf(__cArray2, 8192, "%s", __cArray);
        snprintf(__cArray3, 8192, "%s", "");
        
        ReportTableRow(__tableHandle, 0, __cArray2, __cAOp, 0x3, __cArray3, __oneOfFlag, __bSetInCheckAlignment);
        
        if (0 >= 0 && 0 < 64)
        {
          __output.byte((word)0) = 0x3;
        }
        else
        {
          testStepErrorInTestSystem(0, __cEmpty, "Index out of range. Unable to set byte %lld in message. Please check input parameter.", (int64)0);
          __testStepInitOk = 0;
        }
        ReportByteIndex("", 1, __cArray, elCount(__cArray));
        snprintf(__cArray2, 8192, "%s", __cArray);
        snprintf(__cArray3, 8192, "%s", "");
        
        ReportTableRow(__tableHandle, 0, __cArray2, __cAOp, 0x22, __cArray3, __oneOfFlag, __bSetInCheckAlignment);
        
        if (1 >= 0 && 1 < 64)
        {
          __output.byte((word)1) = 0x22;
        }
        else
        {
          testStepErrorInTestSystem(0, __cEmpty, "Index out of range. Unable to set byte %lld in message. Please check input parameter.", (int64)1);
          __testStepInitOk = 0;
        }
        ReportByteIndex("", 2, __cArray, elCount(__cArray));
        snprintf(__cArray2, 8192, "%s", __cArray);
        snprintf(__cArray3, 8192, "%s", "");
        
        ReportTableRow(__tableHandle, 0, __cArray2, __cAOp, 0xF1, __cArray3, __oneOfFlag, __bSetInCheckAlignment);
        
        if (2 >= 0 && 2 < 64)
        {
          __output.byte((word)2) = 0xF1;
        }
        else
        {
          testStepErrorInTestSystem(0, __cEmpty, "Index out of range. Unable to set byte %lld in message. Please check input parameter.", (int64)2);
          __testStepInitOk = 0;
        }
        ReportByteIndex("", 3, __cArray, elCount(__cArray));
        snprintf(__cArray2, 8192, "%s", __cArray);
        snprintf(__cArray3, 8192, "%s", "");
        
        ReportTableRow(__tableHandle, 0, __cArray2, __cAOp, 0x55, __cArray3, __oneOfFlag, __bSetInCheckAlignment);
        
        if (3 >= 0 && 3 < 64)
        {
          __output.byte((word)3) = 0x55;
        }
        else
        {
          testStepErrorInTestSystem(0, __cEmpty, "Index out of range. Unable to set byte %lld in message. Please check input parameter.", (int64)3);
          __testStepInitOk = 0;
        }
      
        ReportTableEndTestStep(__tableHandle, "Req1");
      }
      if (__testStepInitOk)
      {
        output(__output);
      }
    }
    if (__timeout <= 0)
    {
      testStepErrorInTestSystem(0, "1", "Unable to wait for %.3f %s. Please check input parameter.", __timeout / ((float)1000000), "ms");
    }
    else
    {
      __tt0cnt_21 = 0;
      snprintf(__cArray, elCount(__cArray), "CAN message '%s' ID = 417001888x (0x18DAF1A0x) on bus FDCAN2", "DIAGNOSTIC_RESPONSE_PAM");
      if(SetBusContextByName("FDCAN2", __eSaveCurrent, __nBusContextNew, __nBusContextOld))
        testJoinMessageEvent(`FDCAN2::`DIAGNOSTIC_RESPONSE_PAM,  __cArray,
             delegate dword(message * __m)
             {
               dword __msg_callback_ret;
               if (__tt0cnt_21 == -1)
               {
                 return 1;
               }
               __msg_callback_ret = 1;
               __tt0cnt_21++;
               if (__msg_callback_ret)
               {
                 __tt0cnt_21 = -1;
                 return 1;
               }
               return 0;
             });
      __res = testWaitForAllJoinedEventsNS(__timeout);
      if (__nInt64 != 0)
      {
        snprintf(__cArray, elCount(__cArray), "CAN message '%s' ID = 417001888x (0x18DAF1A0x) on bus FDCAN2", "DIAGNOSTIC_RESPONSE_PAM");
        if(__tt0cnt_21 == -1)
        {
          snprintf(__cArray2, 8192, "Response of %s", __cArray);
        }
        else
        {
          snprintf(__cArray2, 8192, "Response of %s (received %d times)", __cArray, __tt0cnt_21);
        }
        if (__tt0cnt_21 == 0)
        {
          testStepFail(0, "Resp1", __cArray2);
        }
        else
        {
          testStepPass(2, "Resp1", __cArray2);
        }
        __ReportRequestResponseResult(__res, 0);
      }
      ResetBusContext(__nBusContextNew, __nBusContextOld);
    }
  }
  TestCommandEnd();

}

void Ttvccmce9_F187_DID_with_Physical_Address()
{
  stack long __tableHandle;
  TestCommandBegin(__eDiagService, __cDiagService, "", "0");
  {
    if (DiagIsFunctionalGroup("CVADAS_0001_00000000_000"))
    {
      DiagResponse * __resp;
      DiagRequest CVADAS_0001_00000000_000._22F187_CODEP_ECU_Part_Number __req;
      __diagServicevccmce9_23(__req, __resp);
    }
    else
    {
      DiagResponse CVADAS_0001_00000000_000.* __resp;
      DiagRequest CVADAS_0001_00000000_000._22F187_CODEP_ECU_Part_Number __req;
      __diagServicevccmce9_23(__req, __resp);
    }
  }
  TestCommandEnd();


}

  
void __diagServicevccmce9_23(DiagRequest * __req, DiagResponse * __resp )
{
  stack long __tableHandle;
  long __res, __paramLen, __bytePos;

   __bVerdict = __eVerdictPass;

  do {
    TestReportResetDiagObjectList();
    DiagSetReportDetailLevel("CVADAS_0001_00000000_000", EnumServiceDetails_onfail);
    // Request aspect
    {

      if (0 >= DiagSendReqAndWaitForResp("CVADAS_0001_00000000_000", __req, __resp, __res, -1, -1, -1, -1, -1, EnumResult_pos, EnumServiceDetails_onfail, EnumSendingMode_physical, EnumSuppressPosResBit_asconfigured, EnumVerdictOnInvalidValues_fail))
        break;
    }

    __res = DiagErrCodeTestStep(__res, "Can't retrieve last response for request! No check possible.") < 0;
    if(__res)
    {
	  __bVerdict = __eVerdictFail;
      break;
    }
    {
      __res = DiagInterpretAs(__resp, "RDBI_PR");
      if(__res != 0)
      {
        __bVerdict = __eVerdictFail;
        DiagErrCodeTestStep(__res, "Can't interpret response as diagnostic primitive 'RDBI_PR'.");
        break;
      }
      else
      {
        TestStepPass( "Received primitive can be interpreted as diagnostic primitive 'RDBI_PR'.");
      }
    }
  }
  while(0);


  // Response, check & read aspect
  {
    __res = 1;
    __tableHandle = ReportTableHead5Columns(__cCheckCaption, __cTSym, __cTOp, __cRefVal, __cActual, __cRes);
    {
      __bDiagValueArrayCtr = DiagGetParameterErrorHandled(__resp, "_CODEP_ECU_Part_Number_24", __bDiagValueArray, elcount(__bDiagValueArray), __cDiagValueArray, elcount(__cDiagValueArray));
      {
        __bSetInCheckAlignment = 1;	
        {
          __bArrayCtr = __CopyBytes(__bDiagValueArray, __bDiagValueArrayCtr, __bArray);
          {
            sysvar * __systemVariable;
            __systemVariable = sysvarData::`PartNumber::`Part_Number;
            CheckSysVarSetBufferConsistency(sysSetVariableData(sysvarData::`PartNumber::`Part_Number, __bArray, __bArrayCtr), __systemVariable.name);
          }
          snprintf(__cArray, 8192, "%s", "Part_Number");
          snprintf(__cArray2, 8192, "%s '%s'", __cSysVar, __cArray);
          snprintf(__cArray3, 8192, "%s", "_CODEP_ECU_Part_Number_24");
          
          ReportTableRow(__tableHandle, 0, __cArray2, __cAOp, __bArray, __bArrayCtr, __cArray3, __oneOfFlag, __bSetInCheckAlignment);
        
        }
    
        __bSetInCheckAlignment = 0;
      }
    }
    ReportTableEndVerdict(__tableHandle, __cEvaluateResponse, __res);
	__bVerdict = __bVerdict && __res;
  }
  if (__bVerdict == __eVerdictFail)
    TestReportWriteDiagObjectList();
}

void Ttvccmce9_F187_DID_with_Functional_Address()
{
  stack long __tableHandle;
  TestCommandBegin(__eDiagService, __cDiagService, "", "0");
  {
    if (DiagIsFunctionalGroup("CVADAS_0001_00000000_000"))
    {
      DiagResponse * __resp;
      DiagRequest CVADAS_0001_00000000_000._22F187_CODEP_ECU_Part_Number __req;
      __diagServicevccmce9_24(__req, __resp);
    }
    else
    {
      DiagResponse CVADAS_0001_00000000_000.* __resp;
      DiagRequest CVADAS_0001_00000000_000._22F187_CODEP_ECU_Part_Number __req;
      __diagServicevccmce9_24(__req, __resp);
    }
  }
  TestCommandEnd();


}

  
void __diagServicevccmce9_24(DiagRequest * __req, DiagResponse * __resp )
{
  stack long __tableHandle;
  long __res, __paramLen, __bytePos;

   __bVerdict = __eVerdictPass;

  do {
    TestReportResetDiagObjectList();
    DiagSetReportDetailLevel("CVADAS_0001_00000000_000", EnumServiceDetails_onfail);
    // Request aspect
    {

      if (0 >= DiagSendReqAndWaitForResp("CVADAS_0001_00000000_000", __req, __resp, __res, -1, -1, -1, -1, -1, EnumResult_pos, EnumServiceDetails_onfail, EnumSendingMode_physical, EnumSuppressPosResBit_asconfigured, EnumVerdictOnInvalidValues_fail))
        break;
    }

    __res = DiagErrCodeTestStep(__res, "Can't retrieve last response for request! No check possible.") < 0;
    if(__res)
    {
	  __bVerdict = __eVerdictFail;
      break;
    }
    {
      __res = DiagInterpretAs(__resp, "RDBI_PR");
      if(__res != 0)
      {
        __bVerdict = __eVerdictFail;
        DiagErrCodeTestStep(__res, "Can't interpret response as diagnostic primitive 'RDBI_PR'.");
        break;
      }
      else
      {
        TestStepPass( "Received primitive can be interpreted as diagnostic primitive 'RDBI_PR'.");
      }
    }
  }
  while(0);


  // Response, check & read aspect
  {
    __res = 1;
    __tableHandle = ReportTableHead5Columns(__cCheckCaption, __cTSym, __cTOp, __cRefVal, __cActual, __cRes);
    {
      __bDiagValueArrayCtr = DiagGetParameterErrorHandled(__resp, "_CODEP_ECU_Part_Number_24", __bDiagValueArray, elcount(__bDiagValueArray), __cDiagValueArray, elcount(__cDiagValueArray));
      {
        __bSetInCheckAlignment = 1;	
        {
          __bArrayCtr = __CopyBytes(__bDiagValueArray, __bDiagValueArrayCtr, __bArray);
          {
            sysvar * __systemVariable;
            __systemVariable = sysvarData::`PartNumber::`Part_Number;
            CheckSysVarSetBufferConsistency(sysSetVariableData(sysvarData::`PartNumber::`Part_Number, __bArray, __bArrayCtr), __systemVariable.name);
          }
          snprintf(__cArray, 8192, "%s", "Part_Number");
          snprintf(__cArray2, 8192, "%s '%s'", __cSysVar, __cArray);
          snprintf(__cArray3, 8192, "%s", "_CODEP_ECU_Part_Number_24");
          
          ReportTableRow(__tableHandle, 0, __cArray2, __cAOp, __bArray, __bArrayCtr, __cArray3, __oneOfFlag, __bSetInCheckAlignment);
        
        }
    
        __bSetInCheckAlignment = 0;
      }
    }
    ReportTableEndVerdict(__tableHandle, __cEvaluateResponse, __res);
	__bVerdict = __bVerdict && __res;
  }
  if (__bVerdict == __eVerdictFail)
    TestReportWriteDiagObjectList();
}

void Ttvccmce9_F187_DID_with_Standard_Physical_Address()
{
  stack long __tableHandle;
  TestCommandBegin(__eRequestResponse, __cRequestResponse, "", "0");
  {
  
    long __res;
    int64 __timeout;
    __res = 0;
    __nInt64 = 1;
    __timeout = syspar::`P2_Server * 1000000LL;
    {
    
      long __testStepInitOk;
      message `FDCAN2::`DIAGNOSTIC_REQUEST_PAM __output;
      message `FDCAN2::`DIAGNOSTIC_REQUEST_PAM __msgOrig;
      __output = __msgOrig;
      __testStepInitOk = 1;
      {
        int64 __dlc;
        __dlc = 4;
        if (__dlc >= 0 && __dlc <= (__output.EDL ? 15 : 8))
          __output.DLC = __dlc;
        else
        {
          testStepErrorInTestSystem(0, __cEmpty, "Unable to set DLC=%lld in message. Please check input parameter.", __dlc);
          __testStepInitOk = 0;
        }
      }
      if (__testStepInitOk)
      {
        snprintf(__cArray, elCount(__cArray), "CAN message '%s' ID = 416981233x (0x18DAA0F1x) on bus FDCAN2", "DIAGNOSTIC_REQUEST_PAM");
        snprintf(__cArray2, elCount(__cArray2), "Send %s", __cArray);
        __tableHandle = ReportTableHead3Columns(__cArray2, "Byte", __cTOp, __cAssigned);
        ReportByteIndex("", 0, __cArray, elCount(__cArray));
        snprintf(__cArray2, 8192, "%s", __cArray);
        snprintf(__cArray3, 8192, "%s", "");
        
        ReportTableRow(__tableHandle, 0, __cArray2, __cAOp, 0x3, __cArray3, __oneOfFlag, __bSetInCheckAlignment);
        
        if (0 >= 0 && 0 < 64)
        {
          __output.byte((word)0) = 0x3;
        }
        else
        {
          testStepErrorInTestSystem(0, __cEmpty, "Index out of range. Unable to set byte %lld in message. Please check input parameter.", (int64)0);
          __testStepInitOk = 0;
        }
        ReportByteIndex("", 1, __cArray, elCount(__cArray));
        snprintf(__cArray2, 8192, "%s", __cArray);
        snprintf(__cArray3, 8192, "%s", "");
        
        ReportTableRow(__tableHandle, 0, __cArray2, __cAOp, 0x22, __cArray3, __oneOfFlag, __bSetInCheckAlignment);
        
        if (1 >= 0 && 1 < 64)
        {
          __output.byte((word)1) = 0x22;
        }
        else
        {
          testStepErrorInTestSystem(0, __cEmpty, "Index out of range. Unable to set byte %lld in message. Please check input parameter.", (int64)1);
          __testStepInitOk = 0;
        }
        ReportByteIndex("", 2, __cArray, elCount(__cArray));
        snprintf(__cArray2, 8192, "%s", __cArray);
        snprintf(__cArray3, 8192, "%s", "");
        
        ReportTableRow(__tableHandle, 0, __cArray2, __cAOp, 0xF1, __cArray3, __oneOfFlag, __bSetInCheckAlignment);
        
        if (2 >= 0 && 2 < 64)
        {
          __output.byte((word)2) = 0xF1;
        }
        else
        {
          testStepErrorInTestSystem(0, __cEmpty, "Index out of range. Unable to set byte %lld in message. Please check input parameter.", (int64)2);
          __testStepInitOk = 0;
        }
        ReportByteIndex("", 3, __cArray, elCount(__cArray));
        snprintf(__cArray2, 8192, "%s", __cArray);
        snprintf(__cArray3, 8192, "%s", "");
        
        ReportTableRow(__tableHandle, 0, __cArray2, __cAOp, 0x87, __cArray3, __oneOfFlag, __bSetInCheckAlignment);
        
        if (3 >= 0 && 3 < 64)
        {
          __output.byte((word)3) = 0x87;
        }
        else
        {
          testStepErrorInTestSystem(0, __cEmpty, "Index out of range. Unable to set byte %lld in message. Please check input parameter.", (int64)3);
          __testStepInitOk = 0;
        }
      
        ReportTableEndTestStep(__tableHandle, "Req1");
      }
      if (__testStepInitOk)
      {
        output(__output);
      }
    }
    if (__timeout <= 0)
    {
      testStepErrorInTestSystem(0, "1", "Unable to wait for %.3f %s. Please check input parameter.", __timeout / ((float)1000000), "ms");
    }
    else
    {
      __tt0cnt_23 = 0;
      snprintf(__cArray, elCount(__cArray), "CAN message '%s' ID = 417001888x (0x18DAF1A0x) on bus FDCAN2", "DIAGNOSTIC_RESPONSE_PAM");
      if(SetBusContextByName("FDCAN2", __eSaveCurrent, __nBusContextNew, __nBusContextOld))
        testJoinMessageEvent(`FDCAN2::`DIAGNOSTIC_RESPONSE_PAM,  __cArray,
             delegate dword(message * __m)
             {
               dword __msg_callback_ret;
               if (__tt0cnt_23 == -1)
               {
                 return 1;
               }
               __msg_callback_ret = 1;
               __tt0cnt_23++;
               if (__msg_callback_ret)
               {
                 __tt0cnt_23 = -1;
                 return 1;
               }
               return 0;
             });
      __res = testWaitForAllJoinedEventsNS(__timeout);
      if (__nInt64 != 0)
      {
        snprintf(__cArray, elCount(__cArray), "CAN message '%s' ID = 417001888x (0x18DAF1A0x) on bus FDCAN2", "DIAGNOSTIC_RESPONSE_PAM");
        if(__tt0cnt_23 == -1)
        {
          snprintf(__cArray2, 8192, "Response of %s", __cArray);
        }
        else
        {
          snprintf(__cArray2, 8192, "Response of %s (received %d times)", __cArray, __tt0cnt_23);
        }
        if (__tt0cnt_23 == 0)
        {
          testStepFail(0, "Resp1", __cArray2);
        }
        else
        {
          testStepPass(2, "Resp1", __cArray2);
        }
        __ReportRequestResponseResult(__res, 0);
      }
      ResetBusContext(__nBusContextNew, __nBusContextOld);
    }
  }
  TestCommandEnd();

}

void Ttvccmce9_F110_DID_with_Physical_Address()
{
  stack long __tableHandle;
  TestCommandBegin(__eDiagService, __cDiagService, "", "0");
  {
    if (DiagIsFunctionalGroup("CVADAS_0001_00000000_000"))
    {
      DiagResponse * __resp;
      DiagRequest CVADAS_0001_00000000_000._22F110_ECU_Diagnostic_Identification __req;
      __diagServicevccmce9_25(__req, __resp);
    }
    else
    {
      DiagResponse CVADAS_0001_00000000_000.* __resp;
      DiagRequest CVADAS_0001_00000000_000._22F110_ECU_Diagnostic_Identification __req;
      __diagServicevccmce9_25(__req, __resp);
    }
  }
  TestCommandEnd();


}

  
void __diagServicevccmce9_25(DiagRequest * __req, DiagResponse * __resp )
{
  stack long __tableHandle;
  long __res, __paramLen, __bytePos;

   __bVerdict = __eVerdictPass;

  do {
    TestReportResetDiagObjectList();
    DiagSetReportDetailLevel("CVADAS_0001_00000000_000", EnumServiceDetails_onfail);
    // Request aspect
    {

      if (0 >= DiagSendReqAndWaitForResp("CVADAS_0001_00000000_000", __req, __resp, __res, -1, -1, -1, -1, -1, EnumResult_pos, EnumServiceDetails_onfail, EnumSendingMode_physical, EnumSuppressPosResBit_asconfigured, EnumVerdictOnInvalidValues_fail))
        break;
    }

    __res = DiagErrCodeTestStep(__res, "Can't retrieve last response for request! No check possible.") < 0;
    if(__res)
    {
	  __bVerdict = __eVerdictFail;
      break;
    }
    {
      __res = DiagInterpretAs(__resp, "RDBI_PR");
      if(__res != 0)
      {
        __bVerdict = __eVerdictFail;
        DiagErrCodeTestStep(__res, "Can't interpret response as diagnostic primitive 'RDBI_PR'.");
        break;
      }
      else
      {
        TestStepPass( "Received primitive can be interpreted as diagnostic primitive 'RDBI_PR'.");
      }
    }
  }
  while(0);


  // Response, check & read aspect
  {
    __res = 1;
    __tableHandle = ReportTableHead5Columns(__cCheckCaption, __cTSym, __cTOp, __cRefVal, __cActual, __cRes);
    {
      __bDiagValueArrayCtr = DiagGetParameterErrorHandled(__resp, "_Diagnostic_Variant_24", __bDiagValueArray, elcount(__bDiagValueArray), __cDiagValueArray, elcount(__cDiagValueArray));
      {
        __bSetInCheckAlignment = 1;	
        {
          __bArrayCtr = __CopyBytes(__bDiagValueArray, __bDiagValueArrayCtr, __bArray);
          {
            sysvar * __systemVariable;
            __systemVariable = sysvarData::`PartNumber::`Part_Number;
            CheckSysVarSetBufferConsistency(sysSetVariableData(sysvarData::`PartNumber::`Part_Number, __bArray, __bArrayCtr), __systemVariable.name);
          }
          snprintf(__cArray, 8192, "%s", "Part_Number");
          snprintf(__cArray2, 8192, "%s '%s'", __cSysVar, __cArray);
          snprintf(__cArray3, 8192, "%s", "_Diagnostic_Variant_24");
          
          ReportTableRow(__tableHandle, 0, __cArray2, __cAOp, __bArray, __bArrayCtr, __cArray3, __oneOfFlag, __bSetInCheckAlignment);
        
        }
    
        __bSetInCheckAlignment = 0;
      }
    }
    {
      __bDiagValueArrayCtr = DiagGetParameterErrorHandled(__resp, "_Diagnostic_Version_40", __bDiagValueArray, elcount(__bDiagValueArray), __cDiagValueArray, elcount(__cDiagValueArray));
      {
        __bSetInCheckAlignment = 1;	
        {
          __bArrayCtr = __CopyBytes(__bDiagValueArray, __bDiagValueArrayCtr, __bArray);
          {
            sysvar * __systemVariable;
            __systemVariable = sysvarData::`PartNumber::`Part_Number;
            CheckSysVarSetBufferConsistency(sysSetVariableData(sysvarData::`PartNumber::`Part_Number, __bArray, __bArrayCtr), __systemVariable.name);
          }
          snprintf(__cArray, 8192, "%s", "Part_Number");
          snprintf(__cArray2, 8192, "%s '%s'", __cSysVar, __cArray);
          snprintf(__cArray3, 8192, "%s", "_Diagnostic_Version_40");
          
          ReportTableRow(__tableHandle, 0, __cArray2, __cAOp, __bArray, __bArrayCtr, __cArray3, __oneOfFlag, __bSetInCheckAlignment);
        
        }
    
        __bSetInCheckAlignment = 0;
      }
    }
    {
      __bDiagValueArrayCtr = DiagGetParameterErrorHandled(__resp, "_Flash_Definition_Number_FDN_72", __bDiagValueArray, elcount(__bDiagValueArray), __cDiagValueArray, elcount(__cDiagValueArray));
      {
        __bSetInCheckAlignment = 1;	
        {
          __bArrayCtr = __CopyBytes(__bDiagValueArray, __bDiagValueArrayCtr, __bArray);
          {
            sysvar * __systemVariable;
            __systemVariable = sysvarData::`PartNumber::`Part_Number;
            CheckSysVarSetBufferConsistency(sysSetVariableData(sysvarData::`PartNumber::`Part_Number, __bArray, __bArrayCtr), __systemVariable.name);
          }
          snprintf(__cArray, 8192, "%s", "Part_Number");
          snprintf(__cArray2, 8192, "%s '%s'", __cSysVar, __cArray);
          snprintf(__cArray3, 8192, "%s", "_Flash_Definition_Number_FDN_72");
          
          ReportTableRow(__tableHandle, 0, __cArray2, __cAOp, __bArray, __bArrayCtr, __cArray3, __oneOfFlag, __bSetInCheckAlignment);
        
        }
    
        __bSetInCheckAlignment = 0;
      }
    }
    {
      __bDiagValueArrayCtr = DiagGetParameterErrorHandled(__resp, "_Supplier_ID_88", __bDiagValueArray, elcount(__bDiagValueArray), __cDiagValueArray, elcount(__cDiagValueArray));
      {
        __bSetInCheckAlignment = 1;	
        {
          __bArrayCtr = __CopyBytes(__bDiagValueArray, __bDiagValueArrayCtr, __bArray);
          {
            sysvar * __systemVariable;
            __systemVariable = sysvarData::`PartNumber::`Part_Number;
            CheckSysVarSetBufferConsistency(sysSetVariableData(sysvarData::`PartNumber::`Part_Number, __bArray, __bArrayCtr), __systemVariable.name);
          }
          snprintf(__cArray, 8192, "%s", "Part_Number");
          snprintf(__cArray2, 8192, "%s '%s'", __cSysVar, __cArray);
          snprintf(__cArray3, 8192, "%s", "_Supplier_ID_88");
          
          ReportTableRow(__tableHandle, 0, __cArray2, __cAOp, __bArray, __bArrayCtr, __cArray3, __oneOfFlag, __bSetInCheckAlignment);
        
        }
    
        __bSetInCheckAlignment = 0;
      }
    }
    ReportTableEndVerdict(__tableHandle, __cEvaluateResponse, __res);
	__bVerdict = __bVerdict && __res;
  }
  if (__bVerdict == __eVerdictFail)
    TestReportWriteDiagObjectList();
}

void Ttvccmce9_F110_DID_with_Functional_Address()
{
  stack long __tableHandle;
  TestCommandBegin(__eDiagService, __cDiagService, "", "0");
  {
    if (DiagIsFunctionalGroup("CVADAS_0001_00000000_000"))
    {
      DiagResponse * __resp;
      DiagRequest CVADAS_0001_00000000_000._22F110_ECU_Diagnostic_Identification __req;
      __diagServicevccmce9_26(__req, __resp);
    }
    else
    {
      DiagResponse CVADAS_0001_00000000_000.* __resp;
      DiagRequest CVADAS_0001_00000000_000._22F110_ECU_Diagnostic_Identification __req;
      __diagServicevccmce9_26(__req, __resp);
    }
  }
  TestCommandEnd();


}

  
void __diagServicevccmce9_26(DiagRequest * __req, DiagResponse * __resp )
{
  stack long __tableHandle;
  long __res, __paramLen, __bytePos;

   __bVerdict = __eVerdictPass;

  do {
    TestReportResetDiagObjectList();
    DiagSetReportDetailLevel("CVADAS_0001_00000000_000", EnumServiceDetails_onfail);
    // Request aspect
    {

      if (0 >= DiagSendReqAndWaitForResp("CVADAS_0001_00000000_000", __req, __resp, __res, -1, -1, -1, -1, -1, EnumResult_pos, EnumServiceDetails_onfail, EnumSendingMode_physical, EnumSuppressPosResBit_asconfigured, EnumVerdictOnInvalidValues_fail))
        break;
    }

    __res = DiagErrCodeTestStep(__res, "Can't retrieve last response for request! No check possible.") < 0;
    if(__res)
    {
	  __bVerdict = __eVerdictFail;
      break;
    }
    {
      __res = DiagInterpretAs(__resp, "RDBI_PR");
      if(__res != 0)
      {
        __bVerdict = __eVerdictFail;
        DiagErrCodeTestStep(__res, "Can't interpret response as diagnostic primitive 'RDBI_PR'.");
        break;
      }
      else
      {
        TestStepPass( "Received primitive can be interpreted as diagnostic primitive 'RDBI_PR'.");
      }
    }
  }
  while(0);


  // Response, check & read aspect
  {
    __res = 1;
    __tableHandle = ReportTableHead5Columns(__cCheckCaption, __cTSym, __cTOp, __cRefVal, __cActual, __cRes);
    {
      __bDiagValueArrayCtr = DiagGetParameterErrorHandled(__resp, "_Diagnostic_Variant_24", __bDiagValueArray, elcount(__bDiagValueArray), __cDiagValueArray, elcount(__cDiagValueArray));
      {
        __bSetInCheckAlignment = 1;	
        {
          __bArrayCtr = __CopyBytes(__bDiagValueArray, __bDiagValueArrayCtr, __bArray);
          {
            sysvar * __systemVariable;
            __systemVariable = sysvarData::`PartNumber::`Part_Number;
            CheckSysVarSetBufferConsistency(sysSetVariableData(sysvarData::`PartNumber::`Part_Number, __bArray, __bArrayCtr), __systemVariable.name);
          }
          snprintf(__cArray, 8192, "%s", "Part_Number");
          snprintf(__cArray2, 8192, "%s '%s'", __cSysVar, __cArray);
          snprintf(__cArray3, 8192, "%s", "_Diagnostic_Variant_24");
          
          ReportTableRow(__tableHandle, 0, __cArray2, __cAOp, __bArray, __bArrayCtr, __cArray3, __oneOfFlag, __bSetInCheckAlignment);
        
        }
    
        __bSetInCheckAlignment = 0;
      }
    }
    {
      __bDiagValueArrayCtr = DiagGetParameterErrorHandled(__resp, "_Diagnostic_Version_40", __bDiagValueArray, elcount(__bDiagValueArray), __cDiagValueArray, elcount(__cDiagValueArray));
      {
        __bSetInCheckAlignment = 1;	
        {
          __bArrayCtr = __CopyBytes(__bDiagValueArray, __bDiagValueArrayCtr, __bArray);
          {
            sysvar * __systemVariable;
            __systemVariable = sysvarData::`PartNumber::`Part_Number;
            CheckSysVarSetBufferConsistency(sysSetVariableData(sysvarData::`PartNumber::`Part_Number, __bArray, __bArrayCtr), __systemVariable.name);
          }
          snprintf(__cArray, 8192, "%s", "Part_Number");
          snprintf(__cArray2, 8192, "%s '%s'", __cSysVar, __cArray);
          snprintf(__cArray3, 8192, "%s", "_Diagnostic_Version_40");
          
          ReportTableRow(__tableHandle, 0, __cArray2, __cAOp, __bArray, __bArrayCtr, __cArray3, __oneOfFlag, __bSetInCheckAlignment);
        
        }
    
        __bSetInCheckAlignment = 0;
      }
    }
    {
      __bDiagValueArrayCtr = DiagGetParameterErrorHandled(__resp, "_Flash_Definition_Number_FDN_72", __bDiagValueArray, elcount(__bDiagValueArray), __cDiagValueArray, elcount(__cDiagValueArray));
      {
        __bSetInCheckAlignment = 1;	
        {
          __bArrayCtr = __CopyBytes(__bDiagValueArray, __bDiagValueArrayCtr, __bArray);
          {
            sysvar * __systemVariable;
            __systemVariable = sysvarData::`PartNumber::`Part_Number;
            CheckSysVarSetBufferConsistency(sysSetVariableData(sysvarData::`PartNumber::`Part_Number, __bArray, __bArrayCtr), __systemVariable.name);
          }
          snprintf(__cArray, 8192, "%s", "Part_Number");
          snprintf(__cArray2, 8192, "%s '%s'", __cSysVar, __cArray);
          snprintf(__cArray3, 8192, "%s", "_Flash_Definition_Number_FDN_72");
          
          ReportTableRow(__tableHandle, 0, __cArray2, __cAOp, __bArray, __bArrayCtr, __cArray3, __oneOfFlag, __bSetInCheckAlignment);
        
        }
    
        __bSetInCheckAlignment = 0;
      }
    }
    {
      __bDiagValueArrayCtr = DiagGetParameterErrorHandled(__resp, "_Supplier_ID_88", __bDiagValueArray, elcount(__bDiagValueArray), __cDiagValueArray, elcount(__cDiagValueArray));
      {
        __bSetInCheckAlignment = 1;	
        {
          __bArrayCtr = __CopyBytes(__bDiagValueArray, __bDiagValueArrayCtr, __bArray);
          {
            sysvar * __systemVariable;
            __systemVariable = sysvarData::`PartNumber::`Part_Number;
            CheckSysVarSetBufferConsistency(sysSetVariableData(sysvarData::`PartNumber::`Part_Number, __bArray, __bArrayCtr), __systemVariable.name);
          }
          snprintf(__cArray, 8192, "%s", "Part_Number");
          snprintf(__cArray2, 8192, "%s '%s'", __cSysVar, __cArray);
          snprintf(__cArray3, 8192, "%s", "_Supplier_ID_88");
          
          ReportTableRow(__tableHandle, 0, __cArray2, __cAOp, __bArray, __bArrayCtr, __cArray3, __oneOfFlag, __bSetInCheckAlignment);
        
        }
    
        __bSetInCheckAlignment = 0;
      }
    }
    ReportTableEndVerdict(__tableHandle, __cEvaluateResponse, __res);
	__bVerdict = __bVerdict && __res;
  }
  if (__bVerdict == __eVerdictFail)
    TestReportWriteDiagObjectList();
}

void Ttvccmce9_F110_DID_with_Standard_Physical_Address()
{
  stack long __tableHandle;
  TestCommandBegin(__eRequestResponse, __cRequestResponse, "", "0");
  {
  
    long __res;
    int64 __timeout;
    __res = 0;
    __nInt64 = 1;
    __timeout = syspar::`P2_Server * 1000000LL;
    {
    
      long __testStepInitOk;
      message `FDCAN2::`DIAGNOSTIC_REQUEST_PAM __output;
      message `FDCAN2::`DIAGNOSTIC_REQUEST_PAM __msgOrig;
      __output = __msgOrig;
      __testStepInitOk = 1;
      {
        int64 __dlc;
        __dlc = 8;
        if (__dlc >= 0 && __dlc <= (__output.EDL ? 15 : 8))
          __output.DLC = __dlc;
        else
        {
          testStepErrorInTestSystem(0, __cEmpty, "Unable to set DLC=%lld in message. Please check input parameter.", __dlc);
          __testStepInitOk = 0;
        }
      }
      if (__testStepInitOk)
      {
        snprintf(__cArray, elCount(__cArray), "CAN message '%s' ID = 416981233x (0x18DAA0F1x) on bus FDCAN2", "DIAGNOSTIC_REQUEST_PAM");
        snprintf(__cArray2, elCount(__cArray2), "Send %s", __cArray);
        __tableHandle = ReportTableHead3Columns(__cArray2, "Byte", __cTOp, __cAssigned);
        ReportByteIndex("", 0, __cArray, elCount(__cArray));
        snprintf(__cArray2, 8192, "%s", __cArray);
        snprintf(__cArray3, 8192, "%s", "");
        
        ReportTableRow(__tableHandle, 0, __cArray2, __cAOp, 0x3, __cArray3, __oneOfFlag, __bSetInCheckAlignment);
        
        if (0 >= 0 && 0 < 64)
        {
          __output.byte((word)0) = 0x3;
        }
        else
        {
          testStepErrorInTestSystem(0, __cEmpty, "Index out of range. Unable to set byte %lld in message. Please check input parameter.", (int64)0);
          __testStepInitOk = 0;
        }
        ReportByteIndex("", 1, __cArray, elCount(__cArray));
        snprintf(__cArray2, 8192, "%s", __cArray);
        snprintf(__cArray3, 8192, "%s", "");
        
        ReportTableRow(__tableHandle, 0, __cArray2, __cAOp, 0x22, __cArray3, __oneOfFlag, __bSetInCheckAlignment);
        
        if (1 >= 0 && 1 < 64)
        {
          __output.byte((word)1) = 0x22;
        }
        else
        {
          testStepErrorInTestSystem(0, __cEmpty, "Index out of range. Unable to set byte %lld in message. Please check input parameter.", (int64)1);
          __testStepInitOk = 0;
        }
        ReportByteIndex("", 2, __cArray, elCount(__cArray));
        snprintf(__cArray2, 8192, "%s", __cArray);
        snprintf(__cArray3, 8192, "%s", "");
        
        ReportTableRow(__tableHandle, 0, __cArray2, __cAOp, 0xF1, __cArray3, __oneOfFlag, __bSetInCheckAlignment);
        
        if (2 >= 0 && 2 < 64)
        {
          __output.byte((word)2) = 0xF1;
        }
        else
        {
          testStepErrorInTestSystem(0, __cEmpty, "Index out of range. Unable to set byte %lld in message. Please check input parameter.", (int64)2);
          __testStepInitOk = 0;
        }
        ReportByteIndex("", 3, __cArray, elCount(__cArray));
        snprintf(__cArray2, 8192, "%s", __cArray);
        snprintf(__cArray3, 8192, "%s", "");
        
        ReportTableRow(__tableHandle, 0, __cArray2, __cAOp, 0x10, __cArray3, __oneOfFlag, __bSetInCheckAlignment);
        
        if (3 >= 0 && 3 < 64)
        {
          __output.byte((word)3) = 0x10;
        }
        else
        {
          testStepErrorInTestSystem(0, __cEmpty, "Index out of range. Unable to set byte %lld in message. Please check input parameter.", (int64)3);
          __testStepInitOk = 0;
        }
      
        ReportTableEndTestStep(__tableHandle, "Req1");
      }
      if (__testStepInitOk)
      {
        output(__output);
      }
    }
    if (__timeout <= 0)
    {
      testStepErrorInTestSystem(0, "1", "Unable to wait for %.3f %s. Please check input parameter.", __timeout / ((float)1000000), "ms");
    }
    else
    {
      __tt0cnt_25 = 0;
      snprintf(__cArray, elCount(__cArray), "CAN message '%s' ID = 417001888x (0x18DAF1A0x) on bus FDCAN2", "DIAGNOSTIC_RESPONSE_PAM");
      if(SetBusContextByName("FDCAN2", __eSaveCurrent, __nBusContextNew, __nBusContextOld))
        testJoinMessageEvent(`FDCAN2::`DIAGNOSTIC_RESPONSE_PAM,  __cArray,
             delegate dword(message * __m)
             {
               dword __msg_callback_ret;
               if (__tt0cnt_25 == -1)
               {
                 return 1;
               }
               __msg_callback_ret = 1;
               __tt0cnt_25++;
               if (__msg_callback_ret)
               {
                 __tt0cnt_25 = -1;
                 return 1;
               }
               return 0;
             });
      __res = testWaitForAllJoinedEventsNS(__timeout);
      if (__nInt64 != 0)
      {
        snprintf(__cArray, elCount(__cArray), "CAN message '%s' ID = 417001888x (0x18DAF1A0x) on bus FDCAN2", "DIAGNOSTIC_RESPONSE_PAM");
        if(__tt0cnt_25 == -1)
        {
          snprintf(__cArray2, 8192, "Response of %s", __cArray);
        }
        else
        {
          snprintf(__cArray2, 8192, "Response of %s (received %d times)", __cArray, __tt0cnt_25);
        }
        if (__tt0cnt_25 == 0)
        {
          testStepFail(0, "Resp1", __cArray2);
        }
        else
        {
          testStepPass(2, "Resp1", __cArray2);
        }
        __ReportRequestResponseResult(__res, 0);
      }
      ResetBusContext(__nBusContextNew, __nBusContextOld);
    }
  }
  TestCommandEnd();

}

void Ttvccmce9_F186_DID_with_PhysicalAdd_DefaultSession()
{
  stack long __tableHandle;
  TestCommandBegin(__eDiagService, __cDiagService, "", "0");
  {
    if (DiagIsFunctionalGroup("CVADAS_0001_00000000_000"))
    {
      DiagResponse * __resp;
      DiagRequest CVADAS_0001_00000000_000._22F186_Active_Diagnostic_Session __req;
      __diagServicevccmce9_27(__req, __resp);
    }
    else
    {
      DiagResponse CVADAS_0001_00000000_000.* __resp;
      DiagRequest CVADAS_0001_00000000_000._22F186_Active_Diagnostic_Session __req;
      __diagServicevccmce9_27(__req, __resp);
    }
  }
  TestCommandEnd();


}

  
void __diagServicevccmce9_27(DiagRequest * __req, DiagResponse * __resp )
{
  stack long __tableHandle;
  long __res, __paramLen, __bytePos;

   __bVerdict = __eVerdictPass;

  do {
    TestReportResetDiagObjectList();
    DiagSetReportDetailLevel("CVADAS_0001_00000000_000", EnumServiceDetails_onfail);
    // Request aspect
    {

      if (0 >= DiagSendReqAndWaitForResp("CVADAS_0001_00000000_000", __req, __resp, __res, -1, -1, -1, -1, -1, EnumResult_pos, EnumServiceDetails_onfail, EnumSendingMode_physical, EnumSuppressPosResBit_asconfigured, EnumVerdictOnInvalidValues_fail))
        break;
    }

    __res = DiagErrCodeTestStep(__res, "Can't retrieve last response for request! No check possible.") < 0;
    if(__res)
    {
	  __bVerdict = __eVerdictFail;
      break;
    }
    {
      __res = DiagInterpretAs(__resp, "RDBI_PR");
      if(__res != 0)
      {
        __bVerdict = __eVerdictFail;
        DiagErrCodeTestStep(__res, "Can't interpret response as diagnostic primitive 'RDBI_PR'.");
        break;
      }
      else
      {
        TestStepPass( "Received primitive can be interpreted as diagnostic primitive 'RDBI_PR'.");
      }
    }
  }
  while(0);


  // Response, check & read aspect
  {
    __res = 1;
    __tableHandle = ReportTableHead5Columns(__cCheckCaption, __cTSym, __cTOp, __cRefVal, __cActual, __cRes);
    {
      __bDiagValueArrayCtr = DiagGetParameterErrorHandled(__resp, "_Active_Diagnostic_Session_24", __bDiagValueArray, elcount(__bDiagValueArray), __cDiagValueArray, elcount(__cDiagValueArray));
      {
        __bSetInCheckAlignment = 1;	
        {
          __bArrayCtr = __CopyBytes(__bDiagValueArray, __bDiagValueArrayCtr, __bArray);
          {
            sysvar * __systemVariable;
            __systemVariable = sysvarData::`PartNumber::`Part_Number;
            CheckSysVarSetBufferConsistency(sysSetVariableData(sysvarData::`PartNumber::`Part_Number, __bArray, __bArrayCtr), __systemVariable.name);
          }
          snprintf(__cArray, 8192, "%s", "Part_Number");
          snprintf(__cArray2, 8192, "%s '%s'", __cSysVar, __cArray);
          snprintf(__cArray3, 8192, "%s", "_Active_Diagnostic_Session_24");
          
          ReportTableRow(__tableHandle, 0, __cArray2, __cAOp, __bArray, __bArrayCtr, __cArray3, __oneOfFlag, __bSetInCheckAlignment);
        
        }
    
        __bSetInCheckAlignment = 0;
      }
    }
    {
      __bDiagValueArrayCtr = DiagGetParameterErrorHandled(__resp, "Authentication_Status", __bDiagValueArray, elcount(__bDiagValueArray), __cDiagValueArray, elcount(__cDiagValueArray));
      {
        __bSetInCheckAlignment = 1;	
        {
          __bArrayCtr = __CopyBytes(__bDiagValueArray, __bDiagValueArrayCtr, __bArray);
          {
            sysvar * __systemVariable;
            __systemVariable = sysvarData::`PartNumber::`Part_Number;
            CheckSysVarSetBufferConsistency(sysSetVariableData(sysvarData::`PartNumber::`Part_Number, __bArray, __bArrayCtr), __systemVariable.name);
          }
          snprintf(__cArray, 8192, "%s", "Part_Number");
          snprintf(__cArray2, 8192, "%s '%s'", __cSysVar, __cArray);
          snprintf(__cArray3, 8192, "%s", "Authentication_Status");
          
          ReportTableRow(__tableHandle, 0, __cArray2, __cAOp, __bArray, __bArrayCtr, __cArray3, __oneOfFlag, __bSetInCheckAlignment);
        
        }
    
        __bSetInCheckAlignment = 0;
      }
    }
    {
      __bDiagValueArrayCtr = DiagGetParameterErrorHandled(__resp, "Bitfield/Bitfield._Active_Diagnostic_Session_of_ECU__ECU_Software_Mode_32", __bDiagValueArray, elcount(__bDiagValueArray), __cDiagValueArray, elcount(__cDiagValueArray));
      {
        __bSetInCheckAlignment = 1;	
        {
          __bArrayCtr = __CopyBytes(__bDiagValueArray, __bDiagValueArrayCtr, __bArray);
          {
            sysvar * __systemVariable;
            __systemVariable = sysvarData::`PartNumber::`Part_Number;
            CheckSysVarSetBufferConsistency(sysSetVariableData(sysvarData::`PartNumber::`Part_Number, __bArray, __bArrayCtr), __systemVariable.name);
          }
          snprintf(__cArray, 8192, "%s", "Part_Number");
          snprintf(__cArray2, 8192, "%s '%s'", __cSysVar, __cArray);
          snprintf(__cArray3, 8192, "%s", "Bitfield/Bitfield._Active_Diagnostic_Session_of_ECU__ECU_Software_Mode_32");
          
          ReportTableRow(__tableHandle, 0, __cArray2, __cAOp, __bArray, __bArrayCtr, __cArray3, __oneOfFlag, __bSetInCheckAlignment);
        
        }
    
        __bSetInCheckAlignment = 0;
      }
    }
    ReportTableEndVerdict(__tableHandle, __cEvaluateResponse, __res);
	__bVerdict = __bVerdict && __res;
  }
  if (__bVerdict == __eVerdictFail)
    TestReportWriteDiagObjectList();
}

void Ttvccmce9_F186_DID_with_Standard_Physical_Address_Default_Session()
{
  stack long __tableHandle;
  TestCommandBegin(__eRequestResponse, __cRequestResponse, "", "0");
  {
    message `FDCAN2::`DIAGNOSTIC_RESPONSE_PAM __tt0msg_26;
  
    long __res;
    int64 __timeout;
    __res = 0;
    __nInt64 = 1;
    __timeout = syspar::`P2_Server * 1000000LL;
    {
    
      long __testStepInitOk;
      message `FDCAN2::`DIAGNOSTIC_REQUEST_PAM __output;
      message `FDCAN2::`DIAGNOSTIC_REQUEST_PAM __msgOrig;
      __output = __msgOrig;
      __testStepInitOk = 1;
      {
        int64 __dlc;
        __dlc = 8;
        if (__dlc >= 0 && __dlc <= (__output.EDL ? 15 : 8))
          __output.DLC = __dlc;
        else
        {
          testStepErrorInTestSystem(0, __cEmpty, "Unable to set DLC=%lld in message. Please check input parameter.", __dlc);
          __testStepInitOk = 0;
        }
      }
      if (__testStepInitOk)
      {
        snprintf(__cArray, elCount(__cArray), "CAN message '%s' ID = 416981233x (0x18DAA0F1x) on bus FDCAN2", "DIAGNOSTIC_REQUEST_PAM");
        snprintf(__cArray2, elCount(__cArray2), "Send %s", __cArray);
        __tableHandle = ReportTableHead3Columns(__cArray2, "Byte", __cTOp, __cAssigned);
        ReportByteIndex("", 0, __cArray, elCount(__cArray));
        snprintf(__cArray2, 8192, "%s", __cArray);
        snprintf(__cArray3, 8192, "%s", "");
        
        ReportTableRow(__tableHandle, 0, __cArray2, __cAOp, 0x3, __cArray3, __oneOfFlag, __bSetInCheckAlignment);
        
        if (0 >= 0 && 0 < 64)
        {
          __output.byte((word)0) = 0x3;
        }
        else
        {
          testStepErrorInTestSystem(0, __cEmpty, "Index out of range. Unable to set byte %lld in message. Please check input parameter.", (int64)0);
          __testStepInitOk = 0;
        }
        ReportByteIndex("", 1, __cArray, elCount(__cArray));
        snprintf(__cArray2, 8192, "%s", __cArray);
        snprintf(__cArray3, 8192, "%s", "");
        
        ReportTableRow(__tableHandle, 0, __cArray2, __cAOp, 0x22, __cArray3, __oneOfFlag, __bSetInCheckAlignment);
        
        if (1 >= 0 && 1 < 64)
        {
          __output.byte((word)1) = 0x22;
        }
        else
        {
          testStepErrorInTestSystem(0, __cEmpty, "Index out of range. Unable to set byte %lld in message. Please check input parameter.", (int64)1);
          __testStepInitOk = 0;
        }
        ReportByteIndex("", 2, __cArray, elCount(__cArray));
        snprintf(__cArray2, 8192, "%s", __cArray);
        snprintf(__cArray3, 8192, "%s", "");
        
        ReportTableRow(__tableHandle, 0, __cArray2, __cAOp, 0xF1, __cArray3, __oneOfFlag, __bSetInCheckAlignment);
        
        if (2 >= 0 && 2 < 64)
        {
          __output.byte((word)2) = 0xF1;
        }
        else
        {
          testStepErrorInTestSystem(0, __cEmpty, "Index out of range. Unable to set byte %lld in message. Please check input parameter.", (int64)2);
          __testStepInitOk = 0;
        }
        ReportByteIndex("", 3, __cArray, elCount(__cArray));
        snprintf(__cArray2, 8192, "%s", __cArray);
        snprintf(__cArray3, 8192, "%s", "");
        
        ReportTableRow(__tableHandle, 0, __cArray2, __cAOp, 0x86, __cArray3, __oneOfFlag, __bSetInCheckAlignment);
        
        if (3 >= 0 && 3 < 64)
        {
          __output.byte((word)3) = 0x86;
        }
        else
        {
          testStepErrorInTestSystem(0, __cEmpty, "Index out of range. Unable to set byte %lld in message. Please check input parameter.", (int64)3);
          __testStepInitOk = 0;
        }
      
        ReportTableEndTestStep(__tableHandle, "Req1");
      }
      if (__testStepInitOk)
      {
        output(__output);
      }
    }
    if (__timeout <= 0)
    {
      testStepErrorInTestSystem(0, "1", "Unable to wait for %.3f %s. Please check input parameter.", __timeout / ((float)1000000), "ms");
    }
    else
    {
      if (0 < 0 || 64 <= 0)
      {
        testStepErrorInTestSystem(0, __cEmpty, "Index out of range. Unable to get byte %lld in message.", (int64) 0);
        __nInt64 = 0;
      }
      if (1 < 0 || 64 <= 1)
      {
        testStepErrorInTestSystem(0, __cEmpty, "Index out of range. Unable to get byte %lld in message.", (int64) 1);
        __nInt64 = 0;
      }
      if (2 < 0 || 64 <= 2)
      {
        testStepErrorInTestSystem(0, __cEmpty, "Index out of range. Unable to get byte %lld in message.", (int64) 2);
        __nInt64 = 0;
      }
      if (3 < 0 || 64 <= 3)
      {
        testStepErrorInTestSystem(0, __cEmpty, "Index out of range. Unable to get byte %lld in message.", (int64) 3);
        __nInt64 = 0;
      }
      if (4 < 0 || 64 <= 4)
      {
        testStepErrorInTestSystem(0, __cEmpty, "Index out of range. Unable to get byte %lld in message.", (int64) 4);
        __nInt64 = 0;
      }
      if (5 < 0 || 64 <= 5)
      {
        testStepErrorInTestSystem(0, __cEmpty, "Index out of range. Unable to get byte %lld in message.", (int64) 5);
        __nInt64 = 0;
      }
      if (6 < 0 || 64 <= 6)
      {
        testStepErrorInTestSystem(0, __cEmpty, "Index out of range. Unable to get byte %lld in message.", (int64) 6);
        __nInt64 = 0;
      }
      __tt0cnt_27 = 0;
      snprintf(__cArray, elCount(__cArray), "CAN message '%s' ID = 417001888x (0x18DAF1A0x) on bus FDCAN2", "DIAGNOSTIC_RESPONSE_PAM");
      if(SetBusContextByName("FDCAN2", __eSaveCurrent, __nBusContextNew, __nBusContextOld))
        testJoinMessageEvent(`FDCAN2::`DIAGNOSTIC_RESPONSE_PAM,  __cArray,
             delegate dword(message * __m)
             {
               dword __msg_callback_ret;
               byte __b0;
               byte __b1;
               byte __b2;
               byte __b3;
               byte __b4;
               byte __b5;
               byte __b6;
               if (__tt0cnt_27 == -1)
               {
                 return 1;
               }
               __tt0msg_26 = __m;
               __msg_callback_ret = 1;
               __tt0cnt_27++;
               if (0 < 0 || 64 <= 0) return 0;
               __csr = CheckSignalMatch(__tt0msg_26.byte((word)0), 0x6, "==") == 1;
               __msg_callback_ret &= __csr;
               if (1 < 0 || 64 <= 1) return 0;
               __csr = CheckSignalMatch(__tt0msg_26.byte((word)1), 0x62, "==") == 1;
               __msg_callback_ret &= __csr;
               if (2 < 0 || 64 <= 2) return 0;
               __csr = CheckSignalMatch(__tt0msg_26.byte((word)2), 0xF1, "==") == 1;
               __msg_callback_ret &= __csr;
               if (3 < 0 || 64 <= 3) return 0;
               __csr = CheckSignalMatch(__tt0msg_26.byte((word)3), 0x86, "==") == 1;
               __msg_callback_ret &= __csr;
               if (4 < 0 || 64 <= 4) return 0;
               __csr = CheckSignalMatch(__tt0msg_26.byte((word)4), 0x1, "==") == 1;
               __msg_callback_ret &= __csr;
               if (5 < 0 || 64 <= 5) return 0;
               __csr = CheckSignalMatch(__tt0msg_26.byte((word)5), 0x5, "==") == 1;
               __msg_callback_ret &= __csr;
               if (6 < 0 || 64 <= 6) return 0;
               __csr = CheckSignalMatch(__tt0msg_26.byte((word)6), 0x0, "==") == 1;
               __msg_callback_ret &= __csr;
               if (__msg_callback_ret)
               {
                 __tt0cnt_27 = -1;
                 return 1;
               }
               return 0;
             });
      __res = testWaitForAllJoinedEventsNS(__timeout);
      if (__nInt64 != 0)
      {
        snprintf(__cArray, elCount(__cArray), "CAN message '%s' ID = 417001888x (0x18DAF1A0x) on bus FDCAN2", "DIAGNOSTIC_RESPONSE_PAM");
        if(__tt0cnt_27 == -1)
        {
          snprintf(__cArray2, 8192, "Response of %s", __cArray);
        snprintf(__cArray, 8192, "%s", __cActual);
        }
        else
        {
          snprintf(__cArray2, 8192, "Response of %s (received %d times)", __cArray, __tt0cnt_27);
          snprintf(__cArray, 8192, "Last Received");
        }
        if (__tt0cnt_27 == 0)
        {
          testStepFail(0, "Resp1", __cArray2);
        }
        else
        {
          byte __b0;
          byte __b1;
          byte __b2;
          byte __b3;
          byte __b4;
          byte __b5;
          byte __b6;
          __bVerdict = __eVerdictPass;
          __tableHandle = ReportTableHead5Columns(__cArray2, "Signal/Byte", __cTOp, __cRefVal, __cArray, __cRes);
        __csr = CheckSignalMatch(__tt0msg_26.byte((word)0), 0x6, "==") == 1;
        ReportByteIndex("", 0, __cArray, elCount(__cArray));
        snprintf(__cArray2, 8192, "%s", __cArray);
        snprintf(__cArray3, 8192, "%s", "");
        ReportTableRow(__tableHandle, 0, __cArray2, "==", 0x6, __cArray3, __oneOfFlag, __bSetInCheckAlignment);
        ReportCell(__tableHandle, __tt0msg_26.byte((word)0));
        ReportCellResult(__tableHandle, __csr, __ePassFail);
          __bVerdict &= __csr;
        __csr = CheckSignalMatch(__tt0msg_26.byte((word)1), 0x62, "==") == 1;
        ReportByteIndex("", 1, __cArray, elCount(__cArray));
        snprintf(__cArray2, 8192, "%s", __cArray);
        snprintf(__cArray3, 8192, "%s", "");
        ReportTableRow(__tableHandle, 0, __cArray2, "==", 0x62, __cArray3, __oneOfFlag, __bSetInCheckAlignment);
        ReportCell(__tableHandle, __tt0msg_26.byte((word)1));
        ReportCellResult(__tableHandle, __csr, __ePassFail);
          __bVerdict &= __csr;
        __csr = CheckSignalMatch(__tt0msg_26.byte((word)2), 0xF1, "==") == 1;
        ReportByteIndex("", 2, __cArray, elCount(__cArray));
        snprintf(__cArray2, 8192, "%s", __cArray);
        snprintf(__cArray3, 8192, "%s", "");
        ReportTableRow(__tableHandle, 0, __cArray2, "==", 0xF1, __cArray3, __oneOfFlag, __bSetInCheckAlignment);
        ReportCell(__tableHandle, __tt0msg_26.byte((word)2));
        ReportCellResult(__tableHandle, __csr, __ePassFail);
          __bVerdict &= __csr;
        __csr = CheckSignalMatch(__tt0msg_26.byte((word)3), 0x86, "==") == 1;
        ReportByteIndex("", 3, __cArray, elCount(__cArray));
        snprintf(__cArray2, 8192, "%s", __cArray);
        snprintf(__cArray3, 8192, "%s", "");
        ReportTableRow(__tableHandle, 0, __cArray2, "==", 0x86, __cArray3, __oneOfFlag, __bSetInCheckAlignment);
        ReportCell(__tableHandle, __tt0msg_26.byte((word)3));
        ReportCellResult(__tableHandle, __csr, __ePassFail);
          __bVerdict &= __csr;
        __csr = CheckSignalMatch(__tt0msg_26.byte((word)4), 0x1, "==") == 1;
        ReportByteIndex("", 4, __cArray, elCount(__cArray));
        snprintf(__cArray2, 8192, "%s", __cArray);
        snprintf(__cArray3, 8192, "%s", "");
        ReportTableRow(__tableHandle, 0, __cArray2, "==", 0x1, __cArray3, __oneOfFlag, __bSetInCheckAlignment);
        ReportCell(__tableHandle, __tt0msg_26.byte((word)4));
        ReportCellResult(__tableHandle, __csr, __ePassFail);
          __bVerdict &= __csr;
        __csr = CheckSignalMatch(__tt0msg_26.byte((word)5), 0x5, "==") == 1;
        ReportByteIndex("", 5, __cArray, elCount(__cArray));
        snprintf(__cArray2, 8192, "%s", __cArray);
        snprintf(__cArray3, 8192, "%s", "");
        ReportTableRow(__tableHandle, 0, __cArray2, "==", 0x5, __cArray3, __oneOfFlag, __bSetInCheckAlignment);
        ReportCell(__tableHandle, __tt0msg_26.byte((word)5));
        ReportCellResult(__tableHandle, __csr, __ePassFail);
          __bVerdict &= __csr;
        __csr = CheckSignalMatch(__tt0msg_26.byte((word)6), 0x0, "==") == 1;
        ReportByteIndex("", 6, __cArray, elCount(__cArray));
        snprintf(__cArray2, 8192, "%s", __cArray);
        snprintf(__cArray3, 8192, "%s", "");
        ReportTableRow(__tableHandle, 0, __cArray2, "==", 0x0, __cArray3, __oneOfFlag, __bSetInCheckAlignment);
        ReportCell(__tableHandle, __tt0msg_26.byte((word)6));
        ReportCellResult(__tableHandle, __csr, __ePassFail);
          __bVerdict &= __csr;
          ReportTableEndVerdict(__tableHandle, "Resp1", __bVerdict);
        }
        __ReportRequestResponseResult(__res, 0);
      }
      ResetBusContext(__nBusContextNew, __nBusContextOld);
    }
  }
  TestCommandEnd();

}

void Ttvccmce9_F186_DID_with_PhysicalAdd_ExtendedSession()
{
  stack long __tableHandle;
  TestCommandBegin(__eDiagService, __cDiagService, "", "0");
  {
    if (DiagIsFunctionalGroup("CVADAS_0001_00000000_000"))
    {
      DiagResponse * __resp;
      DiagRequest CVADAS_0001_00000000_000._22F186_Active_Diagnostic_Session __req;
      __diagServicevccmce9_28(__req, __resp);
    }
    else
    {
      DiagResponse CVADAS_0001_00000000_000.* __resp;
      DiagRequest CVADAS_0001_00000000_000._22F186_Active_Diagnostic_Session __req;
      __diagServicevccmce9_28(__req, __resp);
    }
  }
  TestCommandEnd();


}

  
void __diagServicevccmce9_28(DiagRequest * __req, DiagResponse * __resp )
{
  stack long __tableHandle;
  long __res, __paramLen, __bytePos;

   __bVerdict = __eVerdictPass;

  do {
    TestReportResetDiagObjectList();
    DiagSetReportDetailLevel("CVADAS_0001_00000000_000", EnumServiceDetails_onfail);
    // Request aspect
    {

      if (0 >= DiagSendReqAndWaitForResp("CVADAS_0001_00000000_000", __req, __resp, __res, -1, -1, -1, -1, -1, EnumResult_pos, EnumServiceDetails_onfail, EnumSendingMode_physical, EnumSuppressPosResBit_asconfigured, EnumVerdictOnInvalidValues_fail))
        break;
    }

    __res = DiagErrCodeTestStep(__res, "Can't retrieve last response for request! No check possible.") < 0;
    if(__res)
    {
	  __bVerdict = __eVerdictFail;
      break;
    }
    {
      __res = DiagInterpretAs(__resp, "RDBI_PR");
      if(__res != 0)
      {
        __bVerdict = __eVerdictFail;
        DiagErrCodeTestStep(__res, "Can't interpret response as diagnostic primitive 'RDBI_PR'.");
        break;
      }
      else
      {
        TestStepPass( "Received primitive can be interpreted as diagnostic primitive 'RDBI_PR'.");
      }
    }
  }
  while(0);


  // Response, check & read aspect
  {
    __res = 1;
    __tableHandle = ReportTableHead5Columns(__cCheckCaption, __cTSym, __cTOp, __cRefVal, __cActual, __cRes);
    {
      __bDiagValueArrayCtr = DiagGetParameterErrorHandled(__resp, "_Active_Diagnostic_Session_24", __bDiagValueArray, elcount(__bDiagValueArray), __cDiagValueArray, elcount(__cDiagValueArray));
      {
        __bSetInCheckAlignment = 1;	
        {
          __bArrayCtr = __CopyBytes(__bDiagValueArray, __bDiagValueArrayCtr, __bArray);
          {
            sysvar * __systemVariable;
            __systemVariable = sysvarData::`PartNumber::`Part_Number;
            CheckSysVarSetBufferConsistency(sysSetVariableData(sysvarData::`PartNumber::`Part_Number, __bArray, __bArrayCtr), __systemVariable.name);
          }
          snprintf(__cArray, 8192, "%s", "Part_Number");
          snprintf(__cArray2, 8192, "%s '%s'", __cSysVar, __cArray);
          snprintf(__cArray3, 8192, "%s", "_Active_Diagnostic_Session_24");
          
          ReportTableRow(__tableHandle, 0, __cArray2, __cAOp, __bArray, __bArrayCtr, __cArray3, __oneOfFlag, __bSetInCheckAlignment);
        
        }
    
        __bSetInCheckAlignment = 0;
      }
    }
    {
      __bDiagValueArrayCtr = DiagGetParameterErrorHandled(__resp, "Authentication_Status", __bDiagValueArray, elcount(__bDiagValueArray), __cDiagValueArray, elcount(__cDiagValueArray));
      {
        __bSetInCheckAlignment = 1;	
        {
          __bArrayCtr = __CopyBytes(__bDiagValueArray, __bDiagValueArrayCtr, __bArray);
          {
            sysvar * __systemVariable;
            __systemVariable = sysvarData::`PartNumber::`Part_Number;
            CheckSysVarSetBufferConsistency(sysSetVariableData(sysvarData::`PartNumber::`Part_Number, __bArray, __bArrayCtr), __systemVariable.name);
          }
          snprintf(__cArray, 8192, "%s", "Part_Number");
          snprintf(__cArray2, 8192, "%s '%s'", __cSysVar, __cArray);
          snprintf(__cArray3, 8192, "%s", "Authentication_Status");
          
          ReportTableRow(__tableHandle, 0, __cArray2, __cAOp, __bArray, __bArrayCtr, __cArray3, __oneOfFlag, __bSetInCheckAlignment);
        
        }
    
        __bSetInCheckAlignment = 0;
      }
    }
    {
      __bDiagValueArrayCtr = DiagGetParameterErrorHandled(__resp, "Bitfield/Bitfield._Active_Diagnostic_Session_of_ECU__ECU_Software_Mode_32", __bDiagValueArray, elcount(__bDiagValueArray), __cDiagValueArray, elcount(__cDiagValueArray));
      {
        __bSetInCheckAlignment = 1;	
        {
          __bArrayCtr = __CopyBytes(__bDiagValueArray, __bDiagValueArrayCtr, __bArray);
          {
            sysvar * __systemVariable;
            __systemVariable = sysvarData::`PartNumber::`Part_Number;
            CheckSysVarSetBufferConsistency(sysSetVariableData(sysvarData::`PartNumber::`Part_Number, __bArray, __bArrayCtr), __systemVariable.name);
          }
          snprintf(__cArray, 8192, "%s", "Part_Number");
          snprintf(__cArray2, 8192, "%s '%s'", __cSysVar, __cArray);
          snprintf(__cArray3, 8192, "%s", "Bitfield/Bitfield._Active_Diagnostic_Session_of_ECU__ECU_Software_Mode_32");
          
          ReportTableRow(__tableHandle, 0, __cArray2, __cAOp, __bArray, __bArrayCtr, __cArray3, __oneOfFlag, __bSetInCheckAlignment);
        
        }
    
        __bSetInCheckAlignment = 0;
      }
    }
    ReportTableEndVerdict(__tableHandle, __cEvaluateResponse, __res);
	__bVerdict = __bVerdict && __res;
  }
  if (__bVerdict == __eVerdictFail)
    TestReportWriteDiagObjectList();
}

void Ttvccmce9_F186_DID_with_Standard_Physical_Address_Extended_Session()
{
  stack long __tableHandle;
  TestCommandBegin(__eRequestResponse, __cRequestResponse, "", "0");
  {
    message `FDCAN2::`DIAGNOSTIC_RESPONSE_PAM __tt0msg_28;
  
    long __res;
    int64 __timeout;
    __res = 0;
    __nInt64 = 1;
    __timeout = syspar::`P2_Server * 1000000LL;
    {
    
      long __testStepInitOk;
      message `FDCAN2::`DIAGNOSTIC_REQUEST_PAM __output;
      message `FDCAN2::`DIAGNOSTIC_REQUEST_PAM __msgOrig;
      __output = __msgOrig;
      __testStepInitOk = 1;
      {
        int64 __dlc;
        __dlc = 8;
        if (__dlc >= 0 && __dlc <= (__output.EDL ? 15 : 8))
          __output.DLC = __dlc;
        else
        {
          testStepErrorInTestSystem(0, __cEmpty, "Unable to set DLC=%lld in message. Please check input parameter.", __dlc);
          __testStepInitOk = 0;
        }
      }
      if (__testStepInitOk)
      {
        snprintf(__cArray, elCount(__cArray), "CAN message '%s' ID = 416981233x (0x18DAA0F1x) on bus FDCAN2", "DIAGNOSTIC_REQUEST_PAM");
        snprintf(__cArray2, elCount(__cArray2), "Send %s", __cArray);
        __tableHandle = ReportTableHead3Columns(__cArray2, "Byte", __cTOp, __cAssigned);
        ReportByteIndex("", 0, __cArray, elCount(__cArray));
        snprintf(__cArray2, 8192, "%s", __cArray);
        snprintf(__cArray3, 8192, "%s", "");
        
        ReportTableRow(__tableHandle, 0, __cArray2, __cAOp, 0x3, __cArray3, __oneOfFlag, __bSetInCheckAlignment);
        
        if (0 >= 0 && 0 < 64)
        {
          __output.byte((word)0) = 0x3;
        }
        else
        {
          testStepErrorInTestSystem(0, __cEmpty, "Index out of range. Unable to set byte %lld in message. Please check input parameter.", (int64)0);
          __testStepInitOk = 0;
        }
        ReportByteIndex("", 1, __cArray, elCount(__cArray));
        snprintf(__cArray2, 8192, "%s", __cArray);
        snprintf(__cArray3, 8192, "%s", "");
        
        ReportTableRow(__tableHandle, 0, __cArray2, __cAOp, 0x22, __cArray3, __oneOfFlag, __bSetInCheckAlignment);
        
        if (1 >= 0 && 1 < 64)
        {
          __output.byte((word)1) = 0x22;
        }
        else
        {
          testStepErrorInTestSystem(0, __cEmpty, "Index out of range. Unable to set byte %lld in message. Please check input parameter.", (int64)1);
          __testStepInitOk = 0;
        }
        ReportByteIndex("", 2, __cArray, elCount(__cArray));
        snprintf(__cArray2, 8192, "%s", __cArray);
        snprintf(__cArray3, 8192, "%s", "");
        
        ReportTableRow(__tableHandle, 0, __cArray2, __cAOp, 0xF1, __cArray3, __oneOfFlag, __bSetInCheckAlignment);
        
        if (2 >= 0 && 2 < 64)
        {
          __output.byte((word)2) = 0xF1;
        }
        else
        {
          testStepErrorInTestSystem(0, __cEmpty, "Index out of range. Unable to set byte %lld in message. Please check input parameter.", (int64)2);
          __testStepInitOk = 0;
        }
        ReportByteIndex("", 3, __cArray, elCount(__cArray));
        snprintf(__cArray2, 8192, "%s", __cArray);
        snprintf(__cArray3, 8192, "%s", "");
        
        ReportTableRow(__tableHandle, 0, __cArray2, __cAOp, 0x86, __cArray3, __oneOfFlag, __bSetInCheckAlignment);
        
        if (3 >= 0 && 3 < 64)
        {
          __output.byte((word)3) = 0x86;
        }
        else
        {
          testStepErrorInTestSystem(0, __cEmpty, "Index out of range. Unable to set byte %lld in message. Please check input parameter.", (int64)3);
          __testStepInitOk = 0;
        }
      
        ReportTableEndTestStep(__tableHandle, "Req1");
      }
      if (__testStepInitOk)
      {
        output(__output);
      }
    }
    if (__timeout <= 0)
    {
      testStepErrorInTestSystem(0, "1", "Unable to wait for %.3f %s. Please check input parameter.", __timeout / ((float)1000000), "ms");
    }
    else
    {
      if (0 < 0 || 64 <= 0)
      {
        testStepErrorInTestSystem(0, __cEmpty, "Index out of range. Unable to get byte %lld in message.", (int64) 0);
        __nInt64 = 0;
      }
      if (1 < 0 || 64 <= 1)
      {
        testStepErrorInTestSystem(0, __cEmpty, "Index out of range. Unable to get byte %lld in message.", (int64) 1);
        __nInt64 = 0;
      }
      if (2 < 0 || 64 <= 2)
      {
        testStepErrorInTestSystem(0, __cEmpty, "Index out of range. Unable to get byte %lld in message.", (int64) 2);
        __nInt64 = 0;
      }
      if (3 < 0 || 64 <= 3)
      {
        testStepErrorInTestSystem(0, __cEmpty, "Index out of range. Unable to get byte %lld in message.", (int64) 3);
        __nInt64 = 0;
      }
      if (4 < 0 || 64 <= 4)
      {
        testStepErrorInTestSystem(0, __cEmpty, "Index out of range. Unable to get byte %lld in message.", (int64) 4);
        __nInt64 = 0;
      }
      if (5 < 0 || 64 <= 5)
      {
        testStepErrorInTestSystem(0, __cEmpty, "Index out of range. Unable to get byte %lld in message.", (int64) 5);
        __nInt64 = 0;
      }
      if (6 < 0 || 64 <= 6)
      {
        testStepErrorInTestSystem(0, __cEmpty, "Index out of range. Unable to get byte %lld in message.", (int64) 6);
        __nInt64 = 0;
      }
      __tt0cnt_29 = 0;
      snprintf(__cArray, elCount(__cArray), "CAN message '%s' ID = 417001888x (0x18DAF1A0x) on bus FDCAN2", "DIAGNOSTIC_RESPONSE_PAM");
      if(SetBusContextByName("FDCAN2", __eSaveCurrent, __nBusContextNew, __nBusContextOld))
        testJoinMessageEvent(`FDCAN2::`DIAGNOSTIC_RESPONSE_PAM,  __cArray,
             delegate dword(message * __m)
             {
               dword __msg_callback_ret;
               byte __b0;
               byte __b1;
               byte __b2;
               byte __b3;
               byte __b4;
               byte __b5;
               byte __b6;
               if (__tt0cnt_29 == -1)
               {
                 return 1;
               }
               __tt0msg_28 = __m;
               __msg_callback_ret = 1;
               __tt0cnt_29++;
               if (0 < 0 || 64 <= 0) return 0;
               __csr = CheckSignalMatch(__tt0msg_28.byte((word)0), 0x6, "==") == 1;
               __msg_callback_ret &= __csr;
               if (1 < 0 || 64 <= 1) return 0;
               __csr = CheckSignalMatch(__tt0msg_28.byte((word)1), 0x62, "==") == 1;
               __msg_callback_ret &= __csr;
               if (2 < 0 || 64 <= 2) return 0;
               __csr = CheckSignalMatch(__tt0msg_28.byte((word)2), 0xF1, "==") == 1;
               __msg_callback_ret &= __csr;
               if (3 < 0 || 64 <= 3) return 0;
               __csr = CheckSignalMatch(__tt0msg_28.byte((word)3), 0x86, "==") == 1;
               __msg_callback_ret &= __csr;
               if (4 < 0 || 64 <= 4) return 0;
               __csr = CheckSignalMatch(__tt0msg_28.byte((word)4), 0x3, "==") == 1;
               __msg_callback_ret &= __csr;
               if (5 < 0 || 64 <= 5) return 0;
               __csr = CheckSignalMatch(__tt0msg_28.byte((word)5), 0x5, "==") == 1;
               __msg_callback_ret &= __csr;
               if (6 < 0 || 64 <= 6) return 0;
               __csr = CheckSignalMatch(__tt0msg_28.byte((word)6), 0x0, "==") == 1;
               __msg_callback_ret &= __csr;
               if (__msg_callback_ret)
               {
                 __tt0cnt_29 = -1;
                 return 1;
               }
               return 0;
             });
      __res = testWaitForAllJoinedEventsNS(__timeout);
      if (__nInt64 != 0)
      {
        snprintf(__cArray, elCount(__cArray), "CAN message '%s' ID = 417001888x (0x18DAF1A0x) on bus FDCAN2", "DIAGNOSTIC_RESPONSE_PAM");
        if(__tt0cnt_29 == -1)
        {
          snprintf(__cArray2, 8192, "Response of %s", __cArray);
        snprintf(__cArray, 8192, "%s", __cActual);
        }
        else
        {
          snprintf(__cArray2, 8192, "Response of %s (received %d times)", __cArray, __tt0cnt_29);
          snprintf(__cArray, 8192, "Last Received");
        }
        if (__tt0cnt_29 == 0)
        {
          testStepFail(0, "Resp1", __cArray2);
        }
        else
        {
          byte __b0;
          byte __b1;
          byte __b2;
          byte __b3;
          byte __b4;
          byte __b5;
          byte __b6;
          __bVerdict = __eVerdictPass;
          __tableHandle = ReportTableHead5Columns(__cArray2, "Signal/Byte", __cTOp, __cRefVal, __cArray, __cRes);
        __csr = CheckSignalMatch(__tt0msg_28.byte((word)0), 0x6, "==") == 1;
        ReportByteIndex("", 0, __cArray, elCount(__cArray));
        snprintf(__cArray2, 8192, "%s", __cArray);
        snprintf(__cArray3, 8192, "%s", "");
        ReportTableRow(__tableHandle, 0, __cArray2, "==", 0x6, __cArray3, __oneOfFlag, __bSetInCheckAlignment);
        ReportCell(__tableHandle, __tt0msg_28.byte((word)0));
        ReportCellResult(__tableHandle, __csr, __ePassFail);
          __bVerdict &= __csr;
        __csr = CheckSignalMatch(__tt0msg_28.byte((word)1), 0x62, "==") == 1;
        ReportByteIndex("", 1, __cArray, elCount(__cArray));
        snprintf(__cArray2, 8192, "%s", __cArray);
        snprintf(__cArray3, 8192, "%s", "");
        ReportTableRow(__tableHandle, 0, __cArray2, "==", 0x62, __cArray3, __oneOfFlag, __bSetInCheckAlignment);
        ReportCell(__tableHandle, __tt0msg_28.byte((word)1));
        ReportCellResult(__tableHandle, __csr, __ePassFail);
          __bVerdict &= __csr;
        __csr = CheckSignalMatch(__tt0msg_28.byte((word)2), 0xF1, "==") == 1;
        ReportByteIndex("", 2, __cArray, elCount(__cArray));
        snprintf(__cArray2, 8192, "%s", __cArray);
        snprintf(__cArray3, 8192, "%s", "");
        ReportTableRow(__tableHandle, 0, __cArray2, "==", 0xF1, __cArray3, __oneOfFlag, __bSetInCheckAlignment);
        ReportCell(__tableHandle, __tt0msg_28.byte((word)2));
        ReportCellResult(__tableHandle, __csr, __ePassFail);
          __bVerdict &= __csr;
        __csr = CheckSignalMatch(__tt0msg_28.byte((word)3), 0x86, "==") == 1;
        ReportByteIndex("", 3, __cArray, elCount(__cArray));
        snprintf(__cArray2, 8192, "%s", __cArray);
        snprintf(__cArray3, 8192, "%s", "");
        ReportTableRow(__tableHandle, 0, __cArray2, "==", 0x86, __cArray3, __oneOfFlag, __bSetInCheckAlignment);
        ReportCell(__tableHandle, __tt0msg_28.byte((word)3));
        ReportCellResult(__tableHandle, __csr, __ePassFail);
          __bVerdict &= __csr;
        __csr = CheckSignalMatch(__tt0msg_28.byte((word)4), 0x3, "==") == 1;
        ReportByteIndex("", 4, __cArray, elCount(__cArray));
        snprintf(__cArray2, 8192, "%s", __cArray);
        snprintf(__cArray3, 8192, "%s", "");
        ReportTableRow(__tableHandle, 0, __cArray2, "==", 0x3, __cArray3, __oneOfFlag, __bSetInCheckAlignment);
        ReportCell(__tableHandle, __tt0msg_28.byte((word)4));
        ReportCellResult(__tableHandle, __csr, __ePassFail);
          __bVerdict &= __csr;
        __csr = CheckSignalMatch(__tt0msg_28.byte((word)5), 0x5, "==") == 1;
        ReportByteIndex("", 5, __cArray, elCount(__cArray));
        snprintf(__cArray2, 8192, "%s", __cArray);
        snprintf(__cArray3, 8192, "%s", "");
        ReportTableRow(__tableHandle, 0, __cArray2, "==", 0x5, __cArray3, __oneOfFlag, __bSetInCheckAlignment);
        ReportCell(__tableHandle, __tt0msg_28.byte((word)5));
        ReportCellResult(__tableHandle, __csr, __ePassFail);
          __bVerdict &= __csr;
        __csr = CheckSignalMatch(__tt0msg_28.byte((word)6), 0x0, "==") == 1;
        ReportByteIndex("", 6, __cArray, elCount(__cArray));
        snprintf(__cArray2, 8192, "%s", __cArray);
        snprintf(__cArray3, 8192, "%s", "");
        ReportTableRow(__tableHandle, 0, __cArray2, "==", 0x0, __cArray3, __oneOfFlag, __bSetInCheckAlignment);
        ReportCell(__tableHandle, __tt0msg_28.byte((word)6));
        ReportCellResult(__tableHandle, __csr, __ePassFail);
          __bVerdict &= __csr;
          ReportTableEndVerdict(__tableHandle, "Resp1", __bVerdict);
        }
        __ReportRequestResponseResult(__res, 0);
      }
      ResetBusContext(__nBusContextNew, __nBusContextOld);
    }
  }
  TestCommandEnd();

}

void Ttvccmce9_F186_DID_with_PhysicalAdd_ProgrammingSession()
{
  stack long __tableHandle;
  TestCommandBegin(__eWait, __cWait, "", "0");
  {
    Wait("1", (1100 * 1000000LL), 1000000, "");
  }
  TestCommandEnd();

  TestCommandBegin(__eDiagService, __cDiagService, "", "1");
  {
    if (DiagIsFunctionalGroup("CVADAS_0001_00000000_000"))
    {
      DiagResponse * __resp;
      DiagRequest CVADAS_0001_00000000_000._22F186_Active_Diagnostic_Session __req;
      __diagServicevccmce9_29(__req, __resp);
    }
    else
    {
      DiagResponse CVADAS_0001_00000000_000.* __resp;
      DiagRequest CVADAS_0001_00000000_000._22F186_Active_Diagnostic_Session __req;
      __diagServicevccmce9_29(__req, __resp);
    }
  }
  TestCommandEnd();


}

  
void __diagServicevccmce9_29(DiagRequest * __req, DiagResponse * __resp )
{
  stack long __tableHandle;
  long __res, __paramLen, __bytePos;

   __bVerdict = __eVerdictPass;

  do {
    TestReportResetDiagObjectList();
    DiagSetReportDetailLevel("CVADAS_0001_00000000_000", EnumServiceDetails_onfail);
    // Request aspect
    {

      if (0 >= DiagSendReqAndWaitForResp("CVADAS_0001_00000000_000", __req, __resp, __res, -1, -1, -1, -1, -1, EnumResult_pos, EnumServiceDetails_onfail, EnumSendingMode_physical, EnumSuppressPosResBit_asconfigured, EnumVerdictOnInvalidValues_fail))
        break;
    }

    __res = DiagErrCodeTestStep(__res, "Can't retrieve last response for request! No check possible.") < 0;
    if(__res)
    {
	  __bVerdict = __eVerdictFail;
      break;
    }
    {
      __res = DiagInterpretAs(__resp, "RDBI_PR");
      if(__res != 0)
      {
        __bVerdict = __eVerdictFail;
        DiagErrCodeTestStep(__res, "Can't interpret response as diagnostic primitive 'RDBI_PR'.");
        break;
      }
      else
      {
        TestStepPass( "Received primitive can be interpreted as diagnostic primitive 'RDBI_PR'.");
      }
    }
  }
  while(0);


  // Response, check & read aspect
  {
    __res = 1;
    __tableHandle = ReportTableHead5Columns(__cCheckCaption, __cTSym, __cTOp, __cRefVal, __cActual, __cRes);
    {
      __bDiagValueArrayCtr = DiagGetParameterErrorHandled(__resp, "_Active_Diagnostic_Session_24", __bDiagValueArray, elcount(__bDiagValueArray), __cDiagValueArray, elcount(__cDiagValueArray));
      {
        __bSetInCheckAlignment = 1;	
        {
          __bArrayCtr = __CopyBytes(__bDiagValueArray, __bDiagValueArrayCtr, __bArray);
          {
            sysvar * __systemVariable;
            __systemVariable = sysvarData::`PartNumber::`Part_Number;
            CheckSysVarSetBufferConsistency(sysSetVariableData(sysvarData::`PartNumber::`Part_Number, __bArray, __bArrayCtr), __systemVariable.name);
          }
          snprintf(__cArray, 8192, "%s", "Part_Number");
          snprintf(__cArray2, 8192, "%s '%s'", __cSysVar, __cArray);
          snprintf(__cArray3, 8192, "%s", "_Active_Diagnostic_Session_24");
          
          ReportTableRow(__tableHandle, 0, __cArray2, __cAOp, __bArray, __bArrayCtr, __cArray3, __oneOfFlag, __bSetInCheckAlignment);
        
        }
    
        __bSetInCheckAlignment = 0;
      }
    }
    {
      __bDiagValueArrayCtr = DiagGetParameterErrorHandled(__resp, "Authentication_Status", __bDiagValueArray, elcount(__bDiagValueArray), __cDiagValueArray, elcount(__cDiagValueArray));
      {
        __bSetInCheckAlignment = 1;	
        {
          __bArrayCtr = __CopyBytes(__bDiagValueArray, __bDiagValueArrayCtr, __bArray);
          {
            sysvar * __systemVariable;
            __systemVariable = sysvarData::`PartNumber::`Part_Number;
            CheckSysVarSetBufferConsistency(sysSetVariableData(sysvarData::`PartNumber::`Part_Number, __bArray, __bArrayCtr), __systemVariable.name);
          }
          snprintf(__cArray, 8192, "%s", "Part_Number");
          snprintf(__cArray2, 8192, "%s '%s'", __cSysVar, __cArray);
          snprintf(__cArray3, 8192, "%s", "Authentication_Status");
          
          ReportTableRow(__tableHandle, 0, __cArray2, __cAOp, __bArray, __bArrayCtr, __cArray3, __oneOfFlag, __bSetInCheckAlignment);
        
        }
    
        __bSetInCheckAlignment = 0;
      }
    }
    {
      __bDiagValueArrayCtr = DiagGetParameterErrorHandled(__resp, "Bitfield/Bitfield._Active_Diagnostic_Session_of_ECU__ECU_Software_Mode_32", __bDiagValueArray, elcount(__bDiagValueArray), __cDiagValueArray, elcount(__cDiagValueArray));
      {
        __bSetInCheckAlignment = 1;	
        {
          __bArrayCtr = __CopyBytes(__bDiagValueArray, __bDiagValueArrayCtr, __bArray);
          {
            sysvar * __systemVariable;
            __systemVariable = sysvarData::`PartNumber::`Part_Number;
            CheckSysVarSetBufferConsistency(sysSetVariableData(sysvarData::`PartNumber::`Part_Number, __bArray, __bArrayCtr), __systemVariable.name);
          }
          snprintf(__cArray, 8192, "%s", "Part_Number");
          snprintf(__cArray2, 8192, "%s '%s'", __cSysVar, __cArray);
          snprintf(__cArray3, 8192, "%s", "Bitfield/Bitfield._Active_Diagnostic_Session_of_ECU__ECU_Software_Mode_32");
          
          ReportTableRow(__tableHandle, 0, __cArray2, __cAOp, __bArray, __bArrayCtr, __cArray3, __oneOfFlag, __bSetInCheckAlignment);
        
        }
    
        __bSetInCheckAlignment = 0;
      }
    }
    ReportTableEndVerdict(__tableHandle, __cEvaluateResponse, __res);
	__bVerdict = __bVerdict && __res;
  }
  if (__bVerdict == __eVerdictFail)
    TestReportWriteDiagObjectList();
}

void Ttvccmce9_F186_DID_with_Standard_Physical_Address_Programming_Session()
{
  stack long __tableHandle;
  TestCommandBegin(__eRequestResponse, __cRequestResponse, "", "0");
  {
    message `FDCAN2::`DIAGNOSTIC_RESPONSE_PAM __tt0msg_30;
  
    long __res;
    int64 __timeout;
    __res = 0;
    __nInt64 = 1;
    __timeout = syspar::`P2_Server * 1000000LL;
    {
    
      long __testStepInitOk;
      message `FDCAN2::`DIAGNOSTIC_REQUEST_PAM __output;
      message `FDCAN2::`DIAGNOSTIC_REQUEST_PAM __msgOrig;
      __output = __msgOrig;
      __testStepInitOk = 1;
      {
        int64 __dlc;
        __dlc = 8;
        if (__dlc >= 0 && __dlc <= (__output.EDL ? 15 : 8))
          __output.DLC = __dlc;
        else
        {
          testStepErrorInTestSystem(0, __cEmpty, "Unable to set DLC=%lld in message. Please check input parameter.", __dlc);
          __testStepInitOk = 0;
        }
      }
      if (__testStepInitOk)
      {
        snprintf(__cArray, elCount(__cArray), "CAN message '%s' ID = 416981233x (0x18DAA0F1x) on bus FDCAN2", "DIAGNOSTIC_REQUEST_PAM");
        snprintf(__cArray2, elCount(__cArray2), "Send %s", __cArray);
        __tableHandle = ReportTableHead3Columns(__cArray2, "Byte", __cTOp, __cAssigned);
        ReportByteIndex("", 0, __cArray, elCount(__cArray));
        snprintf(__cArray2, 8192, "%s", __cArray);
        snprintf(__cArray3, 8192, "%s", "");
        
        ReportTableRow(__tableHandle, 0, __cArray2, __cAOp, 0x3, __cArray3, __oneOfFlag, __bSetInCheckAlignment);
        
        if (0 >= 0 && 0 < 64)
        {
          __output.byte((word)0) = 0x3;
        }
        else
        {
          testStepErrorInTestSystem(0, __cEmpty, "Index out of range. Unable to set byte %lld in message. Please check input parameter.", (int64)0);
          __testStepInitOk = 0;
        }
        ReportByteIndex("", 1, __cArray, elCount(__cArray));
        snprintf(__cArray2, 8192, "%s", __cArray);
        snprintf(__cArray3, 8192, "%s", "");
        
        ReportTableRow(__tableHandle, 0, __cArray2, __cAOp, 0x22, __cArray3, __oneOfFlag, __bSetInCheckAlignment);
        
        if (1 >= 0 && 1 < 64)
        {
          __output.byte((word)1) = 0x22;
        }
        else
        {
          testStepErrorInTestSystem(0, __cEmpty, "Index out of range. Unable to set byte %lld in message. Please check input parameter.", (int64)1);
          __testStepInitOk = 0;
        }
        ReportByteIndex("", 2, __cArray, elCount(__cArray));
        snprintf(__cArray2, 8192, "%s", __cArray);
        snprintf(__cArray3, 8192, "%s", "");
        
        ReportTableRow(__tableHandle, 0, __cArray2, __cAOp, 0xF1, __cArray3, __oneOfFlag, __bSetInCheckAlignment);
        
        if (2 >= 0 && 2 < 64)
        {
          __output.byte((word)2) = 0xF1;
        }
        else
        {
          testStepErrorInTestSystem(0, __cEmpty, "Index out of range. Unable to set byte %lld in message. Please check input parameter.", (int64)2);
          __testStepInitOk = 0;
        }
        ReportByteIndex("", 3, __cArray, elCount(__cArray));
        snprintf(__cArray2, 8192, "%s", __cArray);
        snprintf(__cArray3, 8192, "%s", "");
        
        ReportTableRow(__tableHandle, 0, __cArray2, __cAOp, 0x86, __cArray3, __oneOfFlag, __bSetInCheckAlignment);
        
        if (3 >= 0 && 3 < 64)
        {
          __output.byte((word)3) = 0x86;
        }
        else
        {
          testStepErrorInTestSystem(0, __cEmpty, "Index out of range. Unable to set byte %lld in message. Please check input parameter.", (int64)3);
          __testStepInitOk = 0;
        }
      
        ReportTableEndTestStep(__tableHandle, "Req1");
      }
      if (__testStepInitOk)
      {
        output(__output);
      }
    }
    if (__timeout <= 0)
    {
      testStepErrorInTestSystem(0, "1", "Unable to wait for %.3f %s. Please check input parameter.", __timeout / ((float)1000000), "ms");
    }
    else
    {
      if (0 < 0 || 64 <= 0)
      {
        testStepErrorInTestSystem(0, __cEmpty, "Index out of range. Unable to get byte %lld in message.", (int64) 0);
        __nInt64 = 0;
      }
      if (1 < 0 || 64 <= 1)
      {
        testStepErrorInTestSystem(0, __cEmpty, "Index out of range. Unable to get byte %lld in message.", (int64) 1);
        __nInt64 = 0;
      }
      if (2 < 0 || 64 <= 2)
      {
        testStepErrorInTestSystem(0, __cEmpty, "Index out of range. Unable to get byte %lld in message.", (int64) 2);
        __nInt64 = 0;
      }
      if (3 < 0 || 64 <= 3)
      {
        testStepErrorInTestSystem(0, __cEmpty, "Index out of range. Unable to get byte %lld in message.", (int64) 3);
        __nInt64 = 0;
      }
      if (4 < 0 || 64 <= 4)
      {
        testStepErrorInTestSystem(0, __cEmpty, "Index out of range. Unable to get byte %lld in message.", (int64) 4);
        __nInt64 = 0;
      }
      if (5 < 0 || 64 <= 5)
      {
        testStepErrorInTestSystem(0, __cEmpty, "Index out of range. Unable to get byte %lld in message.", (int64) 5);
        __nInt64 = 0;
      }
      if (6 < 0 || 64 <= 6)
      {
        testStepErrorInTestSystem(0, __cEmpty, "Index out of range. Unable to get byte %lld in message.", (int64) 6);
        __nInt64 = 0;
      }
      __tt0cnt_31 = 0;
      snprintf(__cArray, elCount(__cArray), "CAN message '%s' ID = 417001888x (0x18DAF1A0x) on bus FDCAN2", "DIAGNOSTIC_RESPONSE_PAM");
      if(SetBusContextByName("FDCAN2", __eSaveCurrent, __nBusContextNew, __nBusContextOld))
        testJoinMessageEvent(`FDCAN2::`DIAGNOSTIC_RESPONSE_PAM,  __cArray,
             delegate dword(message * __m)
             {
               dword __msg_callback_ret;
               byte __b0;
               byte __b1;
               byte __b2;
               byte __b3;
               byte __b4;
               byte __b5;
               byte __b6;
               if (__tt0cnt_31 == -1)
               {
                 return 1;
               }
               __tt0msg_30 = __m;
               __msg_callback_ret = 1;
               __tt0cnt_31++;
               if (0 < 0 || 64 <= 0) return 0;
               __csr = CheckSignalMatch(__tt0msg_30.byte((word)0), 0x6, "==") == 1;
               __msg_callback_ret &= __csr;
               if (1 < 0 || 64 <= 1) return 0;
               __csr = CheckSignalMatch(__tt0msg_30.byte((word)1), 0x62, "==") == 1;
               __msg_callback_ret &= __csr;
               if (2 < 0 || 64 <= 2) return 0;
               __csr = CheckSignalMatch(__tt0msg_30.byte((word)2), 0xF1, "==") == 1;
               __msg_callback_ret &= __csr;
               if (3 < 0 || 64 <= 3) return 0;
               __csr = CheckSignalMatch(__tt0msg_30.byte((word)3), 0x86, "==") == 1;
               __msg_callback_ret &= __csr;
               if (4 < 0 || 64 <= 4) return 0;
               __csr = CheckSignalMatch(__tt0msg_30.byte((word)4), 0x2, "==") == 1;
               __msg_callback_ret &= __csr;
               if (5 < 0 || 64 <= 5) return 0;
               __csr = CheckSignalMatch(__tt0msg_30.byte((word)5), 0x5, "==") == 1;
               __msg_callback_ret &= __csr;
               if (6 < 0 || 64 <= 6) return 0;
               __csr = CheckSignalMatch(__tt0msg_30.byte((word)6), 0x0, "==") == 1;
               __msg_callback_ret &= __csr;
               if (__msg_callback_ret)
               {
                 __tt0cnt_31 = -1;
                 return 1;
               }
               return 0;
             });
      __res = testWaitForAllJoinedEventsNS(__timeout);
      if (__nInt64 != 0)
      {
        snprintf(__cArray, elCount(__cArray), "CAN message '%s' ID = 417001888x (0x18DAF1A0x) on bus FDCAN2", "DIAGNOSTIC_RESPONSE_PAM");
        if(__tt0cnt_31 == -1)
        {
          snprintf(__cArray2, 8192, "Response of %s", __cArray);
        snprintf(__cArray, 8192, "%s", __cActual);
        }
        else
        {
          snprintf(__cArray2, 8192, "Response of %s (received %d times)", __cArray, __tt0cnt_31);
          snprintf(__cArray, 8192, "Last Received");
        }
        if (__tt0cnt_31 == 0)
        {
          testStepFail(0, "Resp1", __cArray2);
        }
        else
        {
          byte __b0;
          byte __b1;
          byte __b2;
          byte __b3;
          byte __b4;
          byte __b5;
          byte __b6;
          __bVerdict = __eVerdictPass;
          __tableHandle = ReportTableHead5Columns(__cArray2, "Signal/Byte", __cTOp, __cRefVal, __cArray, __cRes);
        __csr = CheckSignalMatch(__tt0msg_30.byte((word)0), 0x6, "==") == 1;
        ReportByteIndex("", 0, __cArray, elCount(__cArray));
        snprintf(__cArray2, 8192, "%s", __cArray);
        snprintf(__cArray3, 8192, "%s", "");
        ReportTableRow(__tableHandle, 0, __cArray2, "==", 0x6, __cArray3, __oneOfFlag, __bSetInCheckAlignment);
        ReportCell(__tableHandle, __tt0msg_30.byte((word)0));
        ReportCellResult(__tableHandle, __csr, __ePassFail);
          __bVerdict &= __csr;
        __csr = CheckSignalMatch(__tt0msg_30.byte((word)1), 0x62, "==") == 1;
        ReportByteIndex("", 1, __cArray, elCount(__cArray));
        snprintf(__cArray2, 8192, "%s", __cArray);
        snprintf(__cArray3, 8192, "%s", "");
        ReportTableRow(__tableHandle, 0, __cArray2, "==", 0x62, __cArray3, __oneOfFlag, __bSetInCheckAlignment);
        ReportCell(__tableHandle, __tt0msg_30.byte((word)1));
        ReportCellResult(__tableHandle, __csr, __ePassFail);
          __bVerdict &= __csr;
        __csr = CheckSignalMatch(__tt0msg_30.byte((word)2), 0xF1, "==") == 1;
        ReportByteIndex("", 2, __cArray, elCount(__cArray));
        snprintf(__cArray2, 8192, "%s", __cArray);
        snprintf(__cArray3, 8192, "%s", "");
        ReportTableRow(__tableHandle, 0, __cArray2, "==", 0xF1, __cArray3, __oneOfFlag, __bSetInCheckAlignment);
        ReportCell(__tableHandle, __tt0msg_30.byte((word)2));
        ReportCellResult(__tableHandle, __csr, __ePassFail);
          __bVerdict &= __csr;
        __csr = CheckSignalMatch(__tt0msg_30.byte((word)3), 0x86, "==") == 1;
        ReportByteIndex("", 3, __cArray, elCount(__cArray));
        snprintf(__cArray2, 8192, "%s", __cArray);
        snprintf(__cArray3, 8192, "%s", "");
        ReportTableRow(__tableHandle, 0, __cArray2, "==", 0x86, __cArray3, __oneOfFlag, __bSetInCheckAlignment);
        ReportCell(__tableHandle, __tt0msg_30.byte((word)3));
        ReportCellResult(__tableHandle, __csr, __ePassFail);
          __bVerdict &= __csr;
        __csr = CheckSignalMatch(__tt0msg_30.byte((word)4), 0x2, "==") == 1;
        ReportByteIndex("", 4, __cArray, elCount(__cArray));
        snprintf(__cArray2, 8192, "%s", __cArray);
        snprintf(__cArray3, 8192, "%s", "");
        ReportTableRow(__tableHandle, 0, __cArray2, "==", 0x2, __cArray3, __oneOfFlag, __bSetInCheckAlignment);
        ReportCell(__tableHandle, __tt0msg_30.byte((word)4));
        ReportCellResult(__tableHandle, __csr, __ePassFail);
          __bVerdict &= __csr;
        __csr = CheckSignalMatch(__tt0msg_30.byte((word)5), 0x5, "==") == 1;
        ReportByteIndex("", 5, __cArray, elCount(__cArray));
        snprintf(__cArray2, 8192, "%s", __cArray);
        snprintf(__cArray3, 8192, "%s", "");
        ReportTableRow(__tableHandle, 0, __cArray2, "==", 0x5, __cArray3, __oneOfFlag, __bSetInCheckAlignment);
        ReportCell(__tableHandle, __tt0msg_30.byte((word)5));
        ReportCellResult(__tableHandle, __csr, __ePassFail);
          __bVerdict &= __csr;
        __csr = CheckSignalMatch(__tt0msg_30.byte((word)6), 0x0, "==") == 1;
        ReportByteIndex("", 6, __cArray, elCount(__cArray));
        snprintf(__cArray2, 8192, "%s", __cArray);
        snprintf(__cArray3, 8192, "%s", "");
        ReportTableRow(__tableHandle, 0, __cArray2, "==", 0x0, __cArray3, __oneOfFlag, __bSetInCheckAlignment);
        ReportCell(__tableHandle, __tt0msg_30.byte((word)6));
        ReportCellResult(__tableHandle, __csr, __ePassFail);
          __bVerdict &= __csr;
          ReportTableEndVerdict(__tableHandle, "Resp1", __bVerdict);
        }
        __ReportRequestResponseResult(__res, 0);
      }
      ResetBusContext(__nBusContextNew, __nBusContextOld);
    }
  }
  TestCommandEnd();

}

void Ttvccmce9_F186_DID_with_FunctionalAdd_DefaultSession()
{
  stack long __tableHandle;
  TestCommandBegin(__eDiagService, __cDiagService, "", "0");
  {
    if (DiagIsFunctionalGroup("CVADAS_0001_00000000_000"))
    {
      DiagResponse * __resp;
      DiagRequest CVADAS_0001_00000000_000._22F186_Active_Diagnostic_Session __req;
      __diagServicevccmce9_30(__req, __resp);
    }
    else
    {
      DiagResponse CVADAS_0001_00000000_000.* __resp;
      DiagRequest CVADAS_0001_00000000_000._22F186_Active_Diagnostic_Session __req;
      __diagServicevccmce9_30(__req, __resp);
    }
  }
  TestCommandEnd();


}

  
void __diagServicevccmce9_30(DiagRequest * __req, DiagResponse * __resp )
{
  stack long __tableHandle;
  long __res, __paramLen, __bytePos;

   __bVerdict = __eVerdictPass;

  do {
    TestReportResetDiagObjectList();
    DiagSetReportDetailLevel("CVADAS_0001_00000000_000", EnumServiceDetails_onfail);
    // Request aspect
    {

      if (0 >= DiagSendReqAndWaitForResp("CVADAS_0001_00000000_000", __req, __resp, __res, -1, -1, -1, -1, -1, EnumResult_pos, EnumServiceDetails_onfail, EnumSendingMode_physical, EnumSuppressPosResBit_asconfigured, EnumVerdictOnInvalidValues_fail))
        break;
    }

    __res = DiagErrCodeTestStep(__res, "Can't retrieve last response for request! No check possible.") < 0;
    if(__res)
    {
	  __bVerdict = __eVerdictFail;
      break;
    }
    {
      __res = DiagInterpretAs(__resp, "RDBI_PR");
      if(__res != 0)
      {
        __bVerdict = __eVerdictFail;
        DiagErrCodeTestStep(__res, "Can't interpret response as diagnostic primitive 'RDBI_PR'.");
        break;
      }
      else
      {
        TestStepPass( "Received primitive can be interpreted as diagnostic primitive 'RDBI_PR'.");
      }
    }
  }
  while(0);


  // Response, check & read aspect
  {
    __res = 1;
    __tableHandle = ReportTableHead5Columns(__cCheckCaption, __cTSym, __cTOp, __cRefVal, __cActual, __cRes);
    {
      __bDiagValueArrayCtr = DiagGetParameterErrorHandled(__resp, "_Active_Diagnostic_Session_24", __bDiagValueArray, elcount(__bDiagValueArray), __cDiagValueArray, elcount(__cDiagValueArray));
      {
        __bSetInCheckAlignment = 1;	
        {
          __bArrayCtr = __CopyBytes(__bDiagValueArray, __bDiagValueArrayCtr, __bArray);
          {
            sysvar * __systemVariable;
            __systemVariable = sysvarData::`PartNumber::`Part_Number;
            CheckSysVarSetBufferConsistency(sysSetVariableData(sysvarData::`PartNumber::`Part_Number, __bArray, __bArrayCtr), __systemVariable.name);
          }
          snprintf(__cArray, 8192, "%s", "Part_Number");
          snprintf(__cArray2, 8192, "%s '%s'", __cSysVar, __cArray);
          snprintf(__cArray3, 8192, "%s", "_Active_Diagnostic_Session_24");
          
          ReportTableRow(__tableHandle, 0, __cArray2, __cAOp, __bArray, __bArrayCtr, __cArray3, __oneOfFlag, __bSetInCheckAlignment);
        
        }
    
        __bSetInCheckAlignment = 0;
      }
    }
    {
      __bDiagValueArrayCtr = DiagGetParameterErrorHandled(__resp, "Authentication_Status", __bDiagValueArray, elcount(__bDiagValueArray), __cDiagValueArray, elcount(__cDiagValueArray));
      {
        __bSetInCheckAlignment = 1;	
        {
          __bArrayCtr = __CopyBytes(__bDiagValueArray, __bDiagValueArrayCtr, __bArray);
          {
            sysvar * __systemVariable;
            __systemVariable = sysvarData::`PartNumber::`Part_Number;
            CheckSysVarSetBufferConsistency(sysSetVariableData(sysvarData::`PartNumber::`Part_Number, __bArray, __bArrayCtr), __systemVariable.name);
          }
          snprintf(__cArray, 8192, "%s", "Part_Number");
          snprintf(__cArray2, 8192, "%s '%s'", __cSysVar, __cArray);
          snprintf(__cArray3, 8192, "%s", "Authentication_Status");
          
          ReportTableRow(__tableHandle, 0, __cArray2, __cAOp, __bArray, __bArrayCtr, __cArray3, __oneOfFlag, __bSetInCheckAlignment);
        
        }
    
        __bSetInCheckAlignment = 0;
      }
    }
    {
      __bDiagValueArrayCtr = DiagGetParameterErrorHandled(__resp, "Bitfield/Bitfield._Active_Diagnostic_Session_of_ECU__ECU_Software_Mode_32", __bDiagValueArray, elcount(__bDiagValueArray), __cDiagValueArray, elcount(__cDiagValueArray));
      {
        __bSetInCheckAlignment = 1;	
        {
          __bArrayCtr = __CopyBytes(__bDiagValueArray, __bDiagValueArrayCtr, __bArray);
          {
            sysvar * __systemVariable;
            __systemVariable = sysvarData::`PartNumber::`Part_Number;
            CheckSysVarSetBufferConsistency(sysSetVariableData(sysvarData::`PartNumber::`Part_Number, __bArray, __bArrayCtr), __systemVariable.name);
          }
          snprintf(__cArray, 8192, "%s", "Part_Number");
          snprintf(__cArray2, 8192, "%s '%s'", __cSysVar, __cArray);
          snprintf(__cArray3, 8192, "%s", "Bitfield/Bitfield._Active_Diagnostic_Session_of_ECU__ECU_Software_Mode_32");
          
          ReportTableRow(__tableHandle, 0, __cArray2, __cAOp, __bArray, __bArrayCtr, __cArray3, __oneOfFlag, __bSetInCheckAlignment);
        
        }
    
        __bSetInCheckAlignment = 0;
      }
    }
    ReportTableEndVerdict(__tableHandle, __cEvaluateResponse, __res);
	__bVerdict = __bVerdict && __res;
  }
  if (__bVerdict == __eVerdictFail)
    TestReportWriteDiagObjectList();
}

void Ttvccmce9_F186_DID_with_FunctionalAdd_ExtendedSession()
{
  stack long __tableHandle;
  TestCommandBegin(__eDiagService, __cDiagService, "", "0");
  {
    if (DiagIsFunctionalGroup("CVADAS_0001_00000000_000"))
    {
      DiagResponse * __resp;
      DiagRequest CVADAS_0001_00000000_000._22F186_Active_Diagnostic_Session __req;
      __diagServicevccmce9_31(__req, __resp);
    }
    else
    {
      DiagResponse CVADAS_0001_00000000_000.* __resp;
      DiagRequest CVADAS_0001_00000000_000._22F186_Active_Diagnostic_Session __req;
      __diagServicevccmce9_31(__req, __resp);
    }
  }
  TestCommandEnd();


}

  
void __diagServicevccmce9_31(DiagRequest * __req, DiagResponse * __resp )
{
  stack long __tableHandle;
  long __res, __paramLen, __bytePos;

   __bVerdict = __eVerdictPass;

  do {
    TestReportResetDiagObjectList();
    DiagSetReportDetailLevel("CVADAS_0001_00000000_000", EnumServiceDetails_onfail);
    // Request aspect
    {

      if (0 >= DiagSendReqAndWaitForResp("CVADAS_0001_00000000_000", __req, __resp, __res, -1, -1, -1, -1, -1, EnumResult_pos, EnumServiceDetails_onfail, EnumSendingMode_physical, EnumSuppressPosResBit_asconfigured, EnumVerdictOnInvalidValues_fail))
        break;
    }

    __res = DiagErrCodeTestStep(__res, "Can't retrieve last response for request! No check possible.") < 0;
    if(__res)
    {
	  __bVerdict = __eVerdictFail;
      break;
    }
    {
      __res = DiagInterpretAs(__resp, "RDBI_PR");
      if(__res != 0)
      {
        __bVerdict = __eVerdictFail;
        DiagErrCodeTestStep(__res, "Can't interpret response as diagnostic primitive 'RDBI_PR'.");
        break;
      }
      else
      {
        TestStepPass( "Received primitive can be interpreted as diagnostic primitive 'RDBI_PR'.");
      }
    }
  }
  while(0);


  // Response, check & read aspect
  {
    __res = 1;
    __tableHandle = ReportTableHead5Columns(__cCheckCaption, __cTSym, __cTOp, __cRefVal, __cActual, __cRes);
    {
      __bDiagValueArrayCtr = DiagGetParameterErrorHandled(__resp, "_Active_Diagnostic_Session_24", __bDiagValueArray, elcount(__bDiagValueArray), __cDiagValueArray, elcount(__cDiagValueArray));
      {
        __bSetInCheckAlignment = 1;	
        {
          __bArrayCtr = __CopyBytes(__bDiagValueArray, __bDiagValueArrayCtr, __bArray);
          {
            sysvar * __systemVariable;
            __systemVariable = sysvarData::`PartNumber::`Part_Number;
            CheckSysVarSetBufferConsistency(sysSetVariableData(sysvarData::`PartNumber::`Part_Number, __bArray, __bArrayCtr), __systemVariable.name);
          }
          snprintf(__cArray, 8192, "%s", "Part_Number");
          snprintf(__cArray2, 8192, "%s '%s'", __cSysVar, __cArray);
          snprintf(__cArray3, 8192, "%s", "_Active_Diagnostic_Session_24");
          
          ReportTableRow(__tableHandle, 0, __cArray2, __cAOp, __bArray, __bArrayCtr, __cArray3, __oneOfFlag, __bSetInCheckAlignment);
        
        }
    
        __bSetInCheckAlignment = 0;
      }
    }
    {
      __bDiagValueArrayCtr = DiagGetParameterErrorHandled(__resp, "Authentication_Status", __bDiagValueArray, elcount(__bDiagValueArray), __cDiagValueArray, elcount(__cDiagValueArray));
      {
        __bSetInCheckAlignment = 1;	
        {
          __bArrayCtr = __CopyBytes(__bDiagValueArray, __bDiagValueArrayCtr, __bArray);
          {
            sysvar * __systemVariable;
            __systemVariable = sysvarData::`PartNumber::`Part_Number;
            CheckSysVarSetBufferConsistency(sysSetVariableData(sysvarData::`PartNumber::`Part_Number, __bArray, __bArrayCtr), __systemVariable.name);
          }
          snprintf(__cArray, 8192, "%s", "Part_Number");
          snprintf(__cArray2, 8192, "%s '%s'", __cSysVar, __cArray);
          snprintf(__cArray3, 8192, "%s", "Authentication_Status");
          
          ReportTableRow(__tableHandle, 0, __cArray2, __cAOp, __bArray, __bArrayCtr, __cArray3, __oneOfFlag, __bSetInCheckAlignment);
        
        }
    
        __bSetInCheckAlignment = 0;
      }
    }
    {
      __bDiagValueArrayCtr = DiagGetParameterErrorHandled(__resp, "Bitfield/Bitfield._Active_Diagnostic_Session_of_ECU__ECU_Software_Mode_32", __bDiagValueArray, elcount(__bDiagValueArray), __cDiagValueArray, elcount(__cDiagValueArray));
      {
        __bSetInCheckAlignment = 1;	
        {
          __bArrayCtr = __CopyBytes(__bDiagValueArray, __bDiagValueArrayCtr, __bArray);
          {
            sysvar * __systemVariable;
            __systemVariable = sysvarData::`PartNumber::`Part_Number;
            CheckSysVarSetBufferConsistency(sysSetVariableData(sysvarData::`PartNumber::`Part_Number, __bArray, __bArrayCtr), __systemVariable.name);
          }
          snprintf(__cArray, 8192, "%s", "Part_Number");
          snprintf(__cArray2, 8192, "%s '%s'", __cSysVar, __cArray);
          snprintf(__cArray3, 8192, "%s", "Bitfield/Bitfield._Active_Diagnostic_Session_of_ECU__ECU_Software_Mode_32");
          
          ReportTableRow(__tableHandle, 0, __cArray2, __cAOp, __bArray, __bArrayCtr, __cArray3, __oneOfFlag, __bSetInCheckAlignment);
        
        }
    
        __bSetInCheckAlignment = 0;
      }
    }
    ReportTableEndVerdict(__tableHandle, __cEvaluateResponse, __res);
	__bVerdict = __bVerdict && __res;
  }
  if (__bVerdict == __eVerdictFail)
    TestReportWriteDiagObjectList();
}

void Ttvccmce9_F186_DID_with_FunctionalAdd_ProgrammingSession()
{
  stack long __tableHandle;
  TestCommandBegin(__eWait, __cWait, "", "0");
  {
    Wait("1", (1100 * 1000000LL), 1000000, "");
  }
  TestCommandEnd();

  TestCommandBegin(__eDiagService, __cDiagService, "", "1");
  {
    if (DiagIsFunctionalGroup("CVADAS_0001_00000000_000"))
    {
      DiagResponse * __resp;
      DiagRequest CVADAS_0001_00000000_000._22F186_Active_Diagnostic_Session __req;
      __diagServicevccmce9_32(__req, __resp);
    }
    else
    {
      DiagResponse CVADAS_0001_00000000_000.* __resp;
      DiagRequest CVADAS_0001_00000000_000._22F186_Active_Diagnostic_Session __req;
      __diagServicevccmce9_32(__req, __resp);
    }
  }
  TestCommandEnd();


}

  
void __diagServicevccmce9_32(DiagRequest * __req, DiagResponse * __resp )
{
  stack long __tableHandle;
  long __res, __paramLen, __bytePos;

   __bVerdict = __eVerdictPass;

  do {
    TestReportResetDiagObjectList();
    DiagSetReportDetailLevel("CVADAS_0001_00000000_000", EnumServiceDetails_onfail);
    // Request aspect
    {

      if (0 >= DiagSendReqAndWaitForResp("CVADAS_0001_00000000_000", __req, __resp, __res, -1, -1, -1, -1, -1, EnumResult_pos, EnumServiceDetails_onfail, EnumSendingMode_physical, EnumSuppressPosResBit_asconfigured, EnumVerdictOnInvalidValues_fail))
        break;
    }

    __res = DiagErrCodeTestStep(__res, "Can't retrieve last response for request! No check possible.") < 0;
    if(__res)
    {
	  __bVerdict = __eVerdictFail;
      break;
    }
    {
      __res = DiagInterpretAs(__resp, "RDBI_PR");
      if(__res != 0)
      {
        __bVerdict = __eVerdictFail;
        DiagErrCodeTestStep(__res, "Can't interpret response as diagnostic primitive 'RDBI_PR'.");
        break;
      }
      else
      {
        TestStepPass( "Received primitive can be interpreted as diagnostic primitive 'RDBI_PR'.");
      }
    }
  }
  while(0);


  // Response, check & read aspect
  {
    __res = 1;
    __tableHandle = ReportTableHead5Columns(__cCheckCaption, __cTSym, __cTOp, __cRefVal, __cActual, __cRes);
    {
      __bDiagValueArrayCtr = DiagGetParameterErrorHandled(__resp, "_Active_Diagnostic_Session_24", __bDiagValueArray, elcount(__bDiagValueArray), __cDiagValueArray, elcount(__cDiagValueArray));
      {
        __bSetInCheckAlignment = 1;	
        {
          __bArrayCtr = __CopyBytes(__bDiagValueArray, __bDiagValueArrayCtr, __bArray);
          {
            sysvar * __systemVariable;
            __systemVariable = sysvarData::`PartNumber::`Part_Number;
            CheckSysVarSetBufferConsistency(sysSetVariableData(sysvarData::`PartNumber::`Part_Number, __bArray, __bArrayCtr), __systemVariable.name);
          }
          snprintf(__cArray, 8192, "%s", "Part_Number");
          snprintf(__cArray2, 8192, "%s '%s'", __cSysVar, __cArray);
          snprintf(__cArray3, 8192, "%s", "_Active_Diagnostic_Session_24");
          
          ReportTableRow(__tableHandle, 0, __cArray2, __cAOp, __bArray, __bArrayCtr, __cArray3, __oneOfFlag, __bSetInCheckAlignment);
        
        }
    
        __bSetInCheckAlignment = 0;
      }
    }
    {
      __bDiagValueArrayCtr = DiagGetParameterErrorHandled(__resp, "Authentication_Status", __bDiagValueArray, elcount(__bDiagValueArray), __cDiagValueArray, elcount(__cDiagValueArray));
      {
        __bSetInCheckAlignment = 1;	
        {
          __bArrayCtr = __CopyBytes(__bDiagValueArray, __bDiagValueArrayCtr, __bArray);
          {
            sysvar * __systemVariable;
            __systemVariable = sysvarData::`PartNumber::`Part_Number;
            CheckSysVarSetBufferConsistency(sysSetVariableData(sysvarData::`PartNumber::`Part_Number, __bArray, __bArrayCtr), __systemVariable.name);
          }
          snprintf(__cArray, 8192, "%s", "Part_Number");
          snprintf(__cArray2, 8192, "%s '%s'", __cSysVar, __cArray);
          snprintf(__cArray3, 8192, "%s", "Authentication_Status");
          
          ReportTableRow(__tableHandle, 0, __cArray2, __cAOp, __bArray, __bArrayCtr, __cArray3, __oneOfFlag, __bSetInCheckAlignment);
        
        }
    
        __bSetInCheckAlignment = 0;
      }
    }
    {
      __bDiagValueArrayCtr = DiagGetParameterErrorHandled(__resp, "Bitfield/Bitfield._Active_Diagnostic_Session_of_ECU__ECU_Software_Mode_32", __bDiagValueArray, elcount(__bDiagValueArray), __cDiagValueArray, elcount(__cDiagValueArray));
      {
        __bSetInCheckAlignment = 1;	
        {
          __bArrayCtr = __CopyBytes(__bDiagValueArray, __bDiagValueArrayCtr, __bArray);
          {
            sysvar * __systemVariable;
            __systemVariable = sysvarData::`PartNumber::`Part_Number;
            CheckSysVarSetBufferConsistency(sysSetVariableData(sysvarData::`PartNumber::`Part_Number, __bArray, __bArrayCtr), __systemVariable.name);
          }
          snprintf(__cArray, 8192, "%s", "Part_Number");
          snprintf(__cArray2, 8192, "%s '%s'", __cSysVar, __cArray);
          snprintf(__cArray3, 8192, "%s", "Bitfield/Bitfield._Active_Diagnostic_Session_of_ECU__ECU_Software_Mode_32");
          
          ReportTableRow(__tableHandle, 0, __cArray2, __cAOp, __bArray, __bArrayCtr, __cArray3, __oneOfFlag, __bSetInCheckAlignment);
        
        }
    
        __bSetInCheckAlignment = 0;
      }
    }
    ReportTableEndVerdict(__tableHandle, __cEvaluateResponse, __res);
	__bVerdict = __bVerdict && __res;
  }
  if (__bVerdict == __eVerdictFail)
    TestReportWriteDiagObjectList();
}

void Ttvccmce9_F10D_DID_with_Physical_Address()
{
  stack long __tableHandle;
  TestCommandBegin(__eDiagService, __cDiagService, "", "0");
  {
    if (DiagIsFunctionalGroup("CVADAS_0001_00000000_000"))
    {
      DiagResponse * __resp;
      DiagRequest CVADAS_0001_00000000_000._22F10D_Diagnostic_Specification_Information __req;
      __diagServicevccmce9_33(__req, __resp);
    }
    else
    {
      DiagResponse CVADAS_0001_00000000_000.* __resp;
      DiagRequest CVADAS_0001_00000000_000._22F10D_Diagnostic_Specification_Information __req;
      __diagServicevccmce9_33(__req, __resp);
    }
  }
  TestCommandEnd();


}

  
void __diagServicevccmce9_33(DiagRequest * __req, DiagResponse * __resp )
{
  stack long __tableHandle;
  long __res, __paramLen, __bytePos;

   __bVerdict = __eVerdictPass;

  do {
    TestReportResetDiagObjectList();
    DiagSetReportDetailLevel("CVADAS_0001_00000000_000", EnumServiceDetails_onfail);
    // Request aspect
    {

      if (0 >= DiagSendReqAndWaitForResp("CVADAS_0001_00000000_000", __req, __resp, __res, -1, -1, -1, -1, -1, EnumResult_pos, EnumServiceDetails_onfail, EnumSendingMode_functional, EnumSuppressPosResBit_asconfigured, EnumVerdictOnInvalidValues_fail))
        break;
    }

    __res = DiagErrCodeTestStep(__res, "Can't retrieve last response for request! No check possible.") < 0;
    if(__res)
    {
	  __bVerdict = __eVerdictFail;
      break;
    }
    {
      __res = DiagInterpretAs(__resp, "RDBI_PR");
      if(__res != 0)
      {
        __bVerdict = __eVerdictFail;
        DiagErrCodeTestStep(__res, "Can't interpret response as diagnostic primitive 'RDBI_PR'.");
        break;
      }
      else
      {
        TestStepPass( "Received primitive can be interpreted as diagnostic primitive 'RDBI_PR'.");
      }
    }
  }
  while(0);


  // Response, check & read aspect
  {
    __res = 1;
    __tableHandle = ReportTableHead5Columns(__cCheckCaption, __cTSym, __cTOp, __cRefVal, __cActual, __cRes);
    {
      __bDiagValueArrayCtr = DiagGetParameterErrorHandled(__resp, "_Diagnostic_Requirements_Standard_Version_48", __bDiagValueArray, elcount(__bDiagValueArray), __cDiagValueArray, elcount(__cDiagValueArray));
      {
        __bSetInCheckAlignment = 1;	
        {
          __bArrayCtr = __CopyBytes(__bDiagValueArray, __bDiagValueArrayCtr, __bArray);
          {
            sysvar * __systemVariable;
            __systemVariable = sysvarData::`PartNumber::`Part_Number;
            CheckSysVarSetBufferConsistency(sysSetVariableData(sysvarData::`PartNumber::`Part_Number, __bArray, __bArrayCtr), __systemVariable.name);
          }
          snprintf(__cArray, 8192, "%s", "Part_Number");
          snprintf(__cArray2, 8192, "%s '%s'", __cSysVar, __cArray);
          snprintf(__cArray3, 8192, "%s", "_Diagnostic_Requirements_Standard_Version_48");
          
          ReportTableRow(__tableHandle, 0, __cArray2, __cAOp, __bArray, __bArrayCtr, __cArray3, __oneOfFlag, __bSetInCheckAlignment);
        
        }
    
        __bSetInCheckAlignment = 0;
      }
    }
    {
      __bDiagValueArrayCtr = DiagGetParameterErrorHandled(__resp, "_ECU_Flash_Reprogramming_Requirements_Version_32", __bDiagValueArray, elcount(__bDiagValueArray), __cDiagValueArray, elcount(__cDiagValueArray));
      {
        __bSetInCheckAlignment = 1;	
        {
          __bArrayCtr = __CopyBytes(__bDiagValueArray, __bDiagValueArrayCtr, __bArray);
          {
            sysvar * __systemVariable;
            __systemVariable = sysvarData::`PartNumber::`Part_Number;
            CheckSysVarSetBufferConsistency(sysSetVariableData(sysvarData::`PartNumber::`Part_Number, __bArray, __bArrayCtr), __systemVariable.name);
          }
          snprintf(__cArray, 8192, "%s", "Part_Number");
          snprintf(__cArray2, 8192, "%s '%s'", __cSysVar, __cArray);
          snprintf(__cArray3, 8192, "%s", "_ECU_Flash_Reprogramming_Requirements_Version_32");
          
          ReportTableRow(__tableHandle, 0, __cArray2, __cAOp, __bArray, __bArrayCtr, __cArray3, __oneOfFlag, __bSetInCheckAlignment);
        
        }
    
        __bSetInCheckAlignment = 0;
      }
    }
    {
      __bDiagValueArrayCtr = DiagGetParameterErrorHandled(__resp, "_Standard_Diagnostic_Data_UDS_Version_40", __bDiagValueArray, elcount(__bDiagValueArray), __cDiagValueArray, elcount(__cDiagValueArray));
      {
        __bSetInCheckAlignment = 1;	
        {
          __bArrayCtr = __CopyBytes(__bDiagValueArray, __bDiagValueArrayCtr, __bArray);
          {
            sysvar * __systemVariable;
            __systemVariable = sysvarData::`PartNumber::`Part_Number;
            CheckSysVarSetBufferConsistency(sysSetVariableData(sysvarData::`PartNumber::`Part_Number, __bArray, __bArrayCtr), __systemVariable.name);
          }
          snprintf(__cArray, 8192, "%s", "Part_Number");
          snprintf(__cArray2, 8192, "%s '%s'", __cSysVar, __cArray);
          snprintf(__cArray3, 8192, "%s", "_Standard_Diagnostic_Data_UDS_Version_40");
          
          ReportTableRow(__tableHandle, 0, __cArray2, __cAOp, __bArray, __bArrayCtr, __cArray3, __oneOfFlag, __bSetInCheckAlignment);
        
        }
    
        __bSetInCheckAlignment = 0;
      }
    }
    {
      __bDiagValueArrayCtr = DiagGetParameterErrorHandled(__resp, "_Standard_Diagnostic_Data_UDS_Version_40", __bDiagValueArray, elcount(__bDiagValueArray), __cDiagValueArray, elcount(__cDiagValueArray));
      {
        __bSetInCheckAlignment = 1;	
        {
          __bArrayCtr = __CopyBytes(__bDiagValueArray, __bDiagValueArrayCtr, __bArray);
          {
            sysvar * __systemVariable;
            __systemVariable = sysvarData::`PartNumber::`Part_Number;
            CheckSysVarSetBufferConsistency(sysSetVariableData(sysvarData::`PartNumber::`Part_Number, __bArray, __bArrayCtr), __systemVariable.name);
          }
          snprintf(__cArray, 8192, "%s", "Part_Number");
          snprintf(__cArray2, 8192, "%s '%s'", __cSysVar, __cArray);
          snprintf(__cArray3, 8192, "%s", "_Standard_Diagnostic_Data_UDS_Version_40");
          
          ReportTableRow(__tableHandle, 0, __cArray2, __cAOp, __bArray, __bArrayCtr, __cArray3, __oneOfFlag, __bSetInCheckAlignment);
        
        }
    
        __bSetInCheckAlignment = 0;
      }
    }
    ReportTableEndVerdict(__tableHandle, __cEvaluateResponse, __res);
	__bVerdict = __bVerdict && __res;
  }
  if (__bVerdict == __eVerdictFail)
    TestReportWriteDiagObjectList();
}

void Ttvccmce9_F10D_DID_with_Functional_Address()
{
  stack long __tableHandle;
  TestCommandBegin(__eDiagService, __cDiagService, "", "0");
  {
    if (DiagIsFunctionalGroup("CVADAS_0001_00000000_000"))
    {
      DiagResponse * __resp;
      DiagRequest CVADAS_0001_00000000_000._22F10D_Diagnostic_Specification_Information __req;
      __diagServicevccmce9_34(__req, __resp);
    }
    else
    {
      DiagResponse CVADAS_0001_00000000_000.* __resp;
      DiagRequest CVADAS_0001_00000000_000._22F10D_Diagnostic_Specification_Information __req;
      __diagServicevccmce9_34(__req, __resp);
    }
  }
  TestCommandEnd();


}

  
void __diagServicevccmce9_34(DiagRequest * __req, DiagResponse * __resp )
{
  stack long __tableHandle;
  long __res, __paramLen, __bytePos;

   __bVerdict = __eVerdictPass;

  do {
    TestReportResetDiagObjectList();
    DiagSetReportDetailLevel("CVADAS_0001_00000000_000", EnumServiceDetails_onfail);
    // Request aspect
    {

      if (0 >= DiagSendReqAndWaitForResp("CVADAS_0001_00000000_000", __req, __resp, __res, -1, -1, -1, -1, -1, EnumResult_pos, EnumServiceDetails_onfail, EnumSendingMode_physical, EnumSuppressPosResBit_asconfigured, EnumVerdictOnInvalidValues_fail))
        break;
    }

    __res = DiagErrCodeTestStep(__res, "Can't retrieve last response for request! No check possible.") < 0;
    if(__res)
    {
	  __bVerdict = __eVerdictFail;
      break;
    }
    {
      __res = DiagInterpretAs(__resp, "RDBI_PR");
      if(__res != 0)
      {
        __bVerdict = __eVerdictFail;
        DiagErrCodeTestStep(__res, "Can't interpret response as diagnostic primitive 'RDBI_PR'.");
        break;
      }
      else
      {
        TestStepPass( "Received primitive can be interpreted as diagnostic primitive 'RDBI_PR'.");
      }
    }
  }
  while(0);


  // Response, check & read aspect
  {
    __res = 1;
    __tableHandle = ReportTableHead5Columns(__cCheckCaption, __cTSym, __cTOp, __cRefVal, __cActual, __cRes);
    {
      __bDiagValueArrayCtr = DiagGetParameterErrorHandled(__resp, "_Diagnostic_Requirements_Standard_Version_48", __bDiagValueArray, elcount(__bDiagValueArray), __cDiagValueArray, elcount(__cDiagValueArray));
      {
        __bSetInCheckAlignment = 1;	
        {
          __bArrayCtr = __CopyBytes(__bDiagValueArray, __bDiagValueArrayCtr, __bArray);
          {
            sysvar * __systemVariable;
            __systemVariable = sysvarData::`PartNumber::`Part_Number;
            CheckSysVarSetBufferConsistency(sysSetVariableData(sysvarData::`PartNumber::`Part_Number, __bArray, __bArrayCtr), __systemVariable.name);
          }
          snprintf(__cArray, 8192, "%s", "Part_Number");
          snprintf(__cArray2, 8192, "%s '%s'", __cSysVar, __cArray);
          snprintf(__cArray3, 8192, "%s", "_Diagnostic_Requirements_Standard_Version_48");
          
          ReportTableRow(__tableHandle, 0, __cArray2, __cAOp, __bArray, __bArrayCtr, __cArray3, __oneOfFlag, __bSetInCheckAlignment);
        
        }
    
        __bSetInCheckAlignment = 0;
      }
    }
    {
      __bDiagValueArrayCtr = DiagGetParameterErrorHandled(__resp, "_ECU_Flash_Reprogramming_Requirements_Version_32", __bDiagValueArray, elcount(__bDiagValueArray), __cDiagValueArray, elcount(__cDiagValueArray));
      {
        __bSetInCheckAlignment = 1;	
        {
          __bArrayCtr = __CopyBytes(__bDiagValueArray, __bDiagValueArrayCtr, __bArray);
          {
            sysvar * __systemVariable;
            __systemVariable = sysvarData::`PartNumber::`Part_Number;
            CheckSysVarSetBufferConsistency(sysSetVariableData(sysvarData::`PartNumber::`Part_Number, __bArray, __bArrayCtr), __systemVariable.name);
          }
          snprintf(__cArray, 8192, "%s", "Part_Number");
          snprintf(__cArray2, 8192, "%s '%s'", __cSysVar, __cArray);
          snprintf(__cArray3, 8192, "%s", "_ECU_Flash_Reprogramming_Requirements_Version_32");
          
          ReportTableRow(__tableHandle, 0, __cArray2, __cAOp, __bArray, __bArrayCtr, __cArray3, __oneOfFlag, __bSetInCheckAlignment);
        
        }
    
        __bSetInCheckAlignment = 0;
      }
    }
    {
      __bDiagValueArrayCtr = DiagGetParameterErrorHandled(__resp, "_Standard_Diagnostic_Data_UDS_Version_40", __bDiagValueArray, elcount(__bDiagValueArray), __cDiagValueArray, elcount(__cDiagValueArray));
      {
        __bSetInCheckAlignment = 1;	
        {
          __bArrayCtr = __CopyBytes(__bDiagValueArray, __bDiagValueArrayCtr, __bArray);
          {
            sysvar * __systemVariable;
            __systemVariable = sysvarData::`PartNumber::`Part_Number;
            CheckSysVarSetBufferConsistency(sysSetVariableData(sysvarData::`PartNumber::`Part_Number, __bArray, __bArrayCtr), __systemVariable.name);
          }
          snprintf(__cArray, 8192, "%s", "Part_Number");
          snprintf(__cArray2, 8192, "%s '%s'", __cSysVar, __cArray);
          snprintf(__cArray3, 8192, "%s", "_Standard_Diagnostic_Data_UDS_Version_40");
          
          ReportTableRow(__tableHandle, 0, __cArray2, __cAOp, __bArray, __bArrayCtr, __cArray3, __oneOfFlag, __bSetInCheckAlignment);
        
        }
    
        __bSetInCheckAlignment = 0;
      }
    }
    {
      __bDiagValueArrayCtr = DiagGetParameterErrorHandled(__resp, "_Standard_Diagnostic_Data_UDS_Version_40", __bDiagValueArray, elcount(__bDiagValueArray), __cDiagValueArray, elcount(__cDiagValueArray));
      {
        __bSetInCheckAlignment = 1;	
        {
          __bArrayCtr = __CopyBytes(__bDiagValueArray, __bDiagValueArrayCtr, __bArray);
          {
            sysvar * __systemVariable;
            __systemVariable = sysvarData::`PartNumber::`Part_Number;
            CheckSysVarSetBufferConsistency(sysSetVariableData(sysvarData::`PartNumber::`Part_Number, __bArray, __bArrayCtr), __systemVariable.name);
          }
          snprintf(__cArray, 8192, "%s", "Part_Number");
          snprintf(__cArray2, 8192, "%s '%s'", __cSysVar, __cArray);
          snprintf(__cArray3, 8192, "%s", "_Standard_Diagnostic_Data_UDS_Version_40");
          
          ReportTableRow(__tableHandle, 0, __cArray2, __cAOp, __bArray, __bArrayCtr, __cArray3, __oneOfFlag, __bSetInCheckAlignment);
        
        }
    
        __bSetInCheckAlignment = 0;
      }
    }
    ReportTableEndVerdict(__tableHandle, __cEvaluateResponse, __res);
	__bVerdict = __bVerdict && __res;
  }
  if (__bVerdict == __eVerdictFail)
    TestReportWriteDiagObjectList();
}

void Ttvccmce9_F10D_DID_with_Standard_Physical_Address()
{
  stack long __tableHandle;
  TestCommandBegin(__eRequestResponse, __cRequestResponse, "", "0");
  {
  
    long __res;
    int64 __timeout;
    __res = 0;
    __nInt64 = 1;
    __timeout = syspar::`P2_Server * 1000000LL;
    {
    
      long __testStepInitOk;
      message `FDCAN2::`DIAGNOSTIC_REQUEST_PAM __output;
      message `FDCAN2::`DIAGNOSTIC_REQUEST_PAM __msgOrig;
      __output = __msgOrig;
      __testStepInitOk = 1;
      snprintf(__cArray, elCount(__cArray), "CAN message '%s' ID = 416981233x (0x18DAA0F1x) on bus FDCAN2", "DIAGNOSTIC_REQUEST_PAM");
      snprintf(__cArray2, elCount(__cArray2), "Send %s", __cArray);
      __tableHandle = ReportTableHead3Columns(__cArray2, "Byte", __cTOp, __cAssigned);
      ReportByteIndex("", 0, __cArray, elCount(__cArray));
      snprintf(__cArray2, 8192, "%s", __cArray);
      snprintf(__cArray3, 8192, "%s", "");
      
      ReportTableRow(__tableHandle, 0, __cArray2, __cAOp, 0x3, __cArray3, __oneOfFlag, __bSetInCheckAlignment);
      
      if (0 >= 0 && 0 < 64)
      {
        __output.byte((word)0) = 0x3;
      }
      else
      {
        testStepErrorInTestSystem(0, __cEmpty, "Index out of range. Unable to set byte %lld in message. Please check input parameter.", (int64)0);
        __testStepInitOk = 0;
      }
      ReportByteIndex("", 1, __cArray, elCount(__cArray));
      snprintf(__cArray2, 8192, "%s", __cArray);
      snprintf(__cArray3, 8192, "%s", "");
      
      ReportTableRow(__tableHandle, 0, __cArray2, __cAOp, 0x22, __cArray3, __oneOfFlag, __bSetInCheckAlignment);
      
      if (1 >= 0 && 1 < 64)
      {
        __output.byte((word)1) = 0x22;
      }
      else
      {
        testStepErrorInTestSystem(0, __cEmpty, "Index out of range. Unable to set byte %lld in message. Please check input parameter.", (int64)1);
        __testStepInitOk = 0;
      }
      ReportByteIndex("", 2, __cArray, elCount(__cArray));
      snprintf(__cArray2, 8192, "%s", __cArray);
      snprintf(__cArray3, 8192, "%s", "");
      
      ReportTableRow(__tableHandle, 0, __cArray2, __cAOp, 0xF1, __cArray3, __oneOfFlag, __bSetInCheckAlignment);
      
      if (2 >= 0 && 2 < 64)
      {
        __output.byte((word)2) = 0xF1;
      }
      else
      {
        testStepErrorInTestSystem(0, __cEmpty, "Index out of range. Unable to set byte %lld in message. Please check input parameter.", (int64)2);
        __testStepInitOk = 0;
      }
      ReportByteIndex("", 3, __cArray, elCount(__cArray));
      snprintf(__cArray2, 8192, "%s", __cArray);
      snprintf(__cArray3, 8192, "%s", "");
      
      ReportTableRow(__tableHandle, 0, __cArray2, __cAOp, 0xD, __cArray3, __oneOfFlag, __bSetInCheckAlignment);
      
      if (3 >= 0 && 3 < 64)
      {
        __output.byte((word)3) = 0xD;
      }
      else
      {
        testStepErrorInTestSystem(0, __cEmpty, "Index out of range. Unable to set byte %lld in message. Please check input parameter.", (int64)3);
        __testStepInitOk = 0;
      }
    
      ReportTableEndTestStep(__tableHandle, "Req1");
      if (__testStepInitOk)
      {
        output(__output);
      }
    }
    if (__timeout <= 0)
    {
      testStepErrorInTestSystem(0, "1", "Unable to wait for %.3f %s. Please check input parameter.", __timeout / ((float)1000000), "ms");
    }
    else
    {
      __tt0cnt_33 = 0;
      snprintf(__cArray, elCount(__cArray), "CAN message '%s' ID = 417001888x (0x18DAF1A0x) on bus FDCAN2", "DIAGNOSTIC_RESPONSE_PAM");
      if(SetBusContextByName("FDCAN2", __eSaveCurrent, __nBusContextNew, __nBusContextOld))
        testJoinMessageEvent(`FDCAN2::`DIAGNOSTIC_RESPONSE_PAM,  __cArray,
             delegate dword(message * __m)
             {
               dword __msg_callback_ret;
               if (__tt0cnt_33 == -1)
               {
                 return 1;
               }
               __msg_callback_ret = 1;
               __tt0cnt_33++;
               if (__msg_callback_ret)
               {
                 __tt0cnt_33 = -1;
                 return 1;
               }
               return 0;
             });
      __res = testWaitForAllJoinedEventsNS(__timeout);
      if (__nInt64 != 0)
      {
        snprintf(__cArray, elCount(__cArray), "CAN message '%s' ID = 417001888x (0x18DAF1A0x) on bus FDCAN2", "DIAGNOSTIC_RESPONSE_PAM");
        if(__tt0cnt_33 == -1)
        {
          snprintf(__cArray2, 8192, "Response of %s", __cArray);
        }
        else
        {
          snprintf(__cArray2, 8192, "Response of %s (received %d times)", __cArray, __tt0cnt_33);
        }
        if (__tt0cnt_33 == 0)
        {
          testStepFail(0, "Resp1", __cArray2);
        }
        else
        {
          testStepPass(2, "Resp1", __cArray2);
        }
        __ReportRequestResponseResult(__res, 0);
      }
      ResetBusContext(__nBusContextNew, __nBusContextOld);
    }
  }
  TestCommandEnd();

}

void Ttvccmce9_F112_DID_with_Physical_Addressing()
{
  stack long __tableHandle;
  TestCommandBegin(__eDiagService, __cDiagService, "", "0");
  {
    if (DiagIsFunctionalGroup("CVADAS_0001_00000000_000"))
    {
      DiagResponse * __resp;
      DiagRequest CVADAS_0001_00000000_000._22F112_PTESLM_Hardware_Number __req;
      __diagServicevccmce9_35(__req, __resp);
    }
    else
    {
      DiagResponse CVADAS_0001_00000000_000.* __resp;
      DiagRequest CVADAS_0001_00000000_000._22F112_PTESLM_Hardware_Number __req;
      __diagServicevccmce9_35(__req, __resp);
    }
  }
  TestCommandEnd();


}

  
void __diagServicevccmce9_35(DiagRequest * __req, DiagResponse * __resp )
{
  stack long __tableHandle;
  long __res, __paramLen, __bytePos;

   __bVerdict = __eVerdictPass;

  do {
    TestReportResetDiagObjectList();
    DiagSetReportDetailLevel("CVADAS_0001_00000000_000", EnumServiceDetails_onfail);
    // Request aspect
    {

      if (0 >= DiagSendReqAndWaitForResp("CVADAS_0001_00000000_000", __req, __resp, __res, -1, -1, -1, -1, -1, EnumResult_pos, EnumServiceDetails_onfail, EnumSendingMode_physical, EnumSuppressPosResBit_asconfigured, EnumVerdictOnInvalidValues_fail))
        break;
    }

    __res = DiagErrCodeTestStep(__res, "Can't retrieve last response for request! No check possible.") < 0;
    if(__res)
    {
	  __bVerdict = __eVerdictFail;
      break;
    }
    {
      __res = DiagInterpretAs(__resp, "RDBI_PR");
      if(__res != 0)
      {
        __bVerdict = __eVerdictFail;
        DiagErrCodeTestStep(__res, "Can't interpret response as diagnostic primitive 'RDBI_PR'.");
        break;
      }
      else
      {
        TestStepPass( "Received primitive can be interpreted as diagnostic primitive 'RDBI_PR'.");
      }
    }
  }
  while(0);


  // Response, check & read aspect
  {
    __res = 1;
    __tableHandle = ReportTableHead5Columns(__cCheckCaption, __cTSym, __cTOp, __cRefVal, __cActual, __cRes);
    {
      __bDiagValueArrayCtr = DiagGetParameterErrorHandled(__resp, "_Hardware_EBOM_Part_Number_24", __bDiagValueArray, elcount(__bDiagValueArray), __cDiagValueArray, elcount(__cDiagValueArray));
      {
        __bSetInCheckAlignment = 1;	
        {
          __bArrayCtr = __CopyBytes(__bDiagValueArray, __bDiagValueArrayCtr, __bArray);
          {
            sysvar * __systemVariable;
            __systemVariable = sysvarData::`PartNumber::`Part_Number;
            CheckSysVarSetBufferConsistency(sysSetVariableData(sysvarData::`PartNumber::`Part_Number, __bArray, __bArrayCtr), __systemVariable.name);
          }
          snprintf(__cArray, 8192, "%s", "Part_Number");
          snprintf(__cArray2, 8192, "%s '%s'", __cSysVar, __cArray);
          snprintf(__cArray3, 8192, "%s", "_Hardware_EBOM_Part_Number_24");
          
          ReportTableRow(__tableHandle, 0, __cArray2, __cAOp, __bArray, __bArrayCtr, __cArray3, __oneOfFlag, __bSetInCheckAlignment);
        
        }
    
        __bSetInCheckAlignment = 0;
      }
    }
    ReportTableEndVerdict(__tableHandle, __cEvaluateResponse, __res);
	__bVerdict = __bVerdict && __res;
  }
  if (__bVerdict == __eVerdictFail)
    TestReportWriteDiagObjectList();
}

void Ttvccmce9_F112_DID_with_Functional_Address()
{
  stack long __tableHandle;
  TestCommandBegin(__eDiagService, __cDiagService, "", "0");
  {
    if (DiagIsFunctionalGroup("CVADAS_0001_00000000_000"))
    {
      DiagResponse * __resp;
      DiagRequest CVADAS_0001_00000000_000._22F112_PTESLM_Hardware_Number __req;
      __diagServicevccmce9_36(__req, __resp);
    }
    else
    {
      DiagResponse CVADAS_0001_00000000_000.* __resp;
      DiagRequest CVADAS_0001_00000000_000._22F112_PTESLM_Hardware_Number __req;
      __diagServicevccmce9_36(__req, __resp);
    }
  }
  TestCommandEnd();


}

  
void __diagServicevccmce9_36(DiagRequest * __req, DiagResponse * __resp )
{
  stack long __tableHandle;
  long __res, __paramLen, __bytePos;

   __bVerdict = __eVerdictPass;

  do {
    TestReportResetDiagObjectList();
    DiagSetReportDetailLevel("CVADAS_0001_00000000_000", EnumServiceDetails_onfail);
    // Request aspect
    {

      if (0 >= DiagSendReqAndWaitForResp("CVADAS_0001_00000000_000", __req, __resp, __res, -1, -1, -1, -1, -1, EnumResult_pos, EnumServiceDetails_onfail, EnumSendingMode_physical, EnumSuppressPosResBit_asconfigured, EnumVerdictOnInvalidValues_fail))
        break;
    }

    __res = DiagErrCodeTestStep(__res, "Can't retrieve last response for request! No check possible.") < 0;
    if(__res)
    {
	  __bVerdict = __eVerdictFail;
      break;
    }
    {
      __res = DiagInterpretAs(__resp, "RDBI_PR");
      if(__res != 0)
      {
        __bVerdict = __eVerdictFail;
        DiagErrCodeTestStep(__res, "Can't interpret response as diagnostic primitive 'RDBI_PR'.");
        break;
      }
      else
      {
        TestStepPass( "Received primitive can be interpreted as diagnostic primitive 'RDBI_PR'.");
      }
    }
  }
  while(0);


  // Response, check & read aspect
  {
    __res = 1;
    __tableHandle = ReportTableHead5Columns(__cCheckCaption, __cTSym, __cTOp, __cRefVal, __cActual, __cRes);
    {
      __bDiagValueArrayCtr = DiagGetParameterErrorHandled(__resp, "_Hardware_EBOM_Part_Number_24", __bDiagValueArray, elcount(__bDiagValueArray), __cDiagValueArray, elcount(__cDiagValueArray));
      {
        __bSetInCheckAlignment = 1;	
        {
          __bArrayCtr = __CopyBytes(__bDiagValueArray, __bDiagValueArrayCtr, __bArray);
          {
            sysvar * __systemVariable;
            __systemVariable = sysvarData::`PartNumber::`Part_Number;
            CheckSysVarSetBufferConsistency(sysSetVariableData(sysvarData::`PartNumber::`Part_Number, __bArray, __bArrayCtr), __systemVariable.name);
          }
          snprintf(__cArray, 8192, "%s", "Part_Number");
          snprintf(__cArray2, 8192, "%s '%s'", __cSysVar, __cArray);
          snprintf(__cArray3, 8192, "%s", "_Hardware_EBOM_Part_Number_24");
          
          ReportTableRow(__tableHandle, 0, __cArray2, __cAOp, __bArray, __bArrayCtr, __cArray3, __oneOfFlag, __bSetInCheckAlignment);
        
        }
    
        __bSetInCheckAlignment = 0;
      }
    }
    ReportTableEndVerdict(__tableHandle, __cEvaluateResponse, __res);
	__bVerdict = __bVerdict && __res;
  }
  if (__bVerdict == __eVerdictFail)
    TestReportWriteDiagObjectList();
}

void Ttvccmce9_F112_DID_with_Standard_Physical_Address()
{
  stack long __tableHandle;
  TestCommandBegin(__eRequestResponse, __cRequestResponse, "", "0");
  {
  
    long __res;
    int64 __timeout;
    __res = 0;
    __nInt64 = 1;
    __timeout = syspar::`P2_Server * 1000000LL;
    {
    
      long __testStepInitOk;
      message `FDCAN2::`DIAGNOSTIC_REQUEST_PAM __output;
      message `FDCAN2::`DIAGNOSTIC_REQUEST_PAM __msgOrig;
      __output = __msgOrig;
      __testStepInitOk = 1;
      {
        int64 __dlc;
        __dlc = 4;
        if (__dlc >= 0 && __dlc <= (__output.EDL ? 15 : 8))
          __output.DLC = __dlc;
        else
        {
          testStepErrorInTestSystem(0, __cEmpty, "Unable to set DLC=%lld in message. Please check input parameter.", __dlc);
          __testStepInitOk = 0;
        }
      }
      if (__testStepInitOk)
      {
        snprintf(__cArray, elCount(__cArray), "CAN message '%s' ID = 416981233x (0x18DAA0F1x) on bus FDCAN2", "DIAGNOSTIC_REQUEST_PAM");
        snprintf(__cArray2, elCount(__cArray2), "Send %s", __cArray);
        __tableHandle = ReportTableHead3Columns(__cArray2, "Byte", __cTOp, __cAssigned);
        ReportByteIndex("", 0, __cArray, elCount(__cArray));
        snprintf(__cArray2, 8192, "%s", __cArray);
        snprintf(__cArray3, 8192, "%s", "");
        
        ReportTableRow(__tableHandle, 0, __cArray2, __cAOp, 0x3, __cArray3, __oneOfFlag, __bSetInCheckAlignment);
        
        if (0 >= 0 && 0 < 64)
        {
          __output.byte((word)0) = 0x3;
        }
        else
        {
          testStepErrorInTestSystem(0, __cEmpty, "Index out of range. Unable to set byte %lld in message. Please check input parameter.", (int64)0);
          __testStepInitOk = 0;
        }
        ReportByteIndex("", 1, __cArray, elCount(__cArray));
        snprintf(__cArray2, 8192, "%s", __cArray);
        snprintf(__cArray3, 8192, "%s", "");
        
        ReportTableRow(__tableHandle, 0, __cArray2, __cAOp, 0x22, __cArray3, __oneOfFlag, __bSetInCheckAlignment);
        
        if (1 >= 0 && 1 < 64)
        {
          __output.byte((word)1) = 0x22;
        }
        else
        {
          testStepErrorInTestSystem(0, __cEmpty, "Index out of range. Unable to set byte %lld in message. Please check input parameter.", (int64)1);
          __testStepInitOk = 0;
        }
        ReportByteIndex("", 2, __cArray, elCount(__cArray));
        snprintf(__cArray2, 8192, "%s", __cArray);
        snprintf(__cArray3, 8192, "%s", "");
        
        ReportTableRow(__tableHandle, 0, __cArray2, __cAOp, 0xF1, __cArray3, __oneOfFlag, __bSetInCheckAlignment);
        
        if (2 >= 0 && 2 < 64)
        {
          __output.byte((word)2) = 0xF1;
        }
        else
        {
          testStepErrorInTestSystem(0, __cEmpty, "Index out of range. Unable to set byte %lld in message. Please check input parameter.", (int64)2);
          __testStepInitOk = 0;
        }
        ReportByteIndex("", 3, __cArray, elCount(__cArray));
        snprintf(__cArray2, 8192, "%s", __cArray);
        snprintf(__cArray3, 8192, "%s", "");
        
        ReportTableRow(__tableHandle, 0, __cArray2, __cAOp, 0x12, __cArray3, __oneOfFlag, __bSetInCheckAlignment);
        
        if (3 >= 0 && 3 < 64)
        {
          __output.byte((word)3) = 0x12;
        }
        else
        {
          testStepErrorInTestSystem(0, __cEmpty, "Index out of range. Unable to set byte %lld in message. Please check input parameter.", (int64)3);
          __testStepInitOk = 0;
        }
      
        ReportTableEndTestStep(__tableHandle, "Req1");
      }
      if (__testStepInitOk)
      {
        output(__output);
      }
    }
    if (__timeout <= 0)
    {
      testStepErrorInTestSystem(0, "1", "Unable to wait for %.3f %s. Please check input parameter.", __timeout / ((float)1000000), "ms");
    }
    else
    {
      __tt0cnt_35 = 0;
      snprintf(__cArray, elCount(__cArray), "CAN message '%s' ID = 417001888x (0x18DAF1A0x) on bus FDCAN2", "DIAGNOSTIC_RESPONSE_PAM");
      if(SetBusContextByName("FDCAN2", __eSaveCurrent, __nBusContextNew, __nBusContextOld))
        testJoinMessageEvent(`FDCAN2::`DIAGNOSTIC_RESPONSE_PAM,  __cArray,
             delegate dword(message * __m)
             {
               dword __msg_callback_ret;
               if (__tt0cnt_35 == -1)
               {
                 return 1;
               }
               __msg_callback_ret = 1;
               __tt0cnt_35++;
               if (__msg_callback_ret)
               {
                 __tt0cnt_35 = -1;
                 return 1;
               }
               return 0;
             });
      __res = testWaitForAllJoinedEventsNS(__timeout);
      if (__nInt64 != 0)
      {
        snprintf(__cArray, elCount(__cArray), "CAN message '%s' ID = 417001888x (0x18DAF1A0x) on bus FDCAN2", "DIAGNOSTIC_RESPONSE_PAM");
        if(__tt0cnt_35 == -1)
        {
          snprintf(__cArray2, 8192, "Response of %s", __cArray);
        }
        else
        {
          snprintf(__cArray2, 8192, "Response of %s (received %d times)", __cArray, __tt0cnt_35);
        }
        if (__tt0cnt_35 == 0)
        {
          testStepFail(0, "Resp1", __cArray2);
        }
        else
        {
          testStepPass(2, "Resp1", __cArray2);
        }
        __ReportRequestResponseResult(__res, 0);
      }
      ResetBusContext(__nBusContextNew, __nBusContextOld);
    }
  }
  TestCommandEnd();

}

void Ttvccmce9_FD1D_DID_with_Physical_Address()
{
  stack long __tableHandle;
  TestCommandBegin(__eDiagService, __cDiagService, "", "0");
  {
    if (DiagIsFunctionalGroup("CVADAS_0001_00000000_000"))
    {
      DiagResponse * __resp;
      DiagRequest CVADAS_0001_00000000_000._22FD1D_PCB_Serial_Number __req;
      __diagServicevccmce9_37(__req, __resp);
    }
    else
    {
      DiagResponse CVADAS_0001_00000000_000.* __resp;
      DiagRequest CVADAS_0001_00000000_000._22FD1D_PCB_Serial_Number __req;
      __diagServicevccmce9_37(__req, __resp);
    }
  }
  TestCommandEnd();


}

  
void __diagServicevccmce9_37(DiagRequest * __req, DiagResponse * __resp )
{
  stack long __tableHandle;
  long __res, __paramLen, __bytePos;

   __bVerdict = __eVerdictPass;

  do {
    TestReportResetDiagObjectList();
    DiagSetReportDetailLevel("CVADAS_0001_00000000_000", EnumServiceDetails_onfail);
    // Request aspect
    {
      {
        CheckLiteralGetStringBufferConsistency("FD1D", 8192);
      snprintf(__cDiagValueArray, 8192, "%s", "FD1D");
        __bDiagValueArrayCtr = __MapChar2ByteAtDiagSet(__cDiagValueArray, __bDiagValueArray);
        if (__bDiagValueArrayCtr >= 0)
        {
          __res = DiagSetParameterErrorHandled(__req, "RecordDataIdentifier", __bDiagValueArray, __bDiagValueArrayCtr);
          if(__res < 0)
          {
            __bVerdict = __eVerdictFail;
            DiagErrCodeTestStep(__res, "Cannot set diagnostic parameter 'RecordDataIdentifier'");
            break;
          }
        }
        else
        {
      	__bVerdict = __eVerdictFail;
          snprintf(__cArray2, 8192, "SetParameter: illegal byte sequence: '%s' (parameter %s). Use hex tuples like '01 AF ...'", __cDiagValueArray, "RecordDataIdentifier");
          DiagErrCodeTestStep(__bDiagValueArrayCtr, __cArray2);
          DiagErrCodeTestStep(-1, "Cannot set diagnostic parameter 'RecordDataIdentifier'");
      	break;
        }
      }

      if (0 >= DiagSendReqAndWaitForResp("CVADAS_0001_00000000_000", __req, __resp, __res, -1, -1, -1, -1, -1, EnumResult_pos, EnumServiceDetails_onfail, EnumSendingMode_physical, EnumSuppressPosResBit_asconfigured, EnumVerdictOnInvalidValues_fail))
        break;
    }

    __res = DiagErrCodeTestStep(__res, "Can't retrieve last response for request! No check possible.") < 0;
    if(__res)
    {
	  __bVerdict = __eVerdictFail;
      break;
    }
    {
      __res = DiagInterpretAs(__resp, "RDBI_PR");
      if(__res != 0)
      {
        __bVerdict = __eVerdictFail;
        DiagErrCodeTestStep(__res, "Can't interpret response as diagnostic primitive 'RDBI_PR'.");
        break;
      }
      else
      {
        TestStepPass( "Received primitive can be interpreted as diagnostic primitive 'RDBI_PR'.");
      }
    }
  }
  while(0);


  // Response, check & read aspect
  {
    __res = 1;
    __tableHandle = ReportTableHead5Columns(__cCheckCaption, __cTSym, __cTOp, __cRefVal, __cActual, __cRes);
    {
      __bDiagValueArrayCtr = DiagGetParameterErrorHandled(__resp, "PCB_Serial_Number_0xFD1D", __bDiagValueArray, elcount(__bDiagValueArray), __cDiagValueArray, elcount(__cDiagValueArray));
      {
        __bSetInCheckAlignment = 1;	
        {
          __bArrayCtr = __CopyBytes(__bDiagValueArray, __bDiagValueArrayCtr, __bArray);
          {
            sysvar * __systemVariable;
            __systemVariable = sysvarData::`PartNumber::`Part_Number;
            CheckSysVarSetBufferConsistency(sysSetVariableData(sysvarData::`PartNumber::`Part_Number, __bArray, __bArrayCtr), __systemVariable.name);
          }
          snprintf(__cArray, 8192, "%s", "Part_Number");
          snprintf(__cArray2, 8192, "%s '%s'", __cSysVar, __cArray);
          snprintf(__cArray3, 8192, "%s", "PCB_Serial_Number_0xFD1D");
          
          ReportTableRow(__tableHandle, 0, __cArray2, __cAOp, __bArray, __bArrayCtr, __cArray3, __oneOfFlag, __bSetInCheckAlignment);
        
        }
    
        __bSetInCheckAlignment = 0;
      }
    }
    {
      __bDiagValueArrayCtr = DiagGetParameterErrorHandled(__resp, "PCB_Serial_Number_0xFD1D/PCB_Serial_Number", __bDiagValueArray, elcount(__bDiagValueArray), __cDiagValueArray, elcount(__cDiagValueArray));
      {
        __bSetInCheckAlignment = 1;	
        {
          __bArrayCtr = __CopyBytes(__bDiagValueArray, __bDiagValueArrayCtr, __bArray);
          {
            sysvar * __systemVariable;
            __systemVariable = sysvarData::`PartNumber::`Part_Number;
            CheckSysVarSetBufferConsistency(sysSetVariableData(sysvarData::`PartNumber::`Part_Number, __bArray, __bArrayCtr), __systemVariable.name);
          }
          snprintf(__cArray, 8192, "%s", "Part_Number");
          snprintf(__cArray2, 8192, "%s '%s'", __cSysVar, __cArray);
          snprintf(__cArray3, 8192, "%s", "PCB_Serial_Number_0xFD1D/PCB_Serial_Number");
          
          ReportTableRow(__tableHandle, 0, __cArray2, __cAOp, __bArray, __bArrayCtr, __cArray3, __oneOfFlag, __bSetInCheckAlignment);
        
        }
    
        __bSetInCheckAlignment = 0;
      }
    }
    ReportTableEndVerdict(__tableHandle, __cEvaluateResponse, __res);
	__bVerdict = __bVerdict && __res;
  }
  if (__bVerdict == __eVerdictFail)
    TestReportWriteDiagObjectList();
}

void Ttvccmce9_FD1D_DID_with_Functional_Address()
{
  stack long __tableHandle;
  TestCommandBegin(__eDiagService, __cDiagService, "", "0");
  {
    if (DiagIsFunctionalGroup("CVADAS_0001_00000000_000"))
    {
      DiagResponse * __resp;
      DiagRequest CVADAS_0001_00000000_000._22FD1D_PCB_Serial_Number __req;
      __diagServicevccmce9_38(__req, __resp);
    }
    else
    {
      DiagResponse CVADAS_0001_00000000_000.* __resp;
      DiagRequest CVADAS_0001_00000000_000._22FD1D_PCB_Serial_Number __req;
      __diagServicevccmce9_38(__req, __resp);
    }
  }
  TestCommandEnd();


}

  
void __diagServicevccmce9_38(DiagRequest * __req, DiagResponse * __resp )
{
  stack long __tableHandle;
  long __res, __paramLen, __bytePos;

   __bVerdict = __eVerdictPass;

  do {
    TestReportResetDiagObjectList();
    DiagSetReportDetailLevel("CVADAS_0001_00000000_000", EnumServiceDetails_onfail);
    // Request aspect
    {
      {
        CheckLiteralGetStringBufferConsistency("FD1D", 8192);
      snprintf(__cDiagValueArray, 8192, "%s", "FD1D");
        __bDiagValueArrayCtr = __MapChar2ByteAtDiagSet(__cDiagValueArray, __bDiagValueArray);
        if (__bDiagValueArrayCtr >= 0)
        {
          __res = DiagSetParameterErrorHandled(__req, "RecordDataIdentifier", __bDiagValueArray, __bDiagValueArrayCtr);
          if(__res < 0)
          {
            __bVerdict = __eVerdictFail;
            DiagErrCodeTestStep(__res, "Cannot set diagnostic parameter 'RecordDataIdentifier'");
            break;
          }
        }
        else
        {
      	__bVerdict = __eVerdictFail;
          snprintf(__cArray2, 8192, "SetParameter: illegal byte sequence: '%s' (parameter %s). Use hex tuples like '01 AF ...'", __cDiagValueArray, "RecordDataIdentifier");
          DiagErrCodeTestStep(__bDiagValueArrayCtr, __cArray2);
          DiagErrCodeTestStep(-1, "Cannot set diagnostic parameter 'RecordDataIdentifier'");
      	break;
        }
      }

      if (0 >= DiagSendReqAndWaitForResp("CVADAS_0001_00000000_000", __req, __resp, __res, -1, -1, -1, -1, -1, EnumResult_pos, EnumServiceDetails_onfail, EnumSendingMode_physical, EnumSuppressPosResBit_asconfigured, EnumVerdictOnInvalidValues_fail))
        break;
    }

    __res = DiagErrCodeTestStep(__res, "Can't retrieve last response for request! No check possible.") < 0;
    if(__res)
    {
	  __bVerdict = __eVerdictFail;
      break;
    }
    {
      __res = DiagInterpretAs(__resp, "RDBI_PR");
      if(__res != 0)
      {
        __bVerdict = __eVerdictFail;
        DiagErrCodeTestStep(__res, "Can't interpret response as diagnostic primitive 'RDBI_PR'.");
        break;
      }
      else
      {
        TestStepPass( "Received primitive can be interpreted as diagnostic primitive 'RDBI_PR'.");
      }
    }
  }
  while(0);


  // Response, check & read aspect
  {
    __res = 1;
    __tableHandle = ReportTableHead5Columns(__cCheckCaption, __cTSym, __cTOp, __cRefVal, __cActual, __cRes);
    {
      __bDiagValueArrayCtr = DiagGetParameterErrorHandled(__resp, "PCB_Serial_Number_0xFD1D", __bDiagValueArray, elcount(__bDiagValueArray), __cDiagValueArray, elcount(__cDiagValueArray));
      {
        __bSetInCheckAlignment = 1;	
        {
          __bArrayCtr = __CopyBytes(__bDiagValueArray, __bDiagValueArrayCtr, __bArray);
          {
            sysvar * __systemVariable;
            __systemVariable = sysvarData::`PartNumber::`Part_Number;
            CheckSysVarSetBufferConsistency(sysSetVariableData(sysvarData::`PartNumber::`Part_Number, __bArray, __bArrayCtr), __systemVariable.name);
          }
          snprintf(__cArray, 8192, "%s", "Part_Number");
          snprintf(__cArray2, 8192, "%s '%s'", __cSysVar, __cArray);
          snprintf(__cArray3, 8192, "%s", "PCB_Serial_Number_0xFD1D");
          
          ReportTableRow(__tableHandle, 0, __cArray2, __cAOp, __bArray, __bArrayCtr, __cArray3, __oneOfFlag, __bSetInCheckAlignment);
        
        }
    
        __bSetInCheckAlignment = 0;
      }
    }
    {
      __bDiagValueArrayCtr = DiagGetParameterErrorHandled(__resp, "PCB_Serial_Number_0xFD1D/PCB_Serial_Number", __bDiagValueArray, elcount(__bDiagValueArray), __cDiagValueArray, elcount(__cDiagValueArray));
      {
        __bSetInCheckAlignment = 1;	
        {
          __bArrayCtr = __CopyBytes(__bDiagValueArray, __bDiagValueArrayCtr, __bArray);
          {
            sysvar * __systemVariable;
            __systemVariable = sysvarData::`PartNumber::`Part_Number;
            CheckSysVarSetBufferConsistency(sysSetVariableData(sysvarData::`PartNumber::`Part_Number, __bArray, __bArrayCtr), __systemVariable.name);
          }
          snprintf(__cArray, 8192, "%s", "Part_Number");
          snprintf(__cArray2, 8192, "%s '%s'", __cSysVar, __cArray);
          snprintf(__cArray3, 8192, "%s", "PCB_Serial_Number_0xFD1D/PCB_Serial_Number");
          
          ReportTableRow(__tableHandle, 0, __cArray2, __cAOp, __bArray, __bArrayCtr, __cArray3, __oneOfFlag, __bSetInCheckAlignment);
        
        }
    
        __bSetInCheckAlignment = 0;
      }
    }
    ReportTableEndVerdict(__tableHandle, __cEvaluateResponse, __res);
	__bVerdict = __bVerdict && __res;
  }
  if (__bVerdict == __eVerdictFail)
    TestReportWriteDiagObjectList();
}

void Ttvccmce9_FD1D_DID_with_Standard_Physical_Address()
{
  stack long __tableHandle;
  TestCommandBegin(__eRequestResponse, __cRequestResponse, "", "0");
  {
  
    long __res;
    int64 __timeout;
    __res = 0;
    __nInt64 = 1;
    __timeout = syspar::`P2_Server * 1000000LL;
    {
    
      long __testStepInitOk;
      message `FDCAN2::`DIAGNOSTIC_REQUEST_PAM __output;
      message `FDCAN2::`DIAGNOSTIC_REQUEST_PAM __msgOrig;
      __output = __msgOrig;
      __testStepInitOk = 1;
      {
        int64 __dlc;
        __dlc = 4;
        if (__dlc >= 0 && __dlc <= (__output.EDL ? 15 : 8))
          __output.DLC = __dlc;
        else
        {
          testStepErrorInTestSystem(0, __cEmpty, "Unable to set DLC=%lld in message. Please check input parameter.", __dlc);
          __testStepInitOk = 0;
        }
      }
      if (__testStepInitOk)
      {
        snprintf(__cArray, elCount(__cArray), "CAN message '%s' ID = 416981233x (0x18DAA0F1x) on bus FDCAN2", "DIAGNOSTIC_REQUEST_PAM");
        snprintf(__cArray2, elCount(__cArray2), "Send %s", __cArray);
        __tableHandle = ReportTableHead3Columns(__cArray2, "Byte", __cTOp, __cAssigned);
        ReportByteIndex("", 0, __cArray, elCount(__cArray));
        snprintf(__cArray2, 8192, "%s", __cArray);
        snprintf(__cArray3, 8192, "%s", "");
        
        ReportTableRow(__tableHandle, 0, __cArray2, __cAOp, 0x3, __cArray3, __oneOfFlag, __bSetInCheckAlignment);
        
        if (0 >= 0 && 0 < 64)
        {
          __output.byte((word)0) = 0x3;
        }
        else
        {
          testStepErrorInTestSystem(0, __cEmpty, "Index out of range. Unable to set byte %lld in message. Please check input parameter.", (int64)0);
          __testStepInitOk = 0;
        }
        ReportByteIndex("", 1, __cArray, elCount(__cArray));
        snprintf(__cArray2, 8192, "%s", __cArray);
        snprintf(__cArray3, 8192, "%s", "");
        
        ReportTableRow(__tableHandle, 0, __cArray2, __cAOp, 0x22, __cArray3, __oneOfFlag, __bSetInCheckAlignment);
        
        if (1 >= 0 && 1 < 64)
        {
          __output.byte((word)1) = 0x22;
        }
        else
        {
          testStepErrorInTestSystem(0, __cEmpty, "Index out of range. Unable to set byte %lld in message. Please check input parameter.", (int64)1);
          __testStepInitOk = 0;
        }
        ReportByteIndex("", 2, __cArray, elCount(__cArray));
        snprintf(__cArray2, 8192, "%s", __cArray);
        snprintf(__cArray3, 8192, "%s", "");
        
        ReportTableRow(__tableHandle, 0, __cArray2, __cAOp, 0xFD, __cArray3, __oneOfFlag, __bSetInCheckAlignment);
        
        if (2 >= 0 && 2 < 64)
        {
          __output.byte((word)2) = 0xFD;
        }
        else
        {
          testStepErrorInTestSystem(0, __cEmpty, "Index out of range. Unable to set byte %lld in message. Please check input parameter.", (int64)2);
          __testStepInitOk = 0;
        }
        ReportByteIndex("", 3, __cArray, elCount(__cArray));
        snprintf(__cArray2, 8192, "%s", __cArray);
        snprintf(__cArray3, 8192, "%s", "");
        
        ReportTableRow(__tableHandle, 0, __cArray2, __cAOp, 0x1D, __cArray3, __oneOfFlag, __bSetInCheckAlignment);
        
        if (3 >= 0 && 3 < 64)
        {
          __output.byte((word)3) = 0x1D;
        }
        else
        {
          testStepErrorInTestSystem(0, __cEmpty, "Index out of range. Unable to set byte %lld in message. Please check input parameter.", (int64)3);
          __testStepInitOk = 0;
        }
      
        ReportTableEndTestStep(__tableHandle, "Req1");
      }
      if (__testStepInitOk)
      {
        output(__output);
      }
    }
    if (__timeout <= 0)
    {
      testStepErrorInTestSystem(0, "1", "Unable to wait for %.3f %s. Please check input parameter.", __timeout / ((float)1000000), "ms");
    }
    else
    {
      __tt0cnt_37 = 0;
      snprintf(__cArray, elCount(__cArray), "CAN message '%s' ID = 417001888x (0x18DAF1A0x) on bus FDCAN2", "DIAGNOSTIC_RESPONSE_PAM");
      if(SetBusContextByName("FDCAN2", __eSaveCurrent, __nBusContextNew, __nBusContextOld))
        testJoinMessageEvent(`FDCAN2::`DIAGNOSTIC_RESPONSE_PAM,  __cArray,
             delegate dword(message * __m)
             {
               dword __msg_callback_ret;
               if (__tt0cnt_37 == -1)
               {
                 return 1;
               }
               __msg_callback_ret = 1;
               __tt0cnt_37++;
               if (__msg_callback_ret)
               {
                 __tt0cnt_37 = -1;
                 return 1;
               }
               return 0;
             });
      __res = testWaitForAllJoinedEventsNS(__timeout);
      if (__nInt64 != 0)
      {
        snprintf(__cArray, elCount(__cArray), "CAN message '%s' ID = 417001888x (0x18DAF1A0x) on bus FDCAN2", "DIAGNOSTIC_RESPONSE_PAM");
        if(__tt0cnt_37 == -1)
        {
          snprintf(__cArray2, 8192, "Response of %s", __cArray);
        }
        else
        {
          snprintf(__cArray2, 8192, "Response of %s (received %d times)", __cArray, __tt0cnt_37);
        }
        if (__tt0cnt_37 == 0)
        {
          testStepFail(0, "Resp1", __cArray2);
        }
        else
        {
          testStepPass(2, "Resp1", __cArray2);
        }
        __ReportRequestResponseResult(__res, 0);
      }
      ResetBusContext(__nBusContextNew, __nBusContextOld);
    }
  }
  TestCommandEnd();

}

void Ttvccmce9_F11D_DID_with_Standard_Physical_Address()
{
  stack long __tableHandle;
  TestCommandBegin(__eRequestResponse, __cRequestResponse, "", "0");
  {
  
    long __res;
    int64 __timeout;
    __res = 0;
    __nInt64 = 1;
    __timeout = syspar::`P2_Server * 1000000LL;
    {
    
      long __testStepInitOk;
      message `FDCAN2::`DIAGNOSTIC_REQUEST_PAM __output;
      message `FDCAN2::`DIAGNOSTIC_REQUEST_PAM __msgOrig;
      __output = __msgOrig;
      __testStepInitOk = 1;
      {
        int64 __dlc;
        __dlc = 4;
        if (__dlc >= 0 && __dlc <= (__output.EDL ? 15 : 8))
          __output.DLC = __dlc;
        else
        {
          testStepErrorInTestSystem(0, __cEmpty, "Unable to set DLC=%lld in message. Please check input parameter.", __dlc);
          __testStepInitOk = 0;
        }
      }
      if (__testStepInitOk)
      {
        snprintf(__cArray, elCount(__cArray), "CAN message '%s' ID = 416981233x (0x18DAA0F1x) on bus FDCAN2", "DIAGNOSTIC_REQUEST_PAM");
        snprintf(__cArray2, elCount(__cArray2), "Send %s", __cArray);
        __tableHandle = ReportTableHead3Columns(__cArray2, "Byte", __cTOp, __cAssigned);
        ReportByteIndex("", 0, __cArray, elCount(__cArray));
        snprintf(__cArray2, 8192, "%s", __cArray);
        snprintf(__cArray3, 8192, "%s", "");
        
        ReportTableRow(__tableHandle, 0, __cArray2, __cAOp, 0x3, __cArray3, __oneOfFlag, __bSetInCheckAlignment);
        
        if (0 >= 0 && 0 < 64)
        {
          __output.byte((word)0) = 0x3;
        }
        else
        {
          testStepErrorInTestSystem(0, __cEmpty, "Index out of range. Unable to set byte %lld in message. Please check input parameter.", (int64)0);
          __testStepInitOk = 0;
        }
        ReportByteIndex("", 1, __cArray, elCount(__cArray));
        snprintf(__cArray2, 8192, "%s", __cArray);
        snprintf(__cArray3, 8192, "%s", "");
        
        ReportTableRow(__tableHandle, 0, __cArray2, __cAOp, 0x22, __cArray3, __oneOfFlag, __bSetInCheckAlignment);
        
        if (1 >= 0 && 1 < 64)
        {
          __output.byte((word)1) = 0x22;
        }
        else
        {
          testStepErrorInTestSystem(0, __cEmpty, "Index out of range. Unable to set byte %lld in message. Please check input parameter.", (int64)1);
          __testStepInitOk = 0;
        }
        ReportByteIndex("", 2, __cArray, elCount(__cArray));
        snprintf(__cArray2, 8192, "%s", __cArray);
        snprintf(__cArray3, 8192, "%s", "");
        
        ReportTableRow(__tableHandle, 0, __cArray2, __cAOp, 0xF1, __cArray3, __oneOfFlag, __bSetInCheckAlignment);
        
        if (2 >= 0 && 2 < 64)
        {
          __output.byte((word)2) = 0xF1;
        }
        else
        {
          testStepErrorInTestSystem(0, __cEmpty, "Index out of range. Unable to set byte %lld in message. Please check input parameter.", (int64)2);
          __testStepInitOk = 0;
        }
        ReportByteIndex("", 3, __cArray, elCount(__cArray));
        snprintf(__cArray2, 8192, "%s", __cArray);
        snprintf(__cArray3, 8192, "%s", "");
        
        ReportTableRow(__tableHandle, 0, __cArray2, __cAOp, 0x1D, __cArray3, __oneOfFlag, __bSetInCheckAlignment);
        
        if (3 >= 0 && 3 < 64)
        {
          __output.byte((word)3) = 0x1D;
        }
        else
        {
          testStepErrorInTestSystem(0, __cEmpty, "Index out of range. Unable to set byte %lld in message. Please check input parameter.", (int64)3);
          __testStepInitOk = 0;
        }
      
        ReportTableEndTestStep(__tableHandle, "Req1");
      }
      if (__testStepInitOk)
      {
        output(__output);
      }
    }
    if (__timeout <= 0)
    {
      testStepErrorInTestSystem(0, "1", "Unable to wait for %.3f %s. Please check input parameter.", __timeout / ((float)1000000), "ms");
    }
    else
    {
      __tt0cnt_39 = 0;
      snprintf(__cArray, elCount(__cArray), "CAN message '%s' ID = 417001888x (0x18DAF1A0x) on bus FDCAN2", "DIAGNOSTIC_RESPONSE_PAM");
      if(SetBusContextByName("FDCAN2", __eSaveCurrent, __nBusContextNew, __nBusContextOld))
        testJoinMessageEvent(`FDCAN2::`DIAGNOSTIC_RESPONSE_PAM,  __cArray,
             delegate dword(message * __m)
             {
               dword __msg_callback_ret;
               if (__tt0cnt_39 == -1)
               {
                 return 1;
               }
               __msg_callback_ret = 1;
               __tt0cnt_39++;
               if (__msg_callback_ret)
               {
                 __tt0cnt_39 = -1;
                 return 1;
               }
               return 0;
             });
      __res = testWaitForAllJoinedEventsNS(__timeout);
      if (__nInt64 != 0)
      {
        snprintf(__cArray, elCount(__cArray), "CAN message '%s' ID = 417001888x (0x18DAF1A0x) on bus FDCAN2", "DIAGNOSTIC_RESPONSE_PAM");
        if(__tt0cnt_39 == -1)
        {
          snprintf(__cArray2, 8192, "Response of %s", __cArray);
        }
        else
        {
          snprintf(__cArray2, 8192, "Response of %s (received %d times)", __cArray, __tt0cnt_39);
        }
        if (__tt0cnt_39 == 0)
        {
          testStepFail(0, "Resp1", __cArray2);
        }
        else
        {
          testStepPass(2, "Resp1", __cArray2);
        }
        __ReportRequestResponseResult(__res, 0);
      }
      ResetBusContext(__nBusContextNew, __nBusContextOld);
    }
  }
  TestCommandEnd();

}

void Ttvccmce9_FD38_DID_with_Physical_Address()
{
  stack long __tableHandle;
  TestCommandBegin(__eDiagService, __cDiagService, "", "0");
  {
    if (DiagIsFunctionalGroup("CVADAS_0001_00000000_000"))
    {
      DiagResponse * __resp;
      DiagRequest CVADAS_0001_00000000_000._22FD38_Programmed_Assembly __req;
      __diagServicevccmce9_39(__req, __resp);
    }
    else
    {
      DiagResponse CVADAS_0001_00000000_000.* __resp;
      DiagRequest CVADAS_0001_00000000_000._22FD38_Programmed_Assembly __req;
      __diagServicevccmce9_39(__req, __resp);
    }
  }
  TestCommandEnd();


}

  
void __diagServicevccmce9_39(DiagRequest * __req, DiagResponse * __resp )
{
  stack long __tableHandle;
  long __res, __paramLen, __bytePos;

   __bVerdict = __eVerdictPass;

  do {
    TestReportResetDiagObjectList();
    DiagSetReportDetailLevel("CVADAS_0001_00000000_000", EnumServiceDetails_onfail);
    // Request aspect
    {
      {
        CheckLiteralGetStringBufferConsistency("FD38", 8192);
      snprintf(__cDiagValueArray, 8192, "%s", "FD38");
        __bDiagValueArrayCtr = __MapChar2ByteAtDiagSet(__cDiagValueArray, __bDiagValueArray);
        if (__bDiagValueArrayCtr >= 0)
        {
          __res = DiagSetParameterErrorHandled(__req, "RecordDataIdentifier", __bDiagValueArray, __bDiagValueArrayCtr);
          if(__res < 0)
          {
            __bVerdict = __eVerdictFail;
            DiagErrCodeTestStep(__res, "Cannot set diagnostic parameter 'RecordDataIdentifier'");
            break;
          }
        }
        else
        {
      	__bVerdict = __eVerdictFail;
          snprintf(__cArray2, 8192, "SetParameter: illegal byte sequence: '%s' (parameter %s). Use hex tuples like '01 AF ...'", __cDiagValueArray, "RecordDataIdentifier");
          DiagErrCodeTestStep(__bDiagValueArrayCtr, __cArray2);
          DiagErrCodeTestStep(-1, "Cannot set diagnostic parameter 'RecordDataIdentifier'");
      	break;
        }
      }

      if (0 >= DiagSendReqAndWaitForResp("CVADAS_0001_00000000_000", __req, __resp, __res, -1, -1, -1, -1, -1, EnumResult_pos, EnumServiceDetails_onfail, EnumSendingMode_physical, EnumSuppressPosResBit_asconfigured, EnumVerdictOnInvalidValues_fail))
        break;
    }

    __res = DiagErrCodeTestStep(__res, "Can't retrieve last response for request! No check possible.") < 0;
    if(__res)
    {
	  __bVerdict = __eVerdictFail;
      break;
    }
    {
      __res = DiagInterpretAs(__resp, "RDBI_PR");
      if(__res != 0)
      {
        __bVerdict = __eVerdictFail;
        DiagErrCodeTestStep(__res, "Can't interpret response as diagnostic primitive 'RDBI_PR'.");
        break;
      }
      else
      {
        TestStepPass( "Received primitive can be interpreted as diagnostic primitive 'RDBI_PR'.");
      }
    }
  }
  while(0);


  // Response, check & read aspect
  {
    __res = 1;
    __tableHandle = ReportTableHead5Columns(__cCheckCaption, __cTSym, __cTOp, __cRefVal, __cActual, __cRes);
    {
      __bDiagValueArrayCtr = DiagGetParameterErrorHandled(__resp, "Programmed_Assembly_0xFD38", __bDiagValueArray, elcount(__bDiagValueArray), __cDiagValueArray, elcount(__cDiagValueArray));
      {
        __bSetInCheckAlignment = 1;	
        {
          __bArrayCtr = __CopyBytes(__bDiagValueArray, __bDiagValueArrayCtr, __bArray);
          {
            sysvar * __systemVariable;
            __systemVariable = sysvarData::`PartNumber::`Part_Number;
            CheckSysVarSetBufferConsistency(sysSetVariableData(sysvarData::`PartNumber::`Part_Number, __bArray, __bArrayCtr), __systemVariable.name);
          }
          snprintf(__cArray, 8192, "%s", "Part_Number");
          snprintf(__cArray2, 8192, "%s '%s'", __cSysVar, __cArray);
          snprintf(__cArray3, 8192, "%s", "Programmed_Assembly_0xFD38");
          
          ReportTableRow(__tableHandle, 0, __cArray2, __cAOp, __bArray, __bArrayCtr, __cArray3, __oneOfFlag, __bSetInCheckAlignment);
        
        }
    
        __bSetInCheckAlignment = 0;
      }
    }
    {
      __bDiagValueArrayCtr = DiagGetParameterErrorHandled(__resp, "Programmed_Assembly_0xFD38/Programmed_Assembly", __bDiagValueArray, elcount(__bDiagValueArray), __cDiagValueArray, elcount(__cDiagValueArray));
      {
        __bSetInCheckAlignment = 1;	
        {
          __bArrayCtr = __CopyBytes(__bDiagValueArray, __bDiagValueArrayCtr, __bArray);
          {
            sysvar * __systemVariable;
            __systemVariable = sysvarData::`PartNumber::`Part_Number;
            CheckSysVarSetBufferConsistency(sysSetVariableData(sysvarData::`PartNumber::`Part_Number, __bArray, __bArrayCtr), __systemVariable.name);
          }
          snprintf(__cArray, 8192, "%s", "Part_Number");
          snprintf(__cArray2, 8192, "%s '%s'", __cSysVar, __cArray);
          snprintf(__cArray3, 8192, "%s", "Programmed_Assembly_0xFD38/Programmed_Assembly");
          
          ReportTableRow(__tableHandle, 0, __cArray2, __cAOp, __bArray, __bArrayCtr, __cArray3, __oneOfFlag, __bSetInCheckAlignment);
        
        }
    
        __bSetInCheckAlignment = 0;
      }
    }
    ReportTableEndVerdict(__tableHandle, __cEvaluateResponse, __res);
	__bVerdict = __bVerdict && __res;
  }
  if (__bVerdict == __eVerdictFail)
    TestReportWriteDiagObjectList();
}

void Ttvccmce9_FD38_DID_with_Functional_Address()
{
  stack long __tableHandle;
  TestCommandBegin(__eDiagService, __cDiagService, "", "0");
  {
    if (DiagIsFunctionalGroup("CVADAS_0001_00000000_000"))
    {
      DiagResponse * __resp;
      DiagRequest CVADAS_0001_00000000_000._22FD38_Programmed_Assembly __req;
      __diagServicevccmce9_40(__req, __resp);
    }
    else
    {
      DiagResponse CVADAS_0001_00000000_000.* __resp;
      DiagRequest CVADAS_0001_00000000_000._22FD38_Programmed_Assembly __req;
      __diagServicevccmce9_40(__req, __resp);
    }
  }
  TestCommandEnd();


}

  
void __diagServicevccmce9_40(DiagRequest * __req, DiagResponse * __resp )
{
  stack long __tableHandle;
  long __res, __paramLen, __bytePos;

   __bVerdict = __eVerdictPass;

  do {
    TestReportResetDiagObjectList();
    DiagSetReportDetailLevel("CVADAS_0001_00000000_000", EnumServiceDetails_onfail);
    // Request aspect
    {
      {
        CheckLiteralGetStringBufferConsistency("FD38", 8192);
      snprintf(__cDiagValueArray, 8192, "%s", "FD38");
        __bDiagValueArrayCtr = __MapChar2ByteAtDiagSet(__cDiagValueArray, __bDiagValueArray);
        if (__bDiagValueArrayCtr >= 0)
        {
          __res = DiagSetParameterErrorHandled(__req, "RecordDataIdentifier", __bDiagValueArray, __bDiagValueArrayCtr);
          if(__res < 0)
          {
            __bVerdict = __eVerdictFail;
            DiagErrCodeTestStep(__res, "Cannot set diagnostic parameter 'RecordDataIdentifier'");
            break;
          }
        }
        else
        {
      	__bVerdict = __eVerdictFail;
          snprintf(__cArray2, 8192, "SetParameter: illegal byte sequence: '%s' (parameter %s). Use hex tuples like '01 AF ...'", __cDiagValueArray, "RecordDataIdentifier");
          DiagErrCodeTestStep(__bDiagValueArrayCtr, __cArray2);
          DiagErrCodeTestStep(-1, "Cannot set diagnostic parameter 'RecordDataIdentifier'");
      	break;
        }
      }

      if (0 >= DiagSendReqAndWaitForResp("CVADAS_0001_00000000_000", __req, __resp, __res, -1, -1, -1, -1, -1, EnumResult_pos, EnumServiceDetails_onfail, EnumSendingMode_physical, EnumSuppressPosResBit_asconfigured, EnumVerdictOnInvalidValues_fail))
        break;
    }

    __res = DiagErrCodeTestStep(__res, "Can't retrieve last response for request! No check possible.") < 0;
    if(__res)
    {
	  __bVerdict = __eVerdictFail;
      break;
    }
    {
      __res = DiagInterpretAs(__resp, "RDBI_PR");
      if(__res != 0)
      {
        __bVerdict = __eVerdictFail;
        DiagErrCodeTestStep(__res, "Can't interpret response as diagnostic primitive 'RDBI_PR'.");
        break;
      }
      else
      {
        TestStepPass( "Received primitive can be interpreted as diagnostic primitive 'RDBI_PR'.");
      }
    }
  }
  while(0);


  // Response, check & read aspect
  {
    __res = 1;
    __tableHandle = ReportTableHead5Columns(__cCheckCaption, __cTSym, __cTOp, __cRefVal, __cActual, __cRes);
    {
      __bDiagValueArrayCtr = DiagGetParameterErrorHandled(__resp, "Programmed_Assembly_0xFD38", __bDiagValueArray, elcount(__bDiagValueArray), __cDiagValueArray, elcount(__cDiagValueArray));
      {
        __bSetInCheckAlignment = 1;	
        {
          __bArrayCtr = __CopyBytes(__bDiagValueArray, __bDiagValueArrayCtr, __bArray);
          {
            sysvar * __systemVariable;
            __systemVariable = sysvarData::`PartNumber::`Part_Number;
            CheckSysVarSetBufferConsistency(sysSetVariableData(sysvarData::`PartNumber::`Part_Number, __bArray, __bArrayCtr), __systemVariable.name);
          }
          snprintf(__cArray, 8192, "%s", "Part_Number");
          snprintf(__cArray2, 8192, "%s '%s'", __cSysVar, __cArray);
          snprintf(__cArray3, 8192, "%s", "Programmed_Assembly_0xFD38");
          
          ReportTableRow(__tableHandle, 0, __cArray2, __cAOp, __bArray, __bArrayCtr, __cArray3, __oneOfFlag, __bSetInCheckAlignment);
        
        }
    
        __bSetInCheckAlignment = 0;
      }
    }
    {
      __bDiagValueArrayCtr = DiagGetParameterErrorHandled(__resp, "Programmed_Assembly_0xFD38/Programmed_Assembly", __bDiagValueArray, elcount(__bDiagValueArray), __cDiagValueArray, elcount(__cDiagValueArray));
      {
        __bSetInCheckAlignment = 1;	
        {
          __bArrayCtr = __CopyBytes(__bDiagValueArray, __bDiagValueArrayCtr, __bArray);
          {
            sysvar * __systemVariable;
            __systemVariable = sysvarData::`PartNumber::`Part_Number;
            CheckSysVarSetBufferConsistency(sysSetVariableData(sysvarData::`PartNumber::`Part_Number, __bArray, __bArrayCtr), __systemVariable.name);
          }
          snprintf(__cArray, 8192, "%s", "Part_Number");
          snprintf(__cArray2, 8192, "%s '%s'", __cSysVar, __cArray);
          snprintf(__cArray3, 8192, "%s", "Programmed_Assembly_0xFD38/Programmed_Assembly");
          
          ReportTableRow(__tableHandle, 0, __cArray2, __cAOp, __bArray, __bArrayCtr, __cArray3, __oneOfFlag, __bSetInCheckAlignment);
        
        }
    
        __bSetInCheckAlignment = 0;
      }
    }
    ReportTableEndVerdict(__tableHandle, __cEvaluateResponse, __res);
	__bVerdict = __bVerdict && __res;
  }
  if (__bVerdict == __eVerdictFail)
    TestReportWriteDiagObjectList();
}

void Ttvccmce9_FD38_DID_with_Standard_Physical_Address()
{
  stack long __tableHandle;
  TestCommandBegin(__eRequestResponse, __cRequestResponse, "", "0");
  {
  
    long __res;
    int64 __timeout;
    __res = 0;
    __nInt64 = 1;
    __timeout = syspar::`P2_Server * 1000000LL;
    {
    
      long __testStepInitOk;
      message `FDCAN2::`DIAGNOSTIC_REQUEST_PAM __output;
      message `FDCAN2::`DIAGNOSTIC_REQUEST_PAM __msgOrig;
      __output = __msgOrig;
      __testStepInitOk = 1;
      {
        int64 __dlc;
        __dlc = 4;
        if (__dlc >= 0 && __dlc <= (__output.EDL ? 15 : 8))
          __output.DLC = __dlc;
        else
        {
          testStepErrorInTestSystem(0, __cEmpty, "Unable to set DLC=%lld in message. Please check input parameter.", __dlc);
          __testStepInitOk = 0;
        }
      }
      if (__testStepInitOk)
      {
        snprintf(__cArray, elCount(__cArray), "CAN message '%s' ID = 416981233x (0x18DAA0F1x) on bus FDCAN2", "DIAGNOSTIC_REQUEST_PAM");
        snprintf(__cArray2, elCount(__cArray2), "Send %s", __cArray);
        __tableHandle = ReportTableHead3Columns(__cArray2, "Byte", __cTOp, __cAssigned);
        ReportByteIndex("", 0, __cArray, elCount(__cArray));
        snprintf(__cArray2, 8192, "%s", __cArray);
        snprintf(__cArray3, 8192, "%s", "");
        
        ReportTableRow(__tableHandle, 0, __cArray2, __cAOp, 0x3, __cArray3, __oneOfFlag, __bSetInCheckAlignment);
        
        if (0 >= 0 && 0 < 64)
        {
          __output.byte((word)0) = 0x3;
        }
        else
        {
          testStepErrorInTestSystem(0, __cEmpty, "Index out of range. Unable to set byte %lld in message. Please check input parameter.", (int64)0);
          __testStepInitOk = 0;
        }
        ReportByteIndex("", 1, __cArray, elCount(__cArray));
        snprintf(__cArray2, 8192, "%s", __cArray);
        snprintf(__cArray3, 8192, "%s", "");
        
        ReportTableRow(__tableHandle, 0, __cArray2, __cAOp, 0x22, __cArray3, __oneOfFlag, __bSetInCheckAlignment);
        
        if (1 >= 0 && 1 < 64)
        {
          __output.byte((word)1) = 0x22;
        }
        else
        {
          testStepErrorInTestSystem(0, __cEmpty, "Index out of range. Unable to set byte %lld in message. Please check input parameter.", (int64)1);
          __testStepInitOk = 0;
        }
        ReportByteIndex("", 2, __cArray, elCount(__cArray));
        snprintf(__cArray2, 8192, "%s", __cArray);
        snprintf(__cArray3, 8192, "%s", "");
        
        ReportTableRow(__tableHandle, 0, __cArray2, __cAOp, 0xFD, __cArray3, __oneOfFlag, __bSetInCheckAlignment);
        
        if (2 >= 0 && 2 < 64)
        {
          __output.byte((word)2) = 0xFD;
        }
        else
        {
          testStepErrorInTestSystem(0, __cEmpty, "Index out of range. Unable to set byte %lld in message. Please check input parameter.", (int64)2);
          __testStepInitOk = 0;
        }
        ReportByteIndex("", 3, __cArray, elCount(__cArray));
        snprintf(__cArray2, 8192, "%s", __cArray);
        snprintf(__cArray3, 8192, "%s", "");
        
        ReportTableRow(__tableHandle, 0, __cArray2, __cAOp, 0x38, __cArray3, __oneOfFlag, __bSetInCheckAlignment);
        
        if (3 >= 0 && 3 < 64)
        {
          __output.byte((word)3) = 0x38;
        }
        else
        {
          testStepErrorInTestSystem(0, __cEmpty, "Index out of range. Unable to set byte %lld in message. Please check input parameter.", (int64)3);
          __testStepInitOk = 0;
        }
      
        ReportTableEndTestStep(__tableHandle, "Req1");
      }
      if (__testStepInitOk)
      {
        output(__output);
      }
    }
    if (__timeout <= 0)
    {
      testStepErrorInTestSystem(0, "1", "Unable to wait for %.3f %s. Please check input parameter.", __timeout / ((float)1000000), "ms");
    }
    else
    {
      __tt0cnt_41 = 0;
      snprintf(__cArray, elCount(__cArray), "CAN message '%s' ID = 417001888x (0x18DAF1A0x) on bus FDCAN2", "DIAGNOSTIC_RESPONSE_PAM");
      if(SetBusContextByName("FDCAN2", __eSaveCurrent, __nBusContextNew, __nBusContextOld))
        testJoinMessageEvent(`FDCAN2::`DIAGNOSTIC_RESPONSE_PAM,  __cArray,
             delegate dword(message * __m)
             {
               dword __msg_callback_ret;
               if (__tt0cnt_41 == -1)
               {
                 return 1;
               }
               __msg_callback_ret = 1;
               __tt0cnt_41++;
               if (__msg_callback_ret)
               {
                 __tt0cnt_41 = -1;
                 return 1;
               }
               return 0;
             });
      __res = testWaitForAllJoinedEventsNS(__timeout);
      if (__nInt64 != 0)
      {
        snprintf(__cArray, elCount(__cArray), "CAN message '%s' ID = 417001888x (0x18DAF1A0x) on bus FDCAN2", "DIAGNOSTIC_RESPONSE_PAM");
        if(__tt0cnt_41 == -1)
        {
          snprintf(__cArray2, 8192, "Response of %s", __cArray);
        }
        else
        {
          snprintf(__cArray2, 8192, "Response of %s (received %d times)", __cArray, __tt0cnt_41);
        }
        if (__tt0cnt_41 == 0)
        {
          testStepFail(0, "Resp1", __cArray2);
        }
        else
        {
          testStepPass(2, "Resp1", __cArray2);
        }
        __ReportRequestResponseResult(__res, 0);
      }
      ResetBusContext(__nBusContextNew, __nBusContextOld);
    }
  }
  TestCommandEnd();

}

void Ttvccmce9_FD13_DID_with_Physical_Address()
{
  stack long __tableHandle;
  TestCommandBegin(__eDiagService, __cDiagService, "", "0");
  {
    if (DiagIsFunctionalGroup("CVADAS_0001_00000000_000"))
    {
      DiagResponse * __resp;
      DiagRequest CVADAS_0001_00000000_000._22FD13_Magna_Software_Version __req;
      __diagServicevccmce9_41(__req, __resp);
    }
    else
    {
      DiagResponse CVADAS_0001_00000000_000.* __resp;
      DiagRequest CVADAS_0001_00000000_000._22FD13_Magna_Software_Version __req;
      __diagServicevccmce9_41(__req, __resp);
    }
  }
  TestCommandEnd();


}

  
void __diagServicevccmce9_41(DiagRequest * __req, DiagResponse * __resp )
{
  stack long __tableHandle;
  long __res, __paramLen, __bytePos;

   __bVerdict = __eVerdictPass;

  do {
    TestReportResetDiagObjectList();
    DiagSetReportDetailLevel("CVADAS_0001_00000000_000", EnumServiceDetails_onfail);
    // Request aspect
    {
      {
        CheckLiteralGetStringBufferConsistency("FD13", 8192);
      snprintf(__cDiagValueArray, 8192, "%s", "FD13");
        __bDiagValueArrayCtr = __MapChar2ByteAtDiagSet(__cDiagValueArray, __bDiagValueArray);
        if (__bDiagValueArrayCtr >= 0)
        {
          __res = DiagSetParameterErrorHandled(__req, "RecordDataIdentifier", __bDiagValueArray, __bDiagValueArrayCtr);
          if(__res < 0)
          {
            __bVerdict = __eVerdictFail;
            DiagErrCodeTestStep(__res, "Cannot set diagnostic parameter 'RecordDataIdentifier'");
            break;
          }
        }
        else
        {
      	__bVerdict = __eVerdictFail;
          snprintf(__cArray2, 8192, "SetParameter: illegal byte sequence: '%s' (parameter %s). Use hex tuples like '01 AF ...'", __cDiagValueArray, "RecordDataIdentifier");
          DiagErrCodeTestStep(__bDiagValueArrayCtr, __cArray2);
          DiagErrCodeTestStep(-1, "Cannot set diagnostic parameter 'RecordDataIdentifier'");
      	break;
        }
      }

      if (0 >= DiagSendReqAndWaitForResp("CVADAS_0001_00000000_000", __req, __resp, __res, -1, -1, -1, -1, -1, EnumResult_pos, EnumServiceDetails_onfail, EnumSendingMode_functional, EnumSuppressPosResBit_asconfigured, EnumVerdictOnInvalidValues_fail))
        break;
    }

    __res = DiagErrCodeTestStep(__res, "Can't retrieve last response for request! No check possible.") < 0;
    if(__res)
    {
	  __bVerdict = __eVerdictFail;
      break;
    }
    {
      __res = DiagInterpretAs(__resp, "RDBI_PR");
      if(__res != 0)
      {
        __bVerdict = __eVerdictFail;
        DiagErrCodeTestStep(__res, "Can't interpret response as diagnostic primitive 'RDBI_PR'.");
        break;
      }
      else
      {
        TestStepPass( "Received primitive can be interpreted as diagnostic primitive 'RDBI_PR'.");
      }
    }
  }
  while(0);


  // Response, check & read aspect
  {
    __res = 1;
    __tableHandle = ReportTableHead5Columns(__cCheckCaption, __cTSym, __cTOp, __cRefVal, __cActual, __cRes);
    {
      __bDiagValueArrayCtr = DiagGetParameterErrorHandled(__resp, "Magna_Software_Version/CVADAS_DC_Applicaion_SW_Build_Number", __bDiagValueArray, elcount(__bDiagValueArray), __cDiagValueArray, elcount(__cDiagValueArray));
      {
        __bSetInCheckAlignment = 1;	
        {
          __bArrayCtr = __CopyBytes(__bDiagValueArray, __bDiagValueArrayCtr, __bArray);
          {
            sysvar * __systemVariable;
            __systemVariable = sysvarData::`PartNumber::`Part_Number;
            CheckSysVarSetBufferConsistency(sysSetVariableData(sysvarData::`PartNumber::`Part_Number, __bArray, __bArrayCtr), __systemVariable.name);
          }
          snprintf(__cArray, 8192, "%s", "Part_Number");
          snprintf(__cArray2, 8192, "%s '%s'", __cSysVar, __cArray);
          snprintf(__cArray3, 8192, "%s", "Magna_Software_Version/CVADAS_DC_Applicaion_SW_Build_Number");
          
          ReportTableRow(__tableHandle, 0, __cArray2, __cAOp, __bArray, __bArrayCtr, __cArray3, __oneOfFlag, __bSetInCheckAlignment);
        
        }
    
        __bSetInCheckAlignment = 0;
      }
    }
    {
      __bDiagValueArrayCtr = DiagGetParameterErrorHandled(__resp, "Magna_Software_Version/CVADAS_DC_Applicaion_SW_Week", __bDiagValueArray, elcount(__bDiagValueArray), __cDiagValueArray, elcount(__cDiagValueArray));
      {
        __bSetInCheckAlignment = 1;	
        {
          __bArrayCtr = __CopyBytes(__bDiagValueArray, __bDiagValueArrayCtr, __bArray);
          {
            sysvar * __systemVariable;
            __systemVariable = sysvarData::`PartNumber::`Part_Number;
            CheckSysVarSetBufferConsistency(sysSetVariableData(sysvarData::`PartNumber::`Part_Number, __bArray, __bArrayCtr), __systemVariable.name);
          }
          snprintf(__cArray, 8192, "%s", "Part_Number");
          snprintf(__cArray2, 8192, "%s '%s'", __cSysVar, __cArray);
          snprintf(__cArray3, 8192, "%s", "Magna_Software_Version/CVADAS_DC_Applicaion_SW_Week");
          
          ReportTableRow(__tableHandle, 0, __cArray2, __cAOp, __bArray, __bArrayCtr, __cArray3, __oneOfFlag, __bSetInCheckAlignment);
        
        }
    
        __bSetInCheckAlignment = 0;
      }
    }
    {
      __bDiagValueArrayCtr = DiagGetParameterErrorHandled(__resp, "Magna_Software_Version/CVADAS_DC_Applicaion_SW_Year", __bDiagValueArray, elcount(__bDiagValueArray), __cDiagValueArray, elcount(__cDiagValueArray));
      {
        __bSetInCheckAlignment = 1;	
        {
          __bArrayCtr = __CopyBytes(__bDiagValueArray, __bDiagValueArrayCtr, __bArray);
          {
            sysvar * __systemVariable;
            __systemVariable = sysvarData::`PartNumber::`Part_Number;
            CheckSysVarSetBufferConsistency(sysSetVariableData(sysvarData::`PartNumber::`Part_Number, __bArray, __bArrayCtr), __systemVariable.name);
          }
          snprintf(__cArray, 8192, "%s", "Part_Number");
          snprintf(__cArray2, 8192, "%s '%s'", __cSysVar, __cArray);
          snprintf(__cArray3, 8192, "%s", "Magna_Software_Version/CVADAS_DC_Applicaion_SW_Year");
          
          ReportTableRow(__tableHandle, 0, __cArray2, __cAOp, __bArray, __bArrayCtr, __cArray3, __oneOfFlag, __bSetInCheckAlignment);
        
        }
    
        __bSetInCheckAlignment = 0;
      }
    }
    {
      __bDiagValueArrayCtr = DiagGetParameterErrorHandled(__resp, "Magna_Software_Version/CVADAS_DC_Application_SW_Day_1", __bDiagValueArray, elcount(__bDiagValueArray), __cDiagValueArray, elcount(__cDiagValueArray));
      {
        __bSetInCheckAlignment = 1;	
        {
          __bArrayCtr = __CopyBytes(__bDiagValueArray, __bDiagValueArrayCtr, __bArray);
          {
            sysvar * __systemVariable;
            __systemVariable = sysvarData::`PartNumber::`Part_Number;
            CheckSysVarSetBufferConsistency(sysSetVariableData(sysvarData::`PartNumber::`Part_Number, __bArray, __bArrayCtr), __systemVariable.name);
          }
          snprintf(__cArray, 8192, "%s", "Part_Number");
          snprintf(__cArray2, 8192, "%s '%s'", __cSysVar, __cArray);
          snprintf(__cArray3, 8192, "%s", "Magna_Software_Version/CVADAS_DC_Application_SW_Day_1");
          
          ReportTableRow(__tableHandle, 0, __cArray2, __cAOp, __bArray, __bArrayCtr, __cArray3, __oneOfFlag, __bSetInCheckAlignment);
        
        }
    
        __bSetInCheckAlignment = 0;
      }
    }
    {
      __bDiagValueArrayCtr = DiagGetParameterErrorHandled(__resp, "Magna_Software_Version/CVADAS_DC_Bootloader_SW_Build_Number", __bDiagValueArray, elcount(__bDiagValueArray), __cDiagValueArray, elcount(__cDiagValueArray));
      {
        __bSetInCheckAlignment = 1;	
        {
          __bArrayCtr = __CopyBytes(__bDiagValueArray, __bDiagValueArrayCtr, __bArray);
          {
            sysvar * __systemVariable;
            __systemVariable = sysvarData::`PartNumber::`Part_Number;
            CheckSysVarSetBufferConsistency(sysSetVariableData(sysvarData::`PartNumber::`Part_Number, __bArray, __bArrayCtr), __systemVariable.name);
          }
          snprintf(__cArray, 8192, "%s", "Part_Number");
          snprintf(__cArray2, 8192, "%s '%s'", __cSysVar, __cArray);
          snprintf(__cArray3, 8192, "%s", "Magna_Software_Version/CVADAS_DC_Bootloader_SW_Build_Number");
          
          ReportTableRow(__tableHandle, 0, __cArray2, __cAOp, __bArray, __bArrayCtr, __cArray3, __oneOfFlag, __bSetInCheckAlignment);
        
        }
    
        __bSetInCheckAlignment = 0;
      }
    }
    {
      __bDiagValueArrayCtr = DiagGetParameterErrorHandled(__resp, "Magna_Software_Version/CVADAS_DC_Bootloader_SW_Day", __bDiagValueArray, elcount(__bDiagValueArray), __cDiagValueArray, elcount(__cDiagValueArray));
      {
        __bSetInCheckAlignment = 1;	
        {
          __bArrayCtr = __CopyBytes(__bDiagValueArray, __bDiagValueArrayCtr, __bArray);
          {
            sysvar * __systemVariable;
            __systemVariable = sysvarData::`PartNumber::`Part_Number;
            CheckSysVarSetBufferConsistency(sysSetVariableData(sysvarData::`PartNumber::`Part_Number, __bArray, __bArrayCtr), __systemVariable.name);
          }
          snprintf(__cArray, 8192, "%s", "Part_Number");
          snprintf(__cArray2, 8192, "%s '%s'", __cSysVar, __cArray);
          snprintf(__cArray3, 8192, "%s", "Magna_Software_Version/CVADAS_DC_Bootloader_SW_Day");
          
          ReportTableRow(__tableHandle, 0, __cArray2, __cAOp, __bArray, __bArrayCtr, __cArray3, __oneOfFlag, __bSetInCheckAlignment);
        
        }
    
        __bSetInCheckAlignment = 0;
      }
    }
    {
      __bDiagValueArrayCtr = DiagGetParameterErrorHandled(__resp, "Magna_Software_Version/CVADAS_DC_Bootloader_SW_Week", __bDiagValueArray, elcount(__bDiagValueArray), __cDiagValueArray, elcount(__cDiagValueArray));
      {
        __bSetInCheckAlignment = 1;	
        {
          __bArrayCtr = __CopyBytes(__bDiagValueArray, __bDiagValueArrayCtr, __bArray);
          {
            sysvar * __systemVariable;
            __systemVariable = sysvarData::`PartNumber::`Part_Number;
            CheckSysVarSetBufferConsistency(sysSetVariableData(sysvarData::`PartNumber::`Part_Number, __bArray, __bArrayCtr), __systemVariable.name);
          }
          snprintf(__cArray, 8192, "%s", "Part_Number");
          snprintf(__cArray2, 8192, "%s '%s'", __cSysVar, __cArray);
          snprintf(__cArray3, 8192, "%s", "Magna_Software_Version/CVADAS_DC_Bootloader_SW_Week");
          
          ReportTableRow(__tableHandle, 0, __cArray2, __cAOp, __bArray, __bArrayCtr, __cArray3, __oneOfFlag, __bSetInCheckAlignment);
        
        }
    
        __bSetInCheckAlignment = 0;
      }
    }
    {
      __bDiagValueArrayCtr = DiagGetParameterErrorHandled(__resp, "Magna_Software_Version/CVADAS_DC_Bootloader_SW_Year", __bDiagValueArray, elcount(__bDiagValueArray), __cDiagValueArray, elcount(__cDiagValueArray));
      {
        __bSetInCheckAlignment = 1;	
        {
          __bArrayCtr = __CopyBytes(__bDiagValueArray, __bDiagValueArrayCtr, __bArray);
          {
            sysvar * __systemVariable;
            __systemVariable = sysvarData::`PartNumber::`Part_Number;
            CheckSysVarSetBufferConsistency(sysSetVariableData(sysvarData::`PartNumber::`Part_Number, __bArray, __bArrayCtr), __systemVariable.name);
          }
          snprintf(__cArray, 8192, "%s", "Part_Number");
          snprintf(__cArray2, 8192, "%s '%s'", __cSysVar, __cArray);
          snprintf(__cArray3, 8192, "%s", "Magna_Software_Version/CVADAS_DC_Bootloader_SW_Year");
          
          ReportTableRow(__tableHandle, 0, __cArray2, __cAOp, __bArray, __bArrayCtr, __cArray3, __oneOfFlag, __bSetInCheckAlignment);
        
        }
    
        __bSetInCheckAlignment = 0;
      }
    }
    {
      __bDiagValueArrayCtr = DiagGetParameterErrorHandled(__resp, "Magna_Software_Version/CVADAS_DC_HSM_High_Security_Module_SW_Build_Number", __bDiagValueArray, elcount(__bDiagValueArray), __cDiagValueArray, elcount(__cDiagValueArray));
      {
        __bSetInCheckAlignment = 1;	
        {
          __bArrayCtr = __CopyBytes(__bDiagValueArray, __bDiagValueArrayCtr, __bArray);
          {
            sysvar * __systemVariable;
            __systemVariable = sysvarData::`PartNumber::`Part_Number;
            CheckSysVarSetBufferConsistency(sysSetVariableData(sysvarData::`PartNumber::`Part_Number, __bArray, __bArrayCtr), __systemVariable.name);
          }
          snprintf(__cArray, 8192, "%s", "Part_Number");
          snprintf(__cArray2, 8192, "%s '%s'", __cSysVar, __cArray);
          snprintf(__cArray3, 8192, "%s", "Magna_Software_Version/CVADAS_DC_HSM_High_Security_Module_SW_Build_Number");
          
          ReportTableRow(__tableHandle, 0, __cArray2, __cAOp, __bArray, __bArrayCtr, __cArray3, __oneOfFlag, __bSetInCheckAlignment);
        
        }
    
        __bSetInCheckAlignment = 0;
      }
    }
    {
      __bDiagValueArrayCtr = DiagGetParameterErrorHandled(__resp, "Magna_Software_Version/CVADAS_DC_HSM_High_Security_Module_SW_Day", __bDiagValueArray, elcount(__bDiagValueArray), __cDiagValueArray, elcount(__cDiagValueArray));
      {
        __bSetInCheckAlignment = 1;	
        {
          __bArrayCtr = __CopyBytes(__bDiagValueArray, __bDiagValueArrayCtr, __bArray);
          {
            sysvar * __systemVariable;
            __systemVariable = sysvarData::`PartNumber::`Part_Number;
            CheckSysVarSetBufferConsistency(sysSetVariableData(sysvarData::`PartNumber::`Part_Number, __bArray, __bArrayCtr), __systemVariable.name);
          }
          snprintf(__cArray, 8192, "%s", "Part_Number");
          snprintf(__cArray2, 8192, "%s '%s'", __cSysVar, __cArray);
          snprintf(__cArray3, 8192, "%s", "Magna_Software_Version/CVADAS_DC_HSM_High_Security_Module_SW_Day");
          
          ReportTableRow(__tableHandle, 0, __cArray2, __cAOp, __bArray, __bArrayCtr, __cArray3, __oneOfFlag, __bSetInCheckAlignment);
        
        }
    
        __bSetInCheckAlignment = 0;
      }
    }
    {
      __bDiagValueArrayCtr = DiagGetParameterErrorHandled(__resp, "Magna_Software_Version/CVADAS_DC_HSM_High_Security_Module_SW_Week", __bDiagValueArray, elcount(__bDiagValueArray), __cDiagValueArray, elcount(__cDiagValueArray));
      {
        __bSetInCheckAlignment = 1;	
        {
          __bArrayCtr = __CopyBytes(__bDiagValueArray, __bDiagValueArrayCtr, __bArray);
          {
            sysvar * __systemVariable;
            __systemVariable = sysvarData::`PartNumber::`Part_Number;
            CheckSysVarSetBufferConsistency(sysSetVariableData(sysvarData::`PartNumber::`Part_Number, __bArray, __bArrayCtr), __systemVariable.name);
          }
          snprintf(__cArray, 8192, "%s", "Part_Number");
          snprintf(__cArray2, 8192, "%s '%s'", __cSysVar, __cArray);
          snprintf(__cArray3, 8192, "%s", "Magna_Software_Version/CVADAS_DC_HSM_High_Security_Module_SW_Week");
          
          ReportTableRow(__tableHandle, 0, __cArray2, __cAOp, __bArray, __bArrayCtr, __cArray3, __oneOfFlag, __bSetInCheckAlignment);
        
        }
    
        __bSetInCheckAlignment = 0;
      }
    }
    {
      __bDiagValueArrayCtr = DiagGetParameterErrorHandled(__resp, "Magna_Software_Version/CVADAS_DC_Bootloader_SW_Year", __bDiagValueArray, elcount(__bDiagValueArray), __cDiagValueArray, elcount(__cDiagValueArray));
      {
        __bSetInCheckAlignment = 1;	
        {
          __bArrayCtr = __CopyBytes(__bDiagValueArray, __bDiagValueArrayCtr, __bArray);
          {
            sysvar * __systemVariable;
            __systemVariable = sysvarData::`PartNumber::`Part_Number;
            CheckSysVarSetBufferConsistency(sysSetVariableData(sysvarData::`PartNumber::`Part_Number, __bArray, __bArrayCtr), __systemVariable.name);
          }
          snprintf(__cArray, 8192, "%s", "Part_Number");
          snprintf(__cArray2, 8192, "%s '%s'", __cSysVar, __cArray);
          snprintf(__cArray3, 8192, "%s", "Magna_Software_Version/CVADAS_DC_Bootloader_SW_Year");
          
          ReportTableRow(__tableHandle, 0, __cArray2, __cAOp, __bArray, __bArrayCtr, __cArray3, __oneOfFlag, __bSetInCheckAlignment);
        
        }
    
        __bSetInCheckAlignment = 0;
      }
    }
    {
      __bDiagValueArrayCtr = DiagGetParameterErrorHandled(__resp, "Magna_Software_Version", __bDiagValueArray, elcount(__bDiagValueArray), __cDiagValueArray, elcount(__cDiagValueArray));
      {
        __bSetInCheckAlignment = 1;	
        {
          __bArrayCtr = __CopyBytes(__bDiagValueArray, __bDiagValueArrayCtr, __bArray);
          {
            sysvar * __systemVariable;
            __systemVariable = sysvarData::`PartNumber::`Part_Number;
            CheckSysVarSetBufferConsistency(sysSetVariableData(sysvarData::`PartNumber::`Part_Number, __bArray, __bArrayCtr), __systemVariable.name);
          }
          snprintf(__cArray, 8192, "%s", "Part_Number");
          snprintf(__cArray2, 8192, "%s '%s'", __cSysVar, __cArray);
          snprintf(__cArray3, 8192, "%s", "Magna_Software_Version");
          
          ReportTableRow(__tableHandle, 0, __cArray2, __cAOp, __bArray, __bArrayCtr, __cArray3, __oneOfFlag, __bSetInCheckAlignment);
        
        }
    
        __bSetInCheckAlignment = 0;
      }
    }
    {
      __bDiagValueArrayCtr = DiagGetParameterErrorHandled(__resp, "Magna_Software_Version/Planned_Release", __bDiagValueArray, elcount(__bDiagValueArray), __cDiagValueArray, elcount(__cDiagValueArray));
      {
        __bSetInCheckAlignment = 1;	
        {
          __bArrayCtr = __CopyBytes(__bDiagValueArray, __bDiagValueArrayCtr, __bArray);
          {
            sysvar * __systemVariable;
            __systemVariable = sysvarData::`PartNumber::`Part_Number;
            CheckSysVarSetBufferConsistency(sysSetVariableData(sysvarData::`PartNumber::`Part_Number, __bArray, __bArrayCtr), __systemVariable.name);
          }
          snprintf(__cArray, 8192, "%s", "Part_Number");
          snprintf(__cArray2, 8192, "%s '%s'", __cSysVar, __cArray);
          snprintf(__cArray3, 8192, "%s", "Magna_Software_Version/Planned_Release");
          
          ReportTableRow(__tableHandle, 0, __cArray2, __cAOp, __bArray, __bArrayCtr, __cArray3, __oneOfFlag, __bSetInCheckAlignment);
        
        }
    
        __bSetInCheckAlignment = 0;
      }
    }
    {
      __bDiagValueArrayCtr = DiagGetParameterErrorHandled(__resp, "Magna_Software_Version/USS_Firmware_version", __bDiagValueArray, elcount(__bDiagValueArray), __cDiagValueArray, elcount(__cDiagValueArray));
      {
        __bSetInCheckAlignment = 1;	
        {
          __bArrayCtr = __CopyBytes(__bDiagValueArray, __bDiagValueArrayCtr, __bArray);
          {
            sysvar * __systemVariable;
            __systemVariable = sysvarData::`PartNumber::`Part_Number;
            CheckSysVarSetBufferConsistency(sysSetVariableData(sysvarData::`PartNumber::`Part_Number, __bArray, __bArrayCtr), __systemVariable.name);
          }
          snprintf(__cArray, 8192, "%s", "Part_Number");
          snprintf(__cArray2, 8192, "%s '%s'", __cSysVar, __cArray);
          snprintf(__cArray3, 8192, "%s", "Magna_Software_Version/USS_Firmware_version");
          
          ReportTableRow(__tableHandle, 0, __cArray2, __cAOp, __bArray, __bArrayCtr, __cArray3, __oneOfFlag, __bSetInCheckAlignment);
        
        }
    
        __bSetInCheckAlignment = 0;
      }
    }
    {
      __bDiagValueArrayCtr = DiagGetParameterErrorHandled(__resp, "Magna_Software_Version/USS_SW_Build_Number", __bDiagValueArray, elcount(__bDiagValueArray), __cDiagValueArray, elcount(__cDiagValueArray));
      {
        __bSetInCheckAlignment = 1;	
        {
          __bArrayCtr = __CopyBytes(__bDiagValueArray, __bDiagValueArrayCtr, __bArray);
          {
            sysvar * __systemVariable;
            __systemVariable = sysvarData::`PartNumber::`Part_Number;
            CheckSysVarSetBufferConsistency(sysSetVariableData(sysvarData::`PartNumber::`Part_Number, __bArray, __bArrayCtr), __systemVariable.name);
          }
          snprintf(__cArray, 8192, "%s", "Part_Number");
          snprintf(__cArray2, 8192, "%s '%s'", __cSysVar, __cArray);
          snprintf(__cArray3, 8192, "%s", "Magna_Software_Version/USS_SW_Build_Number");
          
          ReportTableRow(__tableHandle, 0, __cArray2, __cAOp, __bArray, __bArrayCtr, __cArray3, __oneOfFlag, __bSetInCheckAlignment);
        
        }
    
        __bSetInCheckAlignment = 0;
      }
    }
    {
      __bDiagValueArrayCtr = DiagGetParameterErrorHandled(__resp, "Magna_Software_Version/USS_SW_Day", __bDiagValueArray, elcount(__bDiagValueArray), __cDiagValueArray, elcount(__cDiagValueArray));
      {
        __bSetInCheckAlignment = 1;	
        {
          __bArrayCtr = __CopyBytes(__bDiagValueArray, __bDiagValueArrayCtr, __bArray);
          {
            sysvar * __systemVariable;
            __systemVariable = sysvarData::`PartNumber::`Part_Number;
            CheckSysVarSetBufferConsistency(sysSetVariableData(sysvarData::`PartNumber::`Part_Number, __bArray, __bArrayCtr), __systemVariable.name);
          }
          snprintf(__cArray, 8192, "%s", "Part_Number");
          snprintf(__cArray2, 8192, "%s '%s'", __cSysVar, __cArray);
          snprintf(__cArray3, 8192, "%s", "Magna_Software_Version/USS_SW_Day");
          
          ReportTableRow(__tableHandle, 0, __cArray2, __cAOp, __bArray, __bArrayCtr, __cArray3, __oneOfFlag, __bSetInCheckAlignment);
        
        }
    
        __bSetInCheckAlignment = 0;
      }
    }
    {
      __bDiagValueArrayCtr = DiagGetParameterErrorHandled(__resp, "Magna_Software_Version/USS_SW_Week", __bDiagValueArray, elcount(__bDiagValueArray), __cDiagValueArray, elcount(__cDiagValueArray));
      {
        __bSetInCheckAlignment = 1;	
        {
          __bArrayCtr = __CopyBytes(__bDiagValueArray, __bDiagValueArrayCtr, __bArray);
          {
            sysvar * __systemVariable;
            __systemVariable = sysvarData::`PartNumber::`Part_Number;
            CheckSysVarSetBufferConsistency(sysSetVariableData(sysvarData::`PartNumber::`Part_Number, __bArray, __bArrayCtr), __systemVariable.name);
          }
          snprintf(__cArray, 8192, "%s", "Part_Number");
          snprintf(__cArray2, 8192, "%s '%s'", __cSysVar, __cArray);
          snprintf(__cArray3, 8192, "%s", "Magna_Software_Version/USS_SW_Week");
          
          ReportTableRow(__tableHandle, 0, __cArray2, __cAOp, __bArray, __bArrayCtr, __cArray3, __oneOfFlag, __bSetInCheckAlignment);
        
        }
    
        __bSetInCheckAlignment = 0;
      }
    }
    {
      __bDiagValueArrayCtr = DiagGetParameterErrorHandled(__resp, "Magna_Software_Version/USS_SW_Year", __bDiagValueArray, elcount(__bDiagValueArray), __cDiagValueArray, elcount(__cDiagValueArray));
      {
        __bSetInCheckAlignment = 1;	
        {
          __bArrayCtr = __CopyBytes(__bDiagValueArray, __bDiagValueArrayCtr, __bArray);
          {
            sysvar * __systemVariable;
            __systemVariable = sysvarData::`PartNumber::`Part_Number;
            CheckSysVarSetBufferConsistency(sysSetVariableData(sysvarData::`PartNumber::`Part_Number, __bArray, __bArrayCtr), __systemVariable.name);
          }
          snprintf(__cArray, 8192, "%s", "Part_Number");
          snprintf(__cArray2, 8192, "%s '%s'", __cSysVar, __cArray);
          snprintf(__cArray3, 8192, "%s", "Magna_Software_Version/USS_SW_Year");
          
          ReportTableRow(__tableHandle, 0, __cArray2, __cAOp, __bArray, __bArrayCtr, __cArray3, __oneOfFlag, __bSetInCheckAlignment);
        
        }
    
        __bSetInCheckAlignment = 0;
      }
    }
    ReportTableEndVerdict(__tableHandle, __cEvaluateResponse, __res);
	__bVerdict = __bVerdict && __res;
  }
  if (__bVerdict == __eVerdictFail)
    TestReportWriteDiagObjectList();
}

void Ttvccmce9_FD13_DID_with_Functional_Address()
{
  stack long __tableHandle;
  TestCommandBegin(__eDiagService, __cDiagService, "", "0");
  {
    if (DiagIsFunctionalGroup("CVADAS_0001_00000000_000"))
    {
      DiagResponse * __resp;
      DiagRequest CVADAS_0001_00000000_000._22FD13_Magna_Software_Version __req;
      __diagServicevccmce9_42(__req, __resp);
    }
    else
    {
      DiagResponse CVADAS_0001_00000000_000.* __resp;
      DiagRequest CVADAS_0001_00000000_000._22FD13_Magna_Software_Version __req;
      __diagServicevccmce9_42(__req, __resp);
    }
  }
  TestCommandEnd();


}

  
void __diagServicevccmce9_42(DiagRequest * __req, DiagResponse * __resp )
{
  stack long __tableHandle;
  long __res, __paramLen, __bytePos;

   __bVerdict = __eVerdictPass;

  do {
    TestReportResetDiagObjectList();
    DiagSetReportDetailLevel("CVADAS_0001_00000000_000", EnumServiceDetails_onfail);
    // Request aspect
    {
      {
        CheckLiteralGetStringBufferConsistency("FD13", 8192);
      snprintf(__cDiagValueArray, 8192, "%s", "FD13");
        __bDiagValueArrayCtr = __MapChar2ByteAtDiagSet(__cDiagValueArray, __bDiagValueArray);
        if (__bDiagValueArrayCtr >= 0)
        {
          __res = DiagSetParameterErrorHandled(__req, "RecordDataIdentifier", __bDiagValueArray, __bDiagValueArrayCtr);
          if(__res < 0)
          {
            __bVerdict = __eVerdictFail;
            DiagErrCodeTestStep(__res, "Cannot set diagnostic parameter 'RecordDataIdentifier'");
            break;
          }
        }
        else
        {
      	__bVerdict = __eVerdictFail;
          snprintf(__cArray2, 8192, "SetParameter: illegal byte sequence: '%s' (parameter %s). Use hex tuples like '01 AF ...'", __cDiagValueArray, "RecordDataIdentifier");
          DiagErrCodeTestStep(__bDiagValueArrayCtr, __cArray2);
          DiagErrCodeTestStep(-1, "Cannot set diagnostic parameter 'RecordDataIdentifier'");
      	break;
        }
      }

      if (0 >= DiagSendReqAndWaitForResp("CVADAS_0001_00000000_000", __req, __resp, __res, -1, -1, -1, -1, -1, EnumResult_pos, EnumServiceDetails_onfail, EnumSendingMode_functional, EnumSuppressPosResBit_asconfigured, EnumVerdictOnInvalidValues_fail))
        break;
    }

    __res = DiagErrCodeTestStep(__res, "Can't retrieve last response for request! No check possible.") < 0;
    if(__res)
    {
	  __bVerdict = __eVerdictFail;
      break;
    }
    {
      __res = DiagInterpretAs(__resp, "RDBI_PR");
      if(__res != 0)
      {
        __bVerdict = __eVerdictFail;
        DiagErrCodeTestStep(__res, "Can't interpret response as diagnostic primitive 'RDBI_PR'.");
        break;
      }
      else
      {
        TestStepPass( "Received primitive can be interpreted as diagnostic primitive 'RDBI_PR'.");
      }
    }
  }
  while(0);


  // Response, check & read aspect
  {
    __res = 1;
    __tableHandle = ReportTableHead5Columns(__cCheckCaption, __cTSym, __cTOp, __cRefVal, __cActual, __cRes);
    {
      __bDiagValueArrayCtr = DiagGetParameterErrorHandled(__resp, "Magna_Software_Version/CVADAS_DC_Applicaion_SW_Build_Number", __bDiagValueArray, elcount(__bDiagValueArray), __cDiagValueArray, elcount(__cDiagValueArray));
      {
        __bSetInCheckAlignment = 1;	
        {
          __bArrayCtr = __CopyBytes(__bDiagValueArray, __bDiagValueArrayCtr, __bArray);
          {
            sysvar * __systemVariable;
            __systemVariable = sysvarData::`PartNumber::`Part_Number;
            CheckSysVarSetBufferConsistency(sysSetVariableData(sysvarData::`PartNumber::`Part_Number, __bArray, __bArrayCtr), __systemVariable.name);
          }
          snprintf(__cArray, 8192, "%s", "Part_Number");
          snprintf(__cArray2, 8192, "%s '%s'", __cSysVar, __cArray);
          snprintf(__cArray3, 8192, "%s", "Magna_Software_Version/CVADAS_DC_Applicaion_SW_Build_Number");
          
          ReportTableRow(__tableHandle, 0, __cArray2, __cAOp, __bArray, __bArrayCtr, __cArray3, __oneOfFlag, __bSetInCheckAlignment);
        
        }
    
        __bSetInCheckAlignment = 0;
      }
    }
    {
      __bDiagValueArrayCtr = DiagGetParameterErrorHandled(__resp, "Magna_Software_Version/CVADAS_DC_Applicaion_SW_Week", __bDiagValueArray, elcount(__bDiagValueArray), __cDiagValueArray, elcount(__cDiagValueArray));
      {
        __bSetInCheckAlignment = 1;	
        {
          __bArrayCtr = __CopyBytes(__bDiagValueArray, __bDiagValueArrayCtr, __bArray);
          {
            sysvar * __systemVariable;
            __systemVariable = sysvarData::`PartNumber::`Part_Number;
            CheckSysVarSetBufferConsistency(sysSetVariableData(sysvarData::`PartNumber::`Part_Number, __bArray, __bArrayCtr), __systemVariable.name);
          }
          snprintf(__cArray, 8192, "%s", "Part_Number");
          snprintf(__cArray2, 8192, "%s '%s'", __cSysVar, __cArray);
          snprintf(__cArray3, 8192, "%s", "Magna_Software_Version/CVADAS_DC_Applicaion_SW_Week");
          
          ReportTableRow(__tableHandle, 0, __cArray2, __cAOp, __bArray, __bArrayCtr, __cArray3, __oneOfFlag, __bSetInCheckAlignment);
        
        }
    
        __bSetInCheckAlignment = 0;
      }
    }
    {
      __bDiagValueArrayCtr = DiagGetParameterErrorHandled(__resp, "Magna_Software_Version/CVADAS_DC_Applicaion_SW_Year", __bDiagValueArray, elcount(__bDiagValueArray), __cDiagValueArray, elcount(__cDiagValueArray));
      {
        __bSetInCheckAlignment = 1;	
        {
          __bArrayCtr = __CopyBytes(__bDiagValueArray, __bDiagValueArrayCtr, __bArray);
          {
            sysvar * __systemVariable;
            __systemVariable = sysvarData::`PartNumber::`Part_Number;
            CheckSysVarSetBufferConsistency(sysSetVariableData(sysvarData::`PartNumber::`Part_Number, __bArray, __bArrayCtr), __systemVariable.name);
          }
          snprintf(__cArray, 8192, "%s", "Part_Number");
          snprintf(__cArray2, 8192, "%s '%s'", __cSysVar, __cArray);
          snprintf(__cArray3, 8192, "%s", "Magna_Software_Version/CVADAS_DC_Applicaion_SW_Year");
          
          ReportTableRow(__tableHandle, 0, __cArray2, __cAOp, __bArray, __bArrayCtr, __cArray3, __oneOfFlag, __bSetInCheckAlignment);
        
        }
    
        __bSetInCheckAlignment = 0;
      }
    }
    {
      __bDiagValueArrayCtr = DiagGetParameterErrorHandled(__resp, "Magna_Software_Version/CVADAS_DC_Application_SW_Day_1", __bDiagValueArray, elcount(__bDiagValueArray), __cDiagValueArray, elcount(__cDiagValueArray));
      {
        __bSetInCheckAlignment = 1;	
        {
          __bArrayCtr = __CopyBytes(__bDiagValueArray, __bDiagValueArrayCtr, __bArray);
          {
            sysvar * __systemVariable;
            __systemVariable = sysvarData::`PartNumber::`Part_Number;
            CheckSysVarSetBufferConsistency(sysSetVariableData(sysvarData::`PartNumber::`Part_Number, __bArray, __bArrayCtr), __systemVariable.name);
          }
          snprintf(__cArray, 8192, "%s", "Part_Number");
          snprintf(__cArray2, 8192, "%s '%s'", __cSysVar, __cArray);
          snprintf(__cArray3, 8192, "%s", "Magna_Software_Version/CVADAS_DC_Application_SW_Day_1");
          
          ReportTableRow(__tableHandle, 0, __cArray2, __cAOp, __bArray, __bArrayCtr, __cArray3, __oneOfFlag, __bSetInCheckAlignment);
        
        }
    
        __bSetInCheckAlignment = 0;
      }
    }
    {
      __bDiagValueArrayCtr = DiagGetParameterErrorHandled(__resp, "Magna_Software_Version/CVADAS_DC_Bootloader_SW_Build_Number", __bDiagValueArray, elcount(__bDiagValueArray), __cDiagValueArray, elcount(__cDiagValueArray));
      {
        __bSetInCheckAlignment = 1;	
        {
          __bArrayCtr = __CopyBytes(__bDiagValueArray, __bDiagValueArrayCtr, __bArray);
          {
            sysvar * __systemVariable;
            __systemVariable = sysvarData::`PartNumber::`Part_Number;
            CheckSysVarSetBufferConsistency(sysSetVariableData(sysvarData::`PartNumber::`Part_Number, __bArray, __bArrayCtr), __systemVariable.name);
          }
          snprintf(__cArray, 8192, "%s", "Part_Number");
          snprintf(__cArray2, 8192, "%s '%s'", __cSysVar, __cArray);
          snprintf(__cArray3, 8192, "%s", "Magna_Software_Version/CVADAS_DC_Bootloader_SW_Build_Number");
          
          ReportTableRow(__tableHandle, 0, __cArray2, __cAOp, __bArray, __bArrayCtr, __cArray3, __oneOfFlag, __bSetInCheckAlignment);
        
        }
    
        __bSetInCheckAlignment = 0;
      }
    }
    {
      __bDiagValueArrayCtr = DiagGetParameterErrorHandled(__resp, "Magna_Software_Version/CVADAS_DC_Bootloader_SW_Day", __bDiagValueArray, elcount(__bDiagValueArray), __cDiagValueArray, elcount(__cDiagValueArray));
      {
        __bSetInCheckAlignment = 1;	
        {
          __bArrayCtr = __CopyBytes(__bDiagValueArray, __bDiagValueArrayCtr, __bArray);
          {
            sysvar * __systemVariable;
            __systemVariable = sysvarData::`PartNumber::`Part_Number;
            CheckSysVarSetBufferConsistency(sysSetVariableData(sysvarData::`PartNumber::`Part_Number, __bArray, __bArrayCtr), __systemVariable.name);
          }
          snprintf(__cArray, 8192, "%s", "Part_Number");
          snprintf(__cArray2, 8192, "%s '%s'", __cSysVar, __cArray);
          snprintf(__cArray3, 8192, "%s", "Magna_Software_Version/CVADAS_DC_Bootloader_SW_Day");
          
          ReportTableRow(__tableHandle, 0, __cArray2, __cAOp, __bArray, __bArrayCtr, __cArray3, __oneOfFlag, __bSetInCheckAlignment);
        
        }
    
        __bSetInCheckAlignment = 0;
      }
    }
    {
      __bDiagValueArrayCtr = DiagGetParameterErrorHandled(__resp, "Magna_Software_Version/CVADAS_DC_Bootloader_SW_Week", __bDiagValueArray, elcount(__bDiagValueArray), __cDiagValueArray, elcount(__cDiagValueArray));
      {
        __bSetInCheckAlignment = 1;	
        {
          __bArrayCtr = __CopyBytes(__bDiagValueArray, __bDiagValueArrayCtr, __bArray);
          {
            sysvar * __systemVariable;
            __systemVariable = sysvarData::`PartNumber::`Part_Number;
            CheckSysVarSetBufferConsistency(sysSetVariableData(sysvarData::`PartNumber::`Part_Number, __bArray, __bArrayCtr), __systemVariable.name);
          }
          snprintf(__cArray, 8192, "%s", "Part_Number");
          snprintf(__cArray2, 8192, "%s '%s'", __cSysVar, __cArray);
          snprintf(__cArray3, 8192, "%s", "Magna_Software_Version/CVADAS_DC_Bootloader_SW_Week");
          
          ReportTableRow(__tableHandle, 0, __cArray2, __cAOp, __bArray, __bArrayCtr, __cArray3, __oneOfFlag, __bSetInCheckAlignment);
        
        }
    
        __bSetInCheckAlignment = 0;
      }
    }
    {
      __bDiagValueArrayCtr = DiagGetParameterErrorHandled(__resp, "Magna_Software_Version/CVADAS_DC_Bootloader_SW_Year", __bDiagValueArray, elcount(__bDiagValueArray), __cDiagValueArray, elcount(__cDiagValueArray));
      {
        __bSetInCheckAlignment = 1;	
        {
          __bArrayCtr = __CopyBytes(__bDiagValueArray, __bDiagValueArrayCtr, __bArray);
          {
            sysvar * __systemVariable;
            __systemVariable = sysvarData::`PartNumber::`Part_Number;
            CheckSysVarSetBufferConsistency(sysSetVariableData(sysvarData::`PartNumber::`Part_Number, __bArray, __bArrayCtr), __systemVariable.name);
          }
          snprintf(__cArray, 8192, "%s", "Part_Number");
          snprintf(__cArray2, 8192, "%s '%s'", __cSysVar, __cArray);
          snprintf(__cArray3, 8192, "%s", "Magna_Software_Version/CVADAS_DC_Bootloader_SW_Year");
          
          ReportTableRow(__tableHandle, 0, __cArray2, __cAOp, __bArray, __bArrayCtr, __cArray3, __oneOfFlag, __bSetInCheckAlignment);
        
        }
    
        __bSetInCheckAlignment = 0;
      }
    }
    {
      __bDiagValueArrayCtr = DiagGetParameterErrorHandled(__resp, "Magna_Software_Version/CVADAS_DC_HSM_High_Security_Module_SW_Build_Number", __bDiagValueArray, elcount(__bDiagValueArray), __cDiagValueArray, elcount(__cDiagValueArray));
      {
        __bSetInCheckAlignment = 1;	
        {
          __bArrayCtr = __CopyBytes(__bDiagValueArray, __bDiagValueArrayCtr, __bArray);
          {
            sysvar * __systemVariable;
            __systemVariable = sysvarData::`PartNumber::`Part_Number;
            CheckSysVarSetBufferConsistency(sysSetVariableData(sysvarData::`PartNumber::`Part_Number, __bArray, __bArrayCtr), __systemVariable.name);
          }
          snprintf(__cArray, 8192, "%s", "Part_Number");
          snprintf(__cArray2, 8192, "%s '%s'", __cSysVar, __cArray);
          snprintf(__cArray3, 8192, "%s", "Magna_Software_Version/CVADAS_DC_HSM_High_Security_Module_SW_Build_Number");
          
          ReportTableRow(__tableHandle, 0, __cArray2, __cAOp, __bArray, __bArrayCtr, __cArray3, __oneOfFlag, __bSetInCheckAlignment);
        
        }
    
        __bSetInCheckAlignment = 0;
      }
    }
    {
      __bDiagValueArrayCtr = DiagGetParameterErrorHandled(__resp, "Magna_Software_Version/CVADAS_DC_HSM_High_Security_Module_SW_Day", __bDiagValueArray, elcount(__bDiagValueArray), __cDiagValueArray, elcount(__cDiagValueArray));
      {
        __bSetInCheckAlignment = 1;	
        {
          __bArrayCtr = __CopyBytes(__bDiagValueArray, __bDiagValueArrayCtr, __bArray);
          {
            sysvar * __systemVariable;
            __systemVariable = sysvarData::`PartNumber::`Part_Number;
            CheckSysVarSetBufferConsistency(sysSetVariableData(sysvarData::`PartNumber::`Part_Number, __bArray, __bArrayCtr), __systemVariable.name);
          }
          snprintf(__cArray, 8192, "%s", "Part_Number");
          snprintf(__cArray2, 8192, "%s '%s'", __cSysVar, __cArray);
          snprintf(__cArray3, 8192, "%s", "Magna_Software_Version/CVADAS_DC_HSM_High_Security_Module_SW_Day");
          
          ReportTableRow(__tableHandle, 0, __cArray2, __cAOp, __bArray, __bArrayCtr, __cArray3, __oneOfFlag, __bSetInCheckAlignment);
        
        }
    
        __bSetInCheckAlignment = 0;
      }
    }
    {
      __bDiagValueArrayCtr = DiagGetParameterErrorHandled(__resp, "Magna_Software_Version/CVADAS_DC_HSM_High_Security_Module_SW_Week", __bDiagValueArray, elcount(__bDiagValueArray), __cDiagValueArray, elcount(__cDiagValueArray));
      {
        __bSetInCheckAlignment = 1;	
        {
          __bArrayCtr = __CopyBytes(__bDiagValueArray, __bDiagValueArrayCtr, __bArray);
          {
            sysvar * __systemVariable;
            __systemVariable = sysvarData::`PartNumber::`Part_Number;
            CheckSysVarSetBufferConsistency(sysSetVariableData(sysvarData::`PartNumber::`Part_Number, __bArray, __bArrayCtr), __systemVariable.name);
          }
          snprintf(__cArray, 8192, "%s", "Part_Number");
          snprintf(__cArray2, 8192, "%s '%s'", __cSysVar, __cArray);
          snprintf(__cArray3, 8192, "%s", "Magna_Software_Version/CVADAS_DC_HSM_High_Security_Module_SW_Week");
          
          ReportTableRow(__tableHandle, 0, __cArray2, __cAOp, __bArray, __bArrayCtr, __cArray3, __oneOfFlag, __bSetInCheckAlignment);
        
        }
    
        __bSetInCheckAlignment = 0;
      }
    }
    {
      __bDiagValueArrayCtr = DiagGetParameterErrorHandled(__resp, "Magna_Software_Version/CVADAS_DC_Bootloader_SW_Year", __bDiagValueArray, elcount(__bDiagValueArray), __cDiagValueArray, elcount(__cDiagValueArray));
      {
        __bSetInCheckAlignment = 1;	
        {
          __bArrayCtr = __CopyBytes(__bDiagValueArray, __bDiagValueArrayCtr, __bArray);
          {
            sysvar * __systemVariable;
            __systemVariable = sysvarData::`PartNumber::`Part_Number;
            CheckSysVarSetBufferConsistency(sysSetVariableData(sysvarData::`PartNumber::`Part_Number, __bArray, __bArrayCtr), __systemVariable.name);
          }
          snprintf(__cArray, 8192, "%s", "Part_Number");
          snprintf(__cArray2, 8192, "%s '%s'", __cSysVar, __cArray);
          snprintf(__cArray3, 8192, "%s", "Magna_Software_Version/CVADAS_DC_Bootloader_SW_Year");
          
          ReportTableRow(__tableHandle, 0, __cArray2, __cAOp, __bArray, __bArrayCtr, __cArray3, __oneOfFlag, __bSetInCheckAlignment);
        
        }
    
        __bSetInCheckAlignment = 0;
      }
    }
    {
      __bDiagValueArrayCtr = DiagGetParameterErrorHandled(__resp, "Magna_Software_Version", __bDiagValueArray, elcount(__bDiagValueArray), __cDiagValueArray, elcount(__cDiagValueArray));
      {
        __bSetInCheckAlignment = 1;	
        {
          __bArrayCtr = __CopyBytes(__bDiagValueArray, __bDiagValueArrayCtr, __bArray);
          {
            sysvar * __systemVariable;
            __systemVariable = sysvarData::`PartNumber::`Part_Number;
            CheckSysVarSetBufferConsistency(sysSetVariableData(sysvarData::`PartNumber::`Part_Number, __bArray, __bArrayCtr), __systemVariable.name);
          }
          snprintf(__cArray, 8192, "%s", "Part_Number");
          snprintf(__cArray2, 8192, "%s '%s'", __cSysVar, __cArray);
          snprintf(__cArray3, 8192, "%s", "Magna_Software_Version");
          
          ReportTableRow(__tableHandle, 0, __cArray2, __cAOp, __bArray, __bArrayCtr, __cArray3, __oneOfFlag, __bSetInCheckAlignment);
        
        }
    
        __bSetInCheckAlignment = 0;
      }
    }
    {
      __bDiagValueArrayCtr = DiagGetParameterErrorHandled(__resp, "Magna_Software_Version/Planned_Release", __bDiagValueArray, elcount(__bDiagValueArray), __cDiagValueArray, elcount(__cDiagValueArray));
      {
        __bSetInCheckAlignment = 1;	
        {
          __bArrayCtr = __CopyBytes(__bDiagValueArray, __bDiagValueArrayCtr, __bArray);
          {
            sysvar * __systemVariable;
            __systemVariable = sysvarData::`PartNumber::`Part_Number;
            CheckSysVarSetBufferConsistency(sysSetVariableData(sysvarData::`PartNumber::`Part_Number, __bArray, __bArrayCtr), __systemVariable.name);
          }
          snprintf(__cArray, 8192, "%s", "Part_Number");
          snprintf(__cArray2, 8192, "%s '%s'", __cSysVar, __cArray);
          snprintf(__cArray3, 8192, "%s", "Magna_Software_Version/Planned_Release");
          
          ReportTableRow(__tableHandle, 0, __cArray2, __cAOp, __bArray, __bArrayCtr, __cArray3, __oneOfFlag, __bSetInCheckAlignment);
        
        }
    
        __bSetInCheckAlignment = 0;
      }
    }
    {
      __bDiagValueArrayCtr = DiagGetParameterErrorHandled(__resp, "Magna_Software_Version/USS_Firmware_version", __bDiagValueArray, elcount(__bDiagValueArray), __cDiagValueArray, elcount(__cDiagValueArray));
      {
        __bSetInCheckAlignment = 1;	
        {
          __bArrayCtr = __CopyBytes(__bDiagValueArray, __bDiagValueArrayCtr, __bArray);
          {
            sysvar * __systemVariable;
            __systemVariable = sysvarData::`PartNumber::`Part_Number;
            CheckSysVarSetBufferConsistency(sysSetVariableData(sysvarData::`PartNumber::`Part_Number, __bArray, __bArrayCtr), __systemVariable.name);
          }
          snprintf(__cArray, 8192, "%s", "Part_Number");
          snprintf(__cArray2, 8192, "%s '%s'", __cSysVar, __cArray);
          snprintf(__cArray3, 8192, "%s", "Magna_Software_Version/USS_Firmware_version");
          
          ReportTableRow(__tableHandle, 0, __cArray2, __cAOp, __bArray, __bArrayCtr, __cArray3, __oneOfFlag, __bSetInCheckAlignment);
        
        }
    
        __bSetInCheckAlignment = 0;
      }
    }
    {
      __bDiagValueArrayCtr = DiagGetParameterErrorHandled(__resp, "Magna_Software_Version/USS_SW_Build_Number", __bDiagValueArray, elcount(__bDiagValueArray), __cDiagValueArray, elcount(__cDiagValueArray));
      {
        __bSetInCheckAlignment = 1;	
        {
          __bArrayCtr = __CopyBytes(__bDiagValueArray, __bDiagValueArrayCtr, __bArray);
          {
            sysvar * __systemVariable;
            __systemVariable = sysvarData::`PartNumber::`Part_Number;
            CheckSysVarSetBufferConsistency(sysSetVariableData(sysvarData::`PartNumber::`Part_Number, __bArray, __bArrayCtr), __systemVariable.name);
          }
          snprintf(__cArray, 8192, "%s", "Part_Number");
          snprintf(__cArray2, 8192, "%s '%s'", __cSysVar, __cArray);
          snprintf(__cArray3, 8192, "%s", "Magna_Software_Version/USS_SW_Build_Number");
          
          ReportTableRow(__tableHandle, 0, __cArray2, __cAOp, __bArray, __bArrayCtr, __cArray3, __oneOfFlag, __bSetInCheckAlignment);
        
        }
    
        __bSetInCheckAlignment = 0;
      }
    }
    {
      __bDiagValueArrayCtr = DiagGetParameterErrorHandled(__resp, "Magna_Software_Version/USS_SW_Day", __bDiagValueArray, elcount(__bDiagValueArray), __cDiagValueArray, elcount(__cDiagValueArray));
      {
        __bSetInCheckAlignment = 1;	
        {
          __bArrayCtr = __CopyBytes(__bDiagValueArray, __bDiagValueArrayCtr, __bArray);
          {
            sysvar * __systemVariable;
            __systemVariable = sysvarData::`PartNumber::`Part_Number;
            CheckSysVarSetBufferConsistency(sysSetVariableData(sysvarData::`PartNumber::`Part_Number, __bArray, __bArrayCtr), __systemVariable.name);
          }
          snprintf(__cArray, 8192, "%s", "Part_Number");
          snprintf(__cArray2, 8192, "%s '%s'", __cSysVar, __cArray);
          snprintf(__cArray3, 8192, "%s", "Magna_Software_Version/USS_SW_Day");
          
          ReportTableRow(__tableHandle, 0, __cArray2, __cAOp, __bArray, __bArrayCtr, __cArray3, __oneOfFlag, __bSetInCheckAlignment);
        
        }
    
        __bSetInCheckAlignment = 0;
      }
    }
    {
      __bDiagValueArrayCtr = DiagGetParameterErrorHandled(__resp, "Magna_Software_Version/USS_SW_Week", __bDiagValueArray, elcount(__bDiagValueArray), __cDiagValueArray, elcount(__cDiagValueArray));
      {
        __bSetInCheckAlignment = 1;	
        {
          __bArrayCtr = __CopyBytes(__bDiagValueArray, __bDiagValueArrayCtr, __bArray);
          {
            sysvar * __systemVariable;
            __systemVariable = sysvarData::`PartNumber::`Part_Number;
            CheckSysVarSetBufferConsistency(sysSetVariableData(sysvarData::`PartNumber::`Part_Number, __bArray, __bArrayCtr), __systemVariable.name);
          }
          snprintf(__cArray, 8192, "%s", "Part_Number");
          snprintf(__cArray2, 8192, "%s '%s'", __cSysVar, __cArray);
          snprintf(__cArray3, 8192, "%s", "Magna_Software_Version/USS_SW_Week");
          
          ReportTableRow(__tableHandle, 0, __cArray2, __cAOp, __bArray, __bArrayCtr, __cArray3, __oneOfFlag, __bSetInCheckAlignment);
        
        }
    
        __bSetInCheckAlignment = 0;
      }
    }
    {
      __bDiagValueArrayCtr = DiagGetParameterErrorHandled(__resp, "Magna_Software_Version/USS_SW_Year", __bDiagValueArray, elcount(__bDiagValueArray), __cDiagValueArray, elcount(__cDiagValueArray));
      {
        __bSetInCheckAlignment = 1;	
        {
          __bArrayCtr = __CopyBytes(__bDiagValueArray, __bDiagValueArrayCtr, __bArray);
          {
            sysvar * __systemVariable;
            __systemVariable = sysvarData::`PartNumber::`Part_Number;
            CheckSysVarSetBufferConsistency(sysSetVariableData(sysvarData::`PartNumber::`Part_Number, __bArray, __bArrayCtr), __systemVariable.name);
          }
          snprintf(__cArray, 8192, "%s", "Part_Number");
          snprintf(__cArray2, 8192, "%s '%s'", __cSysVar, __cArray);
          snprintf(__cArray3, 8192, "%s", "Magna_Software_Version/USS_SW_Year");
          
          ReportTableRow(__tableHandle, 0, __cArray2, __cAOp, __bArray, __bArrayCtr, __cArray3, __oneOfFlag, __bSetInCheckAlignment);
        
        }
    
        __bSetInCheckAlignment = 0;
      }
    }
    ReportTableEndVerdict(__tableHandle, __cEvaluateResponse, __res);
	__bVerdict = __bVerdict && __res;
  }
  if (__bVerdict == __eVerdictFail)
    TestReportWriteDiagObjectList();
}

void Ttvccmce9_FD13_DID_with_Standard_Physical_Address()
{
  stack long __tableHandle;
  TestCommandBegin(__eRequestResponse, __cRequestResponse, "", "0");
  {
  
    long __res;
    int64 __timeout;
    __res = 0;
    __nInt64 = 1;
    __timeout = syspar::`P2_Server * 1000000LL;
    {
    
      long __testStepInitOk;
      message `FDCAN2::`DIAGNOSTIC_REQUEST_PAM __output;
      message `FDCAN2::`DIAGNOSTIC_REQUEST_PAM __msgOrig;
      __output = __msgOrig;
      __testStepInitOk = 1;
      {
        int64 __dlc;
        __dlc = 4;
        if (__dlc >= 0 && __dlc <= (__output.EDL ? 15 : 8))
          __output.DLC = __dlc;
        else
        {
          testStepErrorInTestSystem(0, __cEmpty, "Unable to set DLC=%lld in message. Please check input parameter.", __dlc);
          __testStepInitOk = 0;
        }
      }
      if (__testStepInitOk)
      {
        snprintf(__cArray, elCount(__cArray), "CAN message '%s' ID = 416981233x (0x18DAA0F1x) on bus FDCAN2", "DIAGNOSTIC_REQUEST_PAM");
        snprintf(__cArray2, elCount(__cArray2), "Send %s", __cArray);
        __tableHandle = ReportTableHead3Columns(__cArray2, "Byte", __cTOp, __cAssigned);
        ReportByteIndex("", 0, __cArray, elCount(__cArray));
        snprintf(__cArray2, 8192, "%s", __cArray);
        snprintf(__cArray3, 8192, "%s", "");
        
        ReportTableRow(__tableHandle, 0, __cArray2, __cAOp, 0x3, __cArray3, __oneOfFlag, __bSetInCheckAlignment);
        
        if (0 >= 0 && 0 < 64)
        {
          __output.byte((word)0) = 0x3;
        }
        else
        {
          testStepErrorInTestSystem(0, __cEmpty, "Index out of range. Unable to set byte %lld in message. Please check input parameter.", (int64)0);
          __testStepInitOk = 0;
        }
        ReportByteIndex("", 1, __cArray, elCount(__cArray));
        snprintf(__cArray2, 8192, "%s", __cArray);
        snprintf(__cArray3, 8192, "%s", "");
        
        ReportTableRow(__tableHandle, 0, __cArray2, __cAOp, 0x22, __cArray3, __oneOfFlag, __bSetInCheckAlignment);
        
        if (1 >= 0 && 1 < 64)
        {
          __output.byte((word)1) = 0x22;
        }
        else
        {
          testStepErrorInTestSystem(0, __cEmpty, "Index out of range. Unable to set byte %lld in message. Please check input parameter.", (int64)1);
          __testStepInitOk = 0;
        }
        ReportByteIndex("", 2, __cArray, elCount(__cArray));
        snprintf(__cArray2, 8192, "%s", __cArray);
        snprintf(__cArray3, 8192, "%s", "");
        
        ReportTableRow(__tableHandle, 0, __cArray2, __cAOp, 0xFD, __cArray3, __oneOfFlag, __bSetInCheckAlignment);
        
        if (2 >= 0 && 2 < 64)
        {
          __output.byte((word)2) = 0xFD;
        }
        else
        {
          testStepErrorInTestSystem(0, __cEmpty, "Index out of range. Unable to set byte %lld in message. Please check input parameter.", (int64)2);
          __testStepInitOk = 0;
        }
        ReportByteIndex("", 3, __cArray, elCount(__cArray));
        snprintf(__cArray2, 8192, "%s", __cArray);
        snprintf(__cArray3, 8192, "%s", "");
        
        ReportTableRow(__tableHandle, 0, __cArray2, __cAOp, 0x13, __cArray3, __oneOfFlag, __bSetInCheckAlignment);
        
        if (3 >= 0 && 3 < 64)
        {
          __output.byte((word)3) = 0x13;
        }
        else
        {
          testStepErrorInTestSystem(0, __cEmpty, "Index out of range. Unable to set byte %lld in message. Please check input parameter.", (int64)3);
          __testStepInitOk = 0;
        }
      
        ReportTableEndTestStep(__tableHandle, "Req1");
      }
      if (__testStepInitOk)
      {
        output(__output);
      }
    }
    if (__timeout <= 0)
    {
      testStepErrorInTestSystem(0, "1", "Unable to wait for %.3f %s. Please check input parameter.", __timeout / ((float)1000000), "ms");
    }
    else
    {
      __tt0cnt_43 = 0;
      snprintf(__cArray, elCount(__cArray), "CAN message '%s' ID = 417001888x (0x18DAF1A0x) on bus FDCAN2", "DIAGNOSTIC_RESPONSE_PAM");
      if(SetBusContextByName("FDCAN2", __eSaveCurrent, __nBusContextNew, __nBusContextOld))
        testJoinMessageEvent(`FDCAN2::`DIAGNOSTIC_RESPONSE_PAM,  __cArray,
             delegate dword(message * __m)
             {
               dword __msg_callback_ret;
               if (__tt0cnt_43 == -1)
               {
                 return 1;
               }
               __msg_callback_ret = 1;
               __tt0cnt_43++;
               if (__msg_callback_ret)
               {
                 __tt0cnt_43 = -1;
                 return 1;
               }
               return 0;
             });
      __res = testWaitForAllJoinedEventsNS(__timeout);
      if (__nInt64 != 0)
      {
        snprintf(__cArray, elCount(__cArray), "CAN message '%s' ID = 417001888x (0x18DAF1A0x) on bus FDCAN2", "DIAGNOSTIC_RESPONSE_PAM");
        if(__tt0cnt_43 == -1)
        {
          snprintf(__cArray2, 8192, "Response of %s", __cArray);
        }
        else
        {
          snprintf(__cArray2, 8192, "Response of %s (received %d times)", __cArray, __tt0cnt_43);
        }
        if (__tt0cnt_43 == 0)
        {
          testStepFail(0, "Resp1", __cArray2);
        }
        else
        {
          testStepPass(2, "Resp1", __cArray2);
        }
        __ReportRequestResponseResult(__res, 0);
      }
      ResetBusContext(__nBusContextNew, __nBusContextOld);
    }
  }
  TestCommandEnd();

}

void Ttvccmce9_F18C_DID_with_Physical_Addressing()
{
  stack long __tableHandle;
  TestCommandBegin(__eRequestResponse, __cRequestResponse, "", "0");
  {
  
    long __res;
    int64 __timeout;
    __res = 0;
    __nInt64 = 1;
    __timeout = syspar::`P2_Server * 1000000LL;
    {
    
      long __testStepInitOk;
      message `FDCAN2::`DIAGNOSTIC_REQUEST_FD_PAM __output;
      message `FDCAN2::`DIAGNOSTIC_REQUEST_FD_PAM __msgOrig;
      __output = __msgOrig;
      __testStepInitOk = 1;
      {
        int64 __dlc;
        __dlc = 4;
        if (__dlc >= 0 && __dlc <= (__output.EDL ? 15 : 8))
          __output.DLC = __dlc;
        else
        {
          testStepErrorInTestSystem(0, __cEmpty, "Unable to set DLC=%lld in message. Please check input parameter.", __dlc);
          __testStepInitOk = 0;
        }
      }
      if (__testStepInitOk)
      {
        snprintf(__cArray, elCount(__cArray), "CAN message '%s' ID = 416981234x (0x18DAA0F2x) on bus FDCAN2", "DIAGNOSTIC_REQUEST_FD_PAM");
        snprintf(__cArray2, elCount(__cArray2), "Send %s", __cArray);
        __tableHandle = ReportTableHead3Columns(__cArray2, "Byte", __cTOp, __cAssigned);
        ReportByteIndex("", 0, __cArray, elCount(__cArray));
        snprintf(__cArray2, 8192, "%s", __cArray);
        snprintf(__cArray3, 8192, "%s", "");
        
        ReportTableRow(__tableHandle, 0, __cArray2, __cAOp, 0x3, __cArray3, __oneOfFlag, __bSetInCheckAlignment);
        
        if (0 >= 0 && 0 < 64)
        {
          __output.byte((word)0) = 0x3;
        }
        else
        {
          testStepErrorInTestSystem(0, __cEmpty, "Index out of range. Unable to set byte %lld in message. Please check input parameter.", (int64)0);
          __testStepInitOk = 0;
        }
        ReportByteIndex("", 1, __cArray, elCount(__cArray));
        snprintf(__cArray2, 8192, "%s", __cArray);
        snprintf(__cArray3, 8192, "%s", "");
        
        ReportTableRow(__tableHandle, 0, __cArray2, __cAOp, 0x22, __cArray3, __oneOfFlag, __bSetInCheckAlignment);
        
        if (1 >= 0 && 1 < 64)
        {
          __output.byte((word)1) = 0x22;
        }
        else
        {
          testStepErrorInTestSystem(0, __cEmpty, "Index out of range. Unable to set byte %lld in message. Please check input parameter.", (int64)1);
          __testStepInitOk = 0;
        }
        ReportByteIndex("", 2, __cArray, elCount(__cArray));
        snprintf(__cArray2, 8192, "%s", __cArray);
        snprintf(__cArray3, 8192, "%s", "");
        
        ReportTableRow(__tableHandle, 0, __cArray2, __cAOp, 0xF1, __cArray3, __oneOfFlag, __bSetInCheckAlignment);
        
        if (2 >= 0 && 2 < 64)
        {
          __output.byte((word)2) = 0xF1;
        }
        else
        {
          testStepErrorInTestSystem(0, __cEmpty, "Index out of range. Unable to set byte %lld in message. Please check input parameter.", (int64)2);
          __testStepInitOk = 0;
        }
        ReportByteIndex("", 3, __cArray, elCount(__cArray));
        snprintf(__cArray2, 8192, "%s", __cArray);
        snprintf(__cArray3, 8192, "%s", "");
        
        ReportTableRow(__tableHandle, 0, __cArray2, __cAOp, 0x8C, __cArray3, __oneOfFlag, __bSetInCheckAlignment);
        
        if (3 >= 0 && 3 < 64)
        {
          __output.byte((word)3) = 0x8C;
        }
        else
        {
          testStepErrorInTestSystem(0, __cEmpty, "Index out of range. Unable to set byte %lld in message. Please check input parameter.", (int64)3);
          __testStepInitOk = 0;
        }
      
        ReportTableEndTestStep(__tableHandle, "Req1");
      }
      if (__testStepInitOk)
      {
        output(__output);
      }
    }
    if (__timeout <= 0)
    {
      testStepErrorInTestSystem(0, "1", "Unable to wait for %.3f %s. Please check input parameter.", __timeout / ((float)1000000), "ms");
    }
    else
    {
      __tt0cnt_45 = 0;
      snprintf(__cArray, elCount(__cArray), "CAN message '%s' ID = 417002144x (0x18DAF2A0x) on bus FDCAN2", "DIAGNOSTIC_RESPONSE_FD_PAM");
      if(SetBusContextByName("FDCAN2", __eSaveCurrent, __nBusContextNew, __nBusContextOld))
        testJoinMessageEvent(`FDCAN2::`DIAGNOSTIC_RESPONSE_FD_PAM,  __cArray,
             delegate dword(message * __m)
             {
               dword __msg_callback_ret;
               if (__tt0cnt_45 == -1)
               {
                 return 1;
               }
               __msg_callback_ret = 1;
               __tt0cnt_45++;
               if (__msg_callback_ret)
               {
                 __tt0cnt_45 = -1;
                 return 1;
               }
               return 0;
             });
      __res = testWaitForAllJoinedEventsNS(__timeout);
      if (__nInt64 != 0)
      {
        snprintf(__cArray, elCount(__cArray), "CAN message '%s' ID = 417002144x (0x18DAF2A0x) on bus FDCAN2", "DIAGNOSTIC_RESPONSE_FD_PAM");
        if(__tt0cnt_45 == -1)
        {
          snprintf(__cArray2, 8192, "Response of %s", __cArray);
        }
        else
        {
          snprintf(__cArray2, 8192, "Response of %s (received %d times)", __cArray, __tt0cnt_45);
        }
        if (__tt0cnt_45 == 0)
        {
          testStepFail(0, "Resp1", __cArray2);
        }
        else
        {
          testStepPass(2, "Resp1", __cArray2);
        }
        __ReportRequestResponseResult(__res, 0);
      }
      ResetBusContext(__nBusContextNew, __nBusContextOld);
    }
  }
  TestCommandEnd();

}

void Ttvccmce9_F18C_DID_with_Functional_Addressing()
{
  stack long __tableHandle;
  TestCommandBegin(__eDiagService, __cDiagService, "", "0");
  {
    if (DiagIsFunctionalGroup("CVADAS_0001_00000000_000"))
    {
      DiagResponse * __resp;
      DiagRequest CVADAS_0001_00000000_000._22F18C_ECU_Serial_Number __req;
      __diagServicevccmce9_43(__req, __resp);
    }
    else
    {
      DiagResponse CVADAS_0001_00000000_000.* __resp;
      DiagRequest CVADAS_0001_00000000_000._22F18C_ECU_Serial_Number __req;
      __diagServicevccmce9_43(__req, __resp);
    }
  }
  TestCommandEnd();


}

  
void __diagServicevccmce9_43(DiagRequest * __req, DiagResponse * __resp )
{
  stack long __tableHandle;
  long __res, __paramLen, __bytePos;

   __bVerdict = __eVerdictPass;

  do {
    TestReportResetDiagObjectList();
    DiagSetReportDetailLevel("CVADAS_0001_00000000_000", EnumServiceDetails_onfail);
    // Request aspect
    {

      if (0 >= DiagSendReqAndWaitForResp("CVADAS_0001_00000000_000", __req, __resp, __res, -1, -1, -1, -1, -1, EnumResult_pos, EnumServiceDetails_onfail, EnumSendingMode_functional, EnumSuppressPosResBit_asconfigured, EnumVerdictOnInvalidValues_fail))
        break;
    }

    __res = DiagErrCodeTestStep(__res, "Can't retrieve last response for request! No check possible.") < 0;
    if(__res)
    {
	  __bVerdict = __eVerdictFail;
      break;
    }
    {
      __res = DiagInterpretAs(__resp, "RDBI_PR");
      if(__res != 0)
      {
        __bVerdict = __eVerdictFail;
        DiagErrCodeTestStep(__res, "Can't interpret response as diagnostic primitive 'RDBI_PR'.");
        break;
      }
      else
      {
        TestStepPass( "Received primitive can be interpreted as diagnostic primitive 'RDBI_PR'.");
      }
    }
  }
  while(0);


  // Response, check & read aspect
  {
    __res = 1;
    __tableHandle = ReportTableHead5Columns(__cCheckCaption, __cTSym, __cTOp, __cRefVal, __cActual, __cRes);
    {
      __bDiagValueArrayCtr = DiagGetParameterErrorHandled(__resp, "_Calendar_Year_88", __bDiagValueArray, elcount(__bDiagValueArray), __cDiagValueArray, elcount(__cDiagValueArray));
      {
        __bSetInCheckAlignment = 1;	
        {
          __bArrayCtr = __CopyBytes(__bDiagValueArray, __bDiagValueArrayCtr, __bArray);
          {
            sysvar * __systemVariable;
            __systemVariable = sysvarData::`PartNumber::`Part_Number;
            CheckSysVarSetBufferConsistency(sysSetVariableData(sysvarData::`PartNumber::`Part_Number, __bArray, __bArrayCtr), __systemVariable.name);
          }
          snprintf(__cArray, 8192, "%s", "Part_Number");
          snprintf(__cArray2, 8192, "%s '%s'", __cSysVar, __cArray);
          snprintf(__cArray3, 8192, "%s", "_Calendar_Year_88");
          
          ReportTableRow(__tableHandle, 0, __cArray2, __cAOp, __bArray, __bArrayCtr, __cArray3, __oneOfFlag, __bSetInCheckAlignment);
        
        }
    
        __bSetInCheckAlignment = 0;
      }
    }
    {
      __bDiagValueArrayCtr = DiagGetParameterErrorHandled(__resp, "_Component_Code_48", __bDiagValueArray, elcount(__bDiagValueArray), __cDiagValueArray, elcount(__cDiagValueArray));
      {
        __bSetInCheckAlignment = 1;	
        {
          __bArrayCtr = __CopyBytes(__bDiagValueArray, __bDiagValueArrayCtr, __bArray);
          {
            sysvar * __systemVariable;
            __systemVariable = sysvarData::`PartNumber::`Part_Number;
            CheckSysVarSetBufferConsistency(sysSetVariableData(sysvarData::`PartNumber::`Part_Number, __bArray, __bArrayCtr), __systemVariable.name);
          }
          snprintf(__cArray, 8192, "%s", "Part_Number");
          snprintf(__cArray2, 8192, "%s '%s'", __cSysVar, __cArray);
          snprintf(__cArray3, 8192, "%s", "_Component_Code_48");
          
          ReportTableRow(__tableHandle, 0, __cArray2, __cAOp, __bArray, __bArrayCtr, __cArray3, __oneOfFlag, __bSetInCheckAlignment);
        
        }
    
        __bSetInCheckAlignment = 0;
      }
    }
    {
      __bDiagValueArrayCtr = DiagGetParameterErrorHandled(__resp, "_Data_Identifier_24", __bDiagValueArray, elcount(__bDiagValueArray), __cDiagValueArray, elcount(__cDiagValueArray));
      {
        __bSetInCheckAlignment = 1;	
        {
          __bArrayCtr = __CopyBytes(__bDiagValueArray, __bDiagValueArrayCtr, __bArray);
          {
            sysvar * __systemVariable;
            __systemVariable = sysvarData::`PartNumber::`Part_Number;
            CheckSysVarSetBufferConsistency(sysSetVariableData(sysvarData::`PartNumber::`Part_Number, __bArray, __bArrayCtr), __systemVariable.name);
          }
          snprintf(__cArray, 8192, "%s", "Part_Number");
          snprintf(__cArray2, 8192, "%s '%s'", __cSysVar, __cArray);
          snprintf(__cArray3, 8192, "%s", "_Data_Identifier_24");
          
          ReportTableRow(__tableHandle, 0, __cArray2, __cAOp, __bArray, __bArrayCtr, __cArray3, __oneOfFlag, __bSetInCheckAlignment);
        
        }
    
        __bSetInCheckAlignment = 0;
      }
    }
    {
      __bDiagValueArrayCtr = DiagGetParameterErrorHandled(__resp, "_Day_of_Year_64", __bDiagValueArray, elcount(__bDiagValueArray), __cDiagValueArray, elcount(__cDiagValueArray));
      {
        __bSetInCheckAlignment = 1;	
        {
          __bArrayCtr = __CopyBytes(__bDiagValueArray, __bDiagValueArrayCtr, __bArray);
          {
            sysvar * __systemVariable;
            __systemVariable = sysvarData::`PartNumber::`Part_Number;
            CheckSysVarSetBufferConsistency(sysSetVariableData(sysvarData::`PartNumber::`Part_Number, __bArray, __bArrayCtr), __systemVariable.name);
          }
          snprintf(__cArray, 8192, "%s", "Part_Number");
          snprintf(__cArray2, 8192, "%s '%s'", __cSysVar, __cArray);
          snprintf(__cArray3, 8192, "%s", "_Day_of_Year_64");
          
          ReportTableRow(__tableHandle, 0, __cArray2, __cAOp, __bArray, __bArrayCtr, __cArray3, __oneOfFlag, __bSetInCheckAlignment);
        
        }
    
        __bSetInCheckAlignment = 0;
      }
    }
    {
      __bDiagValueArrayCtr = DiagGetParameterErrorHandled(__resp, "_Sequence_Number_96", __bDiagValueArray, elcount(__bDiagValueArray), __cDiagValueArray, elcount(__cDiagValueArray));
      {
        __bSetInCheckAlignment = 1;	
        {
          __bArrayCtr = __CopyBytes(__bDiagValueArray, __bDiagValueArrayCtr, __bArray);
          {
            sysvar * __systemVariable;
            __systemVariable = sysvarData::`PartNumber::`Part_Number;
            CheckSysVarSetBufferConsistency(sysSetVariableData(sysvarData::`PartNumber::`Part_Number, __bArray, __bArrayCtr), __systemVariable.name);
          }
          snprintf(__cArray, 8192, "%s", "Part_Number");
          snprintf(__cArray2, 8192, "%s '%s'", __cSysVar, __cArray);
          snprintf(__cArray3, 8192, "%s", "_Sequence_Number_96");
          
          ReportTableRow(__tableHandle, 0, __cArray2, __cAOp, __bArray, __bArrayCtr, __cArray3, __oneOfFlag, __bSetInCheckAlignment);
        
        }
    
        __bSetInCheckAlignment = 0;
      }
    }
    {
      __bDiagValueArrayCtr = DiagGetParameterErrorHandled(__resp, "_Supplier_Option_32", __bDiagValueArray, elcount(__bDiagValueArray), __cDiagValueArray, elcount(__cDiagValueArray));
      {
        __bSetInCheckAlignment = 1;	
        {
          __bArrayCtr = __CopyBytes(__bDiagValueArray, __bDiagValueArrayCtr, __bArray);
          {
            sysvar * __systemVariable;
            __systemVariable = sysvarData::`PartNumber::`Part_Number;
            CheckSysVarSetBufferConsistency(sysSetVariableData(sysvarData::`PartNumber::`Part_Number, __bArray, __bArrayCtr), __systemVariable.name);
          }
          snprintf(__cArray, 8192, "%s", "Part_Number");
          snprintf(__cArray2, 8192, "%s '%s'", __cSysVar, __cArray);
          snprintf(__cArray3, 8192, "%s", "_Supplier_Option_32");
          
          ReportTableRow(__tableHandle, 0, __cArray2, __cAOp, __bArray, __bArrayCtr, __cArray3, __oneOfFlag, __bSetInCheckAlignment);
        
        }
    
        __bSetInCheckAlignment = 0;
      }
    }
    ReportTableEndVerdict(__tableHandle, __cEvaluateResponse, __res);
	__bVerdict = __bVerdict && __res;
  }
  if (__bVerdict == __eVerdictFail)
    TestReportWriteDiagObjectList();
}

void Ttvccmce9_F192_DID_with_Physical_Addressing()
{
  stack long __tableHandle;
  TestCommandBegin(__eDiagService, __cDiagService, "", "0");
  {
    if (DiagIsFunctionalGroup("CVADAS_0001_00000000_000"))
    {
      DiagResponse * __resp;
      DiagRequest CVADAS_0001_00000000_000._22F192_Supplier_ECU_Hardware_Part_Number __req;
      __diagServicevccmce9_44(__req, __resp);
    }
    else
    {
      DiagResponse CVADAS_0001_00000000_000.* __resp;
      DiagRequest CVADAS_0001_00000000_000._22F192_Supplier_ECU_Hardware_Part_Number __req;
      __diagServicevccmce9_44(__req, __resp);
    }
  }
  TestCommandEnd();


}

  
void __diagServicevccmce9_44(DiagRequest * __req, DiagResponse * __resp )
{
  stack long __tableHandle;
  long __res, __paramLen, __bytePos;

   __bVerdict = __eVerdictPass;

  do {
    TestReportResetDiagObjectList();
    DiagSetReportDetailLevel("CVADAS_0001_00000000_000", EnumServiceDetails_onfail);
    // Request aspect
    {
      {
        CheckLiteralGetStringBufferConsistency("F192", 8192);
      snprintf(__cDiagValueArray, 8192, "%s", "F192");
        __bDiagValueArrayCtr = __MapChar2ByteAtDiagSet(__cDiagValueArray, __bDiagValueArray);
        if (__bDiagValueArrayCtr >= 0)
        {
          __res = DiagSetParameterErrorHandled(__req, "RecordDataIdentifier", __bDiagValueArray, __bDiagValueArrayCtr);
          if(__res < 0)
          {
            __bVerdict = __eVerdictFail;
            DiagErrCodeTestStep(__res, "Cannot set diagnostic parameter 'RecordDataIdentifier'");
            break;
          }
        }
        else
        {
      	__bVerdict = __eVerdictFail;
          snprintf(__cArray2, 8192, "SetParameter: illegal byte sequence: '%s' (parameter %s). Use hex tuples like '01 AF ...'", __cDiagValueArray, "RecordDataIdentifier");
          DiagErrCodeTestStep(__bDiagValueArrayCtr, __cArray2);
          DiagErrCodeTestStep(-1, "Cannot set diagnostic parameter 'RecordDataIdentifier'");
      	break;
        }
      }

      if (0 >= DiagSendReqAndWaitForResp("CVADAS_0001_00000000_000", __req, __resp, __res, -1, -1, -1, -1, -1, EnumResult_pos, EnumServiceDetails_onfail, EnumSendingMode_physical, EnumSuppressPosResBit_asconfigured, EnumVerdictOnInvalidValues_fail))
        break;
    }

    __res = DiagErrCodeTestStep(__res, "Can't retrieve last response for request! No check possible.") < 0;
    if(__res)
    {
	  __bVerdict = __eVerdictFail;
      break;
    }
    {
      __res = DiagInterpretAs(__resp, "RDBI_PR");
      if(__res != 0)
      {
        __bVerdict = __eVerdictFail;
        DiagErrCodeTestStep(__res, "Can't interpret response as diagnostic primitive 'RDBI_PR'.");
        break;
      }
      else
      {
        TestStepPass( "Received primitive can be interpreted as diagnostic primitive 'RDBI_PR'.");
      }
    }
  }
  while(0);


  // Response, check & read aspect
  {
    __res = 1;
    __tableHandle = ReportTableHead5Columns(__cCheckCaption, __cTSym, __cTOp, __cRefVal, __cActual, __cRes);
    {
      __bDiagValueArrayCtr = DiagGetParameterErrorHandled(__resp, "_Supplier_Manufacturer_ECU_Hardware_Part_Number_24", __bDiagValueArray, elcount(__bDiagValueArray), __cDiagValueArray, elcount(__cDiagValueArray));
      {
        __bSetInCheckAlignment = 1;	
        {
          __bArrayCtr = __CopyBytes(__bDiagValueArray, __bDiagValueArrayCtr, __bArray);
          {
            sysvar * __systemVariable;
            __systemVariable = sysvarData::`PartNumber::`Part_Number;
            CheckSysVarSetBufferConsistency(sysSetVariableData(sysvarData::`PartNumber::`Part_Number, __bArray, __bArrayCtr), __systemVariable.name);
          }
          snprintf(__cArray, 8192, "%s", "Part_Number");
          snprintf(__cArray2, 8192, "%s '%s'", __cSysVar, __cArray);
          snprintf(__cArray3, 8192, "%s", "_Supplier_Manufacturer_ECU_Hardware_Part_Number_24");
          
          ReportTableRow(__tableHandle, 0, __cArray2, __cAOp, __bArray, __bArrayCtr, __cArray3, __oneOfFlag, __bSetInCheckAlignment);
        
        }
    
        __bSetInCheckAlignment = 0;
      }
    }
    ReportTableEndVerdict(__tableHandle, __cEvaluateResponse, __res);
	__bVerdict = __bVerdict && __res;
  }
  if (__bVerdict == __eVerdictFail)
    TestReportWriteDiagObjectList();
}

void Ttvccmce9_F193_DID_with_Physical_Addressing()
{
  stack long __tableHandle;
  TestCommandBegin(__eDiagService, __cDiagService, "", "0");
  {
    if (DiagIsFunctionalGroup("CVADAS_0001_00000000_000"))
    {
      DiagResponse * __resp;
      DiagRequest CVADAS_0001_00000000_000._22F193_Supplier_ECU_Hardware_Version_Number __req;
      __diagServicevccmce9_45(__req, __resp);
    }
    else
    {
      DiagResponse CVADAS_0001_00000000_000.* __resp;
      DiagRequest CVADAS_0001_00000000_000._22F193_Supplier_ECU_Hardware_Version_Number __req;
      __diagServicevccmce9_45(__req, __resp);
    }
  }
  TestCommandEnd();


}

  
void __diagServicevccmce9_45(DiagRequest * __req, DiagResponse * __resp )
{
  stack long __tableHandle;
  long __res, __paramLen, __bytePos;

   __bVerdict = __eVerdictPass;

  do {
    TestReportResetDiagObjectList();
    DiagSetReportDetailLevel("CVADAS_0001_00000000_000", EnumServiceDetails_onfail);
    // Request aspect
    {
      {
        CheckLiteralGetStringBufferConsistency("F193", 8192);
      snprintf(__cDiagValueArray, 8192, "%s", "F193");
        __bDiagValueArrayCtr = __MapChar2ByteAtDiagSet(__cDiagValueArray, __bDiagValueArray);
        if (__bDiagValueArrayCtr >= 0)
        {
          __res = DiagSetParameterErrorHandled(__req, "RecordDataIdentifier", __bDiagValueArray, __bDiagValueArrayCtr);
          if(__res < 0)
          {
            __bVerdict = __eVerdictFail;
            DiagErrCodeTestStep(__res, "Cannot set diagnostic parameter 'RecordDataIdentifier'");
            break;
          }
        }
        else
        {
      	__bVerdict = __eVerdictFail;
          snprintf(__cArray2, 8192, "SetParameter: illegal byte sequence: '%s' (parameter %s). Use hex tuples like '01 AF ...'", __cDiagValueArray, "RecordDataIdentifier");
          DiagErrCodeTestStep(__bDiagValueArrayCtr, __cArray2);
          DiagErrCodeTestStep(-1, "Cannot set diagnostic parameter 'RecordDataIdentifier'");
      	break;
        }
      }

      if (0 >= DiagSendReqAndWaitForResp("CVADAS_0001_00000000_000", __req, __resp, __res, -1, -1, -1, -1, -1, EnumResult_pos, EnumServiceDetails_onfail, EnumSendingMode_physical, EnumSuppressPosResBit_asconfigured, EnumVerdictOnInvalidValues_fail))
        break;
    }

    __res = DiagErrCodeTestStep(__res, "Can't retrieve last response for request! No check possible.") < 0;
    if(__res)
    {
	  __bVerdict = __eVerdictFail;
      break;
    }
    {
      __res = DiagInterpretAs(__resp, "RDBI_PR");
      if(__res != 0)
      {
        __bVerdict = __eVerdictFail;
        DiagErrCodeTestStep(__res, "Can't interpret response as diagnostic primitive 'RDBI_PR'.");
        break;
      }
      else
      {
        TestStepPass( "Received primitive can be interpreted as diagnostic primitive 'RDBI_PR'.");
      }
    }
  }
  while(0);


  // Response, check & read aspect
  {
    __res = 1;
    __tableHandle = ReportTableHead5Columns(__cCheckCaption, __cTSym, __cTOp, __cRefVal, __cActual, __cRes);
    {
      __bDiagValueArrayCtr = DiagGetParameterErrorHandled(__resp, "_Supplier_Manufacturer_ECU_Hardware_Version_Number_24", __bDiagValueArray, elcount(__bDiagValueArray), __cDiagValueArray, elcount(__cDiagValueArray));
      {
        __bSetInCheckAlignment = 1;	
        {
          __bArrayCtr = __CopyBytes(__bDiagValueArray, __bDiagValueArrayCtr, __bArray);
          {
            sysvar * __systemVariable;
            __systemVariable = sysvarData::`PartNumber::`Part_Number;
            CheckSysVarSetBufferConsistency(sysSetVariableData(sysvarData::`PartNumber::`Part_Number, __bArray, __bArrayCtr), __systemVariable.name);
          }
          snprintf(__cArray, 8192, "%s", "Part_Number");
          snprintf(__cArray2, 8192, "%s '%s'", __cSysVar, __cArray);
          snprintf(__cArray3, 8192, "%s", "_Supplier_Manufacturer_ECU_Hardware_Version_Number_24");
          
          ReportTableRow(__tableHandle, 0, __cArray2, __cAOp, __bArray, __bArrayCtr, __cArray3, __oneOfFlag, __bSetInCheckAlignment);
        
        }
    
        __bSetInCheckAlignment = 0;
      }
    }
    ReportTableEndVerdict(__tableHandle, __cEvaluateResponse, __res);
	__bVerdict = __bVerdict && __res;
  }
  if (__bVerdict == __eVerdictFail)
    TestReportWriteDiagObjectList();
}

void Ttvccmce9_FD15_DID_with_Physical_Address()
{
  stack long __tableHandle;
  TestCommandBegin(__eDiagService, __cDiagService, "", "0");
  {
    if (DiagIsFunctionalGroup("CVADAS_0001_00000000_000"))
    {
      DiagResponse * __resp;
      DiagRequest CVADAS_0001_00000000_000._22FD15_Magna_Production_HW_Number_Read __req;
      __diagServicevccmce9_46(__req, __resp);
    }
    else
    {
      DiagResponse CVADAS_0001_00000000_000.* __resp;
      DiagRequest CVADAS_0001_00000000_000._22FD15_Magna_Production_HW_Number_Read __req;
      __diagServicevccmce9_46(__req, __resp);
    }
  }
  TestCommandEnd();


}

  
void __diagServicevccmce9_46(DiagRequest * __req, DiagResponse * __resp )
{
  stack long __tableHandle;
  long __res, __paramLen, __bytePos;

   __bVerdict = __eVerdictPass;

  do {
    TestReportResetDiagObjectList();
    DiagSetReportDetailLevel("CVADAS_0001_00000000_000", EnumServiceDetails_onfail);
    // Request aspect
    {
      {
        CheckLiteralGetStringBufferConsistency("FD15", 8192);
      snprintf(__cDiagValueArray, 8192, "%s", "FD15");
        __bDiagValueArrayCtr = __MapChar2ByteAtDiagSet(__cDiagValueArray, __bDiagValueArray);
        if (__bDiagValueArrayCtr >= 0)
        {
          __res = DiagSetParameterErrorHandled(__req, "RecordDataIdentifier", __bDiagValueArray, __bDiagValueArrayCtr);
          if(__res < 0)
          {
            __bVerdict = __eVerdictFail;
            DiagErrCodeTestStep(__res, "Cannot set diagnostic parameter 'RecordDataIdentifier'");
            break;
          }
        }
        else
        {
      	__bVerdict = __eVerdictFail;
          snprintf(__cArray2, 8192, "SetParameter: illegal byte sequence: '%s' (parameter %s). Use hex tuples like '01 AF ...'", __cDiagValueArray, "RecordDataIdentifier");
          DiagErrCodeTestStep(__bDiagValueArrayCtr, __cArray2);
          DiagErrCodeTestStep(-1, "Cannot set diagnostic parameter 'RecordDataIdentifier'");
      	break;
        }
      }

      if (0 >= DiagSendReqAndWaitForResp("CVADAS_0001_00000000_000", __req, __resp, __res, -1, -1, -1, -1, -1, EnumResult_pos, EnumServiceDetails_onfail, EnumSendingMode_physical, EnumSuppressPosResBit_asconfigured, EnumVerdictOnInvalidValues_fail))
        break;
    }

    __res = DiagErrCodeTestStep(__res, "Can't retrieve last response for request! No check possible.") < 0;
    if(__res)
    {
	  __bVerdict = __eVerdictFail;
      break;
    }
    {
      __res = DiagInterpretAs(__resp, "RDBI_PR");
      if(__res != 0)
      {
        __bVerdict = __eVerdictFail;
        DiagErrCodeTestStep(__res, "Can't interpret response as diagnostic primitive 'RDBI_PR'.");
        break;
      }
      else
      {
        TestStepPass( "Received primitive can be interpreted as diagnostic primitive 'RDBI_PR'.");
      }
    }
  }
  while(0);


  // Response, check & read aspect
  {
    __res = 1;
    __tableHandle = ReportTableHead5Columns(__cCheckCaption, __cTSym, __cTOp, __cRefVal, __cActual, __cRes);
    {
      __bDiagValueArrayCtr = DiagGetParameterErrorHandled(__resp, "Magna_ProdHWNum", __bDiagValueArray, elcount(__bDiagValueArray), __cDiagValueArray, elcount(__cDiagValueArray));
      {
        __bSetInCheckAlignment = 1;	
        {
          __bArrayCtr = __CopyBytes(__bDiagValueArray, __bDiagValueArrayCtr, __bArray);
          {
            sysvar * __systemVariable;
            __systemVariable = sysvarData::`PartNumber::`Part_Number;
            CheckSysVarSetBufferConsistency(sysSetVariableData(sysvarData::`PartNumber::`Part_Number, __bArray, __bArrayCtr), __systemVariable.name);
          }
          snprintf(__cArray, 8192, "%s", "Part_Number");
          snprintf(__cArray2, 8192, "%s '%s'", __cSysVar, __cArray);
          snprintf(__cArray3, 8192, "%s", "Magna_ProdHWNum");
          
          ReportTableRow(__tableHandle, 0, __cArray2, __cAOp, __bArray, __bArrayCtr, __cArray3, __oneOfFlag, __bSetInCheckAlignment);
        
        }
    
        __bSetInCheckAlignment = 0;
      }
    }
    ReportTableEndVerdict(__tableHandle, __cEvaluateResponse, __res);
	__bVerdict = __bVerdict && __res;
  }
  if (__bVerdict == __eVerdictFail)
    TestReportWriteDiagObjectList();
}

void Ttvccmce9_FD15_DID_with_Standard_Physical_Address()
{
  stack long __tableHandle;
  TestCommandBegin(__eRequestResponse, __cRequestResponse, "", "0");
  {
  
    long __res;
    int64 __timeout;
    __res = 0;
    __nInt64 = 1;
    __timeout = syspar::`P2_Server * 1000000LL;
    {
    
      long __testStepInitOk;
      message `FDCAN2::`DIAGNOSTIC_REQUEST_PAM __output;
      message `FDCAN2::`DIAGNOSTIC_REQUEST_PAM __msgOrig;
      __output = __msgOrig;
      __testStepInitOk = 1;
      {
        int64 __dlc;
        __dlc = 4;
        if (__dlc >= 0 && __dlc <= (__output.EDL ? 15 : 8))
          __output.DLC = __dlc;
        else
        {
          testStepErrorInTestSystem(0, __cEmpty, "Unable to set DLC=%lld in message. Please check input parameter.", __dlc);
          __testStepInitOk = 0;
        }
      }
      if (__testStepInitOk)
      {
        snprintf(__cArray, elCount(__cArray), "CAN message '%s' ID = 416981233x (0x18DAA0F1x) on bus FDCAN2", "DIAGNOSTIC_REQUEST_PAM");
        snprintf(__cArray2, elCount(__cArray2), "Send %s", __cArray);
        __tableHandle = ReportTableHead3Columns(__cArray2, "Byte", __cTOp, __cAssigned);
        ReportByteIndex("", 0, __cArray, elCount(__cArray));
        snprintf(__cArray2, 8192, "%s", __cArray);
        snprintf(__cArray3, 8192, "%s", "");
        
        ReportTableRow(__tableHandle, 0, __cArray2, __cAOp, 0x3, __cArray3, __oneOfFlag, __bSetInCheckAlignment);
        
        if (0 >= 0 && 0 < 64)
        {
          __output.byte((word)0) = 0x3;
        }
        else
        {
          testStepErrorInTestSystem(0, __cEmpty, "Index out of range. Unable to set byte %lld in message. Please check input parameter.", (int64)0);
          __testStepInitOk = 0;
        }
        ReportByteIndex("", 1, __cArray, elCount(__cArray));
        snprintf(__cArray2, 8192, "%s", __cArray);
        snprintf(__cArray3, 8192, "%s", "");
        
        ReportTableRow(__tableHandle, 0, __cArray2, __cAOp, 0x22, __cArray3, __oneOfFlag, __bSetInCheckAlignment);
        
        if (1 >= 0 && 1 < 64)
        {
          __output.byte((word)1) = 0x22;
        }
        else
        {
          testStepErrorInTestSystem(0, __cEmpty, "Index out of range. Unable to set byte %lld in message. Please check input parameter.", (int64)1);
          __testStepInitOk = 0;
        }
        ReportByteIndex("", 2, __cArray, elCount(__cArray));
        snprintf(__cArray2, 8192, "%s", __cArray);
        snprintf(__cArray3, 8192, "%s", "");
        
        ReportTableRow(__tableHandle, 0, __cArray2, __cAOp, 0xFD, __cArray3, __oneOfFlag, __bSetInCheckAlignment);
        
        if (2 >= 0 && 2 < 64)
        {
          __output.byte((word)2) = 0xFD;
        }
        else
        {
          testStepErrorInTestSystem(0, __cEmpty, "Index out of range. Unable to set byte %lld in message. Please check input parameter.", (int64)2);
          __testStepInitOk = 0;
        }
        ReportByteIndex("", 3, __cArray, elCount(__cArray));
        snprintf(__cArray2, 8192, "%s", __cArray);
        snprintf(__cArray3, 8192, "%s", "");
        
        ReportTableRow(__tableHandle, 0, __cArray2, __cAOp, 0x15, __cArray3, __oneOfFlag, __bSetInCheckAlignment);
        
        if (3 >= 0 && 3 < 64)
        {
          __output.byte((word)3) = 0x15;
        }
        else
        {
          testStepErrorInTestSystem(0, __cEmpty, "Index out of range. Unable to set byte %lld in message. Please check input parameter.", (int64)3);
          __testStepInitOk = 0;
        }
      
        ReportTableEndTestStep(__tableHandle, "Req1");
      }
      if (__testStepInitOk)
      {
        output(__output);
      }
    }
    if (__timeout <= 0)
    {
      testStepErrorInTestSystem(0, "1", "Unable to wait for %.3f %s. Please check input parameter.", __timeout / ((float)1000000), "ms");
    }
    else
    {
      __tt0cnt_47 = 0;
      snprintf(__cArray, elCount(__cArray), "CAN message '%s' ID = 417001888x (0x18DAF1A0x) on bus FDCAN2", "DIAGNOSTIC_RESPONSE_PAM");
      if(SetBusContextByName("FDCAN2", __eSaveCurrent, __nBusContextNew, __nBusContextOld))
        testJoinMessageEvent(`FDCAN2::`DIAGNOSTIC_RESPONSE_PAM,  __cArray,
             delegate dword(message * __m)
             {
               dword __msg_callback_ret;
               if (__tt0cnt_47 == -1)
               {
                 return 1;
               }
               __msg_callback_ret = 1;
               __tt0cnt_47++;
               if (__msg_callback_ret)
               {
                 __tt0cnt_47 = -1;
                 return 1;
               }
               return 0;
             });
      __res = testWaitForAllJoinedEventsNS(__timeout);
      if (__nInt64 != 0)
      {
        snprintf(__cArray, elCount(__cArray), "CAN message '%s' ID = 417001888x (0x18DAF1A0x) on bus FDCAN2", "DIAGNOSTIC_RESPONSE_PAM");
        if(__tt0cnt_47 == -1)
        {
          snprintf(__cArray2, 8192, "Response of %s", __cArray);
        }
        else
        {
          snprintf(__cArray2, 8192, "Response of %s (received %d times)", __cArray, __tt0cnt_47);
        }
        if (__tt0cnt_47 == 0)
        {
          testStepFail(0, "Resp1", __cArray2);
        }
        else
        {
          testStepPass(2, "Resp1", __cArray2);
        }
        __ReportRequestResponseResult(__res, 0);
      }
      ResetBusContext(__nBusContextNew, __nBusContextOld);
    }
  }
  TestCommandEnd();

}

void Ttvccmce9_FD17_DID_with_Physical_Address()
{
  stack long __tableHandle;
  TestCommandBegin(__eDiagService, __cDiagService, "", "0");
  {
    if (DiagIsFunctionalGroup("CVADAS_0001_00000000_000"))
    {
      DiagResponse * __resp;
      DiagRequest CVADAS_0001_00000000_000._22FD17_Magna_Production_HW_Version_information_Read __req;
      __diagServicevccmce9_47(__req, __resp);
    }
    else
    {
      DiagResponse CVADAS_0001_00000000_000.* __resp;
      DiagRequest CVADAS_0001_00000000_000._22FD17_Magna_Production_HW_Version_information_Read __req;
      __diagServicevccmce9_47(__req, __resp);
    }
  }
  TestCommandEnd();


}

  
void __diagServicevccmce9_47(DiagRequest * __req, DiagResponse * __resp )
{
  stack long __tableHandle;
  long __res, __paramLen, __bytePos;

   __bVerdict = __eVerdictPass;

  do {
    TestReportResetDiagObjectList();
    DiagSetReportDetailLevel("CVADAS_0001_00000000_000", EnumServiceDetails_onfail);
    // Request aspect
    {
      {
        CheckLiteralGetStringBufferConsistency("FD17", 8192);
      snprintf(__cDiagValueArray, 8192, "%s", "FD17");
        __bDiagValueArrayCtr = __MapChar2ByteAtDiagSet(__cDiagValueArray, __bDiagValueArray);
        if (__bDiagValueArrayCtr >= 0)
        {
          __res = DiagSetParameterErrorHandled(__req, "RecordDataIdentifier", __bDiagValueArray, __bDiagValueArrayCtr);
          if(__res < 0)
          {
            __bVerdict = __eVerdictFail;
            DiagErrCodeTestStep(__res, "Cannot set diagnostic parameter 'RecordDataIdentifier'");
            break;
          }
        }
        else
        {
      	__bVerdict = __eVerdictFail;
          snprintf(__cArray2, 8192, "SetParameter: illegal byte sequence: '%s' (parameter %s). Use hex tuples like '01 AF ...'", __cDiagValueArray, "RecordDataIdentifier");
          DiagErrCodeTestStep(__bDiagValueArrayCtr, __cArray2);
          DiagErrCodeTestStep(-1, "Cannot set diagnostic parameter 'RecordDataIdentifier'");
      	break;
        }
      }

      if (0 >= DiagSendReqAndWaitForResp("CVADAS_0001_00000000_000", __req, __resp, __res, -1, -1, -1, -1, -1, EnumResult_pos, EnumServiceDetails_onfail, EnumSendingMode_physical, EnumSuppressPosResBit_asconfigured, EnumVerdictOnInvalidValues_fail))
        break;
    }

    __res = DiagErrCodeTestStep(__res, "Can't retrieve last response for request! No check possible.") < 0;
    if(__res)
    {
	  __bVerdict = __eVerdictFail;
      break;
    }
    {
      __res = DiagInterpretAs(__resp, "RDBI_PR");
      if(__res != 0)
      {
        __bVerdict = __eVerdictFail;
        DiagErrCodeTestStep(__res, "Can't interpret response as diagnostic primitive 'RDBI_PR'.");
        break;
      }
      else
      {
        TestStepPass( "Received primitive can be interpreted as diagnostic primitive 'RDBI_PR'.");
      }
    }
  }
  while(0);


  // Response, check & read aspect
  {
    __res = 1;
    __tableHandle = ReportTableHead5Columns(__cCheckCaption, __cTSym, __cTOp, __cRefVal, __cActual, __cRes);
    {
      __bDiagValueArrayCtr = DiagGetParameterErrorHandled(__resp, "Magna_ProdHwVerInfo_HW_PatchLvl", __bDiagValueArray, elcount(__bDiagValueArray), __cDiagValueArray, elcount(__cDiagValueArray));
      {
        __bSetInCheckAlignment = 1;	
        {
          __bArrayCtr = __CopyBytes(__bDiagValueArray, __bDiagValueArrayCtr, __bArray);
          {
            sysvar * __systemVariable;
            __systemVariable = sysvarData::`PartNumber::`Part_Number;
            CheckSysVarSetBufferConsistency(sysSetVariableData(sysvarData::`PartNumber::`Part_Number, __bArray, __bArrayCtr), __systemVariable.name);
          }
          snprintf(__cArray, 8192, "%s", "Part_Number");
          snprintf(__cArray2, 8192, "%s '%s'", __cSysVar, __cArray);
          snprintf(__cArray3, 8192, "%s", "Magna_ProdHwVerInfo_HW_PatchLvl");
          
          ReportTableRow(__tableHandle, 0, __cArray2, __cAOp, __bArray, __bArrayCtr, __cArray3, __oneOfFlag, __bSetInCheckAlignment);
        
        }
    
        __bSetInCheckAlignment = 0;
      }
    }
    {
      __bDiagValueArrayCtr = DiagGetParameterErrorHandled(__resp, "Magna_ProdHwVerInfo_HW_Week", __bDiagValueArray, elcount(__bDiagValueArray), __cDiagValueArray, elcount(__cDiagValueArray));
      {
        __bSetInCheckAlignment = 1;	
        {
          __bArrayCtr = __CopyBytes(__bDiagValueArray, __bDiagValueArrayCtr, __bArray);
          {
            sysvar * __systemVariable;
            __systemVariable = sysvarData::`PartNumber::`Part_Number;
            CheckSysVarSetBufferConsistency(sysSetVariableData(sysvarData::`PartNumber::`Part_Number, __bArray, __bArrayCtr), __systemVariable.name);
          }
          snprintf(__cArray, 8192, "%s", "Part_Number");
          snprintf(__cArray2, 8192, "%s '%s'", __cSysVar, __cArray);
          snprintf(__cArray3, 8192, "%s", "Magna_ProdHwVerInfo_HW_Week");
          
          ReportTableRow(__tableHandle, 0, __cArray2, __cAOp, __bArray, __bArrayCtr, __cArray3, __oneOfFlag, __bSetInCheckAlignment);
        
        }
    
        __bSetInCheckAlignment = 0;
      }
    }
    {
      __bDiagValueArrayCtr = DiagGetParameterErrorHandled(__resp, "Magna_ProdHwVerInfo_HW_Year", __bDiagValueArray, elcount(__bDiagValueArray), __cDiagValueArray, elcount(__cDiagValueArray));
      {
        __bSetInCheckAlignment = 1;	
        {
          __bArrayCtr = __CopyBytes(__bDiagValueArray, __bDiagValueArrayCtr, __bArray);
          {
            sysvar * __systemVariable;
            __systemVariable = sysvarData::`PartNumber::`Part_Number;
            CheckSysVarSetBufferConsistency(sysSetVariableData(sysvarData::`PartNumber::`Part_Number, __bArray, __bArrayCtr), __systemVariable.name);
          }
          snprintf(__cArray, 8192, "%s", "Part_Number");
          snprintf(__cArray2, 8192, "%s '%s'", __cSysVar, __cArray);
          snprintf(__cArray3, 8192, "%s", "Magna_ProdHwVerInfo_HW_Year");
          
          ReportTableRow(__tableHandle, 0, __cArray2, __cAOp, __bArray, __bArrayCtr, __cArray3, __oneOfFlag, __bSetInCheckAlignment);
        
        }
    
        __bSetInCheckAlignment = 0;
      }
    }
    ReportTableEndVerdict(__tableHandle, __cEvaluateResponse, __res);
	__bVerdict = __bVerdict && __res;
  }
  if (__bVerdict == __eVerdictFail)
    TestReportWriteDiagObjectList();
}

void Ttvccmce9_FD17_DID_with_Standard_Physical_Address()
{
  stack long __tableHandle;
  TestCommandBegin(__eRequestResponse, __cRequestResponse, "", "0");
  {
  
    long __res;
    int64 __timeout;
    __res = 0;
    __nInt64 = 1;
    __timeout = syspar::`P2_Server * 1000000LL;
    {
    
      long __testStepInitOk;
      message `FDCAN2::`DIAGNOSTIC_REQUEST_PAM __output;
      message `FDCAN2::`DIAGNOSTIC_REQUEST_PAM __msgOrig;
      __output = __msgOrig;
      __testStepInitOk = 1;
      {
        int64 __dlc;
        __dlc = 4;
        if (__dlc >= 0 && __dlc <= (__output.EDL ? 15 : 8))
          __output.DLC = __dlc;
        else
        {
          testStepErrorInTestSystem(0, __cEmpty, "Unable to set DLC=%lld in message. Please check input parameter.", __dlc);
          __testStepInitOk = 0;
        }
      }
      if (__testStepInitOk)
      {
        snprintf(__cArray, elCount(__cArray), "CAN message '%s' ID = 416981233x (0x18DAA0F1x) on bus FDCAN2", "DIAGNOSTIC_REQUEST_PAM");
        snprintf(__cArray2, elCount(__cArray2), "Send %s", __cArray);
        __tableHandle = ReportTableHead3Columns(__cArray2, "Byte", __cTOp, __cAssigned);
        ReportByteIndex("", 0, __cArray, elCount(__cArray));
        snprintf(__cArray2, 8192, "%s", __cArray);
        snprintf(__cArray3, 8192, "%s", "");
        
        ReportTableRow(__tableHandle, 0, __cArray2, __cAOp, 0x3, __cArray3, __oneOfFlag, __bSetInCheckAlignment);
        
        if (0 >= 0 && 0 < 64)
        {
          __output.byte((word)0) = 0x3;
        }
        else
        {
          testStepErrorInTestSystem(0, __cEmpty, "Index out of range. Unable to set byte %lld in message. Please check input parameter.", (int64)0);
          __testStepInitOk = 0;
        }
        ReportByteIndex("", 1, __cArray, elCount(__cArray));
        snprintf(__cArray2, 8192, "%s", __cArray);
        snprintf(__cArray3, 8192, "%s", "");
        
        ReportTableRow(__tableHandle, 0, __cArray2, __cAOp, 0x22, __cArray3, __oneOfFlag, __bSetInCheckAlignment);
        
        if (1 >= 0 && 1 < 64)
        {
          __output.byte((word)1) = 0x22;
        }
        else
        {
          testStepErrorInTestSystem(0, __cEmpty, "Index out of range. Unable to set byte %lld in message. Please check input parameter.", (int64)1);
          __testStepInitOk = 0;
        }
        ReportByteIndex("", 2, __cArray, elCount(__cArray));
        snprintf(__cArray2, 8192, "%s", __cArray);
        snprintf(__cArray3, 8192, "%s", "");
        
        ReportTableRow(__tableHandle, 0, __cArray2, __cAOp, 0xFD, __cArray3, __oneOfFlag, __bSetInCheckAlignment);
        
        if (2 >= 0 && 2 < 64)
        {
          __output.byte((word)2) = 0xFD;
        }
        else
        {
          testStepErrorInTestSystem(0, __cEmpty, "Index out of range. Unable to set byte %lld in message. Please check input parameter.", (int64)2);
          __testStepInitOk = 0;
        }
        ReportByteIndex("", 3, __cArray, elCount(__cArray));
        snprintf(__cArray2, 8192, "%s", __cArray);
        snprintf(__cArray3, 8192, "%s", "");
        
        ReportTableRow(__tableHandle, 0, __cArray2, __cAOp, 0x17, __cArray3, __oneOfFlag, __bSetInCheckAlignment);
        
        if (3 >= 0 && 3 < 64)
        {
          __output.byte((word)3) = 0x17;
        }
        else
        {
          testStepErrorInTestSystem(0, __cEmpty, "Index out of range. Unable to set byte %lld in message. Please check input parameter.", (int64)3);
          __testStepInitOk = 0;
        }
      
        ReportTableEndTestStep(__tableHandle, "Req1");
      }
      if (__testStepInitOk)
      {
        output(__output);
      }
    }
    if (__timeout <= 0)
    {
      testStepErrorInTestSystem(0, "1", "Unable to wait for %.3f %s. Please check input parameter.", __timeout / ((float)1000000), "ms");
    }
    else
    {
      __tt0cnt_49 = 0;
      snprintf(__cArray, elCount(__cArray), "CAN message '%s' ID = 417001888x (0x18DAF1A0x) on bus FDCAN2", "DIAGNOSTIC_RESPONSE_PAM");
      if(SetBusContextByName("FDCAN2", __eSaveCurrent, __nBusContextNew, __nBusContextOld))
        testJoinMessageEvent(`FDCAN2::`DIAGNOSTIC_RESPONSE_PAM,  __cArray,
             delegate dword(message * __m)
             {
               dword __msg_callback_ret;
               if (__tt0cnt_49 == -1)
               {
                 return 1;
               }
               __msg_callback_ret = 1;
               __tt0cnt_49++;
               if (__msg_callback_ret)
               {
                 __tt0cnt_49 = -1;
                 return 1;
               }
               return 0;
             });
      __res = testWaitForAllJoinedEventsNS(__timeout);
      if (__nInt64 != 0)
      {
        snprintf(__cArray, elCount(__cArray), "CAN message '%s' ID = 417001888x (0x18DAF1A0x) on bus FDCAN2", "DIAGNOSTIC_RESPONSE_PAM");
        if(__tt0cnt_49 == -1)
        {
          snprintf(__cArray2, 8192, "Response of %s", __cArray);
        }
        else
        {
          snprintf(__cArray2, 8192, "Response of %s (received %d times)", __cArray, __tt0cnt_49);
        }
        if (__tt0cnt_49 == 0)
        {
          testStepFail(0, "Resp1", __cArray2);
        }
        else
        {
          testStepPass(2, "Resp1", __cArray2);
        }
        __ReportRequestResponseResult(__res, 0);
      }
      ResetBusContext(__nBusContextNew, __nBusContextOld);
    }
  }
  TestCommandEnd();

}

void Ttvccmce9_FD16_DID_with_Physical_Address()
{
  stack long __tableHandle;
  TestCommandBegin(__eDiagService, __cDiagService, "", "0");
  {
    if (DiagIsFunctionalGroup("CVADAS_0001_00000000_000"))
    {
      DiagResponse * __resp;
      DiagRequest CVADAS_0001_00000000_000._22FD16_Magna_Production_ICT_Data_Read __req;
      __diagServicevccmce9_48(__req, __resp);
    }
    else
    {
      DiagResponse CVADAS_0001_00000000_000.* __resp;
      DiagRequest CVADAS_0001_00000000_000._22FD16_Magna_Production_ICT_Data_Read __req;
      __diagServicevccmce9_48(__req, __resp);
    }
  }
  TestCommandEnd();


}

  
void __diagServicevccmce9_48(DiagRequest * __req, DiagResponse * __resp )
{
  stack long __tableHandle;
  long __res, __paramLen, __bytePos;

   __bVerdict = __eVerdictPass;

  do {
    TestReportResetDiagObjectList();
    DiagSetReportDetailLevel("CVADAS_0001_00000000_000", EnumServiceDetails_onfail);
    // Request aspect
    {
      {
        CheckLiteralGetStringBufferConsistency("FD16", 8192);
      snprintf(__cDiagValueArray, 8192, "%s", "FD16");
        __bDiagValueArrayCtr = __MapChar2ByteAtDiagSet(__cDiagValueArray, __bDiagValueArray);
        if (__bDiagValueArrayCtr >= 0)
        {
          __res = DiagSetParameterErrorHandled(__req, "RecordDataIdentifier", __bDiagValueArray, __bDiagValueArrayCtr);
          if(__res < 0)
          {
            __bVerdict = __eVerdictFail;
            DiagErrCodeTestStep(__res, "Cannot set diagnostic parameter 'RecordDataIdentifier'");
            break;
          }
        }
        else
        {
      	__bVerdict = __eVerdictFail;
          snprintf(__cArray2, 8192, "SetParameter: illegal byte sequence: '%s' (parameter %s). Use hex tuples like '01 AF ...'", __cDiagValueArray, "RecordDataIdentifier");
          DiagErrCodeTestStep(__bDiagValueArrayCtr, __cArray2);
          DiagErrCodeTestStep(-1, "Cannot set diagnostic parameter 'RecordDataIdentifier'");
      	break;
        }
      }

      if (0 >= DiagSendReqAndWaitForResp("CVADAS_0001_00000000_000", __req, __resp, __res, -1, -1, -1, -1, -1, EnumResult_pos, EnumServiceDetails_onfail, EnumSendingMode_physical, EnumSuppressPosResBit_asconfigured, EnumVerdictOnInvalidValues_fail))
        break;
    }

    __res = DiagErrCodeTestStep(__res, "Can't retrieve last response for request! No check possible.") < 0;
    if(__res)
    {
	  __bVerdict = __eVerdictFail;
      break;
    }
    {
      __res = DiagInterpretAs(__resp, "RDBI_PR");
      if(__res != 0)
      {
        __bVerdict = __eVerdictFail;
        DiagErrCodeTestStep(__res, "Can't interpret response as diagnostic primitive 'RDBI_PR'.");
        break;
      }
      else
      {
        TestStepPass( "Received primitive can be interpreted as diagnostic primitive 'RDBI_PR'.");
      }
    }
  }
  while(0);


  // Response, check & read aspect
  {
    __res = 1;
    __tableHandle = ReportTableHead5Columns(__cCheckCaption, __cTSym, __cTOp, __cRefVal, __cActual, __cRes);
    {
      __bDiagValueArrayCtr = DiagGetParameterErrorHandled(__resp, "Magna_ProdHWNum", __bDiagValueArray, elcount(__bDiagValueArray), __cDiagValueArray, elcount(__cDiagValueArray));
      {
        __bSetInCheckAlignment = 1;	
        {
          __bArrayCtr = __CopyBytes(__bDiagValueArray, __bDiagValueArrayCtr, __bArray);
          {
            sysvar * __systemVariable;
            __systemVariable = sysvarData::`PartNumber::`Part_Number;
            CheckSysVarSetBufferConsistency(sysSetVariableData(sysvarData::`PartNumber::`Part_Number, __bArray, __bArrayCtr), __systemVariable.name);
          }
          snprintf(__cArray, 8192, "%s", "Part_Number");
          snprintf(__cArray2, 8192, "%s '%s'", __cSysVar, __cArray);
          snprintf(__cArray3, 8192, "%s", "Magna_ProdHWNum");
          
          ReportTableRow(__tableHandle, 0, __cArray2, __cAOp, __bArray, __bArrayCtr, __cArray3, __oneOfFlag, __bSetInCheckAlignment);
        
        }
    
        __bSetInCheckAlignment = 0;
      }
    }
    ReportTableEndVerdict(__tableHandle, __cEvaluateResponse, __res);
	__bVerdict = __bVerdict && __res;
  }
  if (__bVerdict == __eVerdictFail)
    TestReportWriteDiagObjectList();
}

void Ttvccmce9_FD16_DID_with_Standard_Physical_Address()
{
  stack long __tableHandle;
  TestCommandBegin(__eRequestResponse, __cRequestResponse, "", "0");
  {
  
    long __res;
    int64 __timeout;
    __res = 0;
    __nInt64 = 1;
    __timeout = syspar::`P2_Server * 1000000LL;
    {
    
      long __testStepInitOk;
      message `FDCAN2::`DIAGNOSTIC_REQUEST_PAM __output;
      message `FDCAN2::`DIAGNOSTIC_REQUEST_PAM __msgOrig;
      __output = __msgOrig;
      __testStepInitOk = 1;
      {
        int64 __dlc;
        __dlc = 4;
        if (__dlc >= 0 && __dlc <= (__output.EDL ? 15 : 8))
          __output.DLC = __dlc;
        else
        {
          testStepErrorInTestSystem(0, __cEmpty, "Unable to set DLC=%lld in message. Please check input parameter.", __dlc);
          __testStepInitOk = 0;
        }
      }
      if (__testStepInitOk)
      {
        snprintf(__cArray, elCount(__cArray), "CAN message '%s' ID = 416981233x (0x18DAA0F1x) on bus FDCAN2", "DIAGNOSTIC_REQUEST_PAM");
        snprintf(__cArray2, elCount(__cArray2), "Send %s", __cArray);
        __tableHandle = ReportTableHead3Columns(__cArray2, "Byte", __cTOp, __cAssigned);
        ReportByteIndex("", 0, __cArray, elCount(__cArray));
        snprintf(__cArray2, 8192, "%s", __cArray);
        snprintf(__cArray3, 8192, "%s", "");
        
        ReportTableRow(__tableHandle, 0, __cArray2, __cAOp, 0x3, __cArray3, __oneOfFlag, __bSetInCheckAlignment);
        
        if (0 >= 0 && 0 < 64)
        {
          __output.byte((word)0) = 0x3;
        }
        else
        {
          testStepErrorInTestSystem(0, __cEmpty, "Index out of range. Unable to set byte %lld in message. Please check input parameter.", (int64)0);
          __testStepInitOk = 0;
        }
        ReportByteIndex("", 1, __cArray, elCount(__cArray));
        snprintf(__cArray2, 8192, "%s", __cArray);
        snprintf(__cArray3, 8192, "%s", "");
        
        ReportTableRow(__tableHandle, 0, __cArray2, __cAOp, 0x22, __cArray3, __oneOfFlag, __bSetInCheckAlignment);
        
        if (1 >= 0 && 1 < 64)
        {
          __output.byte((word)1) = 0x22;
        }
        else
        {
          testStepErrorInTestSystem(0, __cEmpty, "Index out of range. Unable to set byte %lld in message. Please check input parameter.", (int64)1);
          __testStepInitOk = 0;
        }
        ReportByteIndex("", 2, __cArray, elCount(__cArray));
        snprintf(__cArray2, 8192, "%s", __cArray);
        snprintf(__cArray3, 8192, "%s", "");
        
        ReportTableRow(__tableHandle, 0, __cArray2, __cAOp, 0xFD, __cArray3, __oneOfFlag, __bSetInCheckAlignment);
        
        if (2 >= 0 && 2 < 64)
        {
          __output.byte((word)2) = 0xFD;
        }
        else
        {
          testStepErrorInTestSystem(0, __cEmpty, "Index out of range. Unable to set byte %lld in message. Please check input parameter.", (int64)2);
          __testStepInitOk = 0;
        }
        ReportByteIndex("", 3, __cArray, elCount(__cArray));
        snprintf(__cArray2, 8192, "%s", __cArray);
        snprintf(__cArray3, 8192, "%s", "");
        
        ReportTableRow(__tableHandle, 0, __cArray2, __cAOp, 0x16, __cArray3, __oneOfFlag, __bSetInCheckAlignment);
        
        if (3 >= 0 && 3 < 64)
        {
          __output.byte((word)3) = 0x16;
        }
        else
        {
          testStepErrorInTestSystem(0, __cEmpty, "Index out of range. Unable to set byte %lld in message. Please check input parameter.", (int64)3);
          __testStepInitOk = 0;
        }
      
        ReportTableEndTestStep(__tableHandle, "Req1");
      }
      if (__testStepInitOk)
      {
        output(__output);
      }
    }
    if (__timeout <= 0)
    {
      testStepErrorInTestSystem(0, "1", "Unable to wait for %.3f %s. Please check input parameter.", __timeout / ((float)1000000), "ms");
    }
    else
    {
      __tt0cnt_51 = 0;
      snprintf(__cArray, elCount(__cArray), "CAN message '%s' ID = 417001888x (0x18DAF1A0x) on bus FDCAN2", "DIAGNOSTIC_RESPONSE_PAM");
      if(SetBusContextByName("FDCAN2", __eSaveCurrent, __nBusContextNew, __nBusContextOld))
        testJoinMessageEvent(`FDCAN2::`DIAGNOSTIC_RESPONSE_PAM,  __cArray,
             delegate dword(message * __m)
             {
               dword __msg_callback_ret;
               if (__tt0cnt_51 == -1)
               {
                 return 1;
               }
               __msg_callback_ret = 1;
               __tt0cnt_51++;
               if (__msg_callback_ret)
               {
                 __tt0cnt_51 = -1;
                 return 1;
               }
               return 0;
             });
      __res = testWaitForAllJoinedEventsNS(__timeout);
      if (__nInt64 != 0)
      {
        snprintf(__cArray, elCount(__cArray), "CAN message '%s' ID = 417001888x (0x18DAF1A0x) on bus FDCAN2", "DIAGNOSTIC_RESPONSE_PAM");
        if(__tt0cnt_51 == -1)
        {
          snprintf(__cArray2, 8192, "Response of %s", __cArray);
        }
        else
        {
          snprintf(__cArray2, 8192, "Response of %s (received %d times)", __cArray, __tt0cnt_51);
        }
        if (__tt0cnt_51 == 0)
        {
          testStepFail(0, "Resp1", __cArray2);
        }
        else
        {
          testStepPass(2, "Resp1", __cArray2);
        }
        __ReportRequestResponseResult(__res, 0);
      }
      ResetBusContext(__nBusContextNew, __nBusContextOld);
    }
  }
  TestCommandEnd();

}

void Ttvccmce9_Hard_Reset_with_Physical_Address()
{
  stack long __tableHandle;
  TestCommandBegin(__eDiagService, __cDiagService, "", "0");
  {
    if (DiagIsFunctionalGroup("CVADAS_0001_00000000_000"))
    {
      DiagResponse * __resp;
      DiagRequest CVADAS_0001_00000000_000.HardReset_Reset __req;
      __diagServicevccmce9_49(__req, __resp);
    }
    else
    {
      DiagResponse CVADAS_0001_00000000_000.* __resp;
      DiagRequest CVADAS_0001_00000000_000.HardReset_Reset __req;
      __diagServicevccmce9_49(__req, __resp);
    }
  }
  TestCommandEnd();


}

  
void __diagServicevccmce9_49(DiagRequest * __req, DiagResponse * __resp )
{
  stack long __tableHandle;
  long __res, __paramLen, __bytePos;

   __bVerdict = __eVerdictPass;

  do {
    TestReportResetDiagObjectList();
    DiagSetReportDetailLevel("CVADAS_0001_00000000_000", EnumServiceDetails_onfail);
    // Request aspect
    {

      if (0 >= DiagSendReqAndWaitForResp("CVADAS_0001_00000000_000", __req, __resp, __res, -1, -1, -1, -1, -1, EnumResult_pos, EnumServiceDetails_onfail, EnumSendingMode_physical, EnumSuppressPosResBit_clear, EnumVerdictOnInvalidValues_fail))
        break;
    }

    __res = DiagErrCodeTestStep(__res, "Can't retrieve last response for request! No check possible.") < 0;
    if(__res)
    {
	  __bVerdict = __eVerdictFail;
      break;
    }
    {
      __res = DiagInterpretAs(__resp, "ER_PR");
      if(__res != 0)
      {
        __bVerdict = __eVerdictFail;
        DiagErrCodeTestStep(__res, "Can't interpret response as diagnostic primitive 'ER_PR'.");
        break;
      }
      else
      {
        TestStepPass( "Received primitive can be interpreted as diagnostic primitive 'ER_PR'.");
      }
    }
  }
  while(0);


  // Response, check & read aspect
  {
    __res = 1;
    __tableHandle = ReportTableHead5Columns(__cCheckCaption, __cTSym, __cTOp, __cRefVal, __cActual, __cRes);
    {
      double __nDiagValue;
      DiagGetParameterErrorHandled(__resp, "ResetType", __nDiagValue);
      __csr = CheckSignalMatch(__nDiagValue, syspar::`ECU_Reset::`Hard_Reset, "==") == 1;
      snprintf(__cArray, 8192, "%s", "Diagnostic parameter \'ResetType\'");
      snprintf(__cArray2, 8192, "%s", __cArray);
      snprintf(__cArray3, 8192, "%s", "Hard_Reset");
      ReportTableRow(__tableHandle, 0, __cArray2, "==", syspar::`ECU_Reset::`Hard_Reset, __cArray3, __oneOfFlag, __bSetInCheckAlignment);
      ReportCell(__tableHandle, __nDiagValue);
      ReportCellResult(__tableHandle, __csr, __ePassFail);
    
      __res = __res && __csr;
    
    }
    ReportTableEndVerdict(__tableHandle, __cEvaluateResponse, __res);
	__bVerdict = __bVerdict && __res;
  }
  if (__bVerdict == __eVerdictFail)
    TestReportWriteDiagObjectList();
}

void Ttvccmce9_Hard_Reset_with_Functional_Address()
{
  stack long __tableHandle;
  TestCommandBegin(__eDiagService, __cDiagService, "", "0");
  {
    if (DiagIsFunctionalGroup("CVADAS_0001_00000000_000"))
    {
      DiagResponse * __resp;
      DiagRequest CVADAS_0001_00000000_000.HardReset_Reset __req;
      __diagServicevccmce9_50(__req, __resp);
    }
    else
    {
      DiagResponse CVADAS_0001_00000000_000.* __resp;
      DiagRequest CVADAS_0001_00000000_000.HardReset_Reset __req;
      __diagServicevccmce9_50(__req, __resp);
    }
  }
  TestCommandEnd();


}

  
void __diagServicevccmce9_50(DiagRequest * __req, DiagResponse * __resp )
{
  stack long __tableHandle;
  long __res, __paramLen, __bytePos;

   __bVerdict = __eVerdictPass;

  do {
    TestReportResetDiagObjectList();
    DiagSetReportDetailLevel("CVADAS_0001_00000000_000", EnumServiceDetails_onfail);
    // Request aspect
    {

      if (0 >= DiagSendReqAndWaitForResp("CVADAS_0001_00000000_000", __req, __resp, __res, -1, -1, -1, -1, -1, EnumResult_pos, EnumServiceDetails_onfail, EnumSendingMode_functional, EnumSuppressPosResBit_clear, EnumVerdictOnInvalidValues_fail))
        break;
    }

    __res = DiagErrCodeTestStep(__res, "Can't retrieve last response for request! No check possible.") < 0;
    if(__res)
    {
	  __bVerdict = __eVerdictFail;
      break;
    }
    {
      __res = DiagInterpretAs(__resp, "ER_PR");
      if(__res != 0)
      {
        __bVerdict = __eVerdictFail;
        DiagErrCodeTestStep(__res, "Can't interpret response as diagnostic primitive 'ER_PR'.");
        break;
      }
      else
      {
        TestStepPass( "Received primitive can be interpreted as diagnostic primitive 'ER_PR'.");
      }
    }
  }
  while(0);


  // Response, check & read aspect
  {
    __res = 1;
    __tableHandle = ReportTableHead5Columns(__cCheckCaption, __cTSym, __cTOp, __cRefVal, __cActual, __cRes);
    {
      double __nDiagValue;
      DiagGetParameterErrorHandled(__resp, "ResetType", __nDiagValue);
      __csr = CheckSignalMatch(__nDiagValue, syspar::`ECU_Reset::`Hard_Reset, "==") == 1;
      snprintf(__cArray, 8192, "%s", "Diagnostic parameter \'ResetType\'");
      snprintf(__cArray2, 8192, "%s", __cArray);
      snprintf(__cArray3, 8192, "%s", "Hard_Reset");
      ReportTableRow(__tableHandle, 0, __cArray2, "==", syspar::`ECU_Reset::`Hard_Reset, __cArray3, __oneOfFlag, __bSetInCheckAlignment);
      ReportCell(__tableHandle, __nDiagValue);
      ReportCellResult(__tableHandle, __csr, __ePassFail);
    
      __res = __res && __csr;
    
    }
    ReportTableEndVerdict(__tableHandle, __cEvaluateResponse, __res);
	__bVerdict = __bVerdict && __res;
  }
  if (__bVerdict == __eVerdictFail)
    TestReportWriteDiagObjectList();
}

void Ttvccmce9__19_02_Report_DTC_By_Status_Mask_Physical_Add()
{
  stack long __tableHandle;
  TestCommandBegin(__eDiagService, __cDiagService, "", "0");
  {
    if (DiagIsFunctionalGroup("CVADAS_0001_00000000_000"))
    {
      DiagResponse * __resp;
      DiagRequest CVADAS_0001_00000000_000.FaultMemory_ReadAllIdentified __req;
      __diagServicevccmce9_51(__req, __resp);
    }
    else
    {
      DiagResponse CVADAS_0001_00000000_000.* __resp;
      DiagRequest CVADAS_0001_00000000_000.FaultMemory_ReadAllIdentified __req;
      __diagServicevccmce9_51(__req, __resp);
    }
  }
  TestCommandEnd();


}

  
void __diagServicevccmce9_51(DiagRequest * __req, DiagResponse * __resp )
{
  stack long __tableHandle;
  long __res, __paramLen, __bytePos;

   __bVerdict = __eVerdictPass;

  do {
    TestReportResetDiagObjectList();
    DiagSetReportDetailLevel("CVADAS_0001_00000000_000", EnumServiceDetails_onfail);
    // Request aspect
    {
      {
        {
          byte __bArray[1] = { 0x02 };
          __bArrayCtr = elCount(__bArray);
          __bDiagValueArrayCtr = __CopyBytes(__bArray, __bArrayCtr, __bDiagValueArray);
        }
      
        __res = DiagSetParameterErrorHandled(__req, "ReportDtcByStatusMask", __bDiagValueArray, __bDiagValueArrayCtr);
        if(__res < 0)
        {
          __bVerdict = __eVerdictFail;
          DiagErrCodeTestStep(__res, "Cannot set diagnostic parameter 'ReportDtcByStatusMask'");
          break;
        }
      }
      {
        {
          byte __bArray[1] = { 0x7F };
          __bArrayCtr = elCount(__bArray);
          __bDiagValueArrayCtr = __CopyBytes(__bArray, __bArrayCtr, __bDiagValueArray);
        }
      
        __res = DiagSetParameterErrorHandled(__req, "DTCStatusMask", __bDiagValueArray, __bDiagValueArrayCtr);
        if(__res < 0)
        {
          __bVerdict = __eVerdictFail;
          DiagErrCodeTestStep(__res, "Cannot set diagnostic parameter 'DTCStatusMask'");
          break;
        }
      }

      if (0 >= DiagSendReqAndWaitForResp("CVADAS_0001_00000000_000", __req, __resp, __res, -1, -1, -1, -1, -1, EnumResult_pos, EnumServiceDetails_onfail, EnumSendingMode_physical, EnumSuppressPosResBit_asconfigured, EnumVerdictOnInvalidValues_fail))
        break;
    }

    __res = DiagErrCodeTestStep(__res, "Can't retrieve last response for request! No check possible.") < 0;
    if(__res)
    {
	  __bVerdict = __eVerdictFail;
      break;
    }
    {
      __res = DiagInterpretAs(__resp, "RDI_RDTCBSM_PR");
      if(__res != 0)
      {
        __bVerdict = __eVerdictFail;
        DiagErrCodeTestStep(__res, "Can't interpret response as diagnostic primitive 'RDI_RDTCBSM_PR'.");
        break;
      }
      else
      {
        TestStepPass( "Received primitive can be interpreted as diagnostic primitive 'RDI_RDTCBSM_PR'.");
      }
    }
  }
  while(0);


  // Response, check & read aspect
  {
    __res = 1;
    __tableHandle = ReportTableHead5Columns(__cCheckCaption, __cTSym, __cTOp, __cRefVal, __cActual, __cRes);
    {
      __bDiagValueArrayCtr = DiagGetParameterErrorHandled(__resp, "ReportDtcByStatusMask", __bDiagValueArray, elcount(__bDiagValueArray), __cDiagValueArray, elcount(__cDiagValueArray));
      {
        byte __bArray2[1] = { 0x02 };
        __bArrayCtr = __CopyBytes(__bDiagValueArray, __bDiagValueArrayCtr, __bArray);
        __bArrayCtr2 = elCount(__bArray2);
        __csr = CompareBytes(__bArray, __bArrayCtr, __bArray2, __bArrayCtr2) == 0;
        snprintf(__cArray, 8192, "%s", "Diagnostic parameter \'ReportDtcByStatusMask\'");
        snprintf(__cArray2, 8192, "%s", __cArray);
        snprintf(__cArray3, 8192, "%s", "");
        ReportTableRow(__tableHandle, 0, __cArray2, "Bytes", __bArray2, __bArrayCtr2, __cArray3, __oneOfFlag, __bSetInCheckAlignment);
        ReportCell(__tableHandle, __bArray, __bArrayCtr);
        ReportCellResult(__tableHandle, __csr, __ePassFail);
      }
    
      __res = __res && __csr;
    
    }
    {
      __bDiagValueArrayCtr = DiagGetParameterErrorHandled(__resp, "DtcAvailabilityMask", __bDiagValueArray, elcount(__bDiagValueArray), __cDiagValueArray, elcount(__cDiagValueArray));
      {
        byte __bArray2[1] = { 0x7F };
        __bArrayCtr = __CopyBytes(__bDiagValueArray, __bDiagValueArrayCtr, __bArray);
        __bArrayCtr2 = elCount(__bArray2);
        __csr = CompareBytes(__bArray, __bArrayCtr, __bArray2, __bArrayCtr2) == 0;
        snprintf(__cArray, 8192, "%s", "Diagnostic parameter \'DtcAvailabilityMask\'");
        snprintf(__cArray2, 8192, "%s", __cArray);
        snprintf(__cArray3, 8192, "%s", "");
        ReportTableRow(__tableHandle, 0, __cArray2, "Bytes", __bArray2, __bArrayCtr2, __cArray3, __oneOfFlag, __bSetInCheckAlignment);
        ReportCell(__tableHandle, __bArray, __bArrayCtr);
        ReportCellResult(__tableHandle, __csr, __ePassFail);
      }
    
      __res = __res && __csr;
    
    }
    ReportTableEndVerdict(__tableHandle, __cEvaluateResponse, __res);
	__bVerdict = __bVerdict && __res;
  }
  if (__bVerdict == __eVerdictFail)
    TestReportWriteDiagObjectList();
}

void Ttvccmce9__14_Clear_Diag_Info_Physical_Add()
{
  stack long __tableHandle;
  TestCommandBegin(__eDiagService, __cDiagService, "", "0");
  {
    if (DiagIsFunctionalGroup("CVADAS_0001_00000000_000"))
    {
      DiagResponse * __resp;
      DiagRequest CVADAS_0001_00000000_000.FaultMemory_Clear __req;
      __diagServicevccmce9_52(__req, __resp);
    }
    else
    {
      DiagResponse CVADAS_0001_00000000_000.* __resp;
      DiagRequest CVADAS_0001_00000000_000.FaultMemory_Clear __req;
      __diagServicevccmce9_52(__req, __resp);
    }
  }
  TestCommandEnd();


}

  
void __diagServicevccmce9_52(DiagRequest * __req, DiagResponse * __resp )
{
  stack long __tableHandle;
  long __res, __paramLen, __bytePos;

   __bVerdict = __eVerdictPass;

  do {
    TestReportResetDiagObjectList();
    DiagSetReportDetailLevel("CVADAS_0001_00000000_000", EnumServiceDetails_onfail);
    // Request aspect
    {
      {
        CheckLiteralGetStringBufferConsistency("FFFFFF", 8192);
      snprintf(__cDiagValueArray, 8192, "%s", "FFFFFF");
        __bDiagValueArrayCtr = __MapChar2ByteAtDiagSet(__cDiagValueArray, __bDiagValueArray);
        if (__bDiagValueArrayCtr >= 0)
        {
          __res = DiagSetParameterErrorHandled(__req, "GroupOfDtc", __bDiagValueArray, __bDiagValueArrayCtr);
          if(__res < 0)
          {
            __bVerdict = __eVerdictFail;
            DiagErrCodeTestStep(__res, "Cannot set diagnostic parameter 'GroupOfDtc'");
            break;
          }
        }
        else
        {
      	__bVerdict = __eVerdictFail;
          snprintf(__cArray2, 8192, "SetParameter: illegal byte sequence: '%s' (parameter %s). Use hex tuples like '01 AF ...'", __cDiagValueArray, "GroupOfDtc");
          DiagErrCodeTestStep(__bDiagValueArrayCtr, __cArray2);
          DiagErrCodeTestStep(-1, "Cannot set diagnostic parameter 'GroupOfDtc'");
      	break;
        }
      }

      if (0 >= DiagSendReqAndWaitForResp("CVADAS_0001_00000000_000", __req, __resp, __res, -1, -1, -1, -1, -1, EnumResult_pos, EnumServiceDetails_onfail, EnumSendingMode_physical, EnumSuppressPosResBit_asconfigured, EnumVerdictOnInvalidValues_fail))
        break;
    }

    __res = DiagErrCodeTestStep(__res, "Can't retrieve last response for request! No check possible.") < 0;
    if(__res)
    {
	  __bVerdict = __eVerdictFail;
      break;
    }
    {
      __res = DiagInterpretAs(__resp, "CDI_PR");
      if(__res != 0)
      {
        __bVerdict = __eVerdictFail;
        DiagErrCodeTestStep(__res, "Can't interpret response as diagnostic primitive 'CDI_PR'.");
        break;
      }
      else
      {
        TestStepPass( "Received primitive can be interpreted as diagnostic primitive 'CDI_PR'.");
      }
    }
  }
  while(0);


  if (__bVerdict == __eVerdictFail)
    TestReportWriteDiagObjectList();
}

void Ttvccmce9_CaptureMasterImage()
{
  stack long __tableHandle;
  TestCommandBegin(__eCAPLInline, __cCAPLInline, "CaptureImage", "0");
  {
    __civccmce9CaplInline0();
  }
  TestCommandEnd();

}

void __civccmce9CaplInline0()
{
  stack long __tableHandle;
  {
    long response;
response = testWaitForSyscall("pythonw Image_Comparison.py --capture_image --master_frame_mode", 0, 10000);

if (response == 2)
{
  testStepFail("Check Image");
}
else{
testStepPass();
}

  }
}

void Ttvccmce9_CaptureImage()
{
  stack long __tableHandle;
  TestCommandBegin(__eCAPLInline, __cCAPLInline, "CaptureImage", "0");
  {
    __civccmce9CaplInline1();
  }
  TestCommandEnd();

}

void __civccmce9CaplInline1()
{
  stack long __tableHandle;
  {
    long response;
response = testWaitForSyscall("pythonw Image_Comparison.py --capture_image", 0, 10000);

if (response == 2)
{
  testStepFail("Check Image");
}
else{
testStepPass();
}

  }
}

testcase Ttvccmce9_HMI_Views_Steering_Angle_Test()
{
  stack long __tableHandle;
double __tt0LoopVar0;

  SetBreakOnFail(0);

  {
    __type_of(-500) __tcLocVar0;
    __type_of(0) __tcLocVar1;
    __type_of(100) __tcLocVar2;
  
    __tcLocVar0 = -500;
    __tcLocVar1 = 0;
    __tcLocVar2 = 100;
  
    snprintf(__cArray, 8192, "%s", "-500");
    snprintf(__cArray2, 8192, "%s", "0");
    snprintf(__cArray3, 8192, "%s", "100");
  
    snprintf(__cArray4, 8192, "For (For i=%s..%s, increment=%s)", __cArray, __cArray2, __cArray3);
    TestControlStructBegin(__cFor, __cArray4, "0");  
    for(__tt0LoopVar0 = __tcLocVar0; (__tcLocVar2 < 0) ? (CheckSignalMatch(__tt0LoopVar0, __tcLocVar1, ">=" ) == 1) : (CheckSignalMatch(__tt0LoopVar0, __tcLocVar1, "<=") == 1); __tt0LoopVar0 += __tcLocVar2)
    {
      if(__LoopIsBlocking())  
        break;
  
      snprintf(__cArray, 8192, "%s", "-500");
      snprintf(__cArray2, 8192, "%s", "0");
      snprintf(__cArray3, 8192, "%s", "100");
      snprintf(__cArray4, 8192, "For (For i=%s..%s, increment=%s; current i = %.15g)", __cArray, __cArray2, __cArray3, __tt0LoopVar0);
      TestControlStructBegin(__cForIteration, __cArray4, "0");
      TestCommandBegin(__eSet, __cSet, "", "1");
      {
        __tableHandle = ReportTableHead3Columns(__cSetCaption , __cTSym, __cTOp, __cAssigned); 
        {
          $`FDCAN2::dbNode::`BCM::`IPC_VEHICLE_SETUP::`SVC_Guidelines.phys = 1;
          snprintf(__cArray, 8192, "%s", "SVC_Guidelines");
          snprintf(__cArray2, 8192, "%s '%s'", __cCANSignal, __cArray);
          snprintf(__cArray3, 8192, "%s", "");
          
          ReportSetLValueOrSignalNotOnline(getSignalTime(`FDCAN2::dbNode::`BCM::`IPC_VEHICLE_SETUP::`SVC_Guidelines), __cArray2, __cArray4, 8192);
          ReportTableRow(__tableHandle, 0, __cArray4, __cAOp, 1, __cArray3, __oneOfFlag, __bSetInCheckAlignment);
          
      
        }
        ReportTableEndTestStep(__tableHandle, "1");
      }
      TestCommandEnd();


      TestCommandBegin(__eSet, __cSet, "", "2");
      {
        __tableHandle = ReportTableHead3Columns(__cSetCaption , __cTSym, __cTOp, __cAssigned); 
        {
          $`FDCAN2::dbNode::`BCM::`IPC_VEHICLE_SETUP::`Fwrd_Cam_Guidelines.phys = 1;
          snprintf(__cArray, 8192, "%s", "Fwrd_Cam_Guidelines");
          snprintf(__cArray2, 8192, "%s '%s'", __cCANSignal, __cArray);
          snprintf(__cArray3, 8192, "%s", "");
          
          ReportSetLValueOrSignalNotOnline(getSignalTime(`FDCAN2::dbNode::`BCM::`IPC_VEHICLE_SETUP::`Fwrd_Cam_Guidelines), __cArray2, __cArray4, 8192);
          ReportTableRow(__tableHandle, 0, __cArray4, __cAOp, 1, __cArray3, __oneOfFlag, __bSetInCheckAlignment);
          
      
        }
        ReportTableEndTestStep(__tableHandle, "1");
      }
      TestCommandEnd();


      TestCommandBegin(__eSet, __cSet, "", "3");
      {
        __tableHandle = ReportTableHead3Columns(__cSetCaption , __cTSym, __cTOp, __cAssigned); 
        {
          $`FDCAN14::dbNode::`EPS::`EPS_FD_1::`LwsAngle.phys = __tt0LoopVar0;
          snprintf(__cArray, 8192, "%s", "FDCAN14::EPS::EPS_FD_1::LwsAngle");
          snprintf(__cArray2, 8192, "%s '%s'", __cCANSignal, __cArray);
          snprintf(__cArray3, 8192, "%s", "i");
          
          ReportSetLValueOrSignalNotOnline(getSignalTime(`FDCAN14::dbNode::`EPS::`EPS_FD_1::`LwsAngle), __cArray2, __cArray4, 8192);
          ReportTableRow(__tableHandle, 0, __cArray4, __cAOp, __tt0LoopVar0, __cArray3, __oneOfFlag, __bSetInCheckAlignment);
          
      
        }
        ReportTableEndTestStep(__tableHandle, "1");
      }
      TestCommandEnd();


      TestControlStructEnd(__eUndefined);
    }
    TestControlStructEnd(__eUndefined);
  }

}

testsequence Ttvccmce9_EOL_Calibration()
{
  stack long __tableHandle;
  SetBreakOnFail(0);

  CreateTTEIFFunction("Ttvccmce9_TsTc0", __eTcDef, __eLocal);
  AddIFParameterTestCaseAttribute("TC_ID", "");
  AddIFParameterTestCaseAttribute("Test Case ID", "");
  CallInterfaceFunction("21189419_Calibrate_All_Cameras", __cEmpty , "4b08e827-8d21-4d8b-be4d-8e368ff0120c");

}

testcase Ttvccmce9_TsTc0()
{
  stack long __tableHandle;
  SetBreakOnFail(1);

  TestPreparationBegin();
  {
  }
  TestPreparationEnd();

  TestCommandBegin(__eDiagService, __cDiagService, "", "0");
  {
    if (DiagIsFunctionalGroup("CVADAS_0001_00000000_000"))
    {
      DiagResponse * __resp;
      DiagRequest CVADAS_0001_00000000_000.Extended_Diagnostic_Session_Start __req;
      __diagServicevccmce9_53(__req, __resp);
    }
    else
    {
      DiagResponse CVADAS_0001_00000000_000.* __resp;
      DiagRequest CVADAS_0001_00000000_000.Extended_Diagnostic_Session_Start __req;
      __diagServicevccmce9_53(__req, __resp);
    }
  }
  TestCommandEnd();


  TestCommandBegin(__eDiagService, __cDiagService, "", "1");
  {
    if (DiagIsFunctionalGroup("CVADAS_0001_00000000_000"))
    {
      DiagResponse * __resp;
      DiagRequest CVADAS_0001_00000000_000._22FD00_Plant_Camera_Calibration_Data_Write __req;
      __diagServicevccmce9_54(__req, __resp);
    }
    else
    {
      DiagResponse CVADAS_0001_00000000_000.* __resp;
      DiagRequest CVADAS_0001_00000000_000._22FD00_Plant_Camera_Calibration_Data_Write __req;
      __diagServicevccmce9_54(__req, __resp);
    }
  }
  TestCommandEnd();


  TestCommandBegin(__eWait, __cWait, "", "2");
  {
    Wait("1", (1000 * 1000000LL), 1000000, "");
  }
  TestCommandEnd();

  {
    CreateCaplIFFunction("Hard_Reset", __eFct);
    CallInterfaceFunction(__cEmpty, __cEmpty, "3");
  }


}

  
void __diagServicevccmce9_53(DiagRequest * __req, DiagResponse * __resp )
{
  stack long __tableHandle;
  long __res, __paramLen, __bytePos;

   __bVerdict = __eVerdictPass;

  do {
    TestReportResetDiagObjectList();
    DiagSetReportDetailLevel("CVADAS_0001_00000000_000", EnumServiceDetails_onfail);
    // Request aspect
    {
      {
        __res = DiagSetParameterErrorHandled(__req, "DiagSessionType", 03);
        if(__res < 0)
        {
          __bVerdict = __eVerdictFail;
          DiagErrCodeTestStep(__res, "Cannot set diagnostic parameter 'DiagSessionType'");
          break;
        }
      }

      if (0 >= DiagSendReqAndWaitForResp("CVADAS_0001_00000000_000", __req, __resp, __res, -1, -1, -1, -1, -1, EnumResult_pos, EnumServiceDetails_onfail, EnumSendingMode_physical, EnumSuppressPosResBit_asconfigured, EnumVerdictOnInvalidValues_fail))
        break;
    }

    __res = DiagErrCodeTestStep(__res, "Can't retrieve last response for request! No check possible.") < 0;
    if(__res)
    {
	  __bVerdict = __eVerdictFail;
      break;
    }
    {
      __res = DiagInterpretAs(__resp, "DSC_PR");
      if(__res != 0)
      {
        __bVerdict = __eVerdictFail;
        DiagErrCodeTestStep(__res, "Can't interpret response as diagnostic primitive 'DSC_PR'.");
        break;
      }
      else
      {
        TestStepPass( "Received primitive can be interpreted as diagnostic primitive 'DSC_PR'.");
      }
    }
  }
  while(0);


  // Response, check & read aspect
  {
    __res = 1;
    __tableHandle = ReportTableHead5Columns(__cCheckCaption, __cTSym, __cTOp, __cRefVal, __cActual, __cRes);
    {
      double __nDiagValue;
      DiagGetParameterErrorHandled(__resp, "DiagSessionType", __nDiagValue);
      __csr = CheckSignalMatch(__nDiagValue, 03, "==") == 1;
      snprintf(__cArray, 8192, "%s", "Diagnostic parameter \'DiagSessionType\'");
      snprintf(__cArray2, 8192, "%s", __cArray);
      snprintf(__cArray3, 8192, "%s", "");
      ReportTableRow(__tableHandle, 0, __cArray2, "==", 03, __cArray3, __oneOfFlag, __bSetInCheckAlignment);
      ReportCell(__tableHandle, __nDiagValue);
      ReportCellResult(__tableHandle, __csr, __ePassFail);
    
      __res = __res && __csr;
    
    }
    ReportTableEndVerdict(__tableHandle, __cEvaluateResponse, __res);
	__bVerdict = __bVerdict && __res;
  }
  if (__bVerdict == __eVerdictFail)
    TestReportWriteDiagObjectList();
}
  
void __diagServicevccmce9_54(DiagRequest * __req, DiagResponse * __resp )
{
  stack long __tableHandle;
  long __res, __paramLen, __bytePos;

   __bVerdict = __eVerdictPass;

  do {
    TestReportResetDiagObjectList();
    DiagSetReportDetailLevel("CVADAS_0001_00000000_000", EnumServiceDetails_onfail);
    // Request aspect
    {
      {
        {
          byte __bArray[1] = { 0x03 };
          __bArrayCtr = elCount(__bArray);
          __bDiagValueArrayCtr = __CopyBytes(__bArray, __bArrayCtr, __bDiagValueArray);
        }
      
        __res = DiagSetParameterErrorHandled(__req, "CalibrationStatus_Front", __bDiagValueArray, __bDiagValueArrayCtr);
        if(__res < 0)
        {
          __bVerdict = __eVerdictFail;
          DiagErrCodeTestStep(__res, "Cannot set diagnostic parameter 'CalibrationStatus_Front'");
          break;
        }
      }
      {
        {
          byte __bArray[1] = { 0x03 };
          __bArrayCtr = elCount(__bArray);
          __bDiagValueArrayCtr = __CopyBytes(__bArray, __bArrayCtr, __bDiagValueArray);
        }
      
        __res = DiagSetParameterErrorHandled(__req, "CalibrationStatus_Left", __bDiagValueArray, __bDiagValueArrayCtr);
        if(__res < 0)
        {
          __bVerdict = __eVerdictFail;
          DiagErrCodeTestStep(__res, "Cannot set diagnostic parameter 'CalibrationStatus_Left'");
          break;
        }
      }
      {
        {
          byte __bArray[1] = { 0x03 };
          __bArrayCtr = elCount(__bArray);
          __bDiagValueArrayCtr = __CopyBytes(__bArray, __bArrayCtr, __bDiagValueArray);
        }
      
        __res = DiagSetParameterErrorHandled(__req, "CalibrationStatus_Rear", __bDiagValueArray, __bDiagValueArrayCtr);
        if(__res < 0)
        {
          __bVerdict = __eVerdictFail;
          DiagErrCodeTestStep(__res, "Cannot set diagnostic parameter 'CalibrationStatus_Rear'");
          break;
        }
      }
      {
        {
          byte __bArray[1] = { 0x03 };
          __bArrayCtr = elCount(__bArray);
          __bDiagValueArrayCtr = __CopyBytes(__bArray, __bArrayCtr, __bDiagValueArray);
        }
      
        __res = DiagSetParameterErrorHandled(__req, "CalibrationStatus_Right", __bDiagValueArray, __bDiagValueArrayCtr);
        if(__res < 0)
        {
          __bVerdict = __eVerdictFail;
          DiagErrCodeTestStep(__res, "Cannot set diagnostic parameter 'CalibrationStatus_Right'");
          break;
        }
      }

      if (0 >= DiagSendReqAndWaitForResp("CVADAS_0001_00000000_000", __req, __resp, __res, -1, -1, -1, -1, -1, EnumResult_pos, EnumServiceDetails_onfail, EnumSendingMode_physical, EnumSuppressPosResBit_asconfigured, EnumVerdictOnInvalidValues_fail))
        break;
    }

    __res = DiagErrCodeTestStep(__res, "Can't retrieve last response for request! No check possible.") < 0;
    if(__res)
    {
	  __bVerdict = __eVerdictFail;
      break;
    }
    {
      __res = DiagInterpretAs(__resp, "WDBI_PR");
      if(__res != 0)
      {
        __bVerdict = __eVerdictFail;
        DiagErrCodeTestStep(__res, "Can't interpret response as diagnostic primitive 'WDBI_PR'.");
        break;
      }
      else
      {
        TestStepPass( "Received primitive can be interpreted as diagnostic primitive 'WDBI_PR'.");
      }
    }
  }
  while(0);


  if (__bVerdict == __eVerdictFail)
    TestReportWriteDiagObjectList();
}

testsequence Ttvccmce9_Reset_NVM()
{
  stack long __tableHandle;
  SetBreakOnFail(0);

  CreateTTEIFFunction("Ttvccmce9_TsTc1", __eTcDef, __eLocal);
  AddIFParameterTestCaseAttribute("TC_ID", "");
  AddIFParameterTestCaseAttribute("Test Case ID", "");
  CallInterfaceFunction("20657328_Reset_NVM", __cEmpty , "839f8ce5-3f09-4431-ae67-96c146858f84");

}

testcase Ttvccmce9_TsTc1()
{
  stack long __tableHandle;
  SetBreakOnFail(1);

  TestPreparationBegin();
  {
  }
  TestPreparationEnd();

  TestCaseDescription("");

  TestCommandBegin(__eWait, __cWait, "Wait for boot up initally after flash", "0");
  {
    Wait("1", (45000 * 1000000LL), 1000000, "");
  }
  TestCommandEnd();

  TestCommandBegin(__eDiagService, __cDiagService, "", "1");
  {
    if (DiagIsFunctionalGroup("CVADAS_0001_00000000_000"))
    {
      DiagResponse * __resp;
      DiagRequest CVADAS_0001_00000000_000.Extended_Diagnostic_Session_Start __req;
      __diagServicevccmce9_55(__req, __resp);
    }
    else
    {
      DiagResponse CVADAS_0001_00000000_000.* __resp;
      DiagRequest CVADAS_0001_00000000_000.Extended_Diagnostic_Session_Start __req;
      __diagServicevccmce9_55(__req, __resp);
    }
  }
  TestCommandEnd();


  TestCommandBegin(__eDiagService, __cDiagService, "", "2");
  {
    if (DiagIsFunctionalGroup("CVADAS_0001_00000000_000"))
    {
      DiagResponse * __resp;
      DiagRequest CVADAS_0001_00000000_000._2EFD4E_Reset_NVM_Write __req;
      __diagServicevccmce9_56(__req, __resp);
    }
    else
    {
      DiagResponse CVADAS_0001_00000000_000.* __resp;
      DiagRequest CVADAS_0001_00000000_000._2EFD4E_Reset_NVM_Write __req;
      __diagServicevccmce9_56(__req, __resp);
    }
  }
  TestCommandEnd();


  TestCommandBegin(__eWait, __cWait, "", "3");
  {
    Wait("1", (10000 * 1000000LL), 1000000, "");
  }
  TestCommandEnd();

  {
    CreateCaplIFFunction("Hard_Reset", __eFct);
    CallInterfaceFunction(__cEmpty, __cEmpty, "4");
  }


  TestCommandBegin(__eWait, __cWait, "", "5");
  {
    Wait("1", (45000 * 1000000LL), 1000000, "");
  }
  TestCommandEnd();

}

  
void __diagServicevccmce9_55(DiagRequest * __req, DiagResponse * __resp )
{
  stack long __tableHandle;
  long __res, __paramLen, __bytePos;

   __bVerdict = __eVerdictPass;

  do {
    TestReportResetDiagObjectList();
    DiagSetReportDetailLevel("CVADAS_0001_00000000_000", EnumServiceDetails_onfail);
    // Request aspect
    {
      {
        __res = DiagSetParameterErrorHandled(__req, "DiagSessionType", 03);
        if(__res < 0)
        {
          __bVerdict = __eVerdictFail;
          DiagErrCodeTestStep(__res, "Cannot set diagnostic parameter 'DiagSessionType'");
          break;
        }
      }

      if (0 >= DiagSendReqAndWaitForResp("CVADAS_0001_00000000_000", __req, __resp, __res, -1, -1, -1, -1, -1, EnumResult_pos, EnumServiceDetails_onfail, EnumSendingMode_physical, EnumSuppressPosResBit_asconfigured, EnumVerdictOnInvalidValues_fail))
        break;
    }

    __res = DiagErrCodeTestStep(__res, "Can't retrieve last response for request! No check possible.") < 0;
    if(__res)
    {
	  __bVerdict = __eVerdictFail;
      break;
    }
    {
      __res = DiagInterpretAs(__resp, "DSC_PR");
      if(__res != 0)
      {
        __bVerdict = __eVerdictFail;
        DiagErrCodeTestStep(__res, "Can't interpret response as diagnostic primitive 'DSC_PR'.");
        break;
      }
      else
      {
        TestStepPass( "Received primitive can be interpreted as diagnostic primitive 'DSC_PR'.");
      }
    }
  }
  while(0);


  // Response, check & read aspect
  {
    __res = 1;
    __tableHandle = ReportTableHead5Columns(__cCheckCaption, __cTSym, __cTOp, __cRefVal, __cActual, __cRes);
    {
      double __nDiagValue;
      DiagGetParameterErrorHandled(__resp, "DiagSessionType", __nDiagValue);
      __csr = CheckSignalMatch(__nDiagValue, 03, "==") == 1;
      snprintf(__cArray, 8192, "%s", "Diagnostic parameter \'DiagSessionType\'");
      snprintf(__cArray2, 8192, "%s", __cArray);
      snprintf(__cArray3, 8192, "%s", "");
      ReportTableRow(__tableHandle, 0, __cArray2, "==", 03, __cArray3, __oneOfFlag, __bSetInCheckAlignment);
      ReportCell(__tableHandle, __nDiagValue);
      ReportCellResult(__tableHandle, __csr, __ePassFail);
    
      __res = __res && __csr;
    
    }
    ReportTableEndVerdict(__tableHandle, __cEvaluateResponse, __res);
	__bVerdict = __bVerdict && __res;
  }
  if (__bVerdict == __eVerdictFail)
    TestReportWriteDiagObjectList();
}
  
void __diagServicevccmce9_56(DiagRequest * __req, DiagResponse * __resp )
{
  stack long __tableHandle;
  long __res, __paramLen, __bytePos;

   __bVerdict = __eVerdictPass;

  do {
    TestReportResetDiagObjectList();
    DiagSetReportDetailLevel("CVADAS_0001_00000000_000", EnumServiceDetails_onfail);
    // Request aspect
    {
      {
        {
          byte __bArray[1] = { 0x00 };
          __bArrayCtr = elCount(__bArray);
          __bDiagValueArrayCtr = __CopyBytes(__bArray, __bArrayCtr, __bDiagValueArray);
        }
      
        __res = DiagSetParameterErrorHandled(__req, "HighLevel_NVM_Block_ID", __bDiagValueArray, __bDiagValueArrayCtr);
        if(__res < 0)
        {
          __bVerdict = __eVerdictFail;
          DiagErrCodeTestStep(__res, "Cannot set diagnostic parameter 'HighLevel_NVM_Block_ID'");
          break;
        }
      }

      if (0 >= DiagSendReqAndWaitForResp("CVADAS_0001_00000000_000", __req, __resp, __res, -1, -1, -1, -1, -1, EnumResult_pos, EnumServiceDetails_onfail, EnumSendingMode_physical, EnumSuppressPosResBit_asconfigured, EnumVerdictOnInvalidValues_fail))
        break;
    }

    __res = DiagErrCodeTestStep(__res, "Can't retrieve last response for request! No check possible.") < 0;
    if(__res)
    {
	  __bVerdict = __eVerdictFail;
      break;
    }
    {
      __res = DiagInterpretAs(__resp, "WDBI_PR");
      if(__res != 0)
      {
        __bVerdict = __eVerdictFail;
        DiagErrCodeTestStep(__res, "Can't interpret response as diagnostic primitive 'WDBI_PR'.");
        break;
      }
      else
      {
        TestStepPass( "Received primitive can be interpreted as diagnostic primitive 'WDBI_PR'.");
      }
    }
  }
  while(0);


  if (__bVerdict == __eVerdictFail)
    TestReportWriteDiagObjectList();
}

testsequence Ttvccmce9_HMI_View_Switch()
{
  stack long __tableHandle;
  SetBreakOnFail(0);

  CreateTTEIFFunction("Ttvccmce9_TsTc2", __eTcDef, __eLocal);
  AddIFParameterTestCaseAttribute("TC_ID", "");
  AddIFParameterTestCaseAttribute("Test Case ID", "");
  CallInterfaceFunction("Set to Surround View Camera", __cEmpty , "cf20fbaf-64c2-4ebb-a226-5368a42eb026");

  CreateTTEIFFunction("Ttvccmce9_TsTc3", __eTcDef, __eLocal);
  AddIFParameterTestCaseAttribute("TC_ID", "");
  AddIFParameterTestCaseAttribute("Test Case ID", "");
  CallInterfaceFunction("Default View", __cEmpty , "8145141b-2f60-49de-b995-b466d69cc8b3");

  CreateTTEIFFunction("Ttvccmce9_TsTc4", __eTcDef, __eLocal);
  AddIFParameterTestCaseAttribute("TC_ID", "");
  AddIFParameterTestCaseAttribute("Test Case ID", "");
  CallInterfaceFunction("View 1: FVTV_RVTV", __cEmpty , "3b0daef5-0ef5-41ab-b791-eaa9b5bede4f");

  CreateTTEIFFunction("Ttvccmce9_TsTc5", __eTcDef, __eLocal);
  AddIFParameterTestCaseAttribute("TC_ID", "");
  AddIFParameterTestCaseAttribute("Test Case ID", "");
  CallInterfaceFunction("View 2: BackupRearView", __cEmpty , "68bf865b-ce9b-4e52-b1dd-0e9edcf9e570");

  CreateTTEIFFunction("Ttvccmce9_TsTc6", __eTcDef, __eLocal);
  AddIFParameterTestCaseAttribute("TC_ID", "");
  AddIFParameterTestCaseAttribute("Test Case ID", "");
  CallInterfaceFunction("View 3: Forward Facing Camera", __cEmpty , "094749f3-0db6-4842-9672-495ec4064883");

  CreateTTEIFFunction("Ttvccmce9_TsTc7", __eTcDef, __eLocal);
  AddIFParameterTestCaseAttribute("TC_ID", "");
  AddIFParameterTestCaseAttribute("Test Case ID", "");
  CallInterfaceFunction("View 5: Trailer Reverse Guidance", __cEmpty , "4648d96e-d6ce-467d-ad5e-897a4c8eb1be");

  CreateTTEIFFunction("Ttvccmce9_TsTc8", __eTcDef, __eLocal);
  AddIFParameterTestCaseAttribute("TC_ID", "");
  AddIFParameterTestCaseAttribute("Test Case ID", "");
  CallInterfaceFunction("View 6: Trailer Left View", __cEmpty , "9072d4c9-0159-4c29-b5cc-17129f84709d");

  CreateTTEIFFunction("Ttvccmce9_TsTc9", __eTcDef, __eLocal);
  AddIFParameterTestCaseAttribute("TC_ID", "");
  AddIFParameterTestCaseAttribute("Test Case ID", "");
  CallInterfaceFunction("View 7: Trailer Right View", __cEmpty , "5baf868a-6ffa-4689-8b92-ccd619e960f6");

  CreateTTEIFFunction("Ttvccmce9_TsTc10", __eTcDef, __eLocal);
  AddIFParameterTestCaseAttribute("TC_ID", "");
  AddIFParameterTestCaseAttribute("Test Case ID", "");
  CallInterfaceFunction("View 8: Blind Spot Left View", __cEmpty , "071c6a3f-44d0-420c-9725-d523d36fd28d");

  CreateTTEIFFunction("Ttvccmce9_TsTc11", __eTcDef, __eLocal);
  AddIFParameterTestCaseAttribute("TC_ID", "");
  AddIFParameterTestCaseAttribute("Test Case ID", "");
  CallInterfaceFunction("View 9: Blind Spot Right View", __cEmpty , "84d89d40-ad63-49e8-851a-a77344af3be3");

  CreateTTEIFFunction("Ttvccmce9_TsTc12", __eTcDef, __eLocal);
  AddIFParameterTestCaseAttribute("TC_ID", "");
  AddIFParameterTestCaseAttribute("Test Case ID", "");
  CallInterfaceFunction("View 11: FVTV", __cEmpty , "0ce2a5d0-4f3d-493a-bcfb-8574c2cd9a1e");

  CreateTTEIFFunction("Ttvccmce9_TsTc13", __eTcDef, __eLocal);
  AddIFParameterTestCaseAttribute("TC_ID", "");
  AddIFParameterTestCaseAttribute("Test Case ID", "");
  CallInterfaceFunction("View 12: RVTV", __cEmpty , "e278422c-cdc6-4f5c-b277-e6e6dd06b9aa");

  CreateTTEIFFunction("Ttvccmce9_TsTc14", __eTcDef, __eLocal);
  AddIFParameterTestCaseAttribute("TC_ID", "");
  AddIFParameterTestCaseAttribute("Test Case ID", "");
  CallInterfaceFunction("View 13: FrontCrossPathView", __cEmpty , "aefc3ed0-bc97-49c3-83dd-f3d2d2f07b74");

  CreateTTEIFFunction("Ttvccmce9_TsTc15", __eTcDef, __eLocal);
  AddIFParameterTestCaseAttribute("TC_ID", "");
  AddIFParameterTestCaseAttribute("Test Case ID", "");
  CallInterfaceFunction("View 14: RearCrossPathView", __cEmpty , "3f6d0cba-0824-4545-99ec-cad299ae5ef5");

}

testcase Ttvccmce9_TsTc2()
{
  stack long __tableHandle;
  SetBreakOnFail(1);

  TestPreparationBegin();
  {
  }
  TestPreparationEnd();

  TestCommandBegin(__eSet, __cSet, "", "0");
  {
    __tableHandle = ReportTableHead3Columns(__cSetCaption , __cTSym, __cTOp, __cAssigned); 
    {
      $`FDCAN2::dbNode::`SGW::`TELEMATIC_FD_14::`TGW_CAMERA_DISP_STAT.phys = 4;
      snprintf(__cArray, 8192, "%s", "TGW_CAMERA_DISP_STAT");
      snprintf(__cArray2, 8192, "%s '%s'", __cCANSignal, __cArray);
      snprintf(__cArray3, 8192, "%s", "");
      
      ReportSetLValueOrSignalNotOnline(getSignalTime(`FDCAN2::dbNode::`SGW::`TELEMATIC_FD_14::`TGW_CAMERA_DISP_STAT), __cArray2, __cArray4, 8192);
      ReportTableRow(__tableHandle, 0, __cArray4, __cAOp, 4, __cArray3, __oneOfFlag, __bSetInCheckAlignment);
      
  
    }
    {
      $`FDCAN2::dbNode::`SGW::`TELEMATIC_FD_5::`CameraDisplaySts2.phys = 0;
      snprintf(__cArray, 8192, "%s", "CameraDisplaySts2");
      snprintf(__cArray2, 8192, "%s '%s'", __cCANSignal, __cArray);
      snprintf(__cArray3, 8192, "%s", "Default");
      
      ReportSetLValueOrSignalNotOnline(getSignalTime(`FDCAN2::dbNode::`SGW::`TELEMATIC_FD_5::`CameraDisplaySts2), __cArray2, __cArray4, 8192);
      ReportTableRow(__tableHandle, 0, __cArray4, __cAOp, 0, __cArray3, __oneOfFlag, __bSetInCheckAlignment);
      
  
    }
    ReportTableEndTestStep(__tableHandle, "1");
  }
  TestCommandEnd();


  TestCommandBegin(__eWait, __cWait, "", "1");
  {
    Wait("1", (1 * 1000000000LL), 1000000000, "");
  }
  TestCommandEnd();

  TestCommandBegin(__eCheck, __cCheck, "", "2");
  {
    __bVerdict = __eVerdictPass;
    __tableHandle = ReportTableHead5Columns(__cCheckCaption, __cTSym, __cTOp, __cRefVal, __cActual, __cRes);
    {
      {
        int __res1,__res2;
        __res1 = CheckSignalMatch(`FDCAN2::dbNode::`SGW::`TELEMATIC_FD_14::`TGW_CAMERA_DISP_STAT, 0, __cGreaterEqualThan) == 1;
        __res2 = CheckSignalMatch(`FDCAN2::dbNode::`SGW::`TELEMATIC_FD_14::`TGW_CAMERA_DISP_STAT, 4, __cLessEqualThan) == 1;
        __csr = __res1 && __res2;
        snprintf(__cArray, 8192, "%s", "TGW_CAMERA_DISP_STAT");
        snprintf(__cArray2, 8192, "%s '%s'", __cCANSignal, __cArray);
        snprintf(__cArray3, 8192, "%s", "");
        snprintf(__cArray4, 8192, "%s", "");
        snprintf(__cArray5, 8192, "%s", __cArray3);
        snprintf(__cArray6, 8192, "%s", __cArray4);
        ReportRange(0, 4, __cArray5, __cArray6, __cArray7, 8192);
        ReportTableRow(__tableHandle, 0, __cArray2, __cRange, __cArray7, __cEmpty, __oneOfFlag, __bSetInCheckAlignment);
        ReportLValueOrSignalNotOnline(`FDCAN2::dbNode::`SGW::`TELEMATIC_FD_14::`TGW_CAMERA_DISP_STAT, __cArray8, 8192);
        ReportCell(__tableHandle, __cArray8);
        ReportCellResult(__tableHandle, __csr, __ePassFail);
      }
  
      __bVerdict = __bVerdict && __csr;
    }
    ReportTableEndVerdict(__tableHandle, "1", __bVerdict);
  }
  TestCommandEnd();


  TestCommandBegin(__eWait, __cWait, "", "3");
  {
    Wait("1", (1 * 1000000000LL), 1000000000, "");
  }
  TestCommandEnd();

}

testcase Ttvccmce9_TsTc3()
{
  stack long __tableHandle;
  SetBreakOnFail(1);

  TestCommandBegin(__eSet, __cSet, "", "0");
  {
    __tableHandle = ReportTableHead3Columns(__cSetCaption , __cTSym, __cTOp, __cAssigned); 
    {
      $`FDCAN2::dbNode::`SGW::`TELEMATIC_FD_5::`CameraDisplaySts2.phys = 2;
      snprintf(__cArray, 8192, "%s", "CameraDisplaySts2");
      snprintf(__cArray2, 8192, "%s '%s'", __cCANSignal, __cArray);
      snprintf(__cArray3, 8192, "%s", "");
      
      ReportSetLValueOrSignalNotOnline(getSignalTime(`FDCAN2::dbNode::`SGW::`TELEMATIC_FD_5::`CameraDisplaySts2), __cArray2, __cArray4, 8192);
      ReportTableRow(__tableHandle, 0, __cArray4, __cAOp, 2, __cArray3, __oneOfFlag, __bSetInCheckAlignment);
      
  
    }
    ReportTableEndTestStep(__tableHandle, "1");
  }
  TestCommandEnd();


  TestCommandBegin(__eWait, __cWait, "", "1");
  {
    Wait("1", (1000 * 1000000LL), 1000000, "");
  }
  TestCommandEnd();

  TestCommandBegin(__eSet, __cSet, "", "2");
  {
    __tableHandle = ReportTableHead3Columns(__cSetCaption , __cTSym, __cTOp, __cAssigned); 
    {
      $`FDCAN2::dbNode::`SGW::`TELEMATIC_FD_5::`CameraDisplaySts2.phys = 0;
      snprintf(__cArray, 8192, "%s", "CameraDisplaySts2");
      snprintf(__cArray2, 8192, "%s '%s'", __cCANSignal, __cArray);
      snprintf(__cArray3, 8192, "%s", "");
      
      ReportSetLValueOrSignalNotOnline(getSignalTime(`FDCAN2::dbNode::`SGW::`TELEMATIC_FD_5::`CameraDisplaySts2), __cArray2, __cArray4, 8192);
      ReportTableRow(__tableHandle, 0, __cArray4, __cAOp, 0, __cArray3, __oneOfFlag, __bSetInCheckAlignment);
      
  
    }
    ReportTableEndTestStep(__tableHandle, "1");
  }
  TestCommandEnd();


  TestCommandBegin(__eWait, __cWait, "", "3");
  {
    Wait("1", (1000 * 1000000LL), 1000000, "");
  }
  TestCommandEnd();

  TestCommandBegin(__eCheck, __cCheck, "", "4");
  {
    __bVerdict = __eVerdictPass;
    __tableHandle = ReportTableHead5Columns(__cCheckCaption, __cTSym, __cTOp, __cRefVal, __cActual, __cRes);
    {
      {
        int __res1,__res2;
        __res1 = CheckSignalMatch(`FDCAN2::dbNode::`CVADAS::`CVPAM_FD_Info::`DisplayView2, 1, __cGreaterEqualThan) == 1;
        __res2 = CheckSignalMatch(`FDCAN2::dbNode::`CVADAS::`CVPAM_FD_Info::`DisplayView2, 15, __cLessEqualThan) == 1;
        __csr = __res1 && __res2;
        snprintf(__cArray, 8192, "%s", "DisplayView2");
        snprintf(__cArray2, 8192, "%s '%s'", __cCANSignal, __cArray);
        snprintf(__cArray3, 8192, "%s", "");
        snprintf(__cArray4, 8192, "%s", "");
        snprintf(__cArray5, 8192, "%s", __cArray3);
        snprintf(__cArray6, 8192, "%s", __cArray4);
        ReportRange(1, 15, __cArray5, __cArray6, __cArray7, 8192);
        ReportTableRow(__tableHandle, 0, __cArray2, __cRange, __cArray7, __cEmpty, __oneOfFlag, __bSetInCheckAlignment);
        ReportLValueOrSignalNotOnline(`FDCAN2::dbNode::`CVADAS::`CVPAM_FD_Info::`DisplayView2, __cArray8, 8192);
        ReportCell(__tableHandle, __cArray8);
        ReportCellResult(__tableHandle, __csr, __ePassFail);
      }
  
      __bVerdict = __bVerdict && __csr;
    }
    ReportTableEndVerdict(__tableHandle, "1", __bVerdict);
  }
  TestCommandEnd();


}

testcase Ttvccmce9_TsTc4()
{
  stack long __tableHandle;
  SetBreakOnFail(1);

  {
    CreateTTEIFFunction("Ttvccmce9_CaptureMasterImage", __eFct, __eLocal);
    CallInterfaceFunction(__cEmpty, __cEmpty, "a7bc5fa8-1544-4662-9c69-4b8c149a9263");
  }


  TestCommandBegin(__eSet, __cSet, "", "1");
  {
    __tableHandle = ReportTableHead3Columns(__cSetCaption , __cTSym, __cTOp, __cAssigned); 
    {
      $`FDCAN2::dbNode::`SGW::`TELEMATIC_FD_5::`CameraDisplaySts2.phys = 3;
      snprintf(__cArray, 8192, "%s", "CameraDisplaySts2");
      snprintf(__cArray2, 8192, "%s '%s'", __cCANSignal, __cArray);
      snprintf(__cArray3, 8192, "%s", "");
      
      ReportSetLValueOrSignalNotOnline(getSignalTime(`FDCAN2::dbNode::`SGW::`TELEMATIC_FD_5::`CameraDisplaySts2), __cArray2, __cArray4, 8192);
      ReportTableRow(__tableHandle, 0, __cArray4, __cAOp, 3, __cArray3, __oneOfFlag, __bSetInCheckAlignment);
      
  
    }
    ReportTableEndTestStep(__tableHandle, "1");
  }
  TestCommandEnd();


  TestCommandBegin(__eWait, __cWait, "", "2");
  {
    Wait("1", (1000 * 1000000LL), 1000000, "");
  }
  TestCommandEnd();

  TestCommandBegin(__eSet, __cSet, "", "3");
  {
    __tableHandle = ReportTableHead3Columns(__cSetCaption , __cTSym, __cTOp, __cAssigned); 
    {
      $`FDCAN2::dbNode::`SGW::`TELEMATIC_FD_5::`CameraDisplaySts2.phys = 1;
      snprintf(__cArray, 8192, "%s", "CameraDisplaySts2");
      snprintf(__cArray2, 8192, "%s '%s'", __cCANSignal, __cArray);
      snprintf(__cArray3, 8192, "%s", "");
      
      ReportSetLValueOrSignalNotOnline(getSignalTime(`FDCAN2::dbNode::`SGW::`TELEMATIC_FD_5::`CameraDisplaySts2), __cArray2, __cArray4, 8192);
      ReportTableRow(__tableHandle, 0, __cArray4, __cAOp, 1, __cArray3, __oneOfFlag, __bSetInCheckAlignment);
      
  
    }
    ReportTableEndTestStep(__tableHandle, "1");
  }
  TestCommandEnd();


  TestCommandBegin(__eCheck, __cCheck, "", "4");
  {
    __bVerdict = __eVerdictPass;
    __tableHandle = ReportTableHead5Columns(__cCheckCaption, __cTSym, __cTOp, __cRefVal, __cActual, __cRes);
    {
      {
        int __res1,__res2;
        __res1 = CheckSignalMatch(`FDCAN2::dbNode::`CVADAS::`CVPAM_FD_Info::`DisplayView2, 1, __cGreaterEqualThan) == 1;
        __res2 = CheckSignalMatch(`FDCAN2::dbNode::`CVADAS::`CVPAM_FD_Info::`DisplayView2, 15, __cLessEqualThan) == 1;
        __csr = __res1 && __res2;
        snprintf(__cArray, 8192, "%s", "DisplayView2");
        snprintf(__cArray2, 8192, "%s '%s'", __cCANSignal, __cArray);
        snprintf(__cArray3, 8192, "%s", "");
        snprintf(__cArray4, 8192, "%s", "");
        snprintf(__cArray5, 8192, "%s", __cArray3);
        snprintf(__cArray6, 8192, "%s", __cArray4);
        ReportRange(1, 15, __cArray5, __cArray6, __cArray7, 8192);
        ReportTableRow(__tableHandle, 0, __cArray2, __cRange, __cArray7, __cEmpty, __oneOfFlag, __bSetInCheckAlignment);
        ReportLValueOrSignalNotOnline(`FDCAN2::dbNode::`CVADAS::`CVPAM_FD_Info::`DisplayView2, __cArray8, 8192);
        ReportCell(__tableHandle, __cArray8);
        ReportCellResult(__tableHandle, __csr, __ePassFail);
      }
  
      __bVerdict = __bVerdict && __csr;
    }
    ReportTableEndVerdict(__tableHandle, "1", __bVerdict);
  }
  TestCommandEnd();


}

testcase Ttvccmce9_TsTc5()
{
  stack long __tableHandle;
  SetBreakOnFail(1);

  {
    CreateTTEIFFunction("Ttvccmce9_CaptureImage", __eFct, __eLocal);
    CallInterfaceFunction(__cEmpty, __cEmpty, "1daf8716-872e-4d40-8766-e475aac19554");
  }


  TestCommandBegin(__eSet, __cSet, "", "1");
  {
    __tableHandle = ReportTableHead3Columns(__cSetCaption , __cTSym, __cTOp, __cAssigned); 
    {
      $`FDCAN2::dbNode::`SGW::`TELEMATIC_FD_5::`CameraDisplaySts2.phys = 2;
      snprintf(__cArray, 8192, "%s", "CameraDisplaySts2");
      snprintf(__cArray2, 8192, "%s '%s'", __cCANSignal, __cArray);
      snprintf(__cArray3, 8192, "%s", "");
      
      ReportSetLValueOrSignalNotOnline(getSignalTime(`FDCAN2::dbNode::`SGW::`TELEMATIC_FD_5::`CameraDisplaySts2), __cArray2, __cArray4, 8192);
      ReportTableRow(__tableHandle, 0, __cArray4, __cAOp, 2, __cArray3, __oneOfFlag, __bSetInCheckAlignment);
      
  
    }
    ReportTableEndTestStep(__tableHandle, "1");
  }
  TestCommandEnd();


  TestCommandBegin(__eWait, __cWait, "", "2");
  {
    Wait("1", (1000 * 1000000LL), 1000000, "");
  }
  TestCommandEnd();

  TestCommandBegin(__eCheck, __cCheck, "", "3");
  {
    __bVerdict = __eVerdictPass;
    __tableHandle = ReportTableHead5Columns(__cCheckCaption, __cTSym, __cTOp, __cRefVal, __cActual, __cRes);
    {
      {
        int __res1,__res2;
        __res1 = CheckSignalMatch(`FDCAN2::dbNode::`CVADAS::`CVPAM_FD_Info::`DisplayView2, 1, __cGreaterEqualThan) == 1;
        __res2 = CheckSignalMatch(`FDCAN2::dbNode::`CVADAS::`CVPAM_FD_Info::`DisplayView2, 15, __cLessEqualThan) == 1;
        __csr = __res1 && __res2;
        snprintf(__cArray, 8192, "%s", "DisplayView2");
        snprintf(__cArray2, 8192, "%s '%s'", __cCANSignal, __cArray);
        snprintf(__cArray3, 8192, "%s", "");
        snprintf(__cArray4, 8192, "%s", "");
        snprintf(__cArray5, 8192, "%s", __cArray3);
        snprintf(__cArray6, 8192, "%s", __cArray4);
        ReportRange(1, 15, __cArray5, __cArray6, __cArray7, 8192);
        ReportTableRow(__tableHandle, 0, __cArray2, __cRange, __cArray7, __cEmpty, __oneOfFlag, __bSetInCheckAlignment);
        ReportLValueOrSignalNotOnline(`FDCAN2::dbNode::`CVADAS::`CVPAM_FD_Info::`DisplayView2, __cArray8, 8192);
        ReportCell(__tableHandle, __cArray8);
        ReportCellResult(__tableHandle, __csr, __ePassFail);
      }
  
      __bVerdict = __bVerdict && __csr;
    }
    ReportTableEndVerdict(__tableHandle, "1", __bVerdict);
  }
  TestCommandEnd();


}

testcase Ttvccmce9_TsTc6()
{
  stack long __tableHandle;
  SetBreakOnFail(1);

  {
    CreateTTEIFFunction("Ttvccmce9_CaptureImage", __eFct, __eLocal);
    CallInterfaceFunction(__cEmpty, __cEmpty, "1daf8716-872e-4d40-8766-e475aac19554");
  }


  TestCommandBegin(__eSet, __cSet, "", "1");
  {
    __tableHandle = ReportTableHead3Columns(__cSetCaption , __cTSym, __cTOp, __cAssigned); 
    {
      $`FDCAN2::dbNode::`SGW::`TELEMATIC_FD_5::`CameraDisplaySts2.phys = 3;
      snprintf(__cArray, 8192, "%s", "CameraDisplaySts2");
      snprintf(__cArray2, 8192, "%s '%s'", __cCANSignal, __cArray);
      snprintf(__cArray3, 8192, "%s", "");
      
      ReportSetLValueOrSignalNotOnline(getSignalTime(`FDCAN2::dbNode::`SGW::`TELEMATIC_FD_5::`CameraDisplaySts2), __cArray2, __cArray4, 8192);
      ReportTableRow(__tableHandle, 0, __cArray4, __cAOp, 3, __cArray3, __oneOfFlag, __bSetInCheckAlignment);
      
  
    }
    ReportTableEndTestStep(__tableHandle, "1");
  }
  TestCommandEnd();


  TestCommandBegin(__eWait, __cWait, "", "2");
  {
    Wait("1", (1000 * 1000000LL), 1000000, "");
  }
  TestCommandEnd();

  TestCommandBegin(__eCheck, __cCheck, "", "3");
  {
    __bVerdict = __eVerdictPass;
    __tableHandle = ReportTableHead5Columns(__cCheckCaption, __cTSym, __cTOp, __cRefVal, __cActual, __cRes);
    {
      {
        int __res1,__res2;
        __res1 = CheckSignalMatch(`FDCAN2::dbNode::`CVADAS::`CVPAM_FD_Info::`DisplayView2, 1, __cGreaterEqualThan) == 1;
        __res2 = CheckSignalMatch(`FDCAN2::dbNode::`CVADAS::`CVPAM_FD_Info::`DisplayView2, 15, __cLessEqualThan) == 1;
        __csr = __res1 && __res2;
        snprintf(__cArray, 8192, "%s", "DisplayView2");
        snprintf(__cArray2, 8192, "%s '%s'", __cCANSignal, __cArray);
        snprintf(__cArray3, 8192, "%s", "");
        snprintf(__cArray4, 8192, "%s", "");
        snprintf(__cArray5, 8192, "%s", __cArray3);
        snprintf(__cArray6, 8192, "%s", __cArray4);
        ReportRange(1, 15, __cArray5, __cArray6, __cArray7, 8192);
        ReportTableRow(__tableHandle, 0, __cArray2, __cRange, __cArray7, __cEmpty, __oneOfFlag, __bSetInCheckAlignment);
        ReportLValueOrSignalNotOnline(`FDCAN2::dbNode::`CVADAS::`CVPAM_FD_Info::`DisplayView2, __cArray8, 8192);
        ReportCell(__tableHandle, __cArray8);
        ReportCellResult(__tableHandle, __csr, __ePassFail);
      }
  
      __bVerdict = __bVerdict && __csr;
    }
    ReportTableEndVerdict(__tableHandle, "1", __bVerdict);
  }
  TestCommandEnd();


}

testcase Ttvccmce9_TsTc7()
{
  stack long __tableHandle;
  SetBreakOnFail(1);

  {
    CreateTTEIFFunction("Ttvccmce9_CaptureImage", __eFct, __eLocal);
    CallInterfaceFunction(__cEmpty, __cEmpty, "1daf8716-872e-4d40-8766-e475aac19554");
  }


  TestCommandBegin(__eSet, __cSet, "", "1");
  {
    __tableHandle = ReportTableHead3Columns(__cSetCaption , __cTSym, __cTOp, __cAssigned); 
    {
      $`FDCAN2::dbNode::`SGW::`TELEMATIC_FD_5::`CameraDisplaySts2.phys = 5;
      snprintf(__cArray, 8192, "%s", "CameraDisplaySts2");
      snprintf(__cArray2, 8192, "%s '%s'", __cCANSignal, __cArray);
      snprintf(__cArray3, 8192, "%s", "");
      
      ReportSetLValueOrSignalNotOnline(getSignalTime(`FDCAN2::dbNode::`SGW::`TELEMATIC_FD_5::`CameraDisplaySts2), __cArray2, __cArray4, 8192);
      ReportTableRow(__tableHandle, 0, __cArray4, __cAOp, 5, __cArray3, __oneOfFlag, __bSetInCheckAlignment);
      
  
    }
    ReportTableEndTestStep(__tableHandle, "1");
  }
  TestCommandEnd();


  TestCommandBegin(__eWait, __cWait, "", "2");
  {
    Wait("1", (1000 * 1000000LL), 1000000, "");
  }
  TestCommandEnd();

  TestCommandBegin(__eCheck, __cCheck, "", "3");
  {
    __bVerdict = __eVerdictPass;
    __tableHandle = ReportTableHead5Columns(__cCheckCaption, __cTSym, __cTOp, __cRefVal, __cActual, __cRes);
    {
      {
        int __res1,__res2;
        __res1 = CheckSignalMatch(`FDCAN2::dbNode::`CVADAS::`CVPAM_FD_Info::`DisplayView2, 1, __cGreaterEqualThan) == 1;
        __res2 = CheckSignalMatch(`FDCAN2::dbNode::`CVADAS::`CVPAM_FD_Info::`DisplayView2, 15, __cLessEqualThan) == 1;
        __csr = __res1 && __res2;
        snprintf(__cArray, 8192, "%s", "DisplayView2");
        snprintf(__cArray2, 8192, "%s '%s'", __cCANSignal, __cArray);
        snprintf(__cArray3, 8192, "%s", "");
        snprintf(__cArray4, 8192, "%s", "");
        snprintf(__cArray5, 8192, "%s", __cArray3);
        snprintf(__cArray6, 8192, "%s", __cArray4);
        ReportRange(1, 15, __cArray5, __cArray6, __cArray7, 8192);
        ReportTableRow(__tableHandle, 0, __cArray2, __cRange, __cArray7, __cEmpty, __oneOfFlag, __bSetInCheckAlignment);
        ReportLValueOrSignalNotOnline(`FDCAN2::dbNode::`CVADAS::`CVPAM_FD_Info::`DisplayView2, __cArray8, 8192);
        ReportCell(__tableHandle, __cArray8);
        ReportCellResult(__tableHandle, __csr, __ePassFail);
      }
  
      __bVerdict = __bVerdict && __csr;
    }
    ReportTableEndVerdict(__tableHandle, "1", __bVerdict);
  }
  TestCommandEnd();


}

testcase Ttvccmce9_TsTc8()
{
  stack long __tableHandle;
  SetBreakOnFail(1);

  {
    CreateTTEIFFunction("Ttvccmce9_CaptureImage", __eFct, __eLocal);
    CallInterfaceFunction(__cEmpty, __cEmpty, "1daf8716-872e-4d40-8766-e475aac19554");
  }


  TestCommandBegin(__eSet, __cSet, "", "1");
  {
    __tableHandle = ReportTableHead3Columns(__cSetCaption , __cTSym, __cTOp, __cAssigned); 
    {
      $`FDCAN2::dbNode::`SGW::`TELEMATIC_FD_5::`CameraDisplaySts2.phys = 6;
      snprintf(__cArray, 8192, "%s", "CameraDisplaySts2");
      snprintf(__cArray2, 8192, "%s '%s'", __cCANSignal, __cArray);
      snprintf(__cArray3, 8192, "%s", "");
      
      ReportSetLValueOrSignalNotOnline(getSignalTime(`FDCAN2::dbNode::`SGW::`TELEMATIC_FD_5::`CameraDisplaySts2), __cArray2, __cArray4, 8192);
      ReportTableRow(__tableHandle, 0, __cArray4, __cAOp, 6, __cArray3, __oneOfFlag, __bSetInCheckAlignment);
      
  
    }
    ReportTableEndTestStep(__tableHandle, "1");
  }
  TestCommandEnd();


  TestCommandBegin(__eWait, __cWait, "", "2");
  {
    Wait("1", (1000 * 1000000LL), 1000000, "");
  }
  TestCommandEnd();

  TestCommandBegin(__eCheck, __cCheck, "", "3");
  {
    __bVerdict = __eVerdictPass;
    __tableHandle = ReportTableHead5Columns(__cCheckCaption, __cTSym, __cTOp, __cRefVal, __cActual, __cRes);
    {
      {
        int __res1,__res2;
        __res1 = CheckSignalMatch(`FDCAN2::dbNode::`CVADAS::`CVPAM_FD_Info::`DisplayView2, 1, __cGreaterEqualThan) == 1;
        __res2 = CheckSignalMatch(`FDCAN2::dbNode::`CVADAS::`CVPAM_FD_Info::`DisplayView2, 15, __cLessEqualThan) == 1;
        __csr = __res1 && __res2;
        snprintf(__cArray, 8192, "%s", "DisplayView2");
        snprintf(__cArray2, 8192, "%s '%s'", __cCANSignal, __cArray);
        snprintf(__cArray3, 8192, "%s", "");
        snprintf(__cArray4, 8192, "%s", "");
        snprintf(__cArray5, 8192, "%s", __cArray3);
        snprintf(__cArray6, 8192, "%s", __cArray4);
        ReportRange(1, 15, __cArray5, __cArray6, __cArray7, 8192);
        ReportTableRow(__tableHandle, 0, __cArray2, __cRange, __cArray7, __cEmpty, __oneOfFlag, __bSetInCheckAlignment);
        ReportLValueOrSignalNotOnline(`FDCAN2::dbNode::`CVADAS::`CVPAM_FD_Info::`DisplayView2, __cArray8, 8192);
        ReportCell(__tableHandle, __cArray8);
        ReportCellResult(__tableHandle, __csr, __ePassFail);
      }
  
      __bVerdict = __bVerdict && __csr;
    }
    ReportTableEndVerdict(__tableHandle, "1", __bVerdict);
  }
  TestCommandEnd();


}

testcase Ttvccmce9_TsTc9()
{
  stack long __tableHandle;
  SetBreakOnFail(1);

  {
    CreateTTEIFFunction("Ttvccmce9_CaptureImage", __eFct, __eLocal);
    CallInterfaceFunction(__cEmpty, __cEmpty, "1daf8716-872e-4d40-8766-e475aac19554");
  }


  TestCommandBegin(__eSet, __cSet, "", "1");
  {
    __tableHandle = ReportTableHead3Columns(__cSetCaption , __cTSym, __cTOp, __cAssigned); 
    {
      $`FDCAN2::dbNode::`SGW::`TELEMATIC_FD_5::`CameraDisplaySts2.phys = 7;
      snprintf(__cArray, 8192, "%s", "CameraDisplaySts2");
      snprintf(__cArray2, 8192, "%s '%s'", __cCANSignal, __cArray);
      snprintf(__cArray3, 8192, "%s", "");
      
      ReportSetLValueOrSignalNotOnline(getSignalTime(`FDCAN2::dbNode::`SGW::`TELEMATIC_FD_5::`CameraDisplaySts2), __cArray2, __cArray4, 8192);
      ReportTableRow(__tableHandle, 0, __cArray4, __cAOp, 7, __cArray3, __oneOfFlag, __bSetInCheckAlignment);
      
  
    }
    ReportTableEndTestStep(__tableHandle, "1");
  }
  TestCommandEnd();


  TestCommandBegin(__eWait, __cWait, "", "2");
  {
    Wait("1", (1000 * 1000000LL), 1000000, "");
  }
  TestCommandEnd();

  TestCommandBegin(__eCheck, __cCheck, "", "3");
  {
    __bVerdict = __eVerdictPass;
    __tableHandle = ReportTableHead5Columns(__cCheckCaption, __cTSym, __cTOp, __cRefVal, __cActual, __cRes);
    {
      {
        int __res1,__res2;
        __res1 = CheckSignalMatch(`FDCAN2::dbNode::`CVADAS::`CVPAM_FD_Info::`DisplayView2, 1, __cGreaterEqualThan) == 1;
        __res2 = CheckSignalMatch(`FDCAN2::dbNode::`CVADAS::`CVPAM_FD_Info::`DisplayView2, 15, __cLessEqualThan) == 1;
        __csr = __res1 && __res2;
        snprintf(__cArray, 8192, "%s", "DisplayView2");
        snprintf(__cArray2, 8192, "%s '%s'", __cCANSignal, __cArray);
        snprintf(__cArray3, 8192, "%s", "");
        snprintf(__cArray4, 8192, "%s", "");
        snprintf(__cArray5, 8192, "%s", __cArray3);
        snprintf(__cArray6, 8192, "%s", __cArray4);
        ReportRange(1, 15, __cArray5, __cArray6, __cArray7, 8192);
        ReportTableRow(__tableHandle, 0, __cArray2, __cRange, __cArray7, __cEmpty, __oneOfFlag, __bSetInCheckAlignment);
        ReportLValueOrSignalNotOnline(`FDCAN2::dbNode::`CVADAS::`CVPAM_FD_Info::`DisplayView2, __cArray8, 8192);
        ReportCell(__tableHandle, __cArray8);
        ReportCellResult(__tableHandle, __csr, __ePassFail);
      }
  
      __bVerdict = __bVerdict && __csr;
    }
    ReportTableEndVerdict(__tableHandle, "1", __bVerdict);
  }
  TestCommandEnd();


}

testcase Ttvccmce9_TsTc10()
{
  stack long __tableHandle;
  SetBreakOnFail(1);

  {
    CreateTTEIFFunction("Ttvccmce9_CaptureImage", __eFct, __eLocal);
    CallInterfaceFunction(__cEmpty, __cEmpty, "1daf8716-872e-4d40-8766-e475aac19554");
  }


  TestCommandBegin(__eSet, __cSet, "", "1");
  {
    __tableHandle = ReportTableHead3Columns(__cSetCaption , __cTSym, __cTOp, __cAssigned); 
    {
      $`FDCAN2::dbNode::`SGW::`TELEMATIC_FD_5::`CameraDisplaySts2.phys = 8;
      snprintf(__cArray, 8192, "%s", "CameraDisplaySts2");
      snprintf(__cArray2, 8192, "%s '%s'", __cCANSignal, __cArray);
      snprintf(__cArray3, 8192, "%s", "");
      
      ReportSetLValueOrSignalNotOnline(getSignalTime(`FDCAN2::dbNode::`SGW::`TELEMATIC_FD_5::`CameraDisplaySts2), __cArray2, __cArray4, 8192);
      ReportTableRow(__tableHandle, 0, __cArray4, __cAOp, 8, __cArray3, __oneOfFlag, __bSetInCheckAlignment);
      
  
    }
    ReportTableEndTestStep(__tableHandle, "1");
  }
  TestCommandEnd();


  TestCommandBegin(__eWait, __cWait, "", "2");
  {
    Wait("1", (1000 * 1000000LL), 1000000, "");
  }
  TestCommandEnd();

  TestCommandBegin(__eCheck, __cCheck, "", "3");
  {
    __bVerdict = __eVerdictPass;
    __tableHandle = ReportTableHead5Columns(__cCheckCaption, __cTSym, __cTOp, __cRefVal, __cActual, __cRes);
    {
      {
        int __res1,__res2;
        __res1 = CheckSignalMatch(`FDCAN2::dbNode::`CVADAS::`CVPAM_FD_Info::`DisplayView2, 1, __cGreaterEqualThan) == 1;
        __res2 = CheckSignalMatch(`FDCAN2::dbNode::`CVADAS::`CVPAM_FD_Info::`DisplayView2, 15, __cLessEqualThan) == 1;
        __csr = __res1 && __res2;
        snprintf(__cArray, 8192, "%s", "DisplayView2");
        snprintf(__cArray2, 8192, "%s '%s'", __cCANSignal, __cArray);
        snprintf(__cArray3, 8192, "%s", "");
        snprintf(__cArray4, 8192, "%s", "");
        snprintf(__cArray5, 8192, "%s", __cArray3);
        snprintf(__cArray6, 8192, "%s", __cArray4);
        ReportRange(1, 15, __cArray5, __cArray6, __cArray7, 8192);
        ReportTableRow(__tableHandle, 0, __cArray2, __cRange, __cArray7, __cEmpty, __oneOfFlag, __bSetInCheckAlignment);
        ReportLValueOrSignalNotOnline(`FDCAN2::dbNode::`CVADAS::`CVPAM_FD_Info::`DisplayView2, __cArray8, 8192);
        ReportCell(__tableHandle, __cArray8);
        ReportCellResult(__tableHandle, __csr, __ePassFail);
      }
  
      __bVerdict = __bVerdict && __csr;
    }
    ReportTableEndVerdict(__tableHandle, "1", __bVerdict);
  }
  TestCommandEnd();


}

testcase Ttvccmce9_TsTc11()
{
  stack long __tableHandle;
  SetBreakOnFail(1);

  {
    CreateTTEIFFunction("Ttvccmce9_CaptureImage", __eFct, __eLocal);
    CallInterfaceFunction(__cEmpty, __cEmpty, "1daf8716-872e-4d40-8766-e475aac19554");
  }


  TestCommandBegin(__eSet, __cSet, "", "1");
  {
    __tableHandle = ReportTableHead3Columns(__cSetCaption , __cTSym, __cTOp, __cAssigned); 
    {
      $`FDCAN2::dbNode::`SGW::`TELEMATIC_FD_5::`CameraDisplaySts2.phys = 9;
      snprintf(__cArray, 8192, "%s", "CameraDisplaySts2");
      snprintf(__cArray2, 8192, "%s '%s'", __cCANSignal, __cArray);
      snprintf(__cArray3, 8192, "%s", "");
      
      ReportSetLValueOrSignalNotOnline(getSignalTime(`FDCAN2::dbNode::`SGW::`TELEMATIC_FD_5::`CameraDisplaySts2), __cArray2, __cArray4, 8192);
      ReportTableRow(__tableHandle, 0, __cArray4, __cAOp, 9, __cArray3, __oneOfFlag, __bSetInCheckAlignment);
      
  
    }
    ReportTableEndTestStep(__tableHandle, "1");
  }
  TestCommandEnd();


  TestCommandBegin(__eWait, __cWait, "", "2");
  {
    Wait("1", (1000 * 1000000LL), 1000000, "");
  }
  TestCommandEnd();

  TestCommandBegin(__eCheck, __cCheck, "", "3");
  {
    __bVerdict = __eVerdictPass;
    __tableHandle = ReportTableHead5Columns(__cCheckCaption, __cTSym, __cTOp, __cRefVal, __cActual, __cRes);
    {
      {
        int __res1,__res2;
        __res1 = CheckSignalMatch(`FDCAN2::dbNode::`CVADAS::`CVPAM_FD_Info::`DisplayView2, 1, __cGreaterEqualThan) == 1;
        __res2 = CheckSignalMatch(`FDCAN2::dbNode::`CVADAS::`CVPAM_FD_Info::`DisplayView2, 15, __cLessEqualThan) == 1;
        __csr = __res1 && __res2;
        snprintf(__cArray, 8192, "%s", "DisplayView2");
        snprintf(__cArray2, 8192, "%s '%s'", __cCANSignal, __cArray);
        snprintf(__cArray3, 8192, "%s", "");
        snprintf(__cArray4, 8192, "%s", "");
        snprintf(__cArray5, 8192, "%s", __cArray3);
        snprintf(__cArray6, 8192, "%s", __cArray4);
        ReportRange(1, 15, __cArray5, __cArray6, __cArray7, 8192);
        ReportTableRow(__tableHandle, 0, __cArray2, __cRange, __cArray7, __cEmpty, __oneOfFlag, __bSetInCheckAlignment);
        ReportLValueOrSignalNotOnline(`FDCAN2::dbNode::`CVADAS::`CVPAM_FD_Info::`DisplayView2, __cArray8, 8192);
        ReportCell(__tableHandle, __cArray8);
        ReportCellResult(__tableHandle, __csr, __ePassFail);
      }
  
      __bVerdict = __bVerdict && __csr;
    }
    ReportTableEndVerdict(__tableHandle, "1", __bVerdict);
  }
  TestCommandEnd();


}

testcase Ttvccmce9_TsTc12()
{
  stack long __tableHandle;
  SetBreakOnFail(1);

  {
    CreateTTEIFFunction("Ttvccmce9_CaptureImage", __eFct, __eLocal);
    CallInterfaceFunction(__cEmpty, __cEmpty, "1daf8716-872e-4d40-8766-e475aac19554");
  }


  TestCommandBegin(__eSet, __cSet, "", "1");
  {
    __tableHandle = ReportTableHead3Columns(__cSetCaption , __cTSym, __cTOp, __cAssigned); 
    {
      $`FDCAN2::dbNode::`SGW::`TELEMATIC_FD_5::`CameraDisplaySts2.phys = 11;
      snprintf(__cArray, 8192, "%s", "CameraDisplaySts2");
      snprintf(__cArray2, 8192, "%s '%s'", __cCANSignal, __cArray);
      snprintf(__cArray3, 8192, "%s", "");
      
      ReportSetLValueOrSignalNotOnline(getSignalTime(`FDCAN2::dbNode::`SGW::`TELEMATIC_FD_5::`CameraDisplaySts2), __cArray2, __cArray4, 8192);
      ReportTableRow(__tableHandle, 0, __cArray4, __cAOp, 11, __cArray3, __oneOfFlag, __bSetInCheckAlignment);
      
  
    }
    ReportTableEndTestStep(__tableHandle, "1");
  }
  TestCommandEnd();


  TestCommandBegin(__eWait, __cWait, "", "2");
  {
    Wait("1", (1000 * 1000000LL), 1000000, "");
  }
  TestCommandEnd();

  TestCommandBegin(__eCheck, __cCheck, "", "3");
  {
    __bVerdict = __eVerdictPass;
    __tableHandle = ReportTableHead5Columns(__cCheckCaption, __cTSym, __cTOp, __cRefVal, __cActual, __cRes);
    {
      {
        int __res1,__res2;
        __res1 = CheckSignalMatch(`FDCAN2::dbNode::`CVADAS::`CVPAM_FD_Info::`DisplayView2, 1, __cGreaterEqualThan) == 1;
        __res2 = CheckSignalMatch(`FDCAN2::dbNode::`CVADAS::`CVPAM_FD_Info::`DisplayView2, 15, __cLessEqualThan) == 1;
        __csr = __res1 && __res2;
        snprintf(__cArray, 8192, "%s", "DisplayView2");
        snprintf(__cArray2, 8192, "%s '%s'", __cCANSignal, __cArray);
        snprintf(__cArray3, 8192, "%s", "");
        snprintf(__cArray4, 8192, "%s", "");
        snprintf(__cArray5, 8192, "%s", __cArray3);
        snprintf(__cArray6, 8192, "%s", __cArray4);
        ReportRange(1, 15, __cArray5, __cArray6, __cArray7, 8192);
        ReportTableRow(__tableHandle, 0, __cArray2, __cRange, __cArray7, __cEmpty, __oneOfFlag, __bSetInCheckAlignment);
        ReportLValueOrSignalNotOnline(`FDCAN2::dbNode::`CVADAS::`CVPAM_FD_Info::`DisplayView2, __cArray8, 8192);
        ReportCell(__tableHandle, __cArray8);
        ReportCellResult(__tableHandle, __csr, __ePassFail);
      }
  
      __bVerdict = __bVerdict && __csr;
    }
    ReportTableEndVerdict(__tableHandle, "1", __bVerdict);
  }
  TestCommandEnd();


}

testcase Ttvccmce9_TsTc13()
{
  stack long __tableHandle;
  SetBreakOnFail(1);

  {
    CreateTTEIFFunction("Ttvccmce9_CaptureImage", __eFct, __eLocal);
    CallInterfaceFunction(__cEmpty, __cEmpty, "1daf8716-872e-4d40-8766-e475aac19554");
  }


  TestCommandBegin(__eSet, __cSet, "", "1");
  {
    __tableHandle = ReportTableHead3Columns(__cSetCaption , __cTSym, __cTOp, __cAssigned); 
    {
      $`FDCAN2::dbNode::`SGW::`TELEMATIC_FD_5::`CameraDisplaySts2.phys = 12;
      snprintf(__cArray, 8192, "%s", "CameraDisplaySts2");
      snprintf(__cArray2, 8192, "%s '%s'", __cCANSignal, __cArray);
      snprintf(__cArray3, 8192, "%s", "");
      
      ReportSetLValueOrSignalNotOnline(getSignalTime(`FDCAN2::dbNode::`SGW::`TELEMATIC_FD_5::`CameraDisplaySts2), __cArray2, __cArray4, 8192);
      ReportTableRow(__tableHandle, 0, __cArray4, __cAOp, 12, __cArray3, __oneOfFlag, __bSetInCheckAlignment);
      
  
    }
    ReportTableEndTestStep(__tableHandle, "1");
  }
  TestCommandEnd();


  TestCommandBegin(__eWait, __cWait, "", "2");
  {
    Wait("1", (1000 * 1000000LL), 1000000, "");
  }
  TestCommandEnd();

  TestCommandBegin(__eCheck, __cCheck, "", "3");
  {
    __bVerdict = __eVerdictPass;
    __tableHandle = ReportTableHead5Columns(__cCheckCaption, __cTSym, __cTOp, __cRefVal, __cActual, __cRes);
    {
      {
        int __res1,__res2;
        __res1 = CheckSignalMatch(`FDCAN2::dbNode::`CVADAS::`CVPAM_FD_Info::`DisplayView2, 1, __cGreaterEqualThan) == 1;
        __res2 = CheckSignalMatch(`FDCAN2::dbNode::`CVADAS::`CVPAM_FD_Info::`DisplayView2, 15, __cLessEqualThan) == 1;
        __csr = __res1 && __res2;
        snprintf(__cArray, 8192, "%s", "DisplayView2");
        snprintf(__cArray2, 8192, "%s '%s'", __cCANSignal, __cArray);
        snprintf(__cArray3, 8192, "%s", "");
        snprintf(__cArray4, 8192, "%s", "");
        snprintf(__cArray5, 8192, "%s", __cArray3);
        snprintf(__cArray6, 8192, "%s", __cArray4);
        ReportRange(1, 15, __cArray5, __cArray6, __cArray7, 8192);
        ReportTableRow(__tableHandle, 0, __cArray2, __cRange, __cArray7, __cEmpty, __oneOfFlag, __bSetInCheckAlignment);
        ReportLValueOrSignalNotOnline(`FDCAN2::dbNode::`CVADAS::`CVPAM_FD_Info::`DisplayView2, __cArray8, 8192);
        ReportCell(__tableHandle, __cArray8);
        ReportCellResult(__tableHandle, __csr, __ePassFail);
      }
  
      __bVerdict = __bVerdict && __csr;
    }
    ReportTableEndVerdict(__tableHandle, "1", __bVerdict);
  }
  TestCommandEnd();


}

testcase Ttvccmce9_TsTc14()
{
  stack long __tableHandle;
  SetBreakOnFail(1);

  {
    CreateTTEIFFunction("Ttvccmce9_CaptureImage", __eFct, __eLocal);
    CallInterfaceFunction(__cEmpty, __cEmpty, "1daf8716-872e-4d40-8766-e475aac19554");
  }


  TestCommandBegin(__eSet, __cSet, "", "1");
  {
    __tableHandle = ReportTableHead3Columns(__cSetCaption , __cTSym, __cTOp, __cAssigned); 
    {
      $`FDCAN2::dbNode::`SGW::`TELEMATIC_FD_5::`CameraDisplaySts2.phys = 13;
      snprintf(__cArray, 8192, "%s", "CameraDisplaySts2");
      snprintf(__cArray2, 8192, "%s '%s'", __cCANSignal, __cArray);
      snprintf(__cArray3, 8192, "%s", "");
      
      ReportSetLValueOrSignalNotOnline(getSignalTime(`FDCAN2::dbNode::`SGW::`TELEMATIC_FD_5::`CameraDisplaySts2), __cArray2, __cArray4, 8192);
      ReportTableRow(__tableHandle, 0, __cArray4, __cAOp, 13, __cArray3, __oneOfFlag, __bSetInCheckAlignment);
      
  
    }
    ReportTableEndTestStep(__tableHandle, "1");
  }
  TestCommandEnd();


  TestCommandBegin(__eWait, __cWait, "", "2");
  {
    Wait("1", (1000 * 1000000LL), 1000000, "");
  }
  TestCommandEnd();

  TestCommandBegin(__eCheck, __cCheck, "", "3");
  {
    __bVerdict = __eVerdictPass;
    __tableHandle = ReportTableHead5Columns(__cCheckCaption, __cTSym, __cTOp, __cRefVal, __cActual, __cRes);
    {
      {
        int __res1,__res2;
        __res1 = CheckSignalMatch(`FDCAN2::dbNode::`CVADAS::`CVPAM_FD_Info::`DisplayView2, 1, __cGreaterEqualThan) == 1;
        __res2 = CheckSignalMatch(`FDCAN2::dbNode::`CVADAS::`CVPAM_FD_Info::`DisplayView2, 15, __cLessEqualThan) == 1;
        __csr = __res1 && __res2;
        snprintf(__cArray, 8192, "%s", "DisplayView2");
        snprintf(__cArray2, 8192, "%s '%s'", __cCANSignal, __cArray);
        snprintf(__cArray3, 8192, "%s", "");
        snprintf(__cArray4, 8192, "%s", "");
        snprintf(__cArray5, 8192, "%s", __cArray3);
        snprintf(__cArray6, 8192, "%s", __cArray4);
        ReportRange(1, 15, __cArray5, __cArray6, __cArray7, 8192);
        ReportTableRow(__tableHandle, 0, __cArray2, __cRange, __cArray7, __cEmpty, __oneOfFlag, __bSetInCheckAlignment);
        ReportLValueOrSignalNotOnline(`FDCAN2::dbNode::`CVADAS::`CVPAM_FD_Info::`DisplayView2, __cArray8, 8192);
        ReportCell(__tableHandle, __cArray8);
        ReportCellResult(__tableHandle, __csr, __ePassFail);
      }
  
      __bVerdict = __bVerdict && __csr;
    }
    ReportTableEndVerdict(__tableHandle, "1", __bVerdict);
  }
  TestCommandEnd();


}

testcase Ttvccmce9_TsTc15()
{
  stack long __tableHandle;
  SetBreakOnFail(1);

  {
    CreateTTEIFFunction("Ttvccmce9_CaptureImage", __eFct, __eLocal);
    CallInterfaceFunction(__cEmpty, __cEmpty, "1daf8716-872e-4d40-8766-e475aac19554");
  }


  TestCommandBegin(__eSet, __cSet, "", "1");
  {
    __tableHandle = ReportTableHead3Columns(__cSetCaption , __cTSym, __cTOp, __cAssigned); 
    {
      $`FDCAN2::dbNode::`SGW::`TELEMATIC_FD_5::`CameraDisplaySts2.phys = 14;
      snprintf(__cArray, 8192, "%s", "CameraDisplaySts2");
      snprintf(__cArray2, 8192, "%s '%s'", __cCANSignal, __cArray);
      snprintf(__cArray3, 8192, "%s", "");
      
      ReportSetLValueOrSignalNotOnline(getSignalTime(`FDCAN2::dbNode::`SGW::`TELEMATIC_FD_5::`CameraDisplaySts2), __cArray2, __cArray4, 8192);
      ReportTableRow(__tableHandle, 0, __cArray4, __cAOp, 14, __cArray3, __oneOfFlag, __bSetInCheckAlignment);
      
  
    }
    ReportTableEndTestStep(__tableHandle, "1");
  }
  TestCommandEnd();


  TestCommandBegin(__eWait, __cWait, "", "2");
  {
    Wait("1", (1000 * 1000000LL), 1000000, "");
  }
  TestCommandEnd();

  TestCommandBegin(__eCheck, __cCheck, "", "3");
  {
    __bVerdict = __eVerdictPass;
    __tableHandle = ReportTableHead5Columns(__cCheckCaption, __cTSym, __cTOp, __cRefVal, __cActual, __cRes);
    {
      {
        int __res1,__res2;
        __res1 = CheckSignalMatch(`FDCAN2::dbNode::`CVADAS::`CVPAM_FD_Info::`DisplayView2, 1, __cGreaterEqualThan) == 1;
        __res2 = CheckSignalMatch(`FDCAN2::dbNode::`CVADAS::`CVPAM_FD_Info::`DisplayView2, 15, __cLessEqualThan) == 1;
        __csr = __res1 && __res2;
        snprintf(__cArray, 8192, "%s", "DisplayView2");
        snprintf(__cArray2, 8192, "%s '%s'", __cCANSignal, __cArray);
        snprintf(__cArray3, 8192, "%s", "");
        snprintf(__cArray4, 8192, "%s", "");
        snprintf(__cArray5, 8192, "%s", __cArray3);
        snprintf(__cArray6, 8192, "%s", __cArray4);
        ReportRange(1, 15, __cArray5, __cArray6, __cArray7, 8192);
        ReportTableRow(__tableHandle, 0, __cArray2, __cRange, __cArray7, __cEmpty, __oneOfFlag, __bSetInCheckAlignment);
        ReportLValueOrSignalNotOnline(`FDCAN2::dbNode::`CVADAS::`CVPAM_FD_Info::`DisplayView2, __cArray8, 8192);
        ReportCell(__tableHandle, __cArray8);
        ReportCellResult(__tableHandle, __csr, __ePassFail);
      }
  
      __bVerdict = __bVerdict && __csr;
    }
    ReportTableEndVerdict(__tableHandle, "1", __bVerdict);
  }
  TestCommandEnd();


}

testsequence Ttvccmce9_SteeringAngleTest_HMI_View_Switch()
{
  stack long __tableHandle;
  SetBreakOnFail(0);

  {
    CreateTTEIFFunction("Ttvccmce9_CaptureMasterImage", __eFct, __eLocal);
    CallInterfaceFunction(__cEmpty, __cEmpty, "a7bc5fa8-1544-4662-9c69-4b8c149a9263");
  }


  {
    __type_of(0) __tcLocVar0;
    __type_of(500) __tcLocVar1;
    __type_of(100) __tcLocVar2;
  
    __tcLocVar0 = 0;
    __tcLocVar1 = 500;
    __tcLocVar2 = 100;
  
    snprintf(__cArray, 8192, "%s", "0");
    snprintf(__cArray2, 8192, "%s", "500");
    snprintf(__cArray3, 8192, "%s", "100");
  
    snprintf(__cArray4, 8192, "For (For i=%s..%s, increment=%s)", __cArray, __cArray2, __cArray3);
    TestControlStructBegin(__cFor, __cArray4, "0");  
    for(__tt0LoopVar1 = __tcLocVar0; (__tcLocVar2 < 0) ? (CheckSignalMatch(__tt0LoopVar1, __tcLocVar1, ">=" ) == 1) : (CheckSignalMatch(__tt0LoopVar1, __tcLocVar1, "<=") == 1); __tt0LoopVar1 += __tcLocVar2)
    {
      if(__LoopIsBlocking())  
        break;
  
      snprintf(__cArray, 8192, "%s", "0");
      snprintf(__cArray2, 8192, "%s", "500");
      snprintf(__cArray3, 8192, "%s", "100");
      snprintf(__cArray4, 8192, "For (For i=%s..%s, increment=%s; current i = %lld)", __cArray, __cArray2, __cArray3, __tt0LoopVar1);
      TestControlStructBegin(__cForIteration, __cArray4, "1");
      TestCommandBegin(__eSet, __cSet, "", "2");
      {
        __tableHandle = ReportTableHead3Columns(__cSetCaption , __cTSym, __cTOp, __cAssigned); 
        {
          $`FDCAN2::dbNode::`BCM::`IPC_VEHICLE_SETUP::`SVC_Guidelines.phys = 1;
          snprintf(__cArray, 8192, "%s", "SVC_Guidelines");
          snprintf(__cArray2, 8192, "%s '%s'", __cCANSignal, __cArray);
          snprintf(__cArray3, 8192, "%s", "");
          
          ReportSetLValueOrSignalNotOnline(getSignalTime(`FDCAN2::dbNode::`BCM::`IPC_VEHICLE_SETUP::`SVC_Guidelines), __cArray2, __cArray4, 8192);
          ReportTableRow(__tableHandle, 0, __cArray4, __cAOp, 1, __cArray3, __oneOfFlag, __bSetInCheckAlignment);
          
      
        }
        ReportTableEndTestStep(__tableHandle, "1");
      }
      TestCommandEnd();


      TestCommandBegin(__eSet, __cSet, "", "3");
      {
        __tableHandle = ReportTableHead3Columns(__cSetCaption , __cTSym, __cTOp, __cAssigned); 
        {
          $`FDCAN2::dbNode::`BCM::`IPC_VEHICLE_SETUP::`Fwrd_Cam_Guidelines.phys = 1;
          snprintf(__cArray, 8192, "%s", "Fwrd_Cam_Guidelines");
          snprintf(__cArray2, 8192, "%s '%s'", __cCANSignal, __cArray);
          snprintf(__cArray3, 8192, "%s", "");
          
          ReportSetLValueOrSignalNotOnline(getSignalTime(`FDCAN2::dbNode::`BCM::`IPC_VEHICLE_SETUP::`Fwrd_Cam_Guidelines), __cArray2, __cArray4, 8192);
          ReportTableRow(__tableHandle, 0, __cArray4, __cAOp, 1, __cArray3, __oneOfFlag, __bSetInCheckAlignment);
          
      
        }
        ReportTableEndTestStep(__tableHandle, "1");
      }
      TestCommandEnd();


      TestCommandBegin(__eSet, __cSet, "", "4");
      {
        __tableHandle = ReportTableHead3Columns(__cSetCaption , __cTSym, __cTOp, __cAssigned); 
        {
          $`FDCAN14::dbNode::`EPS::`EPS_FD_1::`LwsAngle.phys = __tt0LoopVar1;
          snprintf(__cArray, 8192, "%s", "FDCAN14::EPS::EPS_FD_1::LwsAngle");
          snprintf(__cArray2, 8192, "%s '%s'", __cCANSignal, __cArray);
          snprintf(__cArray3, 8192, "%s", "i");
          
          ReportSetLValueOrSignalNotOnline(getSignalTime(`FDCAN14::dbNode::`EPS::`EPS_FD_1::`LwsAngle), __cArray2, __cArray4, 8192);
          ReportTableRow(__tableHandle, 0, __cArray4, __cAOp, __tt0LoopVar1, __cArray3, __oneOfFlag, __bSetInCheckAlignment);
          
      
        }
        ReportTableEndTestStep(__tableHandle, "1");
      }
      TestCommandEnd();


      CreateTTEIFFunction("Ttvccmce9_TsTc16", __eTcDef, __eLocal);
      AddIFParameterTestCaseAttribute("TC_ID", "");
      AddIFParameterTestCaseAttribute("Test Case ID", "");
      CallInterfaceFunction("Set to Surround View Camera", __cEmpty , "1b7403fd-e087-48f5-b7b8-46d492ffd3d3");

      CreateTTEIFFunction("Ttvccmce9_TsTc17", __eTcDef, __eLocal);
      AddIFParameterTestCaseAttribute("TC_ID", "");
      AddIFParameterTestCaseAttribute("Test Case ID", "");
      CallInterfaceFunction("View 3: Forward Facing Camera", __cEmpty , "6a6d8482-78df-47bb-983f-8ca3d851c121");

      CreateTTEIFFunction("Ttvccmce9_TsTc18", __eTcDef, __eLocal);
      AddIFParameterTestCaseAttribute("TC_ID", "");
      AddIFParameterTestCaseAttribute("Test Case ID", "");
      CallInterfaceFunction("View 11: FVTV", __cEmpty , "913343ab-1fd0-4222-8a7c-909921a59f50");

      CreateTTEIFFunction("Ttvccmce9_TsTc19", __eTcDef, __eLocal);
      AddIFParameterTestCaseAttribute("TC_ID", "");
      AddIFParameterTestCaseAttribute("Test Case ID", "");
      CallInterfaceFunction("View 12: RVTV", __cEmpty , "eea547e5-d48d-4030-961a-386f0d880544");

      TestControlStructEnd(__eUndefined);
    }
    TestControlStructEnd(__eUndefined);
  }

  {
    __type_of(-500) __tcLocVar0;
    __type_of(0) __tcLocVar1;
    __type_of(100) __tcLocVar2;
  
    __tcLocVar0 = -500;
    __tcLocVar1 = 0;
    __tcLocVar2 = 100;
  
    snprintf(__cArray, 8192, "%s", "-500");
    snprintf(__cArray2, 8192, "%s", "0");
    snprintf(__cArray3, 8192, "%s", "100");
  
    snprintf(__cArray4, 8192, "For (For i=%s..%s, increment=%s)", __cArray, __cArray2, __cArray3);
    TestControlStructBegin(__cFor, __cArray4, "0");  
    for(__tt0LoopVar2 = __tcLocVar0; (__tcLocVar2 < 0) ? (CheckSignalMatch(__tt0LoopVar2, __tcLocVar1, ">=" ) == 1) : (CheckSignalMatch(__tt0LoopVar2, __tcLocVar1, "<=") == 1); __tt0LoopVar2 += __tcLocVar2)
    {
      if(__LoopIsBlocking())  
        break;
  
      snprintf(__cArray, 8192, "%s", "-500");
      snprintf(__cArray2, 8192, "%s", "0");
      snprintf(__cArray3, 8192, "%s", "100");
      snprintf(__cArray4, 8192, "For (For i=%s..%s, increment=%s; current i = %.15g)", __cArray, __cArray2, __cArray3, __tt0LoopVar2);
      TestControlStructBegin(__cForIteration, __cArray4, "5");
      TestCommandBegin(__eSet, __cSet, "", "6");
      {
        __tableHandle = ReportTableHead3Columns(__cSetCaption , __cTSym, __cTOp, __cAssigned); 
        {
          $`FDCAN2::dbNode::`BCM::`IPC_VEHICLE_SETUP::`SVC_Guidelines.phys = 1;
          snprintf(__cArray, 8192, "%s", "SVC_Guidelines");
          snprintf(__cArray2, 8192, "%s '%s'", __cCANSignal, __cArray);
          snprintf(__cArray3, 8192, "%s", "");
          
          ReportSetLValueOrSignalNotOnline(getSignalTime(`FDCAN2::dbNode::`BCM::`IPC_VEHICLE_SETUP::`SVC_Guidelines), __cArray2, __cArray4, 8192);
          ReportTableRow(__tableHandle, 0, __cArray4, __cAOp, 1, __cArray3, __oneOfFlag, __bSetInCheckAlignment);
          
      
        }
        ReportTableEndTestStep(__tableHandle, "1");
      }
      TestCommandEnd();


      TestCommandBegin(__eSet, __cSet, "", "7");
      {
        __tableHandle = ReportTableHead3Columns(__cSetCaption , __cTSym, __cTOp, __cAssigned); 
        {
          $`FDCAN2::dbNode::`BCM::`IPC_VEHICLE_SETUP::`Fwrd_Cam_Guidelines.phys = 1;
          snprintf(__cArray, 8192, "%s", "Fwrd_Cam_Guidelines");
          snprintf(__cArray2, 8192, "%s '%s'", __cCANSignal, __cArray);
          snprintf(__cArray3, 8192, "%s", "");
          
          ReportSetLValueOrSignalNotOnline(getSignalTime(`FDCAN2::dbNode::`BCM::`IPC_VEHICLE_SETUP::`Fwrd_Cam_Guidelines), __cArray2, __cArray4, 8192);
          ReportTableRow(__tableHandle, 0, __cArray4, __cAOp, 1, __cArray3, __oneOfFlag, __bSetInCheckAlignment);
          
      
        }
        ReportTableEndTestStep(__tableHandle, "1");
      }
      TestCommandEnd();


      TestCommandBegin(__eSet, __cSet, "", "8");
      {
        __tableHandle = ReportTableHead3Columns(__cSetCaption , __cTSym, __cTOp, __cAssigned); 
        {
          $`FDCAN14::dbNode::`EPS::`EPS_FD_1::`LwsAngle.phys = __tt0LoopVar2;
          snprintf(__cArray, 8192, "%s", "FDCAN14::EPS::EPS_FD_1::LwsAngle");
          snprintf(__cArray2, 8192, "%s '%s'", __cCANSignal, __cArray);
          snprintf(__cArray3, 8192, "%s", "i");
          
          ReportSetLValueOrSignalNotOnline(getSignalTime(`FDCAN14::dbNode::`EPS::`EPS_FD_1::`LwsAngle), __cArray2, __cArray4, 8192);
          ReportTableRow(__tableHandle, 0, __cArray4, __cAOp, __tt0LoopVar2, __cArray3, __oneOfFlag, __bSetInCheckAlignment);
          
      
        }
        ReportTableEndTestStep(__tableHandle, "1");
      }
      TestCommandEnd();


      CreateTTEIFFunction("Ttvccmce9_TsTc20", __eTcDef, __eLocal);
      AddIFParameterTestCaseAttribute("TC_ID", "");
      AddIFParameterTestCaseAttribute("Test Case ID", "");
      CallInterfaceFunction("Set to Surround View Camera", __cEmpty , "04de812c-5da4-43b1-ae1a-28fb409a63b5");

      CreateTTEIFFunction("Ttvccmce9_TsTc21", __eTcDef, __eLocal);
      AddIFParameterTestCaseAttribute("TC_ID", "");
      AddIFParameterTestCaseAttribute("Test Case ID", "");
      CallInterfaceFunction("View 3: Forward Facing Camera", __cEmpty , "1a1a74e1-626b-4953-9d8c-1cfe23907d60");

      CreateTTEIFFunction("Ttvccmce9_TsTc22", __eTcDef, __eLocal);
      AddIFParameterTestCaseAttribute("TC_ID", "");
      AddIFParameterTestCaseAttribute("Test Case ID", "");
      CallInterfaceFunction("View 11: FVTV", __cEmpty , "ffa1f21b-7a1f-495e-9cc5-b4f96fd65613");

      CreateTTEIFFunction("Ttvccmce9_TsTc23", __eTcDef, __eLocal);
      AddIFParameterTestCaseAttribute("TC_ID", "");
      AddIFParameterTestCaseAttribute("Test Case ID", "");
      CallInterfaceFunction("View 12: RVTV", __cEmpty , "af33ca31-2496-409f-b8a0-323981a23d76");

      TestControlStructEnd(__eUndefined);
    }
    TestControlStructEnd(__eUndefined);
  }

}

testcase Ttvccmce9_TsTc16()
{
  stack long __tableHandle;
  SetBreakOnFail(1);

  TestPreparationBegin();
  {
  }
  TestPreparationEnd();

  TestCommandBegin(__eSet, __cSet, "", "0");
  {
    __tableHandle = ReportTableHead3Columns(__cSetCaption , __cTSym, __cTOp, __cAssigned); 
    {
      $`FDCAN2::dbNode::`SGW::`TELEMATIC_FD_14::`TGW_CAMERA_DISP_STAT.phys = 4;
      snprintf(__cArray, 8192, "%s", "TGW_CAMERA_DISP_STAT");
      snprintf(__cArray2, 8192, "%s '%s'", __cCANSignal, __cArray);
      snprintf(__cArray3, 8192, "%s", "");
      
      ReportSetLValueOrSignalNotOnline(getSignalTime(`FDCAN2::dbNode::`SGW::`TELEMATIC_FD_14::`TGW_CAMERA_DISP_STAT), __cArray2, __cArray4, 8192);
      ReportTableRow(__tableHandle, 0, __cArray4, __cAOp, 4, __cArray3, __oneOfFlag, __bSetInCheckAlignment);
      
  
    }
    {
      $`FDCAN2::dbNode::`SGW::`TELEMATIC_FD_5::`CameraDisplaySts2.phys = 0;
      snprintf(__cArray, 8192, "%s", "CameraDisplaySts2");
      snprintf(__cArray2, 8192, "%s '%s'", __cCANSignal, __cArray);
      snprintf(__cArray3, 8192, "%s", "Default");
      
      ReportSetLValueOrSignalNotOnline(getSignalTime(`FDCAN2::dbNode::`SGW::`TELEMATIC_FD_5::`CameraDisplaySts2), __cArray2, __cArray4, 8192);
      ReportTableRow(__tableHandle, 0, __cArray4, __cAOp, 0, __cArray3, __oneOfFlag, __bSetInCheckAlignment);
      
  
    }
    ReportTableEndTestStep(__tableHandle, "1");
  }
  TestCommandEnd();


  TestCommandBegin(__eWait, __cWait, "", "1");
  {
    Wait("1", (1000 * 1000000LL), 1000000, "");
  }
  TestCommandEnd();

  TestCommandBegin(__eCheck, __cCheck, "", "2");
  {
    __bVerdict = __eVerdictPass;
    __tableHandle = ReportTableHead5Columns(__cCheckCaption, __cTSym, __cTOp, __cRefVal, __cActual, __cRes);
    {
      {
        int __res1,__res2;
        __res1 = CheckSignalMatch(`FDCAN2::dbNode::`SGW::`TELEMATIC_FD_14::`TGW_CAMERA_DISP_STAT, 0, __cGreaterEqualThan) == 1;
        __res2 = CheckSignalMatch(`FDCAN2::dbNode::`SGW::`TELEMATIC_FD_14::`TGW_CAMERA_DISP_STAT, 4, __cLessEqualThan) == 1;
        __csr = __res1 && __res2;
        snprintf(__cArray, 8192, "%s", "TGW_CAMERA_DISP_STAT");
        snprintf(__cArray2, 8192, "%s '%s'", __cCANSignal, __cArray);
        snprintf(__cArray3, 8192, "%s", "");
        snprintf(__cArray4, 8192, "%s", "");
        snprintf(__cArray5, 8192, "%s", __cArray3);
        snprintf(__cArray6, 8192, "%s", __cArray4);
        ReportRange(0, 4, __cArray5, __cArray6, __cArray7, 8192);
        ReportTableRow(__tableHandle, 0, __cArray2, __cRange, __cArray7, __cEmpty, __oneOfFlag, __bSetInCheckAlignment);
        ReportLValueOrSignalNotOnline(`FDCAN2::dbNode::`SGW::`TELEMATIC_FD_14::`TGW_CAMERA_DISP_STAT, __cArray8, 8192);
        ReportCell(__tableHandle, __cArray8);
        ReportCellResult(__tableHandle, __csr, __ePassFail);
      }
  
      __bVerdict = __bVerdict && __csr;
    }
    ReportTableEndVerdict(__tableHandle, "1", __bVerdict);
  }
  TestCommandEnd();


  TestCommandBegin(__eWait, __cWait, "", "3");
  {
    Wait("1", (3000 * 1000000LL), 1000000, "");
  }
  TestCommandEnd();

}

testcase Ttvccmce9_TsTc17()
{
  stack long __tableHandle;
  SetBreakOnFail(1);

  {
    CreateTTEIFFunction("Ttvccmce9_CaptureImage", __eFct, __eLocal);
    CallInterfaceFunction(__cEmpty, __cEmpty, "1daf8716-872e-4d40-8766-e475aac19554");
  }


  TestCommandBegin(__eSet, __cSet, "", "1");
  {
    __tableHandle = ReportTableHead3Columns(__cSetCaption , __cTSym, __cTOp, __cAssigned); 
    {
      $`FDCAN2::dbNode::`SGW::`TELEMATIC_FD_5::`CameraDisplaySts2.phys = 3;
      snprintf(__cArray, 8192, "%s", "CameraDisplaySts2");
      snprintf(__cArray2, 8192, "%s '%s'", __cCANSignal, __cArray);
      snprintf(__cArray3, 8192, "%s", "");
      
      ReportSetLValueOrSignalNotOnline(getSignalTime(`FDCAN2::dbNode::`SGW::`TELEMATIC_FD_5::`CameraDisplaySts2), __cArray2, __cArray4, 8192);
      ReportTableRow(__tableHandle, 0, __cArray4, __cAOp, 3, __cArray3, __oneOfFlag, __bSetInCheckAlignment);
      
  
    }
    ReportTableEndTestStep(__tableHandle, "1");
  }
  TestCommandEnd();


  TestCommandBegin(__eWait, __cWait, "", "2");
  {
    Wait("1", (1000 * 1000000LL), 1000000, "");
  }
  TestCommandEnd();

  TestCommandBegin(__eCheck, __cCheck, "", "3");
  {
    __bVerdict = __eVerdictPass;
    __tableHandle = ReportTableHead5Columns(__cCheckCaption, __cTSym, __cTOp, __cRefVal, __cActual, __cRes);
    {
      {
        int __res1,__res2;
        __res1 = CheckSignalMatch(`FDCAN2::dbNode::`CVADAS::`CVPAM_FD_Info::`DisplayView2, 1, __cGreaterEqualThan) == 1;
        __res2 = CheckSignalMatch(`FDCAN2::dbNode::`CVADAS::`CVPAM_FD_Info::`DisplayView2, 15, __cLessEqualThan) == 1;
        __csr = __res1 && __res2;
        snprintf(__cArray, 8192, "%s", "DisplayView2");
        snprintf(__cArray2, 8192, "%s '%s'", __cCANSignal, __cArray);
        snprintf(__cArray3, 8192, "%s", "");
        snprintf(__cArray4, 8192, "%s", "");
        snprintf(__cArray5, 8192, "%s", __cArray3);
        snprintf(__cArray6, 8192, "%s", __cArray4);
        ReportRange(1, 15, __cArray5, __cArray6, __cArray7, 8192);
        ReportTableRow(__tableHandle, 0, __cArray2, __cRange, __cArray7, __cEmpty, __oneOfFlag, __bSetInCheckAlignment);
        ReportLValueOrSignalNotOnline(`FDCAN2::dbNode::`CVADAS::`CVPAM_FD_Info::`DisplayView2, __cArray8, 8192);
        ReportCell(__tableHandle, __cArray8);
        ReportCellResult(__tableHandle, __csr, __ePassFail);
      }
  
      __bVerdict = __bVerdict && __csr;
    }
    ReportTableEndVerdict(__tableHandle, "1", __bVerdict);
  }
  TestCommandEnd();


}

testcase Ttvccmce9_TsTc18()
{
  stack long __tableHandle;
  SetBreakOnFail(1);

  {
    CreateTTEIFFunction("Ttvccmce9_CaptureImage", __eFct, __eLocal);
    CallInterfaceFunction(__cEmpty, __cEmpty, "1daf8716-872e-4d40-8766-e475aac19554");
  }


  TestCommandBegin(__eSet, __cSet, "", "1");
  {
    __tableHandle = ReportTableHead3Columns(__cSetCaption , __cTSym, __cTOp, __cAssigned); 
    {
      $`FDCAN2::dbNode::`SGW::`TELEMATIC_FD_5::`CameraDisplaySts2.phys = 11;
      snprintf(__cArray, 8192, "%s", "CameraDisplaySts2");
      snprintf(__cArray2, 8192, "%s '%s'", __cCANSignal, __cArray);
      snprintf(__cArray3, 8192, "%s", "");
      
      ReportSetLValueOrSignalNotOnline(getSignalTime(`FDCAN2::dbNode::`SGW::`TELEMATIC_FD_5::`CameraDisplaySts2), __cArray2, __cArray4, 8192);
      ReportTableRow(__tableHandle, 0, __cArray4, __cAOp, 11, __cArray3, __oneOfFlag, __bSetInCheckAlignment);
      
  
    }
    ReportTableEndTestStep(__tableHandle, "1");
  }
  TestCommandEnd();


  TestCommandBegin(__eWait, __cWait, "", "2");
  {
    Wait("1", (1000 * 1000000LL), 1000000, "");
  }
  TestCommandEnd();

  TestCommandBegin(__eCheck, __cCheck, "", "3");
  {
    __bVerdict = __eVerdictPass;
    __tableHandle = ReportTableHead5Columns(__cCheckCaption, __cTSym, __cTOp, __cRefVal, __cActual, __cRes);
    {
      {
        int __res1,__res2;
        __res1 = CheckSignalMatch(`FDCAN2::dbNode::`CVADAS::`CVPAM_FD_Info::`DisplayView2, 1, __cGreaterEqualThan) == 1;
        __res2 = CheckSignalMatch(`FDCAN2::dbNode::`CVADAS::`CVPAM_FD_Info::`DisplayView2, 15, __cLessEqualThan) == 1;
        __csr = __res1 && __res2;
        snprintf(__cArray, 8192, "%s", "DisplayView2");
        snprintf(__cArray2, 8192, "%s '%s'", __cCANSignal, __cArray);
        snprintf(__cArray3, 8192, "%s", "");
        snprintf(__cArray4, 8192, "%s", "");
        snprintf(__cArray5, 8192, "%s", __cArray3);
        snprintf(__cArray6, 8192, "%s", __cArray4);
        ReportRange(1, 15, __cArray5, __cArray6, __cArray7, 8192);
        ReportTableRow(__tableHandle, 0, __cArray2, __cRange, __cArray7, __cEmpty, __oneOfFlag, __bSetInCheckAlignment);
        ReportLValueOrSignalNotOnline(`FDCAN2::dbNode::`CVADAS::`CVPAM_FD_Info::`DisplayView2, __cArray8, 8192);
        ReportCell(__tableHandle, __cArray8);
        ReportCellResult(__tableHandle, __csr, __ePassFail);
      }
  
      __bVerdict = __bVerdict && __csr;
    }
    ReportTableEndVerdict(__tableHandle, "1", __bVerdict);
  }
  TestCommandEnd();


}

testcase Ttvccmce9_TsTc19()
{
  stack long __tableHandle;
  SetBreakOnFail(1);

  {
    CreateTTEIFFunction("Ttvccmce9_CaptureImage", __eFct, __eLocal);
    CallInterfaceFunction(__cEmpty, __cEmpty, "1daf8716-872e-4d40-8766-e475aac19554");
  }


  TestCommandBegin(__eSet, __cSet, "", "1");
  {
    __tableHandle = ReportTableHead3Columns(__cSetCaption , __cTSym, __cTOp, __cAssigned); 
    {
      $`FDCAN2::dbNode::`SGW::`TELEMATIC_FD_5::`CameraDisplaySts2.phys = 12;
      snprintf(__cArray, 8192, "%s", "CameraDisplaySts2");
      snprintf(__cArray2, 8192, "%s '%s'", __cCANSignal, __cArray);
      snprintf(__cArray3, 8192, "%s", "");
      
      ReportSetLValueOrSignalNotOnline(getSignalTime(`FDCAN2::dbNode::`SGW::`TELEMATIC_FD_5::`CameraDisplaySts2), __cArray2, __cArray4, 8192);
      ReportTableRow(__tableHandle, 0, __cArray4, __cAOp, 12, __cArray3, __oneOfFlag, __bSetInCheckAlignment);
      
  
    }
    ReportTableEndTestStep(__tableHandle, "1");
  }
  TestCommandEnd();


  TestCommandBegin(__eWait, __cWait, "", "2");
  {
    Wait("1", (1000 * 1000000LL), 1000000, "");
  }
  TestCommandEnd();

  TestCommandBegin(__eCheck, __cCheck, "", "3");
  {
    __bVerdict = __eVerdictPass;
    __tableHandle = ReportTableHead5Columns(__cCheckCaption, __cTSym, __cTOp, __cRefVal, __cActual, __cRes);
    {
      {
        int __res1,__res2;
        __res1 = CheckSignalMatch(`FDCAN2::dbNode::`CVADAS::`CVPAM_FD_Info::`DisplayView2, 1, __cGreaterEqualThan) == 1;
        __res2 = CheckSignalMatch(`FDCAN2::dbNode::`CVADAS::`CVPAM_FD_Info::`DisplayView2, 15, __cLessEqualThan) == 1;
        __csr = __res1 && __res2;
        snprintf(__cArray, 8192, "%s", "DisplayView2");
        snprintf(__cArray2, 8192, "%s '%s'", __cCANSignal, __cArray);
        snprintf(__cArray3, 8192, "%s", "");
        snprintf(__cArray4, 8192, "%s", "");
        snprintf(__cArray5, 8192, "%s", __cArray3);
        snprintf(__cArray6, 8192, "%s", __cArray4);
        ReportRange(1, 15, __cArray5, __cArray6, __cArray7, 8192);
        ReportTableRow(__tableHandle, 0, __cArray2, __cRange, __cArray7, __cEmpty, __oneOfFlag, __bSetInCheckAlignment);
        ReportLValueOrSignalNotOnline(`FDCAN2::dbNode::`CVADAS::`CVPAM_FD_Info::`DisplayView2, __cArray8, 8192);
        ReportCell(__tableHandle, __cArray8);
        ReportCellResult(__tableHandle, __csr, __ePassFail);
      }
  
      __bVerdict = __bVerdict && __csr;
    }
    ReportTableEndVerdict(__tableHandle, "1", __bVerdict);
  }
  TestCommandEnd();


}

testcase Ttvccmce9_TsTc20()
{
  stack long __tableHandle;
  SetBreakOnFail(1);

  TestPreparationBegin();
  {
  }
  TestPreparationEnd();

  TestCommandBegin(__eSet, __cSet, "", "0");
  {
    __tableHandle = ReportTableHead3Columns(__cSetCaption , __cTSym, __cTOp, __cAssigned); 
    {
      $`FDCAN2::dbNode::`SGW::`TELEMATIC_FD_14::`TGW_CAMERA_DISP_STAT.phys = 4;
      snprintf(__cArray, 8192, "%s", "TGW_CAMERA_DISP_STAT");
      snprintf(__cArray2, 8192, "%s '%s'", __cCANSignal, __cArray);
      snprintf(__cArray3, 8192, "%s", "");
      
      ReportSetLValueOrSignalNotOnline(getSignalTime(`FDCAN2::dbNode::`SGW::`TELEMATIC_FD_14::`TGW_CAMERA_DISP_STAT), __cArray2, __cArray4, 8192);
      ReportTableRow(__tableHandle, 0, __cArray4, __cAOp, 4, __cArray3, __oneOfFlag, __bSetInCheckAlignment);
      
  
    }
    {
      $`FDCAN2::dbNode::`SGW::`TELEMATIC_FD_5::`CameraDisplaySts2.phys = 0;
      snprintf(__cArray, 8192, "%s", "CameraDisplaySts2");
      snprintf(__cArray2, 8192, "%s '%s'", __cCANSignal, __cArray);
      snprintf(__cArray3, 8192, "%s", "Default");
      
      ReportSetLValueOrSignalNotOnline(getSignalTime(`FDCAN2::dbNode::`SGW::`TELEMATIC_FD_5::`CameraDisplaySts2), __cArray2, __cArray4, 8192);
      ReportTableRow(__tableHandle, 0, __cArray4, __cAOp, 0, __cArray3, __oneOfFlag, __bSetInCheckAlignment);
      
  
    }
    ReportTableEndTestStep(__tableHandle, "1");
  }
  TestCommandEnd();


  TestCommandBegin(__eWait, __cWait, "", "1");
  {
    Wait("1", (1000 * 1000000LL), 1000000, "");
  }
  TestCommandEnd();

  TestCommandBegin(__eCheck, __cCheck, "", "2");
  {
    __bVerdict = __eVerdictPass;
    __tableHandle = ReportTableHead5Columns(__cCheckCaption, __cTSym, __cTOp, __cRefVal, __cActual, __cRes);
    {
      {
        int __res1,__res2;
        __res1 = CheckSignalMatch(`FDCAN2::dbNode::`SGW::`TELEMATIC_FD_14::`TGW_CAMERA_DISP_STAT, 0, __cGreaterEqualThan) == 1;
        __res2 = CheckSignalMatch(`FDCAN2::dbNode::`SGW::`TELEMATIC_FD_14::`TGW_CAMERA_DISP_STAT, 4, __cLessEqualThan) == 1;
        __csr = __res1 && __res2;
        snprintf(__cArray, 8192, "%s", "TGW_CAMERA_DISP_STAT");
        snprintf(__cArray2, 8192, "%s '%s'", __cCANSignal, __cArray);
        snprintf(__cArray3, 8192, "%s", "");
        snprintf(__cArray4, 8192, "%s", "");
        snprintf(__cArray5, 8192, "%s", __cArray3);
        snprintf(__cArray6, 8192, "%s", __cArray4);
        ReportRange(0, 4, __cArray5, __cArray6, __cArray7, 8192);
        ReportTableRow(__tableHandle, 0, __cArray2, __cRange, __cArray7, __cEmpty, __oneOfFlag, __bSetInCheckAlignment);
        ReportLValueOrSignalNotOnline(`FDCAN2::dbNode::`SGW::`TELEMATIC_FD_14::`TGW_CAMERA_DISP_STAT, __cArray8, 8192);
        ReportCell(__tableHandle, __cArray8);
        ReportCellResult(__tableHandle, __csr, __ePassFail);
      }
  
      __bVerdict = __bVerdict && __csr;
    }
    ReportTableEndVerdict(__tableHandle, "1", __bVerdict);
  }
  TestCommandEnd();


  TestCommandBegin(__eWait, __cWait, "", "3");
  {
    Wait("1", (3000 * 1000000LL), 1000000, "");
  }
  TestCommandEnd();

}

testcase Ttvccmce9_TsTc21()
{
  stack long __tableHandle;
  SetBreakOnFail(1);

  {
    CreateTTEIFFunction("Ttvccmce9_CaptureImage", __eFct, __eLocal);
    CallInterfaceFunction(__cEmpty, __cEmpty, "1daf8716-872e-4d40-8766-e475aac19554");
  }


  TestCommandBegin(__eSet, __cSet, "", "1");
  {
    __tableHandle = ReportTableHead3Columns(__cSetCaption , __cTSym, __cTOp, __cAssigned); 
    {
      $`FDCAN2::dbNode::`SGW::`TELEMATIC_FD_5::`CameraDisplaySts2.phys = 3;
      snprintf(__cArray, 8192, "%s", "CameraDisplaySts2");
      snprintf(__cArray2, 8192, "%s '%s'", __cCANSignal, __cArray);
      snprintf(__cArray3, 8192, "%s", "");
      
      ReportSetLValueOrSignalNotOnline(getSignalTime(`FDCAN2::dbNode::`SGW::`TELEMATIC_FD_5::`CameraDisplaySts2), __cArray2, __cArray4, 8192);
      ReportTableRow(__tableHandle, 0, __cArray4, __cAOp, 3, __cArray3, __oneOfFlag, __bSetInCheckAlignment);
      
  
    }
    ReportTableEndTestStep(__tableHandle, "1");
  }
  TestCommandEnd();


  TestCommandBegin(__eWait, __cWait, "", "2");
  {
    Wait("1", (1000 * 1000000LL), 1000000, "");
  }
  TestCommandEnd();

  TestCommandBegin(__eCheck, __cCheck, "", "3");
  {
    __bVerdict = __eVerdictPass;
    __tableHandle = ReportTableHead5Columns(__cCheckCaption, __cTSym, __cTOp, __cRefVal, __cActual, __cRes);
    {
      {
        int __res1,__res2;
        __res1 = CheckSignalMatch(`FDCAN2::dbNode::`CVADAS::`CVPAM_FD_Info::`DisplayView2, 1, __cGreaterEqualThan) == 1;
        __res2 = CheckSignalMatch(`FDCAN2::dbNode::`CVADAS::`CVPAM_FD_Info::`DisplayView2, 15, __cLessEqualThan) == 1;
        __csr = __res1 && __res2;
        snprintf(__cArray, 8192, "%s", "DisplayView2");
        snprintf(__cArray2, 8192, "%s '%s'", __cCANSignal, __cArray);
        snprintf(__cArray3, 8192, "%s", "");
        snprintf(__cArray4, 8192, "%s", "");
        snprintf(__cArray5, 8192, "%s", __cArray3);
        snprintf(__cArray6, 8192, "%s", __cArray4);
        ReportRange(1, 15, __cArray5, __cArray6, __cArray7, 8192);
        ReportTableRow(__tableHandle, 0, __cArray2, __cRange, __cArray7, __cEmpty, __oneOfFlag, __bSetInCheckAlignment);
        ReportLValueOrSignalNotOnline(`FDCAN2::dbNode::`CVADAS::`CVPAM_FD_Info::`DisplayView2, __cArray8, 8192);
        ReportCell(__tableHandle, __cArray8);
        ReportCellResult(__tableHandle, __csr, __ePassFail);
      }
  
      __bVerdict = __bVerdict && __csr;
    }
    ReportTableEndVerdict(__tableHandle, "1", __bVerdict);
  }
  TestCommandEnd();


}

testcase Ttvccmce9_TsTc22()
{
  stack long __tableHandle;
  SetBreakOnFail(1);

  {
    CreateTTEIFFunction("Ttvccmce9_CaptureImage", __eFct, __eLocal);
    CallInterfaceFunction(__cEmpty, __cEmpty, "1daf8716-872e-4d40-8766-e475aac19554");
  }


  TestCommandBegin(__eSet, __cSet, "", "1");
  {
    __tableHandle = ReportTableHead3Columns(__cSetCaption , __cTSym, __cTOp, __cAssigned); 
    {
      $`FDCAN2::dbNode::`SGW::`TELEMATIC_FD_5::`CameraDisplaySts2.phys = 11;
      snprintf(__cArray, 8192, "%s", "CameraDisplaySts2");
      snprintf(__cArray2, 8192, "%s '%s'", __cCANSignal, __cArray);
      snprintf(__cArray3, 8192, "%s", "");
      
      ReportSetLValueOrSignalNotOnline(getSignalTime(`FDCAN2::dbNode::`SGW::`TELEMATIC_FD_5::`CameraDisplaySts2), __cArray2, __cArray4, 8192);
      ReportTableRow(__tableHandle, 0, __cArray4, __cAOp, 11, __cArray3, __oneOfFlag, __bSetInCheckAlignment);
      
  
    }
    ReportTableEndTestStep(__tableHandle, "1");
  }
  TestCommandEnd();


  TestCommandBegin(__eWait, __cWait, "", "2");
  {
    Wait("1", (1000 * 1000000LL), 1000000, "");
  }
  TestCommandEnd();

  TestCommandBegin(__eCheck, __cCheck, "", "3");
  {
    __bVerdict = __eVerdictPass;
    __tableHandle = ReportTableHead5Columns(__cCheckCaption, __cTSym, __cTOp, __cRefVal, __cActual, __cRes);
    {
      {
        int __res1,__res2;
        __res1 = CheckSignalMatch(`FDCAN2::dbNode::`CVADAS::`CVPAM_FD_Info::`DisplayView2, 1, __cGreaterEqualThan) == 1;
        __res2 = CheckSignalMatch(`FDCAN2::dbNode::`CVADAS::`CVPAM_FD_Info::`DisplayView2, 15, __cLessEqualThan) == 1;
        __csr = __res1 && __res2;
        snprintf(__cArray, 8192, "%s", "DisplayView2");
        snprintf(__cArray2, 8192, "%s '%s'", __cCANSignal, __cArray);
        snprintf(__cArray3, 8192, "%s", "");
        snprintf(__cArray4, 8192, "%s", "");
        snprintf(__cArray5, 8192, "%s", __cArray3);
        snprintf(__cArray6, 8192, "%s", __cArray4);
        ReportRange(1, 15, __cArray5, __cArray6, __cArray7, 8192);
        ReportTableRow(__tableHandle, 0, __cArray2, __cRange, __cArray7, __cEmpty, __oneOfFlag, __bSetInCheckAlignment);
        ReportLValueOrSignalNotOnline(`FDCAN2::dbNode::`CVADAS::`CVPAM_FD_Info::`DisplayView2, __cArray8, 8192);
        ReportCell(__tableHandle, __cArray8);
        ReportCellResult(__tableHandle, __csr, __ePassFail);
      }
  
      __bVerdict = __bVerdict && __csr;
    }
    ReportTableEndVerdict(__tableHandle, "1", __bVerdict);
  }
  TestCommandEnd();


}

testcase Ttvccmce9_TsTc23()
{
  stack long __tableHandle;
  SetBreakOnFail(1);

  {
    CreateTTEIFFunction("Ttvccmce9_CaptureImage", __eFct, __eLocal);
    CallInterfaceFunction(__cEmpty, __cEmpty, "1daf8716-872e-4d40-8766-e475aac19554");
  }


  TestCommandBegin(__eSet, __cSet, "", "1");
  {
    __tableHandle = ReportTableHead3Columns(__cSetCaption , __cTSym, __cTOp, __cAssigned); 
    {
      $`FDCAN2::dbNode::`SGW::`TELEMATIC_FD_5::`CameraDisplaySts2.phys = 12;
      snprintf(__cArray, 8192, "%s", "CameraDisplaySts2");
      snprintf(__cArray2, 8192, "%s '%s'", __cCANSignal, __cArray);
      snprintf(__cArray3, 8192, "%s", "");
      
      ReportSetLValueOrSignalNotOnline(getSignalTime(`FDCAN2::dbNode::`SGW::`TELEMATIC_FD_5::`CameraDisplaySts2), __cArray2, __cArray4, 8192);
      ReportTableRow(__tableHandle, 0, __cArray4, __cAOp, 12, __cArray3, __oneOfFlag, __bSetInCheckAlignment);
      
  
    }
    ReportTableEndTestStep(__tableHandle, "1");
  }
  TestCommandEnd();


  TestCommandBegin(__eWait, __cWait, "", "2");
  {
    Wait("1", (1000 * 1000000LL), 1000000, "");
  }
  TestCommandEnd();

  TestCommandBegin(__eCheck, __cCheck, "", "3");
  {
    __bVerdict = __eVerdictPass;
    __tableHandle = ReportTableHead5Columns(__cCheckCaption, __cTSym, __cTOp, __cRefVal, __cActual, __cRes);
    {
      {
        int __res1,__res2;
        __res1 = CheckSignalMatch(`FDCAN2::dbNode::`CVADAS::`CVPAM_FD_Info::`DisplayView2, 1, __cGreaterEqualThan) == 1;
        __res2 = CheckSignalMatch(`FDCAN2::dbNode::`CVADAS::`CVPAM_FD_Info::`DisplayView2, 15, __cLessEqualThan) == 1;
        __csr = __res1 && __res2;
        snprintf(__cArray, 8192, "%s", "DisplayView2");
        snprintf(__cArray2, 8192, "%s '%s'", __cCANSignal, __cArray);
        snprintf(__cArray3, 8192, "%s", "");
        snprintf(__cArray4, 8192, "%s", "");
        snprintf(__cArray5, 8192, "%s", __cArray3);
        snprintf(__cArray6, 8192, "%s", __cArray4);
        ReportRange(1, 15, __cArray5, __cArray6, __cArray7, 8192);
        ReportTableRow(__tableHandle, 0, __cArray2, __cRange, __cArray7, __cEmpty, __oneOfFlag, __bSetInCheckAlignment);
        ReportLValueOrSignalNotOnline(`FDCAN2::dbNode::`CVADAS::`CVPAM_FD_Info::`DisplayView2, __cArray8, 8192);
        ReportCell(__tableHandle, __cArray8);
        ReportCellResult(__tableHandle, __csr, __ePassFail);
      }
  
      __bVerdict = __bVerdict && __csr;
    }
    ReportTableEndVerdict(__tableHandle, "1", __bVerdict);
  }
  TestCommandEnd();


}

void Ttvccmce9_Tet_TtInit()
{
  stack long __tableHandle;
}

void Ttvccmce9_Tet_Tc0()
{
  CreateTTEIFFunction("Ttvccmce9_Tc0", __eTcDef, __eLocal);  
  AddIFParameterTestCaseAttribute("TC_ID", "");
  AddIFParameterTestCaseAttribute("Test Case ID", "");
  CallInterfaceFunction("NVMReset", __cEmpty , __cEmpty );
}
testcase Ttvccmce9_Tc0()
{
  stack long __tableHandle;
  SetBreakOnFail(0);

  TestCommandBegin(__eWait, __cWait, "", "0");
  {
    Wait("1", (35000 * 1000000LL), 1000000, "");
  }
  TestCommandEnd();

  TestCommandBegin(__eDiagService, __cDiagService, "", "1");
  {
    if (DiagIsFunctionalGroup("CVADAS_0001_00000000_000"))
    {
      DiagResponse * __resp;
      DiagRequest CVADAS_0001_00000000_000.Extended_Diagnostic_Session_Start __req;
      __diagServicevccmce9_57(__req, __resp);
    }
    else
    {
      DiagResponse CVADAS_0001_00000000_000.* __resp;
      DiagRequest CVADAS_0001_00000000_000.Extended_Diagnostic_Session_Start __req;
      __diagServicevccmce9_57(__req, __resp);
    }
  }
  TestCommandEnd();


  TestCommandBegin(__eWait, __cWait, "", "2");
  {
    Wait("1", (1000 * 1000000LL), 1000000, "");
  }
  TestCommandEnd();

  TestCommandBegin(__eDiagService, __cDiagService, "", "3");
  {
    if (DiagIsFunctionalGroup("CVADAS_0001_00000000_000"))
    {
      DiagResponse * __resp;
      DiagRequest CVADAS_0001_00000000_000._2EFD4E_Reset_NVM_Write __req;
      __diagServicevccmce9_58(__req, __resp);
    }
    else
    {
      DiagResponse CVADAS_0001_00000000_000.* __resp;
      DiagRequest CVADAS_0001_00000000_000._2EFD4E_Reset_NVM_Write __req;
      __diagServicevccmce9_58(__req, __resp);
    }
  }
  TestCommandEnd();


  TestCommandBegin(__eWait, __cWait, "", "4");
  {
    Wait("1", (35000 * 1000000LL), 1000000, "");
  }
  TestCommandEnd();

  {
    CreateCaplIFFunction("Hard_Reset", __eFct);
    CallInterfaceFunction(__cEmpty, __cEmpty, "5");
  }


}

  
void __diagServicevccmce9_57(DiagRequest * __req, DiagResponse * __resp )
{
  stack long __tableHandle;
  long __res, __paramLen, __bytePos;

   __bVerdict = __eVerdictPass;

  do {
    TestReportResetDiagObjectList();
    DiagSetReportDetailLevel("CVADAS_0001_00000000_000", EnumServiceDetails_onfail);
    // Request aspect
    {

      if (0 >= DiagSendReqAndWaitForResp("CVADAS_0001_00000000_000", __req, __resp, __res, -1, -1, -1, -1, -1, EnumResult_pos, EnumServiceDetails_onfail, EnumSendingMode_physical, EnumSuppressPosResBit_asconfigured, EnumVerdictOnInvalidValues_fail))
        break;
    }

    __res = DiagErrCodeTestStep(__res, "Can't retrieve last response for request! No check possible.") < 0;
    if(__res)
    {
	  __bVerdict = __eVerdictFail;
      break;
    }
    {
      __res = DiagInterpretAs(__resp, "DSC_PR");
      if(__res != 0)
      {
        __bVerdict = __eVerdictFail;
        DiagErrCodeTestStep(__res, "Can't interpret response as diagnostic primitive 'DSC_PR'.");
        break;
      }
      else
      {
        TestStepPass( "Received primitive can be interpreted as diagnostic primitive 'DSC_PR'.");
      }
    }
  }
  while(0);


  // Response, check & read aspect
  {
    __res = 1;
    __tableHandle = ReportTableHead5Columns(__cCheckCaption, __cTSym, __cTOp, __cRefVal, __cActual, __cRes);
    {
      double __nDiagValue;
      DiagGetParameterErrorHandled(__resp, "DiagSessionType", __nDiagValue);
      __csr = CheckSignalMatch(__nDiagValue, 03, "==") == 1;
      snprintf(__cArray, 8192, "%s", "Diagnostic parameter \'DiagSessionType\'");
      snprintf(__cArray2, 8192, "%s", __cArray);
      snprintf(__cArray3, 8192, "%s", "");
      ReportTableRow(__tableHandle, 0, __cArray2, "==", 03, __cArray3, __oneOfFlag, __bSetInCheckAlignment);
      ReportCell(__tableHandle, __nDiagValue);
      ReportCellResult(__tableHandle, __csr, __ePassFail);
    
      __res = __res && __csr;
    
    }
    ReportTableEndVerdict(__tableHandle, __cEvaluateResponse, __res);
	__bVerdict = __bVerdict && __res;
  }
  if (__bVerdict == __eVerdictFail)
    TestReportWriteDiagObjectList();
}
  
void __diagServicevccmce9_58(DiagRequest * __req, DiagResponse * __resp )
{
  stack long __tableHandle;
  long __res, __paramLen, __bytePos;

   __bVerdict = __eVerdictPass;

  do {
    TestReportResetDiagObjectList();
    DiagSetReportDetailLevel("CVADAS_0001_00000000_000", EnumServiceDetails_onfail);
    // Request aspect
    {

      if (0 >= DiagSendReqAndWaitForResp("CVADAS_0001_00000000_000", __req, __resp, __res, -1, -1, -1, -1, -1, EnumResult_pos, EnumServiceDetails_onfail, EnumSendingMode_physical, EnumSuppressPosResBit_asconfigured, EnumVerdictOnInvalidValues_fail))
        break;
    }

    __res = DiagErrCodeTestStep(__res, "Can't retrieve last response for request! No check possible.") < 0;
    if(__res)
    {
	  __bVerdict = __eVerdictFail;
      break;
    }
    {
      __res = DiagInterpretAs(__resp, "WDBI_PR");
      if(__res != 0)
      {
        __bVerdict = __eVerdictFail;
        DiagErrCodeTestStep(__res, "Can't interpret response as diagnostic primitive 'WDBI_PR'.");
        break;
      }
      else
      {
        TestStepPass( "Received primitive can be interpreted as diagnostic primitive 'WDBI_PR'.");
      }
    }
  }
  while(0);


  if (__bVerdict == __eVerdictFail)
    TestReportWriteDiagObjectList();
}

void Ttvccmce9_Tet_Tc1()
{
  CreateTTEIFFunction("Ttvccmce9_Tc1", __eTcDef, __eLocal);  
  AddIFParameterTestCaseAttribute("TC_ID", "");
  AddIFParameterTestCaseAttribute("Test Case ID", "");
  CallInterfaceFunction("TC_ID_20205275", __cEmpty , __cEmpty );
}
testcase Ttvccmce9_Tc1()
{
  stack long __tableHandle;
  SetBreakOnFail(0);

  CreateTTEIFFunction("Ttvccmce9_Tet_Tc1_Completion", __eFct, __eLocal);
  
  AddIFAsCleanUpFunction();

  TestPreparationBegin();
  {
    TestCommandBegin(__eWait, __cWait, "", "0");
    {
      Wait("1", (45000 * 1000000LL), 1000000, "");
    }
    TestCommandEnd();

    {
      CreateTTEIFFunction("Ttvccmce9_General_Precondition", __eFct, __eLocal);
      CallInterfaceFunction(__cEmpty, __cEmpty, "b588ddda-8fe4-4271-93b3-dd1beefd9138");
    }


  }
  TestPreparationEnd();

  {
    CreateTTEIFFunction("Ttvccmce9__19_02_Report_DTC_By_Status_Mask_Physical_Add", __eFct, __eLocal);
    CallInterfaceFunction(__cEmpty, __cEmpty, "49d14f62-aa99-42aa-87c1-03b55e92f925");
  }



}

void Ttvccmce9_Tet_Tc1_Completion()
{
  stack long __tableHandle;
  TestCompletionBegin();
  {
    {
      CreateTTEIFFunction("Ttvccmce9_General_Postconditions", __eFct, __eLocal);
      CallInterfaceFunction(__cEmpty, __cEmpty, "3d1998f6-ed4f-4d8f-9c0f-63439c24b6a7");
    }


  }
  TestCompletionEnd();
}

void Ttvccmce9_Tet_Tc2()
{
  CreateTTEIFFunction("Ttvccmce9_Tc2", __eTcDef, __eLocal);  
  AddIFParameterTestCaseAttribute("TC_ID", "");
  AddIFParameterTestCaseAttribute("Test Case ID", "");
  CallInterfaceFunction("TC_ID_20205413_Hard_Reset", __cEmpty , __cEmpty );
}
testcase Ttvccmce9_Tc2()
{
  stack long __tableHandle;
  SetBreakOnFail(0);

  CreateTTEIFFunction("Ttvccmce9_Tet_Tc2_Completion", __eFct, __eLocal);
  
  AddIFAsCleanUpFunction();

  TestPreparationBegin();
  {
    {
      CreateTTEIFFunction("Ttvccmce9_General_Precondition", __eFct, __eLocal);
      CallInterfaceFunction(__cEmpty, __cEmpty, "b588ddda-8fe4-4271-93b3-dd1beefd9138");
    }


  }
  TestPreparationEnd();

  {
    CreateTTEIFFunction("Ttvccmce9_Hard_Reset_with_Physical_Address", __eFct, __eLocal);
    CallInterfaceFunction(__cEmpty, __cEmpty, "3faededc-97af-4e0a-8dd6-c11f8fa26bfa");
  }


  TestCommandBegin(__eWait, __cWait, "", "3");
  {
    Wait("1", (15 * 1000000000LL), 1000000000, "");
  }
  TestCommandEnd();

  {
    CreateTTEIFFunction("Ttvccmce9__19_02_Report_DTC_By_Status_Mask_Physical_Add", __eFct, __eLocal);
    CallInterfaceFunction(__cEmpty, __cEmpty, "49d14f62-aa99-42aa-87c1-03b55e92f925");
  }



}

void Ttvccmce9_Tet_Tc2_Completion()
{
  stack long __tableHandle;
  TestCompletionBegin();
  {
    {
      CreateTTEIFFunction("Ttvccmce9_General_Postconditions", __eFct, __eLocal);
      CallInterfaceFunction(__cEmpty, __cEmpty, "3d1998f6-ed4f-4d8f-9c0f-63439c24b6a7");
    }


  }
  TestCompletionEnd();
}

void Ttvccmce9_Tet_Tc3()
{
  CreateTTEIFFunction("Ttvccmce9_Tc3", __eTcDef, __eLocal);  
  AddIFParameterTestCaseAttribute("TC_ID", "");
  AddIFParameterTestCaseAttribute("Test Case ID", "");
  CallInterfaceFunction("TC_ID_20205388_power_Reset", __cEmpty , __cEmpty );
}
testcase Ttvccmce9_Tc3()
{
  stack long __tableHandle;
  SetBreakOnFail(0);

  CreateTTEIFFunction("Ttvccmce9_Tet_Tc3_Completion", __eFct, __eLocal);
  
  AddIFAsCleanUpFunction();

  TestPreparationBegin();
  {
    {
      CreateTTEIFFunction("Ttvccmce9_General_Precondition", __eFct, __eLocal);
      CallInterfaceFunction(__cEmpty, __cEmpty, "b588ddda-8fe4-4271-93b3-dd1beefd9138");
    }


  }
  TestPreparationEnd();

  {
    CreateCaplIFFunction("Power_Supply_OFF", __eFct);
    CallInterfaceFunction(__cEmpty, __cEmpty, "2");
  }


  TestCommandBegin(__eWait, __cWait, "", "3");
  {
    Wait("1", (3000 * 1000000LL), 1000000, "");
  }
  TestCommandEnd();

  {
    CreateCaplIFFunction("Power_Supply_ON", __eFct);
    CallInterfaceFunction(__cEmpty, __cEmpty, "4");
  }


  TestCommandBegin(__eWait, __cWait, "", "5");
  {
    Wait("1", (6500 * 1000000LL), 1000000, "");
  }
  TestCommandEnd();

  {
    CreateTTEIFFunction("Ttvccmce9__19_02_Report_DTC_By_Status_Mask_Physical_Add", __eFct, __eLocal);
    CallInterfaceFunction(__cEmpty, __cEmpty, "49d14f62-aa99-42aa-87c1-03b55e92f925");
  }



}

void Ttvccmce9_Tet_Tc3_Completion()
{
  stack long __tableHandle;
  TestCompletionBegin();
  {
    {
      CreateTTEIFFunction("Ttvccmce9_General_Postconditions", __eFct, __eLocal);
      CallInterfaceFunction(__cEmpty, __cEmpty, "3d1998f6-ed4f-4d8f-9c0f-63439c24b6a7");
    }


  }
  TestCompletionEnd();
}

void Ttvccmce9_Tet_TsCall0()
{
  stack long __tableHandle;
  CreateTTEIFFunction("Ttvccmce9_EOL_Calibration", __eTsDef, __eLocal);
  CallInterfaceFunction(__cEmpty , __cEmpty, __cEmpty );
}

void Ttvccmce9_Tet_CaplTcCall0()
{
  stack long __tableHandle;
  CreateCaplIFFunction("Send_Proxi", __eTcDef);
  AddIFParameterTestCaseAttribute("TC_ID", "");
  AddIFParameterTestCaseAttribute("Test Case ID", "");
  AddIFParameterChar(syspar::`VehicleProxy1_Single);
  CallInterfaceFunction(__cEmpty , "", __cEmpty );
}

void Ttvccmce9_Tet_TsCall1()
{
  stack long __tableHandle;
  CreateTTEIFFunction("Ttvccmce9_HMI_View_Switch", __eTsDef, __eLocal);
  CallInterfaceFunction(__cEmpty , __cEmpty, __cEmpty );
}

void Ttvccmce9_Tet_CaplTcCall1()
{
  stack long __tableHandle;
  CreateCaplIFFunction("Send_Proxi", __eTcDef);
  AddIFParameterTestCaseAttribute("TC_ID", "");
  AddIFParameterTestCaseAttribute("Test Case ID", "");
  AddIFParameterChar(syspar::`VehicleProxy1);
  CallInterfaceFunction(__cEmpty , "", __cEmpty );
}

void Ttvccmce9_Tet_TsCall2()
{
  stack long __tableHandle;
  CreateTTEIFFunction("Ttvccmce9_SteeringAngleTest_HMI_View_Switch", __eTsDef, __eLocal);
  CallInterfaceFunction(__cEmpty , __cEmpty, __cEmpty );
}

void Ttvccmce9_Tet_TsCall3()
{
  stack long __tableHandle;
  CreateTTEIFFunction("Ttvccmce9_HMI_View_Switch", __eTsDef, __eLocal);
  CallInterfaceFunction(__cEmpty , __cEmpty, __cEmpty );
}

void Ttvccmce9_Tet_CaplTcCall2()
{
  stack long __tableHandle;
  CreateCaplIFFunction("Send_Proxi", __eTcDef);
  AddIFParameterTestCaseAttribute("TC_ID", "");
  AddIFParameterTestCaseAttribute("Test Case ID", "");
  AddIFParameterChar(syspar::`VehicleProxy2_Single);
  CallInterfaceFunction(__cEmpty , "", __cEmpty );
}

void Ttvccmce9_Tet_TsCall4()
{
  stack long __tableHandle;
  CreateTTEIFFunction("Ttvccmce9_HMI_View_Switch", __eTsDef, __eLocal);
  CallInterfaceFunction(__cEmpty , __cEmpty, __cEmpty );
}

void Ttvccmce9_Tet_CaplTcCall3()
{
  stack long __tableHandle;
  CreateCaplIFFunction("Send_Proxi", __eTcDef);
  AddIFParameterTestCaseAttribute("TC_ID", "");
  AddIFParameterTestCaseAttribute("Test Case ID", "");
  AddIFParameterChar(syspar::`VehicleProxy2);
  CallInterfaceFunction(__cEmpty , "", __cEmpty );
}

void Ttvccmce9_Tet_TsCall5()
{
  stack long __tableHandle;
  CreateTTEIFFunction("Ttvccmce9_HMI_View_Switch", __eTsDef, __eLocal);
  CallInterfaceFunction(__cEmpty , __cEmpty, __cEmpty );
}

void Ttvccmce9_Tet_CaplTcCall4()
{
  stack long __tableHandle;
  CreateCaplIFFunction("Send_Proxi", __eTcDef);
  AddIFParameterTestCaseAttribute("TC_ID", "");
  AddIFParameterTestCaseAttribute("Test Case ID", "");
  AddIFParameterChar(syspar::`VehicleProxy3);
  CallInterfaceFunction(__cEmpty , "", __cEmpty );
}

void Ttvccmce9_Tet_TsCall6()
{
  stack long __tableHandle;
  CreateTTEIFFunction("Ttvccmce9_HMI_View_Switch", __eTsDef, __eLocal);
  CallInterfaceFunction(__cEmpty , __cEmpty, __cEmpty );
}

void Ttvccmce9_Tet_CaplTcCall5()
{
  stack long __tableHandle;
  CreateCaplIFFunction("Send_Proxi", __eTcDef);
  AddIFParameterTestCaseAttribute("TC_ID", "");
  AddIFParameterTestCaseAttribute("Test Case ID", "");
  AddIFParameterChar(syspar::`VehicleProxy4);
  CallInterfaceFunction(__cEmpty , "", __cEmpty );
}

void Ttvccmce9_Tet_TsCall7()
{
  stack long __tableHandle;
  CreateTTEIFFunction("Ttvccmce9_HMI_View_Switch", __eTsDef, __eLocal);
  CallInterfaceFunction(__cEmpty , __cEmpty, __cEmpty );
}

void Ttvccmce9_Tet_CaplTcCall6()
{
  stack long __tableHandle;
  CreateCaplIFFunction("Send_Proxi", __eTcDef);
  AddIFParameterTestCaseAttribute("TC_ID", "");
  AddIFParameterTestCaseAttribute("Test Case ID", "");
  AddIFParameterChar(syspar::`VehicleProxy5_Single);
  CallInterfaceFunction(__cEmpty , "", __cEmpty );
}

void Ttvccmce9_Tet_TsCall8()
{
  stack long __tableHandle;
  CreateTTEIFFunction("Ttvccmce9_HMI_View_Switch", __eTsDef, __eLocal);
  CallInterfaceFunction(__cEmpty , __cEmpty, __cEmpty );
}

void Ttvccmce9_Tet_CaplTcCall7()
{
  stack long __tableHandle;
  CreateCaplIFFunction("Send_Proxi", __eTcDef);
  AddIFParameterTestCaseAttribute("TC_ID", "");
  AddIFParameterTestCaseAttribute("Test Case ID", "");
  AddIFParameterChar(syspar::`VehicleProxy5);
  CallInterfaceFunction(__cEmpty , "", __cEmpty );
}

void Ttvccmce9_Tet_TsCall9()
{
  stack long __tableHandle;
  CreateTTEIFFunction("Ttvccmce9_HMI_View_Switch", __eTsDef, __eLocal);
  CallInterfaceFunction(__cEmpty , __cEmpty, __cEmpty );
}

void Ttvccmce9_Tet_CaplTcCall8()
{
  stack long __tableHandle;
  CreateCaplIFFunction("Send_Proxi", __eTcDef);
  AddIFParameterTestCaseAttribute("TC_ID", "");
  AddIFParameterTestCaseAttribute("Test Case ID", "");
  AddIFParameterChar(syspar::`VehicleProxy6);
  CallInterfaceFunction(__cEmpty , "", __cEmpty );
}

void Ttvccmce9_Tet_TsCall10()
{
  stack long __tableHandle;
  CreateTTEIFFunction("Ttvccmce9_HMI_View_Switch", __eTsDef, __eLocal);
  CallInterfaceFunction(__cEmpty , __cEmpty, __cEmpty );
}

void Ttvccmce9_Tet_CaplTcCall9()
{
  stack long __tableHandle;
  CreateCaplIFFunction("Send_Proxi", __eTcDef);
  AddIFParameterTestCaseAttribute("TC_ID", "");
  AddIFParameterTestCaseAttribute("Test Case ID", "");
  AddIFParameterChar(syspar::`VehicleProxy7);
  CallInterfaceFunction(__cEmpty , "", __cEmpty );
}

void Ttvccmce9_Tet_TsCall11()
{
  stack long __tableHandle;
  CreateTTEIFFunction("Ttvccmce9_HMI_View_Switch", __eTsDef, __eLocal);
  CallInterfaceFunction(__cEmpty , __cEmpty, __cEmpty );
}

void Ttvccmce9_Tet_CaplTcCall10()
{
  stack long __tableHandle;
  CreateCaplIFFunction("Send_Proxi", __eTcDef);
  AddIFParameterTestCaseAttribute("TC_ID", "");
  AddIFParameterTestCaseAttribute("Test Case ID", "");
  AddIFParameterChar(syspar::`VehicleProxy8);
  CallInterfaceFunction(__cEmpty , "", __cEmpty );
}

void Ttvccmce9_Tet_TsCall12()
{
  stack long __tableHandle;
  CreateTTEIFFunction("Ttvccmce9_HMI_View_Switch", __eTsDef, __eLocal);
  CallInterfaceFunction(__cEmpty , __cEmpty, __cEmpty );
}

void Ttvccmce9_Tet_CaplTcCall11()
{
  stack long __tableHandle;
  CreateCaplIFFunction("Send_Proxi", __eTcDef);
  AddIFParameterTestCaseAttribute("TC_ID", "");
  AddIFParameterTestCaseAttribute("Test Case ID", "");
  AddIFParameterChar(syspar::`VehicleProxy9);
  CallInterfaceFunction(__cEmpty , "", __cEmpty );
}

void Ttvccmce9_Tet_TsCall13()
{
  stack long __tableHandle;
  CreateTTEIFFunction("Ttvccmce9_HMI_View_Switch", __eTsDef, __eLocal);
  CallInterfaceFunction(__cEmpty , __cEmpty, __cEmpty );
}

void Ttvccmce9_Tet_Tc4()
{
  CreateTTEIFFunction("Ttvccmce9_Tc4", __eTcDef, __eLocal);  
  AddIFParameterTestCaseAttribute("TC_ID", "");
  AddIFParameterTestCaseAttribute("Test Case ID", "");
  CallInterfaceFunction("2.5.2.1_PowerUp_Intialization_WakeUp", __cEmpty , __cEmpty );
}
testcase Ttvccmce9_Tc4()
{
  stack long __tableHandle;
  SetBreakOnFail(0);

  TestPreparationBegin();
  {
    {
      CreateTTEIFFunction("Ttvccmce9_General_Precondition", __eFct, __eLocal);
      CallInterfaceFunction(__cEmpty, __cEmpty, "b588ddda-8fe4-4271-93b3-dd1beefd9138");
    }


  }
  TestPreparationEnd();

  TestCommandBegin(__eDiagService, __cDiagService, "", "1");
  {
    if (DiagIsFunctionalGroup("CVADAS_0001_00000000_000"))
    {
      DiagResponse * __resp;
      DiagRequest CVADAS_0001_00000000_000.TesterPresent_Tester_Prresent __req;
      __diagServicevccmce9_59(__req, __resp);
    }
    else
    {
      DiagResponse CVADAS_0001_00000000_000.* __resp;
      DiagRequest CVADAS_0001_00000000_000.TesterPresent_Tester_Prresent __req;
      __diagServicevccmce9_59(__req, __resp);
    }
  }
  TestCommandEnd();


  TestCommandBegin(__eSet, __cSet, "", "2");
  {
    __tableHandle = ReportTableHead3Columns(__cSetCaption , __cTSym, __cTOp, __cAssigned); 
    {
      $`FDCAN2::dbNode::`BCM::`BCM_FD_10::`CmdIgnSts.phys = 4;
      snprintf(__cArray, 8192, "%s", "CmdIgnSts");
      snprintf(__cArray2, 8192, "%s '%s'", __cCANSignal, __cArray);
      snprintf(__cArray3, 8192, "%s", "");
      
      ReportSetLValueOrSignalNotOnline(getSignalTime(`FDCAN2::dbNode::`BCM::`BCM_FD_10::`CmdIgnSts), __cArray2, __cArray4, 8192);
      ReportTableRow(__tableHandle, 0, __cArray4, __cAOp, 4, __cArray3, __oneOfFlag, __bSetInCheckAlignment);
      
  
    }
    {
      @sysvarInt::`IL::`Klemme15 = 1;
      snprintf(__cArray, 8192, "%s", "Klemme15");
      snprintf(__cArray2, 8192, "%s '%s'", __cSysVar, __cArray);
      snprintf(__cArray3, 8192, "%s", "");
      
      ReportTableRow(__tableHandle, 0, __cArray2, __cAOp, 1, __cArray3, __oneOfFlag, __bSetInCheckAlignment);
      
  
    }
    {
      @sysvarInt::`IL::`Klemme30 = 1;
      snprintf(__cArray, 8192, "%s", "Klemme30");
      snprintf(__cArray2, 8192, "%s '%s'", __cSysVar, __cArray);
      snprintf(__cArray3, 8192, "%s", "");
      
      ReportTableRow(__tableHandle, 0, __cArray2, __cAOp, 1, __cArray3, __oneOfFlag, __bSetInCheckAlignment);
      
  
    }
    {
      $`FDCAN2::dbNode::`BCM::`BRAKE_FD_2::`VehicleSpeedVSOSig.phys = 0;
      snprintf(__cArray, 8192, "%s", "BCM::BRAKE_FD_2::VehicleSpeedVSOSig");
      snprintf(__cArray2, 8192, "%s '%s'", __cCANSignal, __cArray);
      snprintf(__cArray3, 8192, "%s", "");
      
      ReportSetLValueOrSignalNotOnline(getSignalTime(`FDCAN2::dbNode::`BCM::`BRAKE_FD_2::`VehicleSpeedVSOSig), __cArray2, __cArray4, 8192);
      ReportTableRow(__tableHandle, 0, __cArray4, __cAOp, 0, __cArray3, __oneOfFlag, __bSetInCheckAlignment);
      
  
    }
    {
      $`FDCAN2::dbNode::`BCM::`TRANSM_FD_1::`TargetGear.phys = 14;
      snprintf(__cArray, 8192, "%s", "TargetGear");
      snprintf(__cArray2, 8192, "%s '%s'", __cCANSignal, __cArray);
      snprintf(__cArray3, 8192, "%s", "ReverseGear");
      
      ReportSetLValueOrSignalNotOnline(getSignalTime(`FDCAN2::dbNode::`BCM::`TRANSM_FD_1::`TargetGear), __cArray2, __cArray4, 8192);
      ReportTableRow(__tableHandle, 0, __cArray4, __cAOp, 14, __cArray3, __oneOfFlag, __bSetInCheckAlignment);
      
  
    }
    {
      $`FDCAN2::dbNode::`BCM::`TRANSM_FD_4::`ShiftLeverPosition.phys = 2;
      snprintf(__cArray, 8192, "%s", "ShiftLeverPosition");
      snprintf(__cArray2, 8192, "%s '%s'", __cCANSignal, __cArray);
      snprintf(__cArray3, 8192, "%s", "R");
      
      ReportSetLValueOrSignalNotOnline(getSignalTime(`FDCAN2::dbNode::`BCM::`TRANSM_FD_4::`ShiftLeverPosition), __cArray2, __cArray4, 8192);
      ReportTableRow(__tableHandle, 0, __cArray4, __cAOp, 2, __cArray3, __oneOfFlag, __bSetInCheckAlignment);
      
  
    }
    {
      $`FDCAN2::dbNode::`BCM::`IPC_FD_1::`TotalOdometer.phys = 0;
      snprintf(__cArray, 8192, "%s", "TotalOdometer");
      snprintf(__cArray2, 8192, "%s '%s'", __cCANSignal, __cArray);
      snprintf(__cArray3, 8192, "%s", "");
      
      ReportSetLValueOrSignalNotOnline(getSignalTime(`FDCAN2::dbNode::`BCM::`IPC_FD_1::`TotalOdometer), __cArray2, __cArray4, 8192);
      ReportTableRow(__tableHandle, 0, __cArray4, __cAOp, 0, __cArray3, __oneOfFlag, __bSetInCheckAlignment);
      
  
    }
    {
      $`FDCAN2::dbNode::`BCM::`IPC_VEHICLE_SETUP::`Fwrd_Cam_Guidelines.phys = 1;
      snprintf(__cArray, 8192, "%s", "Fwrd_Cam_Guidelines");
      snprintf(__cArray2, 8192, "%s '%s'", __cCANSignal, __cArray);
      snprintf(__cArray3, 8192, "%s", "");
      
      ReportSetLValueOrSignalNotOnline(getSignalTime(`FDCAN2::dbNode::`BCM::`IPC_VEHICLE_SETUP::`Fwrd_Cam_Guidelines), __cArray2, __cArray4, 8192);
      ReportTableRow(__tableHandle, 0, __cArray4, __cAOp, 1, __cArray3, __oneOfFlag, __bSetInCheckAlignment);
      
  
    }
    {
      $`FDCAN2::dbNode::`BCM::`IPC_VEHICLE_SETUP::`SVC_Guidelines.phys = 1;
      snprintf(__cArray, 8192, "%s", "SVC_Guidelines");
      snprintf(__cArray2, 8192, "%s '%s'", __cCANSignal, __cArray);
      snprintf(__cArray3, 8192, "%s", "");
      
      ReportSetLValueOrSignalNotOnline(getSignalTime(`FDCAN2::dbNode::`BCM::`IPC_VEHICLE_SETUP::`SVC_Guidelines), __cArray2, __cArray4, 8192);
      ReportTableRow(__tableHandle, 0, __cArray4, __cAOp, 1, __cArray3, __oneOfFlag, __bSetInCheckAlignment);
      
  
    }
    {
      $`FDCAN14::dbNode::`ECM::`ENGINE_FD_2::`EngineSpeed_W.phys = 400;
      snprintf(__cArray, 8192, "%s", "ECM::ENGINE_FD_2::EngineSpeed_W");
      snprintf(__cArray2, 8192, "%s '%s'", __cCANSignal, __cArray);
      snprintf(__cArray3, 8192, "%s", "");
      
      ReportSetLValueOrSignalNotOnline(getSignalTime(`FDCAN14::dbNode::`ECM::`ENGINE_FD_2::`EngineSpeed_W), __cArray2, __cArray4, 8192);
      ReportTableRow(__tableHandle, 0, __cArray4, __cAOp, 400, __cArray3, __oneOfFlag, __bSetInCheckAlignment);
      
  
    }
    {
      $`FDCAN14::dbNode::`BSM::`BRAKE_FD_2::`BrakeBoostStat.phys = 1;
      snprintf(__cArray, 8192, "%s", "BrakeBoostStat");
      snprintf(__cArray2, 8192, "%s '%s'", __cCANSignal, __cArray);
      snprintf(__cArray3, 8192, "%s", "");
      
      ReportSetLValueOrSignalNotOnline(getSignalTime(`FDCAN14::dbNode::`BSM::`BRAKE_FD_2::`BrakeBoostStat), __cArray2, __cArray4, 8192);
      ReportTableRow(__tableHandle, 0, __cArray4, __cAOp, 1, __cArray3, __oneOfFlag, __bSetInCheckAlignment);
      
  
    }
    {
      $`FDCAN2::dbNode::`SGW::`TELEMATIC_FD_5::`CameraDisplaySts2.phys = 2;
      snprintf(__cArray, 8192, "%s", "CameraDisplaySts2");
      snprintf(__cArray2, 8192, "%s '%s'", __cCANSignal, __cArray);
      snprintf(__cArray3, 8192, "%s", "View_2");
      
      ReportSetLValueOrSignalNotOnline(getSignalTime(`FDCAN2::dbNode::`SGW::`TELEMATIC_FD_5::`CameraDisplaySts2), __cArray2, __cArray4, 8192);
      ReportTableRow(__tableHandle, 0, __cArray4, __cAOp, 2, __cArray3, __oneOfFlag, __bSetInCheckAlignment);
      
  
    }
    {
      $`FDCAN2::dbNode::`BCM::`TRANSM_FD_4::`ShiftLeverPosition.phys = 2;
      snprintf(__cArray, 8192, "%s", "ShiftLeverPosition");
      snprintf(__cArray2, 8192, "%s '%s'", __cCANSignal, __cArray);
      snprintf(__cArray3, 8192, "%s", "R");
      
      ReportSetLValueOrSignalNotOnline(getSignalTime(`FDCAN2::dbNode::`BCM::`TRANSM_FD_4::`ShiftLeverPosition), __cArray2, __cArray4, 8192);
      ReportTableRow(__tableHandle, 0, __cArray4, __cAOp, 2, __cArray3, __oneOfFlag, __bSetInCheckAlignment);
      
  
    }
    {
      $`FDCAN2::dbNode::`SGW::`TELEMATIC_FD_14::`TGW_CAMERA_DISP_STAT.phys = 4;
      snprintf(__cArray, 8192, "%s", "TGW_CAMERA_DISP_STAT");
      snprintf(__cArray2, 8192, "%s '%s'", __cCANSignal, __cArray);
      snprintf(__cArray3, 8192, "%s", "");
      
      ReportSetLValueOrSignalNotOnline(getSignalTime(`FDCAN2::dbNode::`SGW::`TELEMATIC_FD_14::`TGW_CAMERA_DISP_STAT), __cArray2, __cArray4, 8192);
      ReportTableRow(__tableHandle, 0, __cArray4, __cAOp, 4, __cArray3, __oneOfFlag, __bSetInCheckAlignment);
      
  
    }
    ReportTableEndTestStep(__tableHandle, "1");
  }
  TestCommandEnd();


  TestCommandBegin(__eWait, __cWait, "", "3");
  {
    Wait("1", (500 * 1000000LL), 1000000, "");
  }
  TestCommandEnd();

}

  
void __diagServicevccmce9_59(DiagRequest * __req, DiagResponse * __resp )
{
  stack long __tableHandle;
  long __res, __paramLen, __bytePos;

   __bVerdict = __eVerdictPass;

  do {
    TestReportResetDiagObjectList();
    DiagSetReportDetailLevel("CVADAS_0001_00000000_000", EnumServiceDetails_onfail);
    // Request aspect
    {

      if (0 >= DiagSendReqAndWaitForResp("CVADAS_0001_00000000_000", __req, __resp, __res, -1, -1, -1, -1, -1, EnumResult_pos, EnumServiceDetails_onfail, EnumSendingMode_physical, EnumSuppressPosResBit_asconfigured, EnumVerdictOnInvalidValues_fail))
        break;
    }

    __res = DiagErrCodeTestStep(__res, "Can't retrieve last response for request! No check possible.") < 0;
    if(__res)
    {
	  __bVerdict = __eVerdictFail;
      break;
    }
    {
      __res = DiagInterpretAs(__resp, "TP_PR");
      if(__res != 0)
      {
        __bVerdict = __eVerdictFail;
        DiagErrCodeTestStep(__res, "Can't interpret response as diagnostic primitive 'TP_PR'.");
        break;
      }
      else
      {
        TestStepPass( "Received primitive can be interpreted as diagnostic primitive 'TP_PR'.");
      }
    }
  }
  while(0);


  if (__bVerdict == __eVerdictFail)
    TestReportWriteDiagObjectList();
}

void Ttvccmce9_Tet_Tc5()
{
  CreateTTEIFFunction("Ttvccmce9_Tc5", __eTcDef, __eLocal);  
  AddIFParameterTestCaseAttribute("TC_ID", "");
  AddIFParameterTestCaseAttribute("Test Case ID", "");
  CallInterfaceFunction("2.5.2.2_CAN_Initialization", __cEmpty , __cEmpty );
}
testcase Ttvccmce9_Tc5()
{
  stack long __tableHandle;
  SetBreakOnFail(0);

  TestCommandBegin(__eSet, __cSet, "", "0");
  {
    __tableHandle = ReportTableHead3Columns(__cSetCaption , __cTSym, __cTOp, __cAssigned); 
    {
      $`FDCAN2::dbNode::`BCM::`BCM_FD_10::`CmdIgnSts.phys = 4;
      snprintf(__cArray, 8192, "%s", "CmdIgnSts");
      snprintf(__cArray2, 8192, "%s '%s'", __cCANSignal, __cArray);
      snprintf(__cArray3, 8192, "%s", "");
      
      ReportSetLValueOrSignalNotOnline(getSignalTime(`FDCAN2::dbNode::`BCM::`BCM_FD_10::`CmdIgnSts), __cArray2, __cArray4, 8192);
      ReportTableRow(__tableHandle, 0, __cArray4, __cAOp, 4, __cArray3, __oneOfFlag, __bSetInCheckAlignment);
      
  
    }
    ReportTableEndTestStep(__tableHandle, "1");
  }
  TestCommandEnd();


  TestCommandBegin(__eSet, __cSet, "", "2");
  {
    __tableHandle = ReportTableHead3Columns(__cSetCaption , __cTSym, __cTOp, __cAssigned); 
    {
      $`FDCAN2::dbNode::`BCM::`BRAKE_FD_2::`VehicleSpeedVSOSig.phys = 0;
      snprintf(__cArray, 8192, "%s", "BCM::BRAKE_FD_2::VehicleSpeedVSOSig");
      snprintf(__cArray2, 8192, "%s '%s'", __cCANSignal, __cArray);
      snprintf(__cArray3, 8192, "%s", "");
      
      ReportSetLValueOrSignalNotOnline(getSignalTime(`FDCAN2::dbNode::`BCM::`BRAKE_FD_2::`VehicleSpeedVSOSig), __cArray2, __cArray4, 8192);
      ReportTableRow(__tableHandle, 0, __cArray4, __cAOp, 0, __cArray3, __oneOfFlag, __bSetInCheckAlignment);
      
  
    }
    ReportTableEndTestStep(__tableHandle, "1");
  }
  TestCommandEnd();


  TestCommandBegin(__eSet, __cSet, "", "3");
  {
    __tableHandle = ReportTableHead3Columns(__cSetCaption , __cTSym, __cTOp, __cAssigned); 
    {
      $`FDCAN2::dbNode::`BCM::`TRANSM_FD_1::`TargetGear.phys = 14;
      snprintf(__cArray, 8192, "%s", "TargetGear");
      snprintf(__cArray2, 8192, "%s '%s'", __cCANSignal, __cArray);
      snprintf(__cArray3, 8192, "%s", "ReverseGear");
      
      ReportSetLValueOrSignalNotOnline(getSignalTime(`FDCAN2::dbNode::`BCM::`TRANSM_FD_1::`TargetGear), __cArray2, __cArray4, 8192);
      ReportTableRow(__tableHandle, 0, __cArray4, __cAOp, 14, __cArray3, __oneOfFlag, __bSetInCheckAlignment);
      
  
    }
    ReportTableEndTestStep(__tableHandle, "1");
  }
  TestCommandEnd();


  TestCommandBegin(__eWait, __cWait, "", "5");
  {
    Wait("1", (250 * 1000000LL), 1000000, "");
  }
  TestCommandEnd();

  TestCommandBegin(__eCheck, __cCheck, "", "6");
  {
    __bVerdict = __eVerdictPass;
    __tableHandle = ReportTableHead5Columns(__cCheckCaption, __cTSym, __cTOp, __cRefVal, __cActual, __cRes);
    {
      __csr = CheckSignalMatch(`FDCAN2::dbNode::`BCM::`IPC_VEHICLE_SETUP::`LanguageSelection, 2, ">=") == 1;
      snprintf(__cArray, 8192, "%s", "LanguageSelection");
      snprintf(__cArray2, 8192, "%s '%s'", __cCANSignal, __cArray);
      snprintf(__cArray3, 8192, "%s", "");
      ReportTableRow(__tableHandle, 0, __cArray2, ">=", 2, __cArray3, __oneOfFlag, __bSetInCheckAlignment);
      ReportLValueOrSignalNotOnline(`FDCAN2::dbNode::`BCM::`IPC_VEHICLE_SETUP::`LanguageSelection, __cArray5, 8192);
      ReportCell(__tableHandle, __cArray5);
      ReportCellResult(__tableHandle, __csr, __ePassFail);
  
      __bVerdict = __bVerdict && __csr;
    }
    {
      __csr = CheckSignalMatch(`FDCAN2::dbNode::`BCM::`IPC_VEHICLE_SETUP::`PamChimeVolumeFront, 1, ">=") == 1;
      snprintf(__cArray, 8192, "%s", "PamChimeVolumeFront");
      snprintf(__cArray2, 8192, "%s '%s'", __cCANSignal, __cArray);
      snprintf(__cArray3, 8192, "%s", "");
      ReportTableRow(__tableHandle, 0, __cArray2, ">=", 1, __cArray3, __oneOfFlag, __bSetInCheckAlignment);
      ReportLValueOrSignalNotOnline(`FDCAN2::dbNode::`BCM::`IPC_VEHICLE_SETUP::`PamChimeVolumeFront, __cArray5, 8192);
      ReportCell(__tableHandle, __cArray5);
      ReportCellResult(__tableHandle, __csr, __ePassFail);
  
      __bVerdict = __bVerdict && __csr;
    }
    {
      __csr = CheckSignalMatch(`FDCAN2::dbNode::`BCM::`IPC_VEHICLE_SETUP::`PamChimeVolumeRear, 1, ">=") == 1;
      snprintf(__cArray, 8192, "%s", "PamChimeVolumeRear");
      snprintf(__cArray2, 8192, "%s '%s'", __cCANSignal, __cArray);
      snprintf(__cArray3, 8192, "%s", "");
      ReportTableRow(__tableHandle, 0, __cArray2, ">=", 1, __cArray3, __oneOfFlag, __bSetInCheckAlignment);
      ReportLValueOrSignalNotOnline(`FDCAN2::dbNode::`BCM::`IPC_VEHICLE_SETUP::`PamChimeVolumeRear, __cArray5, 8192);
      ReportCell(__tableHandle, __cArray5);
      ReportCellResult(__tableHandle, __csr, __ePassFail);
  
      __bVerdict = __bVerdict && __csr;
    }
    {
      __csr = CheckSignalMatch(`FDCAN2::dbNode::`CVADAS::`CVPAM_FD_Info::`DisplayView2, 1, ">=") == 1;
      snprintf(__cArray, 8192, "%s", "DisplayView2");
      snprintf(__cArray2, 8192, "%s '%s'", __cCANSignal, __cArray);
      snprintf(__cArray3, 8192, "%s", "");
      ReportTableRow(__tableHandle, 0, __cArray2, ">=", 1, __cArray3, __oneOfFlag, __bSetInCheckAlignment);
      ReportLValueOrSignalNotOnline(`FDCAN2::dbNode::`CVADAS::`CVPAM_FD_Info::`DisplayView2, __cArray5, 8192);
      ReportCell(__tableHandle, __cArray5);
      ReportCellResult(__tableHandle, __csr, __ePassFail);
  
      __bVerdict = __bVerdict && __csr;
    }
    ReportTableEndVerdict(__tableHandle, "1", __bVerdict);
  }
  TestCommandEnd();


}

void Ttvccmce9_Tet_Tc6()
{
  CreateTTEIFFunction("Ttvccmce9_Tc6", __eTcDef, __eLocal);  
  AddIFParameterTestCaseAttribute("TC_ID", "");
  AddIFParameterTestCaseAttribute("Test Case ID", "");
  CallInterfaceFunction("2.5.2.3_Current_Consumption", __cEmpty , __cEmpty );
}
testcase Ttvccmce9_Tc6()
{
  stack long __tableHandle;
  SetBreakOnFail(0);

  TestCommandBegin(__eWait, __cWait, "", "0");
  {
    Wait("1", (500 * 1000000LL), 1000000, "");
  }
  TestCommandEnd();

  TestCommandBegin(__eDiagService, __cDiagService, "", "1");
  {
    if (DiagIsFunctionalGroup("CVADAS_0001_00000000_000"))
    {
      DiagResponse * __resp;
      DiagRequest CVADAS_0001_00000000_000._22FD4A_Ultrasonic_Sensors_Power_supply_and_Current_Level_Read __req;
      __diagServicevccmce9_60(__req, __resp);
    }
    else
    {
      DiagResponse CVADAS_0001_00000000_000.* __resp;
      DiagRequest CVADAS_0001_00000000_000._22FD4A_Ultrasonic_Sensors_Power_supply_and_Current_Level_Read __req;
      __diagServicevccmce9_60(__req, __resp);
    }
  }
  TestCommandEnd();


  TestCommandBegin(__eWait, __cWait, "", "2");
  {
    Wait("1", (500 * 1000000LL), 1000000, "");
  }
  TestCommandEnd();

}

  
void __diagServicevccmce9_60(DiagRequest * __req, DiagResponse * __resp )
{
  stack long __tableHandle;
  long __res, __paramLen, __bytePos;

   __bVerdict = __eVerdictPass;

  do {
    TestReportResetDiagObjectList();
    DiagSetReportDetailLevel("CVADAS_0001_00000000_000", EnumServiceDetails_onfail);
    // Request aspect
    {

      if (0 >= DiagSendReqAndWaitForResp("CVADAS_0001_00000000_000", __req, __resp, __res, -1, -1, -1, -1, -1, EnumResult_pos, EnumServiceDetails_onfail, EnumSendingMode_physical, EnumSuppressPosResBit_asconfigured, EnumVerdictOnInvalidValues_fail))
        break;
    }

    __res = DiagErrCodeTestStep(__res, "Can't retrieve last response for request! No check possible.") < 0;
    if(__res)
    {
	  __bVerdict = __eVerdictFail;
      break;
    }
    {
      __res = DiagInterpretAs(__resp, "RDBI_PR");
      if(__res != 0)
      {
        __bVerdict = __eVerdictFail;
        DiagErrCodeTestStep(__res, "Can't interpret response as diagnostic primitive 'RDBI_PR'.");
        break;
      }
      else
      {
        TestStepPass( "Received primitive can be interpreted as diagnostic primitive 'RDBI_PR'.");
      }
    }
  }
  while(0);


  // Response, check & read aspect
  {
    __res = 1;
    __tableHandle = ReportTableHead5Columns(__cCheckCaption, __cTSym, __cTOp, __cRefVal, __cActual, __cRes);
    {
      double __nDiagValue;
      DiagGetParameterErrorHandled(__resp, "USS_Power_Supply_for_Stack_A", __nDiagValue);
      __csr = CheckSignalMatch(__nDiagValue, 10, ">") == 1;
      snprintf(__cArray, 8192, "%s", "Diagnostic parameter \'USS_Power_Supply_for_Stack_A\'");
      snprintf(__cArray2, 8192, "%s", __cArray);
      snprintf(__cArray3, 8192, "%s", "");
      ReportTableRow(__tableHandle, 0, __cArray2, ">", 10, __cArray3, __oneOfFlag, __bSetInCheckAlignment);
      ReportCell(__tableHandle, __nDiagValue);
      ReportCellResult(__tableHandle, __csr, __ePassFail);
    
      __res = __res && __csr;
    
    }
    {
      double __nDiagValue;
      DiagGetParameterErrorHandled(__resp, "USS_Power_Supply_for_Stack_B", __nDiagValue);
      __csr = CheckSignalMatch(__nDiagValue, 10, ">") == 1;
      snprintf(__cArray, 8192, "%s", "Diagnostic parameter \'USS_Power_Supply_for_Stack_B\'");
      snprintf(__cArray2, 8192, "%s", __cArray);
      snprintf(__cArray3, 8192, "%s", "");
      ReportTableRow(__tableHandle, 0, __cArray2, ">", 10, __cArray3, __oneOfFlag, __bSetInCheckAlignment);
      ReportCell(__tableHandle, __nDiagValue);
      ReportCellResult(__tableHandle, __csr, __ePassFail);
    
      __res = __res && __csr;
    
    }
    {
      double __nDiagValue;
      DiagGetParameterErrorHandled(__resp, "USS_current_Front", __nDiagValue);
      __csr = CheckSignalMatch(__nDiagValue, 10, ">") == 1;
      snprintf(__cArray, 8192, "%s", "Diagnostic parameter \'USS_current_Front\'");
      snprintf(__cArray2, 8192, "%s", __cArray);
      snprintf(__cArray3, 8192, "%s", "");
      ReportTableRow(__tableHandle, 0, __cArray2, ">", 10, __cArray3, __oneOfFlag, __bSetInCheckAlignment);
      ReportCell(__tableHandle, __nDiagValue);
      ReportCellResult(__tableHandle, __csr, __ePassFail);
    
      __res = __res && __csr;
    
    }
    {
      double __nDiagValue;
      DiagGetParameterErrorHandled(__resp, "USS_current_Rear", __nDiagValue);
      __csr = CheckSignalMatch(__nDiagValue, 10, ">") == 1;
      snprintf(__cArray, 8192, "%s", "Diagnostic parameter \'USS_current_Rear\'");
      snprintf(__cArray2, 8192, "%s", __cArray);
      snprintf(__cArray3, 8192, "%s", "");
      ReportTableRow(__tableHandle, 0, __cArray2, ">", 10, __cArray3, __oneOfFlag, __bSetInCheckAlignment);
      ReportCell(__tableHandle, __nDiagValue);
      ReportCellResult(__tableHandle, __csr, __ePassFail);
    
      __res = __res && __csr;
    
    }
    ReportTableEndVerdict(__tableHandle, __cEvaluateResponse, __res);
	__bVerdict = __bVerdict && __res;
  }
  if (__bVerdict == __eVerdictFail)
    TestReportWriteDiagObjectList();
}

void Ttvccmce9_Tet_Tc7()
{
  CreateTTEIFFunction("Ttvccmce9_Tc7", __eTcDef, __eLocal);  
  AddIFParameterTestCaseAttribute("TC_ID", "");
  AddIFParameterTestCaseAttribute("Test Case ID", "");
  CallInterfaceFunction("2.5.2.4_Normal_Operation", __cEmpty , __cEmpty );
}
testcase Ttvccmce9_Tc7()
{
  stack long __tableHandle;
int64 __ifExec0;
int64 __ifExec1;

  SetBreakOnFail(0);

  TestCommandBegin(__eWait, __cWait, "", "0");
  {
    Wait("1", (500 * 1000000LL), 1000000, "");
  }
  TestCommandEnd();

  TestCommandBegin(__eSet, __cSet, "", "1");
  {
    __tableHandle = ReportTableHead3Columns(__cSetCaption , __cTSym, __cTOp, __cAssigned); 
    {
      $`FDCAN2::dbNode::`BCM::`BRAKE_FD_2::`VehicleSpeedVSOSig.phys = 5;
      snprintf(__cArray, 8192, "%s", "BCM::BRAKE_FD_2::VehicleSpeedVSOSig");
      snprintf(__cArray2, 8192, "%s '%s'", __cCANSignal, __cArray);
      snprintf(__cArray3, 8192, "%s", "");
      
      ReportSetLValueOrSignalNotOnline(getSignalTime(`FDCAN2::dbNode::`BCM::`BRAKE_FD_2::`VehicleSpeedVSOSig), __cArray2, __cArray4, 8192);
      ReportTableRow(__tableHandle, 0, __cArray4, __cAOp, 5, __cArray3, __oneOfFlag, __bSetInCheckAlignment);
      
  
    }
    ReportTableEndTestStep(__tableHandle, "1");
  }
  TestCommandEnd();


  
  TestControlStructBegin(__cIf, "", "2");
  {
    int64 __condition;
    {
      int64 __expr0;
      __ifExec0 = 0;
  
      {
        {
          int __res1,__res2;
          __res1 = CheckSignalMatch(`FDCAN2::dbNode::`CVADAS::`CVPAM_FD_Info::`PAM_Off_Status_2BT, 0, __cGreaterEqualThan) == 1;
          __res2 = CheckSignalMatch(`FDCAN2::dbNode::`CVADAS::`CVPAM_FD_Info::`PAM_Off_Status_2BT, 2, __cLessEqualThan) == 1;
          __csr = __res1 && __res2;
        }
      }
      {
        __expr0 = __csr;
      }
      __condition = __expr0;
  
        snprintf(__cConditionArray, 8192, "%s", "");
        snprintf(__cCompareArray, 8192, "%s", "");
        snprintf(__cArray, 8192, "[%s..%s]", "0", "2");
        snprintf(__cCompareArray, 8192, "%s within %s", "PAM_Off_Status_2BT", __cArray);
        snprintf(__cArray, 8192, "%s", __cCompareArray);
        snprintf(__cCompareArray, 8192, "( %s )", __cArray);
        snprintf(__cArray, 8192, "%s", __cConditionArray);
        snprintf(__cConditionArray, 8192, "%s%s", __cArray, __cCompareArray);
        snprintf(__cArray, 8192, "%s", __cConditionArray);
        snprintf(__cConditionArray, 8192, "%s %s", "If", __cArray);
  
      __tableHandle = ReportConditionTableHead(__cConditionArray, __condition);
      {
        {
          int __res1,__res2;
          __res1 = CheckSignalMatch(`FDCAN2::dbNode::`CVADAS::`CVPAM_FD_Info::`PAM_Off_Status_2BT, 0, __cGreaterEqualThan) == 1;
          __res2 = CheckSignalMatch(`FDCAN2::dbNode::`CVADAS::`CVPAM_FD_Info::`PAM_Off_Status_2BT, 2, __cLessEqualThan) == 1;
          __csr = __res1 && __res2;
          snprintf(__cArray, 8192, "%s", "PAM_Off_Status_2BT");
          snprintf(__cArray2, 8192, "%s '%s'", __cCANSignal, __cArray);
          snprintf(__cArray3, 8192, "%s", "");
          snprintf(__cArray4, 8192, "%s", "");
          snprintf(__cArray5, 8192, "%s", __cArray3);
          snprintf(__cArray6, 8192, "%s", __cArray4);
          ReportRange(0, 2, __cArray5, __cArray6, __cArray7, 8192);
          ReportTableRow(__tableHandle, 0, __cArray2, __cRange, __cArray7, __cEmpty, __oneOfFlag, __bSetInCheckAlignment);
          ReportLValueOrSignalNotOnline(`FDCAN2::dbNode::`CVADAS::`CVPAM_FD_Info::`PAM_Off_Status_2BT, __cArray8, 8192);
          ReportCell(__tableHandle, __cArray8);
          ReportCellResult(__tableHandle, __csr, __eTrueFalse);
        } 
      }
      ReportTableEndCondition(__tableHandle, __cIfCondition);
    }
  
    if(__condition)
    {  
      __ifExec0 = 1;

      
      TestCommandBegin(__eAwaitSignalsAvailable, __cAwaitSignalsAvailable, "", "3");
      {
        long __eventTable[1];
        int64 __time;
        __time = 5000 * 1000000LL;
        if(__time < 0)
        {
          testStepErrorInTestSystem(0, "1", "Unable to wait for %.3f %s. Please check input parameter.", __time / ((float)1000000), "ms");
        }
        else
        {
          __eventTable[0] = testJoinSignalAvailable(`FDCAN2::dbNode::`CVADAS::`CVPAM_FD_Info::`PAM_Off_Status_2BT);
          __bVerdict = testWaitForAllJoinedEventsNS(__time) > 0;
          __tableHandle = ReportTableHead3Columns("Waited for availability of 1 signal.", "Signal/Node", "State", __cRes);
          snprintf(__cArray, 8192, "%s", "PAM_Off_Status_2BT");
          snprintf(__cArray2, 8192, "%s '%s'", __cCANSignal, __cArray);
          __ReportAwaitSignalsAvailableRow(__tableHandle, 0, __eventTable[0], __cArray2);
          ReportTableEndVerdict(__tableHandle, "1", __bVerdict);
        }
      }
      TestCommandEnd();


      TestCommandBegin(__eSet, __cSet, "", "4");
      {
        __tableHandle = ReportTableHead3Columns(__cSetCaption , __cTSym, __cTOp, __cAssigned); 
        {
          @sysvarInt::`User_Node::`ENABLE_AutoPark = 1;
          snprintf(__cArray, 8192, "%s", "ENABLE_AutoPark");
          snprintf(__cArray2, 8192, "%s '%s'", __cSysVar, __cArray);
          snprintf(__cArray3, 8192, "%s", "");
          
          ReportTableRow(__tableHandle, 0, __cArray2, __cAOp, 1, __cArray3, __oneOfFlag, __bSetInCheckAlignment);
          
      
        }
        {
          @sysvarInt::`User_Node::`ENABLE_AutoPark = 0;
          snprintf(__cArray, 8192, "%s", "ENABLE_AutoPark");
          snprintf(__cArray2, 8192, "%s '%s'", __cSysVar, __cArray);
          snprintf(__cArray3, 8192, "%s", "");
          
          ReportTableRow(__tableHandle, 0, __cArray2, __cAOp, 0, __cArray3, __oneOfFlag, __bSetInCheckAlignment);
          
      
        }
        {
          $`FDCAN2::dbNode::`BCM::`BCM_FD_12::`FT_PAMRequestSts.phys = 1;
          snprintf(__cArray, 8192, "%s", "FT_PAMRequestSts");
          snprintf(__cArray2, 8192, "%s '%s'", __cCANSignal, __cArray);
          snprintf(__cArray3, 8192, "%s", "");
          
          ReportSetLValueOrSignalNotOnline(getSignalTime(`FDCAN2::dbNode::`BCM::`BCM_FD_12::`FT_PAMRequestSts), __cArray2, __cArray4, 8192);
          ReportTableRow(__tableHandle, 0, __cArray4, __cAOp, 1, __cArray3, __oneOfFlag, __bSetInCheckAlignment);
          
      
        }
        {
          $`FDCAN2::dbNode::`BCM::`BCM_FD_12::`PAMRequestSts.phys = 1;
          snprintf(__cArray, 8192, "%s", "PAMRequestSts");
          snprintf(__cArray2, 8192, "%s '%s'", __cCANSignal, __cArray);
          snprintf(__cArray3, 8192, "%s", "");
          
          ReportSetLValueOrSignalNotOnline(getSignalTime(`FDCAN2::dbNode::`BCM::`BCM_FD_12::`PAMRequestSts), __cArray2, __cArray4, 8192);
          ReportTableRow(__tableHandle, 0, __cArray4, __cAOp, 1, __cArray3, __oneOfFlag, __bSetInCheckAlignment);
          
      
        }
        ReportTableEndTestStep(__tableHandle, "1");
      }
      TestCommandEnd();


      TestCommandBegin(__eWait, __cWait, "", "5");
      {
        Wait("1", (1000 * 1000000LL), 1000000, "");
      }
      TestCommandEnd();

      TestCommandBegin(__eSet, __cSet, "", "6");
      {
        __tableHandle = ReportTableHead3Columns(__cSetCaption , __cTSym, __cTOp, __cAssigned); 
        {
          $`FDCAN2::dbNode::`BCM::`BCM_FD_12::`PAMRequestSts.phys = 0;
          snprintf(__cArray, 8192, "%s", "PAMRequestSts");
          snprintf(__cArray2, 8192, "%s '%s'", __cCANSignal, __cArray);
          snprintf(__cArray3, 8192, "%s", "");
          
          ReportSetLValueOrSignalNotOnline(getSignalTime(`FDCAN2::dbNode::`BCM::`BCM_FD_12::`PAMRequestSts), __cArray2, __cArray4, 8192);
          ReportTableRow(__tableHandle, 0, __cArray4, __cAOp, 0, __cArray3, __oneOfFlag, __bSetInCheckAlignment);
          
      
        }
        {
          $`FDCAN2::dbNode::`BCM::`BCM_FD_12::`FT_PAMRequestSts.phys = 0;
          snprintf(__cArray, 8192, "%s", "FT_PAMRequestSts");
          snprintf(__cArray2, 8192, "%s '%s'", __cCANSignal, __cArray);
          snprintf(__cArray3, 8192, "%s", "");
          
          ReportSetLValueOrSignalNotOnline(getSignalTime(`FDCAN2::dbNode::`BCM::`BCM_FD_12::`FT_PAMRequestSts), __cArray2, __cArray4, 8192);
          ReportTableRow(__tableHandle, 0, __cArray4, __cAOp, 0, __cArray3, __oneOfFlag, __bSetInCheckAlignment);
          
      
        }
        ReportTableEndTestStep(__tableHandle, "1");
      }
      TestCommandEnd();


    }
  }
  TestControlStructEnd(__eUndefined);

  
  TestControlStructBegin(__cIf, "", "7");
  {
    int64 __condition;
    {
      int64 __expr0;
      __ifExec1 = 0;
  
      {
        {
          int __res1,__res2;
          __res1 = CheckSignalMatch(`FDCAN2::dbNode::`CVADAS::`CVPAM_FD_Info::`PAM_Off_Status_2BT, 0, __cGreaterEqualThan) == 1;
          __res2 = CheckSignalMatch(`FDCAN2::dbNode::`CVADAS::`CVPAM_FD_Info::`PAM_Off_Status_2BT, 2, __cLessEqualThan) == 1;
          __csr = __res1 && __res2;
        }
      }
      {
        __expr0 = __csr;
      }
      __condition = __expr0;
  
        snprintf(__cConditionArray, 8192, "%s", "");
        snprintf(__cCompareArray, 8192, "%s", "");
        snprintf(__cArray, 8192, "[%s..%s]", "0", "2");
        snprintf(__cCompareArray, 8192, "%s within %s", "PAM_Off_Status_2BT", __cArray);
        snprintf(__cArray, 8192, "%s", __cCompareArray);
        snprintf(__cCompareArray, 8192, "( %s )", __cArray);
        snprintf(__cArray, 8192, "%s", __cConditionArray);
        snprintf(__cConditionArray, 8192, "%s%s", __cArray, __cCompareArray);
        snprintf(__cArray, 8192, "%s", __cConditionArray);
        snprintf(__cConditionArray, 8192, "%s %s", "If", __cArray);
  
      __tableHandle = ReportConditionTableHead(__cConditionArray, __condition);
      {
        {
          int __res1,__res2;
          __res1 = CheckSignalMatch(`FDCAN2::dbNode::`CVADAS::`CVPAM_FD_Info::`PAM_Off_Status_2BT, 0, __cGreaterEqualThan) == 1;
          __res2 = CheckSignalMatch(`FDCAN2::dbNode::`CVADAS::`CVPAM_FD_Info::`PAM_Off_Status_2BT, 2, __cLessEqualThan) == 1;
          __csr = __res1 && __res2;
          snprintf(__cArray, 8192, "%s", "PAM_Off_Status_2BT");
          snprintf(__cArray2, 8192, "%s '%s'", __cCANSignal, __cArray);
          snprintf(__cArray3, 8192, "%s", "");
          snprintf(__cArray4, 8192, "%s", "");
          snprintf(__cArray5, 8192, "%s", __cArray3);
          snprintf(__cArray6, 8192, "%s", __cArray4);
          ReportRange(0, 2, __cArray5, __cArray6, __cArray7, 8192);
          ReportTableRow(__tableHandle, 0, __cArray2, __cRange, __cArray7, __cEmpty, __oneOfFlag, __bSetInCheckAlignment);
          ReportLValueOrSignalNotOnline(`FDCAN2::dbNode::`CVADAS::`CVPAM_FD_Info::`PAM_Off_Status_2BT, __cArray8, 8192);
          ReportCell(__tableHandle, __cArray8);
          ReportCellResult(__tableHandle, __csr, __eTrueFalse);
        } 
      }
      ReportTableEndCondition(__tableHandle, __cIfCondition);
    }
  
    if(__condition)
    {  
      __ifExec1 = 1;

      
      TestCommandBegin(__eAwaitSignalsAvailable, __cAwaitSignalsAvailable, "", "8");
      {
        long __eventTable[1];
        int64 __time;
        __time = 5000 * 1000000LL;
        if(__time < 0)
        {
          testStepErrorInTestSystem(0, "1", "Unable to wait for %.3f %s. Please check input parameter.", __time / ((float)1000000), "ms");
        }
        else
        {
          __eventTable[0] = testJoinSignalAvailable(`FDCAN2::dbNode::`CVADAS::`CVPAM_FD_Info::`PAM_Off_Status_2BT);
          __bVerdict = testWaitForAllJoinedEventsNS(__time) > 0;
          __tableHandle = ReportTableHead3Columns("Waited for availability of 1 signal.", "Signal/Node", "State", __cRes);
          snprintf(__cArray, 8192, "%s", "PAM_Off_Status_2BT");
          snprintf(__cArray2, 8192, "%s '%s'", __cCANSignal, __cArray);
          __ReportAwaitSignalsAvailableRow(__tableHandle, 0, __eventTable[0], __cArray2);
          ReportTableEndVerdict(__tableHandle, "1", __bVerdict);
        }
      }
      TestCommandEnd();


      TestCommandBegin(__eSet, __cSet, "", "9");
      {
        __tableHandle = ReportTableHead3Columns(__cSetCaption , __cTSym, __cTOp, __cAssigned); 
        {
          @sysvarInt::`User_Node::`ENABLE_AutoPark = 1;
          snprintf(__cArray, 8192, "%s", "ENABLE_AutoPark");
          snprintf(__cArray2, 8192, "%s '%s'", __cSysVar, __cArray);
          snprintf(__cArray3, 8192, "%s", "");
          
          ReportTableRow(__tableHandle, 0, __cArray2, __cAOp, 1, __cArray3, __oneOfFlag, __bSetInCheckAlignment);
          
      
        }
        {
          @sysvarInt::`User_Node::`ENABLE_AutoPark = 0;
          snprintf(__cArray, 8192, "%s", "ENABLE_AutoPark");
          snprintf(__cArray2, 8192, "%s '%s'", __cSysVar, __cArray);
          snprintf(__cArray3, 8192, "%s", "");
          
          ReportTableRow(__tableHandle, 0, __cArray2, __cAOp, 0, __cArray3, __oneOfFlag, __bSetInCheckAlignment);
          
      
        }
        {
          $`FDCAN2::dbNode::`BCM::`BCM_FD_12::`FT_PAMRequestSts.phys = 1;
          snprintf(__cArray, 8192, "%s", "FT_PAMRequestSts");
          snprintf(__cArray2, 8192, "%s '%s'", __cCANSignal, __cArray);
          snprintf(__cArray3, 8192, "%s", "");
          
          ReportSetLValueOrSignalNotOnline(getSignalTime(`FDCAN2::dbNode::`BCM::`BCM_FD_12::`FT_PAMRequestSts), __cArray2, __cArray4, 8192);
          ReportTableRow(__tableHandle, 0, __cArray4, __cAOp, 1, __cArray3, __oneOfFlag, __bSetInCheckAlignment);
          
      
        }
        {
          $`FDCAN2::dbNode::`BCM::`BCM_FD_12::`PAMRequestSts.phys = 1;
          snprintf(__cArray, 8192, "%s", "PAMRequestSts");
          snprintf(__cArray2, 8192, "%s '%s'", __cCANSignal, __cArray);
          snprintf(__cArray3, 8192, "%s", "");
          
          ReportSetLValueOrSignalNotOnline(getSignalTime(`FDCAN2::dbNode::`BCM::`BCM_FD_12::`PAMRequestSts), __cArray2, __cArray4, 8192);
          ReportTableRow(__tableHandle, 0, __cArray4, __cAOp, 1, __cArray3, __oneOfFlag, __bSetInCheckAlignment);
          
      
        }
        ReportTableEndTestStep(__tableHandle, "1");
      }
      TestCommandEnd();


      TestCommandBegin(__eWait, __cWait, "", "10");
      {
        Wait("1", (1000 * 1000000LL), 1000000, "");
      }
      TestCommandEnd();

      TestCommandBegin(__eSet, __cSet, "", "11");
      {
        __tableHandle = ReportTableHead3Columns(__cSetCaption , __cTSym, __cTOp, __cAssigned); 
        {
          $`FDCAN2::dbNode::`BCM::`BCM_FD_12::`PAMRequestSts.phys = 0;
          snprintf(__cArray, 8192, "%s", "PAMRequestSts");
          snprintf(__cArray2, 8192, "%s '%s'", __cCANSignal, __cArray);
          snprintf(__cArray3, 8192, "%s", "");
          
          ReportSetLValueOrSignalNotOnline(getSignalTime(`FDCAN2::dbNode::`BCM::`BCM_FD_12::`PAMRequestSts), __cArray2, __cArray4, 8192);
          ReportTableRow(__tableHandle, 0, __cArray4, __cAOp, 0, __cArray3, __oneOfFlag, __bSetInCheckAlignment);
          
      
        }
        {
          $`FDCAN2::dbNode::`BCM::`BCM_FD_12::`FT_PAMRequestSts.phys = 0;
          snprintf(__cArray, 8192, "%s", "FT_PAMRequestSts");
          snprintf(__cArray2, 8192, "%s '%s'", __cCANSignal, __cArray);
          snprintf(__cArray3, 8192, "%s", "");
          
          ReportSetLValueOrSignalNotOnline(getSignalTime(`FDCAN2::dbNode::`BCM::`BCM_FD_12::`FT_PAMRequestSts), __cArray2, __cArray4, 8192);
          ReportTableRow(__tableHandle, 0, __cArray4, __cAOp, 0, __cArray3, __oneOfFlag, __bSetInCheckAlignment);
          
      
        }
        ReportTableEndTestStep(__tableHandle, "1");
      }
      TestCommandEnd();


    }
  }
  TestControlStructEnd(__eUndefined);

  TestCommandBegin(__eWait, __cWait, "", "12");
  {
    Wait("1", (1000 * 1000000LL), 1000000, "");
  }
  TestCommandEnd();

  TestCommandBegin(__eCheck, __cCheck, "", "13");
  {
    __bVerdict = __eVerdictPass;
    __tableHandle = ReportTableHead5Columns(__cCheckCaption, __cTSym, __cTOp, __cRefVal, __cActual, __cRes);
    {
      __csr = CheckSignalMatch(`FDCAN2::dbNode::`CVADAS::`PDC_INFO_FD_PAM::`CurrentCanNMState_FD02_PAM, 4, ">=") == 1;
      snprintf(__cArray, 8192, "%s", "CurrentCanNMState_FD02_PAM");
      snprintf(__cArray2, 8192, "%s '%s'", __cCANSignal, __cArray);
      snprintf(__cArray3, 8192, "%s", "Normal Operation State");
      ReportTableRow(__tableHandle, 0, __cArray2, ">=", 4, __cArray3, __oneOfFlag, __bSetInCheckAlignment);
      ReportLValueOrSignalNotOnline(`FDCAN2::dbNode::`CVADAS::`PDC_INFO_FD_PAM::`CurrentCanNMState_FD02_PAM, __cArray5, 8192);
      ReportCell(__tableHandle, __cArray5);
      ReportCellResult(__tableHandle, __csr, __ePassFail);
  
      __bVerdict = __bVerdict && __csr;
    }
    {
      __csr = CheckSignalMatch(`FDCAN2::dbNode::`CVADAS::`CVPAM_FD_Info::`DisplayView2, 1, ">=") == 1;
      snprintf(__cArray, 8192, "%s", "DisplayView2");
      snprintf(__cArray2, 8192, "%s '%s'", __cCANSignal, __cArray);
      snprintf(__cArray3, 8192, "%s", "");
      ReportTableRow(__tableHandle, 0, __cArray2, ">=", 1, __cArray3, __oneOfFlag, __bSetInCheckAlignment);
      ReportLValueOrSignalNotOnline(`FDCAN2::dbNode::`CVADAS::`CVPAM_FD_Info::`DisplayView2, __cArray5, 8192);
      ReportCell(__tableHandle, __cArray5);
      ReportCellResult(__tableHandle, __csr, __ePassFail);
  
      __bVerdict = __bVerdict && __csr;
    }
    {
      __csr = CheckSignalMatch(`FDCAN2::dbNode::`CVADAS::`CVPAM_FD_Info::`PAM_Off_Status_2BT, 3, "==") == 1;
      snprintf(__cArray, 8192, "%s", "PAM_Off_Status_2BT");
      snprintf(__cArray2, 8192, "%s '%s'", __cCANSignal, __cArray);
      snprintf(__cArray3, 8192, "%s", "");
      ReportTableRow(__tableHandle, 0, __cArray2, "==", 3, __cArray3, __oneOfFlag, __bSetInCheckAlignment);
      ReportLValueOrSignalNotOnline(`FDCAN2::dbNode::`CVADAS::`CVPAM_FD_Info::`PAM_Off_Status_2BT, __cArray5, 8192);
      ReportCell(__tableHandle, __cArray5);
      ReportCellResult(__tableHandle, __csr, __ePassFail);
  
      __bVerdict = __bVerdict && __csr;
    }
    {
      __csr = CheckSignalMatch(`FDCAN2::dbNode::`CVADAS::`CVPAM_FD_Info::`DisplayView2, 1, ">=") == 1;
      snprintf(__cArray, 8192, "%s", "DisplayView2");
      snprintf(__cArray2, 8192, "%s '%s'", __cCANSignal, __cArray);
      snprintf(__cArray3, 8192, "%s", "");
      ReportTableRow(__tableHandle, 0, __cArray2, ">=", 1, __cArray3, __oneOfFlag, __bSetInCheckAlignment);
      ReportLValueOrSignalNotOnline(`FDCAN2::dbNode::`CVADAS::`CVPAM_FD_Info::`DisplayView2, __cArray5, 8192);
      ReportCell(__tableHandle, __cArray5);
      ReportCellResult(__tableHandle, __csr, __ePassFail);
  
      __bVerdict = __bVerdict && __csr;
    }
    ReportTableEndVerdict(__tableHandle, "1", __bVerdict);
  }
  TestCommandEnd();


  TestCommandBegin(__eCAPLInline, __cCAPLInline, "", "14");
  {
    __civccmce9CaplInline2();
  }
  TestCommandEnd();

}

void __civccmce9CaplInline2()
{
  stack long __tableHandle;
  {
    testReportAddWindowCapture("cvadas","cvadas","WakeUp","//images//");

  }
}

void Ttvccmce9_Tet_Tc8()
{
  CreateTTEIFFunction("Ttvccmce9_Tc8", __eTcDef, __eLocal);  
  AddIFParameterTestCaseAttribute("TC_ID", "");
  AddIFParameterTestCaseAttribute("Test Case ID", "");
  CallInterfaceFunction("2.5.4.1_FD1D", __cEmpty , __cEmpty );
}
testcase Ttvccmce9_Tc8()
{
  stack long __tableHandle;
  SetBreakOnFail(0);

  TestCommandBegin(__eDiagService, __cDiagService, "", "0");
  {
    if (DiagIsFunctionalGroup("CVADAS_0001_00000000_000"))
    {
      DiagResponse * __resp;
      DiagRequest CVADAS_0001_00000000_000.Default_Session_Start __req;
      __diagServicevccmce9_61(__req, __resp);
    }
    else
    {
      DiagResponse CVADAS_0001_00000000_000.* __resp;
      DiagRequest CVADAS_0001_00000000_000.Default_Session_Start __req;
      __diagServicevccmce9_61(__req, __resp);
    }
  }
  TestCommandEnd();


  TestCommandBegin(__eWait, __cWait, "", "1");
  {
    Wait("1", (syspar::`sleep * 1000000LL), 1000000, "sleep");
  }
  TestCommandEnd();

  TestCommandBegin(__eDiagService, __cDiagService, "", "2");
  {
    if (DiagIsFunctionalGroup("CVADAS_0001_00000000_000"))
    {
      DiagResponse * __resp;
      DiagRequest CVADAS_0001_00000000_000._22FD1D_PCB_Serial_Number __req;
      __diagServicevccmce9_62(__req, __resp);
    }
    else
    {
      DiagResponse CVADAS_0001_00000000_000.* __resp;
      DiagRequest CVADAS_0001_00000000_000._22FD1D_PCB_Serial_Number __req;
      __diagServicevccmce9_62(__req, __resp);
    }
  }
  TestCommandEnd();


  TestCommandBegin(__eDiagService, __cDiagService, "", "3");
  {
    if (DiagIsFunctionalGroup("CVADAS_0001_00000000_000"))
    {
      DiagResponse * __resp;
      DiagRequest CVADAS_0001_00000000_000.Extended_Diagnostic_Session_Start __req;
      __diagServicevccmce9_63(__req, __resp);
    }
    else
    {
      DiagResponse CVADAS_0001_00000000_000.* __resp;
      DiagRequest CVADAS_0001_00000000_000.Extended_Diagnostic_Session_Start __req;
      __diagServicevccmce9_63(__req, __resp);
    }
  }
  TestCommandEnd();


  TestCommandBegin(__eWait, __cWait, "", "4");
  {
    Wait("1", (syspar::`sleep * 1000000LL), 1000000, "sleep");
  }
  TestCommandEnd();

  TestCommandBegin(__eDiagService, __cDiagService, "", "5");
  {
    if (DiagIsFunctionalGroup("CVADAS_0001_00000000_000"))
    {
      DiagResponse * __resp;
      DiagRequest CVADAS_0001_00000000_000._22FD1D_PCB_Serial_Number __req;
      __diagServicevccmce9_64(__req, __resp);
    }
    else
    {
      DiagResponse CVADAS_0001_00000000_000.* __resp;
      DiagRequest CVADAS_0001_00000000_000._22FD1D_PCB_Serial_Number __req;
      __diagServicevccmce9_64(__req, __resp);
    }
  }
  TestCommandEnd();


}

  
void __diagServicevccmce9_61(DiagRequest * __req, DiagResponse * __resp )
{
  stack long __tableHandle;
  long __res, __paramLen, __bytePos;

   __bVerdict = __eVerdictPass;

  do {
    TestReportResetDiagObjectList();
    DiagSetReportDetailLevel("CVADAS_0001_00000000_000", EnumServiceDetails_onfail);
    // Request aspect
    {
      {
        __res = DiagSetParameterErrorHandled(__req, "DiagSessionType", 01);
        if(__res < 0)
        {
          __bVerdict = __eVerdictFail;
          DiagErrCodeTestStep(__res, "Cannot set diagnostic parameter 'DiagSessionType'");
          break;
        }
      }

      if (0 >= DiagSendReqAndWaitForResp("CVADAS_0001_00000000_000", __req, __resp, __res, -1, -1, -1, -1, -1, EnumResult_pos, EnumServiceDetails_onfail, EnumSendingMode_physical, EnumSuppressPosResBit_asconfigured, EnumVerdictOnInvalidValues_fail))
        break;
    }

    __res = DiagErrCodeTestStep(__res, "Can't retrieve last response for request! No check possible.") < 0;
    if(__res)
    {
	  __bVerdict = __eVerdictFail;
      break;
    }
    {
      __res = DiagInterpretAs(__resp, "DSC_PR");
      if(__res != 0)
      {
        __bVerdict = __eVerdictFail;
        DiagErrCodeTestStep(__res, "Can't interpret response as diagnostic primitive 'DSC_PR'.");
        break;
      }
      else
      {
        TestStepPass( "Received primitive can be interpreted as diagnostic primitive 'DSC_PR'.");
      }
    }
  }
  while(0);


  // Response, check & read aspect
  {
    __res = 1;
    __tableHandle = ReportTableHead5Columns(__cCheckCaption, __cTSym, __cTOp, __cRefVal, __cActual, __cRes);
    {
      double __nDiagValue;
      DiagGetParameterErrorHandled(__resp, "DiagSessionType", __nDiagValue);
      __csr = CheckSignalMatch(__nDiagValue, 01, "==") == 1;
      snprintf(__cArray, 8192, "%s", "Diagnostic parameter \'DiagSessionType\'");
      snprintf(__cArray2, 8192, "%s", __cArray);
      snprintf(__cArray3, 8192, "%s", "");
      ReportTableRow(__tableHandle, 0, __cArray2, "==", 01, __cArray3, __oneOfFlag, __bSetInCheckAlignment);
      ReportCell(__tableHandle, __nDiagValue);
      ReportCellResult(__tableHandle, __csr, __ePassFail);
    
      __res = __res && __csr;
    
    }
    ReportTableEndVerdict(__tableHandle, __cEvaluateResponse, __res);
	__bVerdict = __bVerdict && __res;
  }
  if (__bVerdict == __eVerdictFail)
    TestReportWriteDiagObjectList();
}
  
void __diagServicevccmce9_62(DiagRequest * __req, DiagResponse * __resp )
{
  stack long __tableHandle;
  long __res, __paramLen, __bytePos;

   __bVerdict = __eVerdictPass;

  do {
    TestReportResetDiagObjectList();
    DiagSetReportDetailLevel("CVADAS_0001_00000000_000", EnumServiceDetails_onfail);
    // Request aspect
    {

      if (0 >= DiagSendReqAndWaitForResp("CVADAS_0001_00000000_000", __req, __resp, __res, -1, -1, -1, -1, -1, EnumResult_pos, EnumServiceDetails_onfail, EnumSendingMode_physical, EnumSuppressPosResBit_asconfigured, EnumVerdictOnInvalidValues_fail))
        break;
    }

    __res = DiagErrCodeTestStep(__res, "Can't retrieve last response for request! No check possible.") < 0;
    if(__res)
    {
	  __bVerdict = __eVerdictFail;
      break;
    }
    {
      __res = DiagInterpretAs(__resp, "RDBI_PR");
      if(__res != 0)
      {
        __bVerdict = __eVerdictFail;
        DiagErrCodeTestStep(__res, "Can't interpret response as diagnostic primitive 'RDBI_PR'.");
        break;
      }
      else
      {
        TestStepPass( "Received primitive can be interpreted as diagnostic primitive 'RDBI_PR'.");
      }
    }
  }
  while(0);


  // Response, check & read aspect
  {
    __res = 1;
    __tableHandle = ReportTableHead5Columns(__cCheckCaption, __cTSym, __cTOp, __cRefVal, __cActual, __cRes);
    {
      __bDiagValueArrayCtr = DiagGetParameterErrorHandled(__resp, "PCB_Serial_Number_0xFD1D/PCB_Serial_Number", __bDiagValueArray, elcount(__bDiagValueArray), __cDiagValueArray, elcount(__cDiagValueArray));
      {
        byte __bArray2[14] = { 0x00, 0x00, 0x00, 0x00, 0x00, 0x00, 0x00, 0x00, 0x00, 0x00, 0x00, 0x00, 0x00, 0x00 };
        __bArrayCtr = __CopyBytes(__bDiagValueArray, __bDiagValueArrayCtr, __bArray);
        __bArrayCtr2 = elCount(__bArray2);
        __csr = CompareBytes(__bArray, __bArrayCtr, __bArray2, __bArrayCtr2) == 0;
        snprintf(__cArray, 8192, "%s", "Diagnostic parameter \'PCB_Serial_Number_0xFD1D/PCB_Serial_Number\'");
        snprintf(__cArray2, 8192, "%s", __cArray);
        snprintf(__cArray3, 8192, "%s", "");
        ReportTableRow(__tableHandle, 0, __cArray2, "Bytes", __bArray2, __bArrayCtr2, __cArray3, __oneOfFlag, __bSetInCheckAlignment);
        ReportCell(__tableHandle, __bArray, __bArrayCtr);
        ReportCellResult(__tableHandle, __csr, __ePassFail);
      }
    
      __res = __res && __csr;
    
    }
    {
      __bDiagValueArrayCtr = DiagGetParameterErrorHandled(__resp, "PCB_Serial_Number_0xFD1D", __bDiagValueArray, elcount(__bDiagValueArray), __cDiagValueArray, elcount(__cDiagValueArray));
      {
        byte __bArray2[14] = { 0x00, 0x00, 0x00, 0x00, 0x00, 0x00, 0x00, 0x00, 0x00, 0x00, 0x00, 0x00, 0x00, 0x00 };
        __bArrayCtr = __CopyBytes(__bDiagValueArray, __bDiagValueArrayCtr, __bArray);
        __bArrayCtr2 = elCount(__bArray2);
        __csr = CompareBytes(__bArray, __bArrayCtr, __bArray2, __bArrayCtr2) == 0;
        snprintf(__cArray, 8192, "%s", "Diagnostic parameter \'PCB_Serial_Number_0xFD1D\'");
        snprintf(__cArray2, 8192, "%s", __cArray);
        snprintf(__cArray3, 8192, "%s", "");
        ReportTableRow(__tableHandle, 0, __cArray2, "Bytes", __bArray2, __bArrayCtr2, __cArray3, __oneOfFlag, __bSetInCheckAlignment);
        ReportCell(__tableHandle, __bArray, __bArrayCtr);
        ReportCellResult(__tableHandle, __csr, __ePassFail);
      }
    
      __res = __res && __csr;
    
    }
    ReportTableEndVerdict(__tableHandle, __cEvaluateResponse, __res);
	__bVerdict = __bVerdict && __res;
  }
  if (__bVerdict == __eVerdictFail)
    TestReportWriteDiagObjectList();
}
  
void __diagServicevccmce9_63(DiagRequest * __req, DiagResponse * __resp )
{
  stack long __tableHandle;
  long __res, __paramLen, __bytePos;

   __bVerdict = __eVerdictPass;

  do {
    TestReportResetDiagObjectList();
    DiagSetReportDetailLevel("CVADAS_0001_00000000_000", EnumServiceDetails_onfail);
    // Request aspect
    {
      {
        __res = DiagSetParameterErrorHandled(__req, "DiagSessionType", 03);
        if(__res < 0)
        {
          __bVerdict = __eVerdictFail;
          DiagErrCodeTestStep(__res, "Cannot set diagnostic parameter 'DiagSessionType'");
          break;
        }
      }

      if (0 >= DiagSendReqAndWaitForResp("CVADAS_0001_00000000_000", __req, __resp, __res, -1, -1, -1, -1, -1, EnumResult_pos, EnumServiceDetails_onfail, EnumSendingMode_physical, EnumSuppressPosResBit_asconfigured, EnumVerdictOnInvalidValues_fail))
        break;
    }

    __res = DiagErrCodeTestStep(__res, "Can't retrieve last response for request! No check possible.") < 0;
    if(__res)
    {
	  __bVerdict = __eVerdictFail;
      break;
    }
    {
      __res = DiagInterpretAs(__resp, "DSC_PR");
      if(__res != 0)
      {
        __bVerdict = __eVerdictFail;
        DiagErrCodeTestStep(__res, "Can't interpret response as diagnostic primitive 'DSC_PR'.");
        break;
      }
      else
      {
        TestStepPass( "Received primitive can be interpreted as diagnostic primitive 'DSC_PR'.");
      }
    }
  }
  while(0);


  // Response, check & read aspect
  {
    __res = 1;
    __tableHandle = ReportTableHead5Columns(__cCheckCaption, __cTSym, __cTOp, __cRefVal, __cActual, __cRes);
    {
      double __nDiagValue;
      DiagGetParameterErrorHandled(__resp, "DiagSessionType", __nDiagValue);
      __csr = CheckSignalMatch(__nDiagValue, 03, "==") == 1;
      snprintf(__cArray, 8192, "%s", "Diagnostic parameter \'DiagSessionType\'");
      snprintf(__cArray2, 8192, "%s", __cArray);
      snprintf(__cArray3, 8192, "%s", "");
      ReportTableRow(__tableHandle, 0, __cArray2, "==", 03, __cArray3, __oneOfFlag, __bSetInCheckAlignment);
      ReportCell(__tableHandle, __nDiagValue);
      ReportCellResult(__tableHandle, __csr, __ePassFail);
    
      __res = __res && __csr;
    
    }
    ReportTableEndVerdict(__tableHandle, __cEvaluateResponse, __res);
	__bVerdict = __bVerdict && __res;
  }
  if (__bVerdict == __eVerdictFail)
    TestReportWriteDiagObjectList();
}
  
void __diagServicevccmce9_64(DiagRequest * __req, DiagResponse * __resp )
{
  stack long __tableHandle;
  long __res, __paramLen, __bytePos;

   __bVerdict = __eVerdictPass;

  do {
    TestReportResetDiagObjectList();
    DiagSetReportDetailLevel("CVADAS_0001_00000000_000", EnumServiceDetails_onfail);
    // Request aspect
    {

      if (0 >= DiagSendReqAndWaitForResp("CVADAS_0001_00000000_000", __req, __resp, __res, -1, -1, -1, -1, -1, EnumResult_pos, EnumServiceDetails_onfail, EnumSendingMode_physical, EnumSuppressPosResBit_asconfigured, EnumVerdictOnInvalidValues_fail))
        break;
    }

    __res = DiagErrCodeTestStep(__res, "Can't retrieve last response for request! No check possible.") < 0;
    if(__res)
    {
	  __bVerdict = __eVerdictFail;
      break;
    }
    {
      __res = DiagInterpretAs(__resp, "RDBI_PR");
      if(__res != 0)
      {
        __bVerdict = __eVerdictFail;
        DiagErrCodeTestStep(__res, "Can't interpret response as diagnostic primitive 'RDBI_PR'.");
        break;
      }
      else
      {
        TestStepPass( "Received primitive can be interpreted as diagnostic primitive 'RDBI_PR'.");
      }
    }
  }
  while(0);


  // Response, check & read aspect
  {
    __res = 1;
    __tableHandle = ReportTableHead5Columns(__cCheckCaption, __cTSym, __cTOp, __cRefVal, __cActual, __cRes);
    {
      __bDiagValueArrayCtr = DiagGetParameterErrorHandled(__resp, "PCB_Serial_Number_0xFD1D/PCB_Serial_Number", __bDiagValueArray, elcount(__bDiagValueArray), __cDiagValueArray, elcount(__cDiagValueArray));
      {
        byte __bArray2[14] = { 0x00, 0x00, 0x00, 0x00, 0x00, 0x00, 0x00, 0x00, 0x00, 0x00, 0x00, 0x00, 0x00, 0x00 };
        __bArrayCtr = __CopyBytes(__bDiagValueArray, __bDiagValueArrayCtr, __bArray);
        __bArrayCtr2 = elCount(__bArray2);
        __csr = CompareBytes(__bArray, __bArrayCtr, __bArray2, __bArrayCtr2) == 0;
        snprintf(__cArray, 8192, "%s", "Diagnostic parameter \'PCB_Serial_Number_0xFD1D/PCB_Serial_Number\'");
        snprintf(__cArray2, 8192, "%s", __cArray);
        snprintf(__cArray3, 8192, "%s", "");
        ReportTableRow(__tableHandle, 0, __cArray2, "Bytes", __bArray2, __bArrayCtr2, __cArray3, __oneOfFlag, __bSetInCheckAlignment);
        ReportCell(__tableHandle, __bArray, __bArrayCtr);
        ReportCellResult(__tableHandle, __csr, __ePassFail);
      }
    
      __res = __res && __csr;
    
    }
    {
      __bDiagValueArrayCtr = DiagGetParameterErrorHandled(__resp, "PCB_Serial_Number_0xFD1D", __bDiagValueArray, elcount(__bDiagValueArray), __cDiagValueArray, elcount(__cDiagValueArray));
      {
        byte __bArray2[14] = { 0x00, 0x00, 0x00, 0x00, 0x00, 0x00, 0x00, 0x00, 0x00, 0x00, 0x00, 0x00, 0x00, 0x00 };
        __bArrayCtr = __CopyBytes(__bDiagValueArray, __bDiagValueArrayCtr, __bArray);
        __bArrayCtr2 = elCount(__bArray2);
        __csr = CompareBytes(__bArray, __bArrayCtr, __bArray2, __bArrayCtr2) == 0;
        snprintf(__cArray, 8192, "%s", "Diagnostic parameter \'PCB_Serial_Number_0xFD1D\'");
        snprintf(__cArray2, 8192, "%s", __cArray);
        snprintf(__cArray3, 8192, "%s", "");
        ReportTableRow(__tableHandle, 0, __cArray2, "Bytes", __bArray2, __bArrayCtr2, __cArray3, __oneOfFlag, __bSetInCheckAlignment);
        ReportCell(__tableHandle, __bArray, __bArrayCtr);
        ReportCellResult(__tableHandle, __csr, __ePassFail);
      }
    
      __res = __res && __csr;
    
    }
    ReportTableEndVerdict(__tableHandle, __cEvaluateResponse, __res);
	__bVerdict = __bVerdict && __res;
  }
  if (__bVerdict == __eVerdictFail)
    TestReportWriteDiagObjectList();
}

void Ttvccmce9_Tet_Tc9()
{
  CreateTTEIFFunction("Ttvccmce9_Tc9", __eTcDef, __eLocal);  
  AddIFParameterTestCaseAttribute("TC_ID", "");
  AddIFParameterTestCaseAttribute("Test Case ID", "");
  CallInterfaceFunction("2.5.4.2_F18C", __cEmpty , __cEmpty );
}
testcase Ttvccmce9_Tc9()
{
  stack long __tableHandle;
  SetBreakOnFail(0);

  TestCommandBegin(__eDiagService, __cDiagService, "", "0");
  {
    if (DiagIsFunctionalGroup("CVADAS_0001_00000000_000"))
    {
      DiagResponse * __resp;
      DiagRequest CVADAS_0001_00000000_000.Default_Session_Start __req;
      __diagServicevccmce9_65(__req, __resp);
    }
    else
    {
      DiagResponse CVADAS_0001_00000000_000.* __resp;
      DiagRequest CVADAS_0001_00000000_000.Default_Session_Start __req;
      __diagServicevccmce9_65(__req, __resp);
    }
  }
  TestCommandEnd();


  TestCommandBegin(__eWait, __cWait, "", "1");
  {
    Wait("1", (syspar::`sleep * 1000000LL), 1000000, "sleep");
  }
  TestCommandEnd();

  TestCommandBegin(__eDiagService, __cDiagService, "", "2");
  {
    if (DiagIsFunctionalGroup("CVADAS_0001_00000000_000"))
    {
      DiagResponse * __resp;
      DiagRequest CVADAS_0001_00000000_000._22F18C_ECU_Serial_Number __req;
      __diagServicevccmce9_66(__req, __resp);
    }
    else
    {
      DiagResponse CVADAS_0001_00000000_000.* __resp;
      DiagRequest CVADAS_0001_00000000_000._22F18C_ECU_Serial_Number __req;
      __diagServicevccmce9_66(__req, __resp);
    }
  }
  TestCommandEnd();


  TestCommandBegin(__eDiagService, __cDiagService, "", "3");
  {
    if (DiagIsFunctionalGroup("CVADAS_0001_00000000_000"))
    {
      DiagResponse * __resp;
      DiagRequest CVADAS_0001_00000000_000.Extended_Diagnostic_Session_Start __req;
      __diagServicevccmce9_67(__req, __resp);
    }
    else
    {
      DiagResponse CVADAS_0001_00000000_000.* __resp;
      DiagRequest CVADAS_0001_00000000_000.Extended_Diagnostic_Session_Start __req;
      __diagServicevccmce9_67(__req, __resp);
    }
  }
  TestCommandEnd();


  TestCommandBegin(__eWait, __cWait, "", "4");
  {
    Wait("1", (syspar::`sleep * 1000000LL), 1000000, "sleep");
  }
  TestCommandEnd();

  TestCommandBegin(__eDiagService, __cDiagService, "", "5");
  {
    if (DiagIsFunctionalGroup("CVADAS_0001_00000000_000"))
    {
      DiagResponse * __resp;
      DiagRequest CVADAS_0001_00000000_000._22F18C_ECU_Serial_Number __req;
      __diagServicevccmce9_68(__req, __resp);
    }
    else
    {
      DiagResponse CVADAS_0001_00000000_000.* __resp;
      DiagRequest CVADAS_0001_00000000_000._22F18C_ECU_Serial_Number __req;
      __diagServicevccmce9_68(__req, __resp);
    }
  }
  TestCommandEnd();


}

  
void __diagServicevccmce9_65(DiagRequest * __req, DiagResponse * __resp )
{
  stack long __tableHandle;
  long __res, __paramLen, __bytePos;

   __bVerdict = __eVerdictPass;

  do {
    TestReportResetDiagObjectList();
    DiagSetReportDetailLevel("CVADAS_0001_00000000_000", EnumServiceDetails_onfail);
    // Request aspect
    {
      {
        __res = DiagSetParameterErrorHandled(__req, "DiagSessionType", 01);
        if(__res < 0)
        {
          __bVerdict = __eVerdictFail;
          DiagErrCodeTestStep(__res, "Cannot set diagnostic parameter 'DiagSessionType'");
          break;
        }
      }

      if (0 >= DiagSendReqAndWaitForResp("CVADAS_0001_00000000_000", __req, __resp, __res, -1, -1, -1, -1, -1, EnumResult_pos, EnumServiceDetails_onfail, EnumSendingMode_physical, EnumSuppressPosResBit_asconfigured, EnumVerdictOnInvalidValues_fail))
        break;
    }

    __res = DiagErrCodeTestStep(__res, "Can't retrieve last response for request! No check possible.") < 0;
    if(__res)
    {
	  __bVerdict = __eVerdictFail;
      break;
    }
    {
      __res = DiagInterpretAs(__resp, "DSC_PR");
      if(__res != 0)
      {
        __bVerdict = __eVerdictFail;
        DiagErrCodeTestStep(__res, "Can't interpret response as diagnostic primitive 'DSC_PR'.");
        break;
      }
      else
      {
        TestStepPass( "Received primitive can be interpreted as diagnostic primitive 'DSC_PR'.");
      }
    }
  }
  while(0);


  // Response, check & read aspect
  {
    __res = 1;
    __tableHandle = ReportTableHead5Columns(__cCheckCaption, __cTSym, __cTOp, __cRefVal, __cActual, __cRes);
    {
      double __nDiagValue;
      DiagGetParameterErrorHandled(__resp, "DiagSessionType", __nDiagValue);
      __csr = CheckSignalMatch(__nDiagValue, 01, "==") == 1;
      snprintf(__cArray, 8192, "%s", "Diagnostic parameter \'DiagSessionType\'");
      snprintf(__cArray2, 8192, "%s", __cArray);
      snprintf(__cArray3, 8192, "%s", "");
      ReportTableRow(__tableHandle, 0, __cArray2, "==", 01, __cArray3, __oneOfFlag, __bSetInCheckAlignment);
      ReportCell(__tableHandle, __nDiagValue);
      ReportCellResult(__tableHandle, __csr, __ePassFail);
    
      __res = __res && __csr;
    
    }
    ReportTableEndVerdict(__tableHandle, __cEvaluateResponse, __res);
	__bVerdict = __bVerdict && __res;
  }
  if (__bVerdict == __eVerdictFail)
    TestReportWriteDiagObjectList();
}
  
void __diagServicevccmce9_66(DiagRequest * __req, DiagResponse * __resp )
{
  stack long __tableHandle;
  long __res, __paramLen, __bytePos;

   __bVerdict = __eVerdictPass;

  do {
    TestReportResetDiagObjectList();
    DiagSetReportDetailLevel("CVADAS_0001_00000000_000", EnumServiceDetails_onfail);
    // Request aspect
    {

      if (0 >= DiagSendReqAndWaitForResp("CVADAS_0001_00000000_000", __req, __resp, __res, -1, -1, -1, -1, -1, EnumResult_pos, EnumServiceDetails_onfail, EnumSendingMode_physical, EnumSuppressPosResBit_asconfigured, EnumVerdictOnInvalidValues_fail))
        break;
    }

    __res = DiagErrCodeTestStep(__res, "Can't retrieve last response for request! No check possible.") < 0;
    if(__res)
    {
	  __bVerdict = __eVerdictFail;
      break;
    }
    {
      __res = DiagInterpretAs(__resp, "RDBI_PR");
      if(__res != 0)
      {
        __bVerdict = __eVerdictFail;
        DiagErrCodeTestStep(__res, "Can't interpret response as diagnostic primitive 'RDBI_PR'.");
        break;
      }
      else
      {
        TestStepPass( "Received primitive can be interpreted as diagnostic primitive 'RDBI_PR'.");
      }
    }
  }
  while(0);


  // Response, check & read aspect
  {
    __res = 1;
    __tableHandle = ReportTableHead5Columns(__cCheckCaption, __cTSym, __cTOp, __cRefVal, __cActual, __cRes);
    {
      double __nDiagValue;
      DiagGetParameterErrorHandled(__resp, "_Calendar_Year_88", __nDiagValue);
      __csr = CheckSignalMatch(__nDiagValue, 0, ">") == 1;
      snprintf(__cArray, 8192, "%s", "Diagnostic parameter \'_Calendar_Year_88\'");
      snprintf(__cArray2, 8192, "%s", __cArray);
      snprintf(__cArray3, 8192, "%s", "");
      ReportTableRow(__tableHandle, 0, __cArray2, ">", 0, __cArray3, __oneOfFlag, __bSetInCheckAlignment);
      ReportCell(__tableHandle, __nDiagValue);
      ReportCellResult(__tableHandle, __csr, __ePassFail);
    
      __res = __res && __csr;
    
    }
    {
      DiagGetParameterErrorHandled(__resp, "_Component_Code_48", __bDiagValueArray, elcount(__bDiagValueArray), __cDiagValueArray, elcount(__cDiagValueArray));
      CheckCaplGenVarStringBufferConsistency(__cDiagValueArray, 8192);
      snprintf(__cArray, 8192, "%s", __cDiagValueArray);
      CheckLiteralGetStringBufferConsistency("0", 8192);
      snprintf(__cArray2, 8192, "%s", "0");
      __csr = strncmp(__cArray, __cArray2, 8192) > 0;
      snprintf(__cArray3, 8192, "%s", "Diagnostic parameter \'_Component_Code_48\'");
      snprintf(__cArray4, 8192, "%s", __cArray3);
      snprintf(__cArray5, 8192, "%s", "");
      ReportTableRow(__tableHandle, 0, __cArray4, ">", __cArray2, __cArray5, __oneOfFlag, __bSetInCheckAlignment);
      ReportCell(__tableHandle, __cArray);
      ReportCellResult(__tableHandle, __csr, __ePassFail);
    
      __res = __res && __csr;
    
    }
    {
      DiagGetParameterErrorHandled(__resp, "_Data_Identifier_24", __bDiagValueArray, elcount(__bDiagValueArray), __cDiagValueArray, elcount(__cDiagValueArray));
      CheckCaplGenVarStringBufferConsistency(__cDiagValueArray, 8192);
      snprintf(__cArray, 8192, "%s", __cDiagValueArray);
      CheckLiteralGetStringBufferConsistency("0", 8192);
      snprintf(__cArray2, 8192, "%s", "0");
      __csr = strncmp(__cArray, __cArray2, 8192) > 0;
      snprintf(__cArray3, 8192, "%s", "Diagnostic parameter \'_Data_Identifier_24\'");
      snprintf(__cArray4, 8192, "%s", __cArray3);
      snprintf(__cArray5, 8192, "%s", "");
      ReportTableRow(__tableHandle, 0, __cArray4, ">", __cArray2, __cArray5, __oneOfFlag, __bSetInCheckAlignment);
      ReportCell(__tableHandle, __cArray);
      ReportCellResult(__tableHandle, __csr, __ePassFail);
    
      __res = __res && __csr;
    
    }
    {
      DiagGetParameterErrorHandled(__resp, "_Sequence_Number_96", __bDiagValueArray, elcount(__bDiagValueArray), __cDiagValueArray, elcount(__cDiagValueArray));
      CheckCaplGenVarStringBufferConsistency(__cDiagValueArray, 8192);
      snprintf(__cArray, 8192, "%s", __cDiagValueArray);
      CheckLiteralGetStringBufferConsistency("0", 8192);
      snprintf(__cArray2, 8192, "%s", "0");
      __csr = strncmp(__cArray, __cArray2, 8192) > 0;
      snprintf(__cArray3, 8192, "%s", "Diagnostic parameter \'_Sequence_Number_96\'");
      snprintf(__cArray4, 8192, "%s", __cArray3);
      snprintf(__cArray5, 8192, "%s", "");
      ReportTableRow(__tableHandle, 0, __cArray4, ">", __cArray2, __cArray5, __oneOfFlag, __bSetInCheckAlignment);
      ReportCell(__tableHandle, __cArray);
      ReportCellResult(__tableHandle, __csr, __ePassFail);
    
      __res = __res && __csr;
    
    }
    {
      DiagGetParameterErrorHandled(__resp, "_Supplier_Option_32", __bDiagValueArray, elcount(__bDiagValueArray), __cDiagValueArray, elcount(__cDiagValueArray));
      CheckCaplGenVarStringBufferConsistency(__cDiagValueArray, 8192);
      snprintf(__cArray, 8192, "%s", __cDiagValueArray);
      CheckLiteralGetStringBufferConsistency("0", 8192);
      snprintf(__cArray2, 8192, "%s", "0");
      __csr = strncmp(__cArray, __cArray2, 8192) > 0;
      snprintf(__cArray3, 8192, "%s", "Diagnostic parameter \'_Supplier_Option_32\'");
      snprintf(__cArray4, 8192, "%s", __cArray3);
      snprintf(__cArray5, 8192, "%s", "");
      ReportTableRow(__tableHandle, 0, __cArray4, ">", __cArray2, __cArray5, __oneOfFlag, __bSetInCheckAlignment);
      ReportCell(__tableHandle, __cArray);
      ReportCellResult(__tableHandle, __csr, __ePassFail);
    
      __res = __res && __csr;
    
    }
    ReportTableEndVerdict(__tableHandle, __cEvaluateResponse, __res);
	__bVerdict = __bVerdict && __res;
  }
  if (__bVerdict == __eVerdictFail)
    TestReportWriteDiagObjectList();
}
  
void __diagServicevccmce9_67(DiagRequest * __req, DiagResponse * __resp )
{
  stack long __tableHandle;
  long __res, __paramLen, __bytePos;

   __bVerdict = __eVerdictPass;

  do {
    TestReportResetDiagObjectList();
    DiagSetReportDetailLevel("CVADAS_0001_00000000_000", EnumServiceDetails_onfail);
    // Request aspect
    {
      {
        __res = DiagSetParameterErrorHandled(__req, "DiagSessionType", 03);
        if(__res < 0)
        {
          __bVerdict = __eVerdictFail;
          DiagErrCodeTestStep(__res, "Cannot set diagnostic parameter 'DiagSessionType'");
          break;
        }
      }

      if (0 >= DiagSendReqAndWaitForResp("CVADAS_0001_00000000_000", __req, __resp, __res, -1, -1, -1, -1, -1, EnumResult_pos, EnumServiceDetails_onfail, EnumSendingMode_physical, EnumSuppressPosResBit_asconfigured, EnumVerdictOnInvalidValues_fail))
        break;
    }

    __res = DiagErrCodeTestStep(__res, "Can't retrieve last response for request! No check possible.") < 0;
    if(__res)
    {
	  __bVerdict = __eVerdictFail;
      break;
    }
    {
      __res = DiagInterpretAs(__resp, "DSC_PR");
      if(__res != 0)
      {
        __bVerdict = __eVerdictFail;
        DiagErrCodeTestStep(__res, "Can't interpret response as diagnostic primitive 'DSC_PR'.");
        break;
      }
      else
      {
        TestStepPass( "Received primitive can be interpreted as diagnostic primitive 'DSC_PR'.");
      }
    }
  }
  while(0);


  // Response, check & read aspect
  {
    __res = 1;
    __tableHandle = ReportTableHead5Columns(__cCheckCaption, __cTSym, __cTOp, __cRefVal, __cActual, __cRes);
    {
      double __nDiagValue;
      DiagGetParameterErrorHandled(__resp, "DiagSessionType", __nDiagValue);
      __csr = CheckSignalMatch(__nDiagValue, 03, "==") == 1;
      snprintf(__cArray, 8192, "%s", "Diagnostic parameter \'DiagSessionType\'");
      snprintf(__cArray2, 8192, "%s", __cArray);
      snprintf(__cArray3, 8192, "%s", "");
      ReportTableRow(__tableHandle, 0, __cArray2, "==", 03, __cArray3, __oneOfFlag, __bSetInCheckAlignment);
      ReportCell(__tableHandle, __nDiagValue);
      ReportCellResult(__tableHandle, __csr, __ePassFail);
    
      __res = __res && __csr;
    
    }
    ReportTableEndVerdict(__tableHandle, __cEvaluateResponse, __res);
	__bVerdict = __bVerdict && __res;
  }
  if (__bVerdict == __eVerdictFail)
    TestReportWriteDiagObjectList();
}
  
void __diagServicevccmce9_68(DiagRequest * __req, DiagResponse * __resp )
{
  stack long __tableHandle;
  long __res, __paramLen, __bytePos;

   __bVerdict = __eVerdictPass;

  do {
    TestReportResetDiagObjectList();
    DiagSetReportDetailLevel("CVADAS_0001_00000000_000", EnumServiceDetails_onfail);
    // Request aspect
    {

      if (0 >= DiagSendReqAndWaitForResp("CVADAS_0001_00000000_000", __req, __resp, __res, -1, -1, -1, -1, -1, EnumResult_pos, EnumServiceDetails_onfail, EnumSendingMode_physical, EnumSuppressPosResBit_asconfigured, EnumVerdictOnInvalidValues_fail))
        break;
    }

    __res = DiagErrCodeTestStep(__res, "Can't retrieve last response for request! No check possible.") < 0;
    if(__res)
    {
	  __bVerdict = __eVerdictFail;
      break;
    }
    {
      __res = DiagInterpretAs(__resp, "RDBI_PR");
      if(__res != 0)
      {
        __bVerdict = __eVerdictFail;
        DiagErrCodeTestStep(__res, "Can't interpret response as diagnostic primitive 'RDBI_PR'.");
        break;
      }
      else
      {
        TestStepPass( "Received primitive can be interpreted as diagnostic primitive 'RDBI_PR'.");
      }
    }
  }
  while(0);


  // Response, check & read aspect
  {
    __res = 1;
    __tableHandle = ReportTableHead5Columns(__cCheckCaption, __cTSym, __cTOp, __cRefVal, __cActual, __cRes);
    {
      double __nDiagValue;
      DiagGetParameterErrorHandled(__resp, "_Calendar_Year_88", __nDiagValue);
      __csr = CheckSignalMatch(__nDiagValue, 0, ">") == 1;
      snprintf(__cArray, 8192, "%s", "Diagnostic parameter \'_Calendar_Year_88\'");
      snprintf(__cArray2, 8192, "%s", __cArray);
      snprintf(__cArray3, 8192, "%s", "");
      ReportTableRow(__tableHandle, 0, __cArray2, ">", 0, __cArray3, __oneOfFlag, __bSetInCheckAlignment);
      ReportCell(__tableHandle, __nDiagValue);
      ReportCellResult(__tableHandle, __csr, __ePassFail);
    
      __res = __res && __csr;
    
    }
    {
      DiagGetParameterErrorHandled(__resp, "_Component_Code_48", __bDiagValueArray, elcount(__bDiagValueArray), __cDiagValueArray, elcount(__cDiagValueArray));
      CheckCaplGenVarStringBufferConsistency(__cDiagValueArray, 8192);
      snprintf(__cArray, 8192, "%s", __cDiagValueArray);
      CheckLiteralGetStringBufferConsistency("0", 8192);
      snprintf(__cArray2, 8192, "%s", "0");
      __csr = strncmp(__cArray, __cArray2, 8192) > 0;
      snprintf(__cArray3, 8192, "%s", "Diagnostic parameter \'_Component_Code_48\'");
      snprintf(__cArray4, 8192, "%s", __cArray3);
      snprintf(__cArray5, 8192, "%s", "");
      ReportTableRow(__tableHandle, 0, __cArray4, ">", __cArray2, __cArray5, __oneOfFlag, __bSetInCheckAlignment);
      ReportCell(__tableHandle, __cArray);
      ReportCellResult(__tableHandle, __csr, __ePassFail);
    
      __res = __res && __csr;
    
    }
    {
      DiagGetParameterErrorHandled(__resp, "_Data_Identifier_24", __bDiagValueArray, elcount(__bDiagValueArray), __cDiagValueArray, elcount(__cDiagValueArray));
      CheckCaplGenVarStringBufferConsistency(__cDiagValueArray, 8192);
      snprintf(__cArray, 8192, "%s", __cDiagValueArray);
      CheckLiteralGetStringBufferConsistency("0", 8192);
      snprintf(__cArray2, 8192, "%s", "0");
      __csr = strncmp(__cArray, __cArray2, 8192) > 0;
      snprintf(__cArray3, 8192, "%s", "Diagnostic parameter \'_Data_Identifier_24\'");
      snprintf(__cArray4, 8192, "%s", __cArray3);
      snprintf(__cArray5, 8192, "%s", "");
      ReportTableRow(__tableHandle, 0, __cArray4, ">", __cArray2, __cArray5, __oneOfFlag, __bSetInCheckAlignment);
      ReportCell(__tableHandle, __cArray);
      ReportCellResult(__tableHandle, __csr, __ePassFail);
    
      __res = __res && __csr;
    
    }
    {
      DiagGetParameterErrorHandled(__resp, "_Sequence_Number_96", __bDiagValueArray, elcount(__bDiagValueArray), __cDiagValueArray, elcount(__cDiagValueArray));
      CheckCaplGenVarStringBufferConsistency(__cDiagValueArray, 8192);
      snprintf(__cArray, 8192, "%s", __cDiagValueArray);
      CheckLiteralGetStringBufferConsistency("0", 8192);
      snprintf(__cArray2, 8192, "%s", "0");
      __csr = strncmp(__cArray, __cArray2, 8192) > 0;
      snprintf(__cArray3, 8192, "%s", "Diagnostic parameter \'_Sequence_Number_96\'");
      snprintf(__cArray4, 8192, "%s", __cArray3);
      snprintf(__cArray5, 8192, "%s", "");
      ReportTableRow(__tableHandle, 0, __cArray4, ">", __cArray2, __cArray5, __oneOfFlag, __bSetInCheckAlignment);
      ReportCell(__tableHandle, __cArray);
      ReportCellResult(__tableHandle, __csr, __ePassFail);
    
      __res = __res && __csr;
    
    }
    {
      DiagGetParameterErrorHandled(__resp, "_Supplier_Option_32", __bDiagValueArray, elcount(__bDiagValueArray), __cDiagValueArray, elcount(__cDiagValueArray));
      CheckCaplGenVarStringBufferConsistency(__cDiagValueArray, 8192);
      snprintf(__cArray, 8192, "%s", __cDiagValueArray);
      CheckLiteralGetStringBufferConsistency("0", 8192);
      snprintf(__cArray2, 8192, "%s", "0");
      __csr = strncmp(__cArray, __cArray2, 8192) > 0;
      snprintf(__cArray3, 8192, "%s", "Diagnostic parameter \'_Supplier_Option_32\'");
      snprintf(__cArray4, 8192, "%s", __cArray3);
      snprintf(__cArray5, 8192, "%s", "");
      ReportTableRow(__tableHandle, 0, __cArray4, ">", __cArray2, __cArray5, __oneOfFlag, __bSetInCheckAlignment);
      ReportCell(__tableHandle, __cArray);
      ReportCellResult(__tableHandle, __csr, __ePassFail);
    
      __res = __res && __csr;
    
    }
    ReportTableEndVerdict(__tableHandle, __cEvaluateResponse, __res);
	__bVerdict = __bVerdict && __res;
  }
  if (__bVerdict == __eVerdictFail)
    TestReportWriteDiagObjectList();
}

void Ttvccmce9_Tet_Tc10()
{
  CreateTTEIFFunction("Ttvccmce9_Tc10", __eTcDef, __eLocal);  
  AddIFParameterTestCaseAttribute("TC_ID", "");
  AddIFParameterTestCaseAttribute("Test Case ID", "");
  CallInterfaceFunction("2.5.5.1_F122", __cEmpty , __cEmpty );
}
testcase Ttvccmce9_Tc10()
{
  stack long __tableHandle;
  SetBreakOnFail(0);

  TestCommandBegin(__eWait, __cWait, "", "0");
  {
    Wait("1", (syspar::`sleep * 1000000LL), 1000000, "sleep");
  }
  TestCommandEnd();

  TestCommandBegin(__eDiagService, __cDiagService, "", "1");
  {
    if (DiagIsFunctionalGroup("CVADAS_0001_00000000_000"))
    {
      DiagResponse * __resp;
      DiagRequest CVADAS_0001_00000000_000._22F122_Software_EBOM_Part_Number __req;
      __diagServicevccmce9_69(__req, __resp);
    }
    else
    {
      DiagResponse CVADAS_0001_00000000_000.* __resp;
      DiagRequest CVADAS_0001_00000000_000._22F122_Software_EBOM_Part_Number __req;
      __diagServicevccmce9_69(__req, __resp);
    }
  }
  TestCommandEnd();


  TestCommandBegin(__eDiagService, __cDiagService, "", "2");
  {
    if (DiagIsFunctionalGroup("CVADAS_0001_00000000_000"))
    {
      DiagResponse * __resp;
      DiagRequest CVADAS_0001_00000000_000.Default_Session_Start __req;
      __diagServicevccmce9_70(__req, __resp);
    }
    else
    {
      DiagResponse CVADAS_0001_00000000_000.* __resp;
      DiagRequest CVADAS_0001_00000000_000.Default_Session_Start __req;
      __diagServicevccmce9_70(__req, __resp);
    }
  }
  TestCommandEnd();


  TestCommandBegin(__eDiagService, __cDiagService, "", "3");
  {
    if (DiagIsFunctionalGroup("CVADAS_0001_00000000_000"))
    {
      DiagResponse * __resp;
      DiagRequest CVADAS_0001_00000000_000.Extended_Diagnostic_Session_Start __req;
      __diagServicevccmce9_71(__req, __resp);
    }
    else
    {
      DiagResponse CVADAS_0001_00000000_000.* __resp;
      DiagRequest CVADAS_0001_00000000_000.Extended_Diagnostic_Session_Start __req;
      __diagServicevccmce9_71(__req, __resp);
    }
  }
  TestCommandEnd();


  TestCommandBegin(__eWait, __cWait, "", "4");
  {
    Wait("1", (syspar::`sleep * 1000000LL), 1000000, "sleep");
  }
  TestCommandEnd();

  TestCommandBegin(__eDiagService, __cDiagService, "", "5");
  {
    if (DiagIsFunctionalGroup("CVADAS_0001_00000000_000"))
    {
      DiagResponse * __resp;
      DiagRequest CVADAS_0001_00000000_000._22F122_Software_EBOM_Part_Number __req;
      __diagServicevccmce9_72(__req, __resp);
    }
    else
    {
      DiagResponse CVADAS_0001_00000000_000.* __resp;
      DiagRequest CVADAS_0001_00000000_000._22F122_Software_EBOM_Part_Number __req;
      __diagServicevccmce9_72(__req, __resp);
    }
  }
  TestCommandEnd();


}

  
void __diagServicevccmce9_69(DiagRequest * __req, DiagResponse * __resp )
{
  stack long __tableHandle;
  long __res, __paramLen, __bytePos;

   __bVerdict = __eVerdictPass;

  do {
    TestReportResetDiagObjectList();
    DiagSetReportDetailLevel("CVADAS_0001_00000000_000", EnumServiceDetails_onfail);
    // Request aspect
    {

      if (0 >= DiagSendReqAndWaitForResp("CVADAS_0001_00000000_000", __req, __resp, __res, -1, -1, -1, -1, -1, EnumResult_pos, EnumServiceDetails_onfail, EnumSendingMode_physical, EnumSuppressPosResBit_asconfigured, EnumVerdictOnInvalidValues_fail))
        break;
    }

    __res = DiagErrCodeTestStep(__res, "Can't retrieve last response for request! No check possible.") < 0;
    if(__res)
    {
	  __bVerdict = __eVerdictFail;
      break;
    }
    {
      __res = DiagInterpretAs(__resp, "RDBI_PR");
      if(__res != 0)
      {
        __bVerdict = __eVerdictFail;
        DiagErrCodeTestStep(__res, "Can't interpret response as diagnostic primitive 'RDBI_PR'.");
        break;
      }
      else
      {
        TestStepPass( "Received primitive can be interpreted as diagnostic primitive 'RDBI_PR'.");
      }
    }
  }
  while(0);


  // Response, check & read aspect
  {
    __res = 1;
    __tableHandle = ReportTableHead5Columns(__cCheckCaption, __cTSym, __cTOp, __cRefVal, __cActual, __cRes);
    {
      __bDiagValueArrayCtr = DiagGetParameterErrorHandled(__resp, "_Software_Logical_Block_1_Part_Number_24", __bDiagValueArray, elcount(__bDiagValueArray), __cDiagValueArray, elcount(__cDiagValueArray));
      {
        __bSetInCheckAlignment = 1;	
        {
          __bArrayCtr = __CopyBytes(__bDiagValueArray, __bDiagValueArrayCtr, __bArray);
          {
            sysvar * __systemVariable;
            __systemVariable = sysvarData::`PartNumber::`Part_Number;
            CheckSysVarSetBufferConsistency(sysSetVariableData(sysvarData::`PartNumber::`Part_Number, __bArray, __bArrayCtr), __systemVariable.name);
          }
          snprintf(__cArray, 8192, "%s", "Part_Number");
          snprintf(__cArray2, 8192, "%s '%s'", __cSysVar, __cArray);
          snprintf(__cArray3, 8192, "%s", "_Software_Logical_Block_1_Part_Number_24");
          
          ReportTableRow(__tableHandle, 0, __cArray2, __cAOp, __bArray, __bArrayCtr, __cArray3, __oneOfFlag, __bSetInCheckAlignment);
        
        }
    
        __bSetInCheckAlignment = 0;
      }
    }
    {
      __bDiagValueArrayCtr = DiagGetParameterErrorHandled(__resp, "Software_Logical_Block_2_Part_Number", __bDiagValueArray, elcount(__bDiagValueArray), __cDiagValueArray, elcount(__cDiagValueArray));
      {
        __bSetInCheckAlignment = 1;	
        {
          __bArrayCtr = __CopyBytes(__bDiagValueArray, __bDiagValueArrayCtr, __bArray);
          {
            sysvar * __systemVariable;
            __systemVariable = sysvarData::`PartNumber::`Part_Number;
            CheckSysVarSetBufferConsistency(sysSetVariableData(sysvarData::`PartNumber::`Part_Number, __bArray, __bArrayCtr), __systemVariable.name);
          }
          snprintf(__cArray, 8192, "%s", "Part_Number");
          snprintf(__cArray2, 8192, "%s '%s'", __cSysVar, __cArray);
          snprintf(__cArray3, 8192, "%s", "Software_Logical_Block_2_Part_Number");
          
          ReportTableRow(__tableHandle, 0, __cArray2, __cAOp, __bArray, __bArrayCtr, __cArray3, __oneOfFlag, __bSetInCheckAlignment);
        
        }
    
        __bSetInCheckAlignment = 0;
      }
    }
    {
      __bDiagValueArrayCtr = DiagGetParameterErrorHandled(__resp, "Software_Logical_Block_3_Part_Number", __bDiagValueArray, elcount(__bDiagValueArray), __cDiagValueArray, elcount(__cDiagValueArray));
      {
        __bSetInCheckAlignment = 1;	
        {
          __bArrayCtr = __CopyBytes(__bDiagValueArray, __bDiagValueArrayCtr, __bArray);
          {
            sysvar * __systemVariable;
            __systemVariable = sysvarData::`PartNumber::`Part_Number;
            CheckSysVarSetBufferConsistency(sysSetVariableData(sysvarData::`PartNumber::`Part_Number, __bArray, __bArrayCtr), __systemVariable.name);
          }
          snprintf(__cArray, 8192, "%s", "Part_Number");
          snprintf(__cArray2, 8192, "%s '%s'", __cSysVar, __cArray);
          snprintf(__cArray3, 8192, "%s", "Software_Logical_Block_3_Part_Number");
          
          ReportTableRow(__tableHandle, 0, __cArray2, __cAOp, __bArray, __bArrayCtr, __cArray3, __oneOfFlag, __bSetInCheckAlignment);
        
        }
    
        __bSetInCheckAlignment = 0;
      }
    }
    {
      __bDiagValueArrayCtr = DiagGetParameterErrorHandled(__resp, "Software_Logical_Block_4_Part_Number", __bDiagValueArray, elcount(__bDiagValueArray), __cDiagValueArray, elcount(__cDiagValueArray));
      {
        __bSetInCheckAlignment = 1;	
        {
          __bArrayCtr = __CopyBytes(__bDiagValueArray, __bDiagValueArrayCtr, __bArray);
          {
            sysvar * __systemVariable;
            __systemVariable = sysvarData::`PartNumber::`Part_Number;
            CheckSysVarSetBufferConsistency(sysSetVariableData(sysvarData::`PartNumber::`Part_Number, __bArray, __bArrayCtr), __systemVariable.name);
          }
          snprintf(__cArray, 8192, "%s", "Part_Number");
          snprintf(__cArray2, 8192, "%s '%s'", __cSysVar, __cArray);
          snprintf(__cArray3, 8192, "%s", "Software_Logical_Block_4_Part_Number");
          
          ReportTableRow(__tableHandle, 0, __cArray2, __cAOp, __bArray, __bArrayCtr, __cArray3, __oneOfFlag, __bSetInCheckAlignment);
        
        }
    
        __bSetInCheckAlignment = 0;
      }
    }
    {
      __bDiagValueArrayCtr = DiagGetParameterErrorHandled(__resp, "Software_Logical_Block_5_Part_Number", __bDiagValueArray, elcount(__bDiagValueArray), __cDiagValueArray, elcount(__cDiagValueArray));
      {
        __bSetInCheckAlignment = 1;	
        {
          __bArrayCtr = __CopyBytes(__bDiagValueArray, __bDiagValueArrayCtr, __bArray);
          {
            sysvar * __systemVariable;
            __systemVariable = sysvarData::`PartNumber::`Part_Number;
            CheckSysVarSetBufferConsistency(sysSetVariableData(sysvarData::`PartNumber::`Part_Number, __bArray, __bArrayCtr), __systemVariable.name);
          }
          snprintf(__cArray, 8192, "%s", "Part_Number");
          snprintf(__cArray2, 8192, "%s '%s'", __cSysVar, __cArray);
          snprintf(__cArray3, 8192, "%s", "Software_Logical_Block_5_Part_Number");
          
          ReportTableRow(__tableHandle, 0, __cArray2, __cAOp, __bArray, __bArrayCtr, __cArray3, __oneOfFlag, __bSetInCheckAlignment);
        
        }
    
        __bSetInCheckAlignment = 0;
      }
    }
    {
      __bDiagValueArrayCtr = DiagGetParameterErrorHandled(__resp, "Software_Logical_Block_6_Part_Number", __bDiagValueArray, elcount(__bDiagValueArray), __cDiagValueArray, elcount(__cDiagValueArray));
      {
        __bSetInCheckAlignment = 1;	
        {
          __bArrayCtr = __CopyBytes(__bDiagValueArray, __bDiagValueArrayCtr, __bArray);
          {
            sysvar * __systemVariable;
            __systemVariable = sysvarData::`PartNumber::`Part_Number;
            CheckSysVarSetBufferConsistency(sysSetVariableData(sysvarData::`PartNumber::`Part_Number, __bArray, __bArrayCtr), __systemVariable.name);
          }
          snprintf(__cArray, 8192, "%s", "Part_Number");
          snprintf(__cArray2, 8192, "%s '%s'", __cSysVar, __cArray);
          snprintf(__cArray3, 8192, "%s", "Software_Logical_Block_6_Part_Number");
          
          ReportTableRow(__tableHandle, 0, __cArray2, __cAOp, __bArray, __bArrayCtr, __cArray3, __oneOfFlag, __bSetInCheckAlignment);
        
        }
    
        __bSetInCheckAlignment = 0;
      }
    }
    {
      __bDiagValueArrayCtr = DiagGetParameterErrorHandled(__resp, "Software_Logical_Block_7_Part_Number", __bDiagValueArray, elcount(__bDiagValueArray), __cDiagValueArray, elcount(__cDiagValueArray));
      {
        __bSetInCheckAlignment = 1;	
        {
          __bArrayCtr = __CopyBytes(__bDiagValueArray, __bDiagValueArrayCtr, __bArray);
          {
            sysvar * __systemVariable;
            __systemVariable = sysvarData::`PartNumber::`Part_Number;
            CheckSysVarSetBufferConsistency(sysSetVariableData(sysvarData::`PartNumber::`Part_Number, __bArray, __bArrayCtr), __systemVariable.name);
          }
          snprintf(__cArray, 8192, "%s", "Part_Number");
          snprintf(__cArray2, 8192, "%s '%s'", __cSysVar, __cArray);
          snprintf(__cArray3, 8192, "%s", "Software_Logical_Block_7_Part_Number");
          
          ReportTableRow(__tableHandle, 0, __cArray2, __cAOp, __bArray, __bArrayCtr, __cArray3, __oneOfFlag, __bSetInCheckAlignment);
        
        }
    
        __bSetInCheckAlignment = 0;
      }
    }
    {
      __bDiagValueArrayCtr = DiagGetParameterErrorHandled(__resp, "Software_Logical_Block_8_Part_Number", __bDiagValueArray, elcount(__bDiagValueArray), __cDiagValueArray, elcount(__cDiagValueArray));
      {
        __bSetInCheckAlignment = 1;	
        {
          __bArrayCtr = __CopyBytes(__bDiagValueArray, __bDiagValueArrayCtr, __bArray);
          {
            sysvar * __systemVariable;
            __systemVariable = sysvarData::`PartNumber::`Part_Number;
            CheckSysVarSetBufferConsistency(sysSetVariableData(sysvarData::`PartNumber::`Part_Number, __bArray, __bArrayCtr), __systemVariable.name);
          }
          snprintf(__cArray, 8192, "%s", "Part_Number");
          snprintf(__cArray2, 8192, "%s '%s'", __cSysVar, __cArray);
          snprintf(__cArray3, 8192, "%s", "Software_Logical_Block_8_Part_Number");
          
          ReportTableRow(__tableHandle, 0, __cArray2, __cAOp, __bArray, __bArrayCtr, __cArray3, __oneOfFlag, __bSetInCheckAlignment);
        
        }
    
        __bSetInCheckAlignment = 0;
      }
    }
    {
      __bDiagValueArrayCtr = DiagGetParameterErrorHandled(__resp, "Software_Logical_Block_9_Part_Number", __bDiagValueArray, elcount(__bDiagValueArray), __cDiagValueArray, elcount(__cDiagValueArray));
      {
        __bSetInCheckAlignment = 1;	
        {
          __bArrayCtr = __CopyBytes(__bDiagValueArray, __bDiagValueArrayCtr, __bArray);
          {
            sysvar * __systemVariable;
            __systemVariable = sysvarData::`PartNumber::`Part_Number;
            CheckSysVarSetBufferConsistency(sysSetVariableData(sysvarData::`PartNumber::`Part_Number, __bArray, __bArrayCtr), __systemVariable.name);
          }
          snprintf(__cArray, 8192, "%s", "Part_Number");
          snprintf(__cArray2, 8192, "%s '%s'", __cSysVar, __cArray);
          snprintf(__cArray3, 8192, "%s", "Software_Logical_Block_9_Part_Number");
          
          ReportTableRow(__tableHandle, 0, __cArray2, __cAOp, __bArray, __bArrayCtr, __cArray3, __oneOfFlag, __bSetInCheckAlignment);
        
        }
    
        __bSetInCheckAlignment = 0;
      }
    }
    ReportTableEndVerdict(__tableHandle, __cEvaluateResponse, __res);
	__bVerdict = __bVerdict && __res;
  }
  if (__bVerdict == __eVerdictFail)
    TestReportWriteDiagObjectList();
}
  
void __diagServicevccmce9_70(DiagRequest * __req, DiagResponse * __resp )
{
  stack long __tableHandle;
  long __res, __paramLen, __bytePos;

   __bVerdict = __eVerdictPass;

  do {
    TestReportResetDiagObjectList();
    DiagSetReportDetailLevel("CVADAS_0001_00000000_000", EnumServiceDetails_onfail);
    // Request aspect
    {
      {
        __res = DiagSetParameterErrorHandled(__req, "DiagSessionType", 01);
        if(__res < 0)
        {
          __bVerdict = __eVerdictFail;
          DiagErrCodeTestStep(__res, "Cannot set diagnostic parameter 'DiagSessionType'");
          break;
        }
      }

      if (0 >= DiagSendReqAndWaitForResp("CVADAS_0001_00000000_000", __req, __resp, __res, -1, -1, -1, -1, -1, EnumResult_pos, EnumServiceDetails_onfail, EnumSendingMode_physical, EnumSuppressPosResBit_asconfigured, EnumVerdictOnInvalidValues_fail))
        break;
    }

    __res = DiagErrCodeTestStep(__res, "Can't retrieve last response for request! No check possible.") < 0;
    if(__res)
    {
	  __bVerdict = __eVerdictFail;
      break;
    }
    {
      __res = DiagInterpretAs(__resp, "DSC_PR");
      if(__res != 0)
      {
        __bVerdict = __eVerdictFail;
        DiagErrCodeTestStep(__res, "Can't interpret response as diagnostic primitive 'DSC_PR'.");
        break;
      }
      else
      {
        TestStepPass( "Received primitive can be interpreted as diagnostic primitive 'DSC_PR'.");
      }
    }
  }
  while(0);


  // Response, check & read aspect
  {
    __res = 1;
    __tableHandle = ReportTableHead5Columns(__cCheckCaption, __cTSym, __cTOp, __cRefVal, __cActual, __cRes);
    {
      double __nDiagValue;
      DiagGetParameterErrorHandled(__resp, "DiagSessionType", __nDiagValue);
      __csr = CheckSignalMatch(__nDiagValue, 01, "==") == 1;
      snprintf(__cArray, 8192, "%s", "Diagnostic parameter \'DiagSessionType\'");
      snprintf(__cArray2, 8192, "%s", __cArray);
      snprintf(__cArray3, 8192, "%s", "");
      ReportTableRow(__tableHandle, 0, __cArray2, "==", 01, __cArray3, __oneOfFlag, __bSetInCheckAlignment);
      ReportCell(__tableHandle, __nDiagValue);
      ReportCellResult(__tableHandle, __csr, __ePassFail);
    
      __res = __res && __csr;
    
    }
    ReportTableEndVerdict(__tableHandle, __cEvaluateResponse, __res);
	__bVerdict = __bVerdict && __res;
  }
  if (__bVerdict == __eVerdictFail)
    TestReportWriteDiagObjectList();
}
  
void __diagServicevccmce9_71(DiagRequest * __req, DiagResponse * __resp )
{
  stack long __tableHandle;
  long __res, __paramLen, __bytePos;

   __bVerdict = __eVerdictPass;

  do {
    TestReportResetDiagObjectList();
    DiagSetReportDetailLevel("CVADAS_0001_00000000_000", EnumServiceDetails_onfail);
    // Request aspect
    {
      {
        __res = DiagSetParameterErrorHandled(__req, "DiagSessionType", 03);
        if(__res < 0)
        {
          __bVerdict = __eVerdictFail;
          DiagErrCodeTestStep(__res, "Cannot set diagnostic parameter 'DiagSessionType'");
          break;
        }
      }

      if (0 >= DiagSendReqAndWaitForResp("CVADAS_0001_00000000_000", __req, __resp, __res, -1, -1, -1, -1, -1, EnumResult_pos, EnumServiceDetails_onfail, EnumSendingMode_physical, EnumSuppressPosResBit_asconfigured, EnumVerdictOnInvalidValues_fail))
        break;
    }

    __res = DiagErrCodeTestStep(__res, "Can't retrieve last response for request! No check possible.") < 0;
    if(__res)
    {
	  __bVerdict = __eVerdictFail;
      break;
    }
    {
      __res = DiagInterpretAs(__resp, "DSC_PR");
      if(__res != 0)
      {
        __bVerdict = __eVerdictFail;
        DiagErrCodeTestStep(__res, "Can't interpret response as diagnostic primitive 'DSC_PR'.");
        break;
      }
      else
      {
        TestStepPass( "Received primitive can be interpreted as diagnostic primitive 'DSC_PR'.");
      }
    }
  }
  while(0);


  // Response, check & read aspect
  {
    __res = 1;
    __tableHandle = ReportTableHead5Columns(__cCheckCaption, __cTSym, __cTOp, __cRefVal, __cActual, __cRes);
    {
      double __nDiagValue;
      DiagGetParameterErrorHandled(__resp, "DiagSessionType", __nDiagValue);
      __csr = CheckSignalMatch(__nDiagValue, 03, "==") == 1;
      snprintf(__cArray, 8192, "%s", "Diagnostic parameter \'DiagSessionType\'");
      snprintf(__cArray2, 8192, "%s", __cArray);
      snprintf(__cArray3, 8192, "%s", "");
      ReportTableRow(__tableHandle, 0, __cArray2, "==", 03, __cArray3, __oneOfFlag, __bSetInCheckAlignment);
      ReportCell(__tableHandle, __nDiagValue);
      ReportCellResult(__tableHandle, __csr, __ePassFail);
    
      __res = __res && __csr;
    
    }
    ReportTableEndVerdict(__tableHandle, __cEvaluateResponse, __res);
	__bVerdict = __bVerdict && __res;
  }
  if (__bVerdict == __eVerdictFail)
    TestReportWriteDiagObjectList();
}
  
void __diagServicevccmce9_72(DiagRequest * __req, DiagResponse * __resp )
{
  stack long __tableHandle;
  long __res, __paramLen, __bytePos;

   __bVerdict = __eVerdictPass;

  do {
    TestReportResetDiagObjectList();
    DiagSetReportDetailLevel("CVADAS_0001_00000000_000", EnumServiceDetails_onfail);
    // Request aspect
    {

      if (0 >= DiagSendReqAndWaitForResp("CVADAS_0001_00000000_000", __req, __resp, __res, -1, -1, -1, -1, -1, EnumResult_pos, EnumServiceDetails_onfail, EnumSendingMode_physical, EnumSuppressPosResBit_asconfigured, EnumVerdictOnInvalidValues_fail))
        break;
    }

    __res = DiagErrCodeTestStep(__res, "Can't retrieve last response for request! No check possible.") < 0;
    if(__res)
    {
	  __bVerdict = __eVerdictFail;
      break;
    }
    {
      __res = DiagInterpretAs(__resp, "RDBI_PR");
      if(__res != 0)
      {
        __bVerdict = __eVerdictFail;
        DiagErrCodeTestStep(__res, "Can't interpret response as diagnostic primitive 'RDBI_PR'.");
        break;
      }
      else
      {
        TestStepPass( "Received primitive can be interpreted as diagnostic primitive 'RDBI_PR'.");
      }
    }
  }
  while(0);


  // Response, check & read aspect
  {
    __res = 1;
    __tableHandle = ReportTableHead5Columns(__cCheckCaption, __cTSym, __cTOp, __cRefVal, __cActual, __cRes);
    {
      __bDiagValueArrayCtr = DiagGetParameterErrorHandled(__resp, "_Software_Logical_Block_1_Part_Number_24", __bDiagValueArray, elcount(__bDiagValueArray), __cDiagValueArray, elcount(__cDiagValueArray));
      {
        __bSetInCheckAlignment = 1;	
        {
          __bArrayCtr = __CopyBytes(__bDiagValueArray, __bDiagValueArrayCtr, __bArray);
          {
            sysvar * __systemVariable;
            __systemVariable = sysvarData::`PartNumber::`Part_Number;
            CheckSysVarSetBufferConsistency(sysSetVariableData(sysvarData::`PartNumber::`Part_Number, __bArray, __bArrayCtr), __systemVariable.name);
          }
          snprintf(__cArray, 8192, "%s", "Part_Number");
          snprintf(__cArray2, 8192, "%s '%s'", __cSysVar, __cArray);
          snprintf(__cArray3, 8192, "%s", "_Software_Logical_Block_1_Part_Number_24");
          
          ReportTableRow(__tableHandle, 0, __cArray2, __cAOp, __bArray, __bArrayCtr, __cArray3, __oneOfFlag, __bSetInCheckAlignment);
        
        }
    
        __bSetInCheckAlignment = 0;
      }
    }
    {
      __bDiagValueArrayCtr = DiagGetParameterErrorHandled(__resp, "Software_Logical_Block_2_Part_Number", __bDiagValueArray, elcount(__bDiagValueArray), __cDiagValueArray, elcount(__cDiagValueArray));
      {
        __bSetInCheckAlignment = 1;	
        {
          __bArrayCtr = __CopyBytes(__bDiagValueArray, __bDiagValueArrayCtr, __bArray);
          {
            sysvar * __systemVariable;
            __systemVariable = sysvarData::`PartNumber::`Part_Number;
            CheckSysVarSetBufferConsistency(sysSetVariableData(sysvarData::`PartNumber::`Part_Number, __bArray, __bArrayCtr), __systemVariable.name);
          }
          snprintf(__cArray, 8192, "%s", "Part_Number");
          snprintf(__cArray2, 8192, "%s '%s'", __cSysVar, __cArray);
          snprintf(__cArray3, 8192, "%s", "Software_Logical_Block_2_Part_Number");
          
          ReportTableRow(__tableHandle, 0, __cArray2, __cAOp, __bArray, __bArrayCtr, __cArray3, __oneOfFlag, __bSetInCheckAlignment);
        
        }
    
        __bSetInCheckAlignment = 0;
      }
    }
    {
      __bDiagValueArrayCtr = DiagGetParameterErrorHandled(__resp, "Software_Logical_Block_3_Part_Number", __bDiagValueArray, elcount(__bDiagValueArray), __cDiagValueArray, elcount(__cDiagValueArray));
      {
        __bSetInCheckAlignment = 1;	
        {
          __bArrayCtr = __CopyBytes(__bDiagValueArray, __bDiagValueArrayCtr, __bArray);
          {
            sysvar * __systemVariable;
            __systemVariable = sysvarData::`PartNumber::`Part_Number;
            CheckSysVarSetBufferConsistency(sysSetVariableData(sysvarData::`PartNumber::`Part_Number, __bArray, __bArrayCtr), __systemVariable.name);
          }
          snprintf(__cArray, 8192, "%s", "Part_Number");
          snprintf(__cArray2, 8192, "%s '%s'", __cSysVar, __cArray);
          snprintf(__cArray3, 8192, "%s", "Software_Logical_Block_3_Part_Number");
          
          ReportTableRow(__tableHandle, 0, __cArray2, __cAOp, __bArray, __bArrayCtr, __cArray3, __oneOfFlag, __bSetInCheckAlignment);
        
        }
    
        __bSetInCheckAlignment = 0;
      }
    }
    {
      __bDiagValueArrayCtr = DiagGetParameterErrorHandled(__resp, "Software_Logical_Block_4_Part_Number", __bDiagValueArray, elcount(__bDiagValueArray), __cDiagValueArray, elcount(__cDiagValueArray));
      {
        __bSetInCheckAlignment = 1;	
        {
          __bArrayCtr = __CopyBytes(__bDiagValueArray, __bDiagValueArrayCtr, __bArray);
          {
            sysvar * __systemVariable;
            __systemVariable = sysvarData::`PartNumber::`Part_Number;
            CheckSysVarSetBufferConsistency(sysSetVariableData(sysvarData::`PartNumber::`Part_Number, __bArray, __bArrayCtr), __systemVariable.name);
          }
          snprintf(__cArray, 8192, "%s", "Part_Number");
          snprintf(__cArray2, 8192, "%s '%s'", __cSysVar, __cArray);
          snprintf(__cArray3, 8192, "%s", "Software_Logical_Block_4_Part_Number");
          
          ReportTableRow(__tableHandle, 0, __cArray2, __cAOp, __bArray, __bArrayCtr, __cArray3, __oneOfFlag, __bSetInCheckAlignment);
        
        }
    
        __bSetInCheckAlignment = 0;
      }
    }
    {
      __bDiagValueArrayCtr = DiagGetParameterErrorHandled(__resp, "Software_Logical_Block_5_Part_Number", __bDiagValueArray, elcount(__bDiagValueArray), __cDiagValueArray, elcount(__cDiagValueArray));
      {
        __bSetInCheckAlignment = 1;	
        {
          __bArrayCtr = __CopyBytes(__bDiagValueArray, __bDiagValueArrayCtr, __bArray);
          {
            sysvar * __systemVariable;
            __systemVariable = sysvarData::`PartNumber::`Part_Number;
            CheckSysVarSetBufferConsistency(sysSetVariableData(sysvarData::`PartNumber::`Part_Number, __bArray, __bArrayCtr), __systemVariable.name);
          }
          snprintf(__cArray, 8192, "%s", "Part_Number");
          snprintf(__cArray2, 8192, "%s '%s'", __cSysVar, __cArray);
          snprintf(__cArray3, 8192, "%s", "Software_Logical_Block_5_Part_Number");
          
          ReportTableRow(__tableHandle, 0, __cArray2, __cAOp, __bArray, __bArrayCtr, __cArray3, __oneOfFlag, __bSetInCheckAlignment);
        
        }
    
        __bSetInCheckAlignment = 0;
      }
    }
    {
      __bDiagValueArrayCtr = DiagGetParameterErrorHandled(__resp, "Software_Logical_Block_6_Part_Number", __bDiagValueArray, elcount(__bDiagValueArray), __cDiagValueArray, elcount(__cDiagValueArray));
      {
        __bSetInCheckAlignment = 1;	
        {
          __bArrayCtr = __CopyBytes(__bDiagValueArray, __bDiagValueArrayCtr, __bArray);
          {
            sysvar * __systemVariable;
            __systemVariable = sysvarData::`PartNumber::`Part_Number;
            CheckSysVarSetBufferConsistency(sysSetVariableData(sysvarData::`PartNumber::`Part_Number, __bArray, __bArrayCtr), __systemVariable.name);
          }
          snprintf(__cArray, 8192, "%s", "Part_Number");
          snprintf(__cArray2, 8192, "%s '%s'", __cSysVar, __cArray);
          snprintf(__cArray3, 8192, "%s", "Software_Logical_Block_6_Part_Number");
          
          ReportTableRow(__tableHandle, 0, __cArray2, __cAOp, __bArray, __bArrayCtr, __cArray3, __oneOfFlag, __bSetInCheckAlignment);
        
        }
    
        __bSetInCheckAlignment = 0;
      }
    }
    {
      __bDiagValueArrayCtr = DiagGetParameterErrorHandled(__resp, "Software_Logical_Block_7_Part_Number", __bDiagValueArray, elcount(__bDiagValueArray), __cDiagValueArray, elcount(__cDiagValueArray));
      {
        __bSetInCheckAlignment = 1;	
        {
          __bArrayCtr = __CopyBytes(__bDiagValueArray, __bDiagValueArrayCtr, __bArray);
          {
            sysvar * __systemVariable;
            __systemVariable = sysvarData::`PartNumber::`Part_Number;
            CheckSysVarSetBufferConsistency(sysSetVariableData(sysvarData::`PartNumber::`Part_Number, __bArray, __bArrayCtr), __systemVariable.name);
          }
          snprintf(__cArray, 8192, "%s", "Part_Number");
          snprintf(__cArray2, 8192, "%s '%s'", __cSysVar, __cArray);
          snprintf(__cArray3, 8192, "%s", "Software_Logical_Block_7_Part_Number");
          
          ReportTableRow(__tableHandle, 0, __cArray2, __cAOp, __bArray, __bArrayCtr, __cArray3, __oneOfFlag, __bSetInCheckAlignment);
        
        }
    
        __bSetInCheckAlignment = 0;
      }
    }
    {
      __bDiagValueArrayCtr = DiagGetParameterErrorHandled(__resp, "Software_Logical_Block_8_Part_Number", __bDiagValueArray, elcount(__bDiagValueArray), __cDiagValueArray, elcount(__cDiagValueArray));
      {
        __bSetInCheckAlignment = 1;	
        {
          __bArrayCtr = __CopyBytes(__bDiagValueArray, __bDiagValueArrayCtr, __bArray);
          {
            sysvar * __systemVariable;
            __systemVariable = sysvarData::`PartNumber::`Part_Number;
            CheckSysVarSetBufferConsistency(sysSetVariableData(sysvarData::`PartNumber::`Part_Number, __bArray, __bArrayCtr), __systemVariable.name);
          }
          snprintf(__cArray, 8192, "%s", "Part_Number");
          snprintf(__cArray2, 8192, "%s '%s'", __cSysVar, __cArray);
          snprintf(__cArray3, 8192, "%s", "Software_Logical_Block_8_Part_Number");
          
          ReportTableRow(__tableHandle, 0, __cArray2, __cAOp, __bArray, __bArrayCtr, __cArray3, __oneOfFlag, __bSetInCheckAlignment);
        
        }
    
        __bSetInCheckAlignment = 0;
      }
    }
    {
      __bDiagValueArrayCtr = DiagGetParameterErrorHandled(__resp, "Software_Logical_Block_9_Part_Number", __bDiagValueArray, elcount(__bDiagValueArray), __cDiagValueArray, elcount(__cDiagValueArray));
      {
        __bSetInCheckAlignment = 1;	
        {
          __bArrayCtr = __CopyBytes(__bDiagValueArray, __bDiagValueArrayCtr, __bArray);
          {
            sysvar * __systemVariable;
            __systemVariable = sysvarData::`PartNumber::`Part_Number;
            CheckSysVarSetBufferConsistency(sysSetVariableData(sysvarData::`PartNumber::`Part_Number, __bArray, __bArrayCtr), __systemVariable.name);
          }
          snprintf(__cArray, 8192, "%s", "Part_Number");
          snprintf(__cArray2, 8192, "%s '%s'", __cSysVar, __cArray);
          snprintf(__cArray3, 8192, "%s", "Software_Logical_Block_9_Part_Number");
          
          ReportTableRow(__tableHandle, 0, __cArray2, __cAOp, __bArray, __bArrayCtr, __cArray3, __oneOfFlag, __bSetInCheckAlignment);
        
        }
    
        __bSetInCheckAlignment = 0;
      }
    }
    ReportTableEndVerdict(__tableHandle, __cEvaluateResponse, __res);
	__bVerdict = __bVerdict && __res;
  }
  if (__bVerdict == __eVerdictFail)
    TestReportWriteDiagObjectList();
}

void Ttvccmce9_Tet_Tc11()
{
  CreateTTEIFFunction("Ttvccmce9_Tc11", __eTcDef, __eLocal);  
  AddIFParameterTestCaseAttribute("TC_ID", "");
  AddIFParameterTestCaseAttribute("Test Case ID", "");
  CallInterfaceFunction("2.5.5.2_F132", __cEmpty , __cEmpty );
}
testcase Ttvccmce9_Tc11()
{
  stack long __tableHandle;
  SetBreakOnFail(0);

  TestCommandBegin(__eDiagService, __cDiagService, "", "0");
  {
    if (DiagIsFunctionalGroup("CVADAS_0001_00000000_000"))
    {
      DiagResponse * __resp;
      DiagRequest CVADAS_0001_00000000_000.Default_Session_Start __req;
      __diagServicevccmce9_73(__req, __resp);
    }
    else
    {
      DiagResponse CVADAS_0001_00000000_000.* __resp;
      DiagRequest CVADAS_0001_00000000_000.Default_Session_Start __req;
      __diagServicevccmce9_73(__req, __resp);
    }
  }
  TestCommandEnd();


  TestCommandBegin(__eWait, __cWait, "", "1");
  {
    Wait("1", (syspar::`sleep * 1000000LL), 1000000, "sleep");
  }
  TestCommandEnd();

  TestCommandBegin(__eDiagService, __cDiagService, "", "2");
  {
    if (DiagIsFunctionalGroup("CVADAS_0001_00000000_000"))
    {
      DiagResponse * __resp;
      DiagRequest CVADAS_0001_00000000_000._22F132_EBOM_ECU_Part_Number __req;
      __diagServicevccmce9_74(__req, __resp);
    }
    else
    {
      DiagResponse CVADAS_0001_00000000_000.* __resp;
      DiagRequest CVADAS_0001_00000000_000._22F132_EBOM_ECU_Part_Number __req;
      __diagServicevccmce9_74(__req, __resp);
    }
  }
  TestCommandEnd();


  TestCommandBegin(__eDiagService, __cDiagService, "", "3");
  {
    if (DiagIsFunctionalGroup("CVADAS_0001_00000000_000"))
    {
      DiagResponse * __resp;
      DiagRequest CVADAS_0001_00000000_000.Extended_Diagnostic_Session_Start __req;
      __diagServicevccmce9_75(__req, __resp);
    }
    else
    {
      DiagResponse CVADAS_0001_00000000_000.* __resp;
      DiagRequest CVADAS_0001_00000000_000.Extended_Diagnostic_Session_Start __req;
      __diagServicevccmce9_75(__req, __resp);
    }
  }
  TestCommandEnd();


  TestCommandBegin(__eWait, __cWait, "", "4");
  {
    Wait("1", (syspar::`sleep * 1000000LL), 1000000, "sleep");
  }
  TestCommandEnd();

  TestCommandBegin(__eDiagService, __cDiagService, "", "5");
  {
    if (DiagIsFunctionalGroup("CVADAS_0001_00000000_000"))
    {
      DiagResponse * __resp;
      DiagRequest CVADAS_0001_00000000_000._22F132_EBOM_ECU_Part_Number __req;
      __diagServicevccmce9_76(__req, __resp);
    }
    else
    {
      DiagResponse CVADAS_0001_00000000_000.* __resp;
      DiagRequest CVADAS_0001_00000000_000._22F132_EBOM_ECU_Part_Number __req;
      __diagServicevccmce9_76(__req, __resp);
    }
  }
  TestCommandEnd();


}

  
void __diagServicevccmce9_73(DiagRequest * __req, DiagResponse * __resp )
{
  stack long __tableHandle;
  long __res, __paramLen, __bytePos;

   __bVerdict = __eVerdictPass;

  do {
    TestReportResetDiagObjectList();
    DiagSetReportDetailLevel("CVADAS_0001_00000000_000", EnumServiceDetails_onfail);
    // Request aspect
    {
      {
        __res = DiagSetParameterErrorHandled(__req, "DiagSessionType", 01);
        if(__res < 0)
        {
          __bVerdict = __eVerdictFail;
          DiagErrCodeTestStep(__res, "Cannot set diagnostic parameter 'DiagSessionType'");
          break;
        }
      }

      if (0 >= DiagSendReqAndWaitForResp("CVADAS_0001_00000000_000", __req, __resp, __res, -1, -1, -1, -1, -1, EnumResult_pos, EnumServiceDetails_onfail, EnumSendingMode_physical, EnumSuppressPosResBit_asconfigured, EnumVerdictOnInvalidValues_fail))
        break;
    }

    __res = DiagErrCodeTestStep(__res, "Can't retrieve last response for request! No check possible.") < 0;
    if(__res)
    {
	  __bVerdict = __eVerdictFail;
      break;
    }
    {
      __res = DiagInterpretAs(__resp, "DSC_PR");
      if(__res != 0)
      {
        __bVerdict = __eVerdictFail;
        DiagErrCodeTestStep(__res, "Can't interpret response as diagnostic primitive 'DSC_PR'.");
        break;
      }
      else
      {
        TestStepPass( "Received primitive can be interpreted as diagnostic primitive 'DSC_PR'.");
      }
    }
  }
  while(0);


  // Response, check & read aspect
  {
    __res = 1;
    __tableHandle = ReportTableHead5Columns(__cCheckCaption, __cTSym, __cTOp, __cRefVal, __cActual, __cRes);
    {
      double __nDiagValue;
      DiagGetParameterErrorHandled(__resp, "DiagSessionType", __nDiagValue);
      __csr = CheckSignalMatch(__nDiagValue, 01, "==") == 1;
      snprintf(__cArray, 8192, "%s", "Diagnostic parameter \'DiagSessionType\'");
      snprintf(__cArray2, 8192, "%s", __cArray);
      snprintf(__cArray3, 8192, "%s", "");
      ReportTableRow(__tableHandle, 0, __cArray2, "==", 01, __cArray3, __oneOfFlag, __bSetInCheckAlignment);
      ReportCell(__tableHandle, __nDiagValue);
      ReportCellResult(__tableHandle, __csr, __ePassFail);
    
      __res = __res && __csr;
    
    }
    ReportTableEndVerdict(__tableHandle, __cEvaluateResponse, __res);
	__bVerdict = __bVerdict && __res;
  }
  if (__bVerdict == __eVerdictFail)
    TestReportWriteDiagObjectList();
}
  
void __diagServicevccmce9_74(DiagRequest * __req, DiagResponse * __resp )
{
  stack long __tableHandle;
  long __res, __paramLen, __bytePos;

   __bVerdict = __eVerdictPass;

  do {
    TestReportResetDiagObjectList();
    DiagSetReportDetailLevel("CVADAS_0001_00000000_000", EnumServiceDetails_onfail);
    // Request aspect
    {

      if (0 >= DiagSendReqAndWaitForResp("CVADAS_0001_00000000_000", __req, __resp, __res, -1, -1, -1, -1, -1, EnumResult_pos, EnumServiceDetails_onfail, EnumSendingMode_physical, EnumSuppressPosResBit_asconfigured, EnumVerdictOnInvalidValues_fail))
        break;
    }

    __res = DiagErrCodeTestStep(__res, "Can't retrieve last response for request! No check possible.") < 0;
    if(__res)
    {
	  __bVerdict = __eVerdictFail;
      break;
    }
    {
      __res = DiagInterpretAs(__resp, "RDBI_PR");
      if(__res != 0)
      {
        __bVerdict = __eVerdictFail;
        DiagErrCodeTestStep(__res, "Can't interpret response as diagnostic primitive 'RDBI_PR'.");
        break;
      }
      else
      {
        TestStepPass( "Received primitive can be interpreted as diagnostic primitive 'RDBI_PR'.");
      }
    }
  }
  while(0);


  // Response, check & read aspect
  {
    __res = 1;
    __tableHandle = ReportTableHead5Columns(__cCheckCaption, __cTSym, __cTOp, __cRefVal, __cActual, __cRes);
    {
      __bDiagValueArrayCtr = DiagGetParameterErrorHandled(__resp, "_EBOM_ECU_Part_Number_24", __bDiagValueArray, elcount(__bDiagValueArray), __cDiagValueArray, elcount(__cDiagValueArray));
      {
        __bSetInCheckAlignment = 1;	
        {
          __bArrayCtr = __CopyBytes(__bDiagValueArray, __bDiagValueArrayCtr, __bArray);
          {
            sysvar * __systemVariable;
            __systemVariable = sysvarData::`PartNumber::`Part_Number;
            CheckSysVarSetBufferConsistency(sysSetVariableData(sysvarData::`PartNumber::`Part_Number, __bArray, __bArrayCtr), __systemVariable.name);
          }
          snprintf(__cArray, 8192, "%s", "Part_Number");
          snprintf(__cArray2, 8192, "%s '%s'", __cSysVar, __cArray);
          snprintf(__cArray3, 8192, "%s", "_EBOM_ECU_Part_Number_24");
          
          ReportTableRow(__tableHandle, 0, __cArray2, __cAOp, __bArray, __bArrayCtr, __cArray3, __oneOfFlag, __bSetInCheckAlignment);
        
        }
    
        __bSetInCheckAlignment = 0;
      }
    }
    ReportTableEndVerdict(__tableHandle, __cEvaluateResponse, __res);
	__bVerdict = __bVerdict && __res;
  }
  if (__bVerdict == __eVerdictFail)
    TestReportWriteDiagObjectList();
}
  
void __diagServicevccmce9_75(DiagRequest * __req, DiagResponse * __resp )
{
  stack long __tableHandle;
  long __res, __paramLen, __bytePos;

   __bVerdict = __eVerdictPass;

  do {
    TestReportResetDiagObjectList();
    DiagSetReportDetailLevel("CVADAS_0001_00000000_000", EnumServiceDetails_onfail);
    // Request aspect
    {
      {
        __res = DiagSetParameterErrorHandled(__req, "DiagSessionType", 03);
        if(__res < 0)
        {
          __bVerdict = __eVerdictFail;
          DiagErrCodeTestStep(__res, "Cannot set diagnostic parameter 'DiagSessionType'");
          break;
        }
      }

      if (0 >= DiagSendReqAndWaitForResp("CVADAS_0001_00000000_000", __req, __resp, __res, -1, -1, -1, -1, -1, EnumResult_pos, EnumServiceDetails_onfail, EnumSendingMode_physical, EnumSuppressPosResBit_asconfigured, EnumVerdictOnInvalidValues_fail))
        break;
    }

    __res = DiagErrCodeTestStep(__res, "Can't retrieve last response for request! No check possible.") < 0;
    if(__res)
    {
	  __bVerdict = __eVerdictFail;
      break;
    }
    {
      __res = DiagInterpretAs(__resp, "DSC_PR");
      if(__res != 0)
      {
        __bVerdict = __eVerdictFail;
        DiagErrCodeTestStep(__res, "Can't interpret response as diagnostic primitive 'DSC_PR'.");
        break;
      }
      else
      {
        TestStepPass( "Received primitive can be interpreted as diagnostic primitive 'DSC_PR'.");
      }
    }
  }
  while(0);


  // Response, check & read aspect
  {
    __res = 1;
    __tableHandle = ReportTableHead5Columns(__cCheckCaption, __cTSym, __cTOp, __cRefVal, __cActual, __cRes);
    {
      double __nDiagValue;
      DiagGetParameterErrorHandled(__resp, "DiagSessionType", __nDiagValue);
      __csr = CheckSignalMatch(__nDiagValue, 03, "==") == 1;
      snprintf(__cArray, 8192, "%s", "Diagnostic parameter \'DiagSessionType\'");
      snprintf(__cArray2, 8192, "%s", __cArray);
      snprintf(__cArray3, 8192, "%s", "");
      ReportTableRow(__tableHandle, 0, __cArray2, "==", 03, __cArray3, __oneOfFlag, __bSetInCheckAlignment);
      ReportCell(__tableHandle, __nDiagValue);
      ReportCellResult(__tableHandle, __csr, __ePassFail);
    
      __res = __res && __csr;
    
    }
    ReportTableEndVerdict(__tableHandle, __cEvaluateResponse, __res);
	__bVerdict = __bVerdict && __res;
  }
  if (__bVerdict == __eVerdictFail)
    TestReportWriteDiagObjectList();
}
  
void __diagServicevccmce9_76(DiagRequest * __req, DiagResponse * __resp )
{
  stack long __tableHandle;
  long __res, __paramLen, __bytePos;

   __bVerdict = __eVerdictPass;

  do {
    TestReportResetDiagObjectList();
    DiagSetReportDetailLevel("CVADAS_0001_00000000_000", EnumServiceDetails_onfail);
    // Request aspect
    {

      if (0 >= DiagSendReqAndWaitForResp("CVADAS_0001_00000000_000", __req, __resp, __res, -1, -1, -1, -1, -1, EnumResult_pos, EnumServiceDetails_onfail, EnumSendingMode_physical, EnumSuppressPosResBit_asconfigured, EnumVerdictOnInvalidValues_fail))
        break;
    }

    __res = DiagErrCodeTestStep(__res, "Can't retrieve last response for request! No check possible.") < 0;
    if(__res)
    {
	  __bVerdict = __eVerdictFail;
      break;
    }
    {
      __res = DiagInterpretAs(__resp, "RDBI_PR");
      if(__res != 0)
      {
        __bVerdict = __eVerdictFail;
        DiagErrCodeTestStep(__res, "Can't interpret response as diagnostic primitive 'RDBI_PR'.");
        break;
      }
      else
      {
        TestStepPass( "Received primitive can be interpreted as diagnostic primitive 'RDBI_PR'.");
      }
    }
  }
  while(0);


  // Response, check & read aspect
  {
    __res = 1;
    __tableHandle = ReportTableHead5Columns(__cCheckCaption, __cTSym, __cTOp, __cRefVal, __cActual, __cRes);
    {
      __bDiagValueArrayCtr = DiagGetParameterErrorHandled(__resp, "_EBOM_ECU_Part_Number_24", __bDiagValueArray, elcount(__bDiagValueArray), __cDiagValueArray, elcount(__cDiagValueArray));
      {
        __bSetInCheckAlignment = 1;	
        {
          __bArrayCtr = __CopyBytes(__bDiagValueArray, __bDiagValueArrayCtr, __bArray);
          {
            sysvar * __systemVariable;
            __systemVariable = sysvarData::`PartNumber::`Part_Number;
            CheckSysVarSetBufferConsistency(sysSetVariableData(sysvarData::`PartNumber::`Part_Number, __bArray, __bArrayCtr), __systemVariable.name);
          }
          snprintf(__cArray, 8192, "%s", "Part_Number");
          snprintf(__cArray2, 8192, "%s '%s'", __cSysVar, __cArray);
          snprintf(__cArray3, 8192, "%s", "_EBOM_ECU_Part_Number_24");
          
          ReportTableRow(__tableHandle, 0, __cArray2, __cAOp, __bArray, __bArrayCtr, __cArray3, __oneOfFlag, __bSetInCheckAlignment);
        
        }
    
        __bSetInCheckAlignment = 0;
      }
    }
    ReportTableEndVerdict(__tableHandle, __cEvaluateResponse, __res);
	__bVerdict = __bVerdict && __res;
  }
  if (__bVerdict == __eVerdictFail)
    TestReportWriteDiagObjectList();
}

void Ttvccmce9_Tet_Tc12()
{
  CreateTTEIFFunction("Ttvccmce9_Tc12", __eTcDef, __eLocal);  
  AddIFParameterTestCaseAttribute("TC_ID", "");
  AddIFParameterTestCaseAttribute("Test Case ID", "");
  CallInterfaceFunction("2.5.5.3_F133", __cEmpty , __cEmpty );
}
testcase Ttvccmce9_Tc12()
{
  stack long __tableHandle;
  SetBreakOnFail(0);

  TestCommandBegin(__eDiagService, __cDiagService, "", "0");
  {
    if (DiagIsFunctionalGroup("CVADAS_0001_00000000_000"))
    {
      DiagResponse * __resp;
      DiagRequest CVADAS_0001_00000000_000.Default_Session_Start __req;
      __diagServicevccmce9_77(__req, __resp);
    }
    else
    {
      DiagResponse CVADAS_0001_00000000_000.* __resp;
      DiagRequest CVADAS_0001_00000000_000.Default_Session_Start __req;
      __diagServicevccmce9_77(__req, __resp);
    }
  }
  TestCommandEnd();


  TestCommandBegin(__eWait, __cWait, "", "1");
  {
    Wait("1", (syspar::`sleep * 1000000LL), 1000000, "sleep");
  }
  TestCommandEnd();

  TestCommandBegin(__eDiagService, __cDiagService, "", "2");
  {
    if (DiagIsFunctionalGroup("CVADAS_0001_00000000_000"))
    {
      DiagResponse * __resp;
      DiagRequest CVADAS_0001_00000000_000._22F133_EBOM_Assembly_Part_Number __req;
      __diagServicevccmce9_78(__req, __resp);
    }
    else
    {
      DiagResponse CVADAS_0001_00000000_000.* __resp;
      DiagRequest CVADAS_0001_00000000_000._22F133_EBOM_Assembly_Part_Number __req;
      __diagServicevccmce9_78(__req, __resp);
    }
  }
  TestCommandEnd();


  TestCommandBegin(__eDiagService, __cDiagService, "", "3");
  {
    if (DiagIsFunctionalGroup("CVADAS_0001_00000000_000"))
    {
      DiagResponse * __resp;
      DiagRequest CVADAS_0001_00000000_000.Extended_Diagnostic_Session_Start __req;
      __diagServicevccmce9_79(__req, __resp);
    }
    else
    {
      DiagResponse CVADAS_0001_00000000_000.* __resp;
      DiagRequest CVADAS_0001_00000000_000.Extended_Diagnostic_Session_Start __req;
      __diagServicevccmce9_79(__req, __resp);
    }
  }
  TestCommandEnd();


  TestCommandBegin(__eWait, __cWait, "", "4");
  {
    Wait("1", (syspar::`sleep * 1000000LL), 1000000, "sleep");
  }
  TestCommandEnd();

  TestCommandBegin(__eDiagService, __cDiagService, "", "5");
  {
    if (DiagIsFunctionalGroup("CVADAS_0001_00000000_000"))
    {
      DiagResponse * __resp;
      DiagRequest CVADAS_0001_00000000_000._22F133_EBOM_Assembly_Part_Number __req;
      __diagServicevccmce9_80(__req, __resp);
    }
    else
    {
      DiagResponse CVADAS_0001_00000000_000.* __resp;
      DiagRequest CVADAS_0001_00000000_000._22F133_EBOM_Assembly_Part_Number __req;
      __diagServicevccmce9_80(__req, __resp);
    }
  }
  TestCommandEnd();


}

  
void __diagServicevccmce9_77(DiagRequest * __req, DiagResponse * __resp )
{
  stack long __tableHandle;
  long __res, __paramLen, __bytePos;

   __bVerdict = __eVerdictPass;

  do {
    TestReportResetDiagObjectList();
    DiagSetReportDetailLevel("CVADAS_0001_00000000_000", EnumServiceDetails_onfail);
    // Request aspect
    {
      {
        __res = DiagSetParameterErrorHandled(__req, "DiagSessionType", 01);
        if(__res < 0)
        {
          __bVerdict = __eVerdictFail;
          DiagErrCodeTestStep(__res, "Cannot set diagnostic parameter 'DiagSessionType'");
          break;
        }
      }

      if (0 >= DiagSendReqAndWaitForResp("CVADAS_0001_00000000_000", __req, __resp, __res, -1, -1, -1, -1, -1, EnumResult_pos, EnumServiceDetails_onfail, EnumSendingMode_physical, EnumSuppressPosResBit_asconfigured, EnumVerdictOnInvalidValues_fail))
        break;
    }

    __res = DiagErrCodeTestStep(__res, "Can't retrieve last response for request! No check possible.") < 0;
    if(__res)
    {
	  __bVerdict = __eVerdictFail;
      break;
    }
    {
      __res = DiagInterpretAs(__resp, "DSC_PR");
      if(__res != 0)
      {
        __bVerdict = __eVerdictFail;
        DiagErrCodeTestStep(__res, "Can't interpret response as diagnostic primitive 'DSC_PR'.");
        break;
      }
      else
      {
        TestStepPass( "Received primitive can be interpreted as diagnostic primitive 'DSC_PR'.");
      }
    }
  }
  while(0);


  // Response, check & read aspect
  {
    __res = 1;
    __tableHandle = ReportTableHead5Columns(__cCheckCaption, __cTSym, __cTOp, __cRefVal, __cActual, __cRes);
    {
      double __nDiagValue;
      DiagGetParameterErrorHandled(__resp, "DiagSessionType", __nDiagValue);
      __csr = CheckSignalMatch(__nDiagValue, 01, "==") == 1;
      snprintf(__cArray, 8192, "%s", "Diagnostic parameter \'DiagSessionType\'");
      snprintf(__cArray2, 8192, "%s", __cArray);
      snprintf(__cArray3, 8192, "%s", "");
      ReportTableRow(__tableHandle, 0, __cArray2, "==", 01, __cArray3, __oneOfFlag, __bSetInCheckAlignment);
      ReportCell(__tableHandle, __nDiagValue);
      ReportCellResult(__tableHandle, __csr, __ePassFail);
    
      __res = __res && __csr;
    
    }
    ReportTableEndVerdict(__tableHandle, __cEvaluateResponse, __res);
	__bVerdict = __bVerdict && __res;
  }
  if (__bVerdict == __eVerdictFail)
    TestReportWriteDiagObjectList();
}
  
void __diagServicevccmce9_78(DiagRequest * __req, DiagResponse * __resp )
{
  stack long __tableHandle;
  long __res, __paramLen, __bytePos;

   __bVerdict = __eVerdictPass;

  do {
    TestReportResetDiagObjectList();
    DiagSetReportDetailLevel("CVADAS_0001_00000000_000", EnumServiceDetails_onfail);
    // Request aspect
    {

      if (0 >= DiagSendReqAndWaitForResp("CVADAS_0001_00000000_000", __req, __resp, __res, -1, -1, -1, -1, -1, EnumResult_pos, EnumServiceDetails_onfail, EnumSendingMode_physical, EnumSuppressPosResBit_asconfigured, EnumVerdictOnInvalidValues_fail))
        break;
    }

    __res = DiagErrCodeTestStep(__res, "Can't retrieve last response for request! No check possible.") < 0;
    if(__res)
    {
	  __bVerdict = __eVerdictFail;
      break;
    }
    {
      __res = DiagInterpretAs(__resp, "RDBI_PR");
      if(__res != 0)
      {
        __bVerdict = __eVerdictFail;
        DiagErrCodeTestStep(__res, "Can't interpret response as diagnostic primitive 'RDBI_PR'.");
        break;
      }
      else
      {
        TestStepPass( "Received primitive can be interpreted as diagnostic primitive 'RDBI_PR'.");
      }
    }
  }
  while(0);


  // Response, check & read aspect
  {
    __res = 1;
    __tableHandle = ReportTableHead5Columns(__cCheckCaption, __cTSym, __cTOp, __cRefVal, __cActual, __cRes);
    {
      __bDiagValueArrayCtr = DiagGetParameterErrorHandled(__resp, "_EBOM_Assembly_Part_Number_24", __bDiagValueArray, elcount(__bDiagValueArray), __cDiagValueArray, elcount(__cDiagValueArray));
      {
        __bSetInCheckAlignment = 1;	
        {
          __bArrayCtr = __CopyBytes(__bDiagValueArray, __bDiagValueArrayCtr, __bArray);
          {
            sysvar * __systemVariable;
            __systemVariable = sysvarData::`PartNumber::`Part_Number;
            CheckSysVarSetBufferConsistency(sysSetVariableData(sysvarData::`PartNumber::`Part_Number, __bArray, __bArrayCtr), __systemVariable.name);
          }
          snprintf(__cArray, 8192, "%s", "Part_Number");
          snprintf(__cArray2, 8192, "%s '%s'", __cSysVar, __cArray);
          snprintf(__cArray3, 8192, "%s", "_EBOM_Assembly_Part_Number_24");
          
          ReportTableRow(__tableHandle, 0, __cArray2, __cAOp, __bArray, __bArrayCtr, __cArray3, __oneOfFlag, __bSetInCheckAlignment);
        
        }
    
        __bSetInCheckAlignment = 0;
      }
    }
    ReportTableEndVerdict(__tableHandle, __cEvaluateResponse, __res);
	__bVerdict = __bVerdict && __res;
  }
  if (__bVerdict == __eVerdictFail)
    TestReportWriteDiagObjectList();
}
  
void __diagServicevccmce9_79(DiagRequest * __req, DiagResponse * __resp )
{
  stack long __tableHandle;
  long __res, __paramLen, __bytePos;

   __bVerdict = __eVerdictPass;

  do {
    TestReportResetDiagObjectList();
    DiagSetReportDetailLevel("CVADAS_0001_00000000_000", EnumServiceDetails_onfail);
    // Request aspect
    {
      {
        __res = DiagSetParameterErrorHandled(__req, "DiagSessionType", 03);
        if(__res < 0)
        {
          __bVerdict = __eVerdictFail;
          DiagErrCodeTestStep(__res, "Cannot set diagnostic parameter 'DiagSessionType'");
          break;
        }
      }

      if (0 >= DiagSendReqAndWaitForResp("CVADAS_0001_00000000_000", __req, __resp, __res, -1, -1, -1, -1, -1, EnumResult_pos, EnumServiceDetails_onfail, EnumSendingMode_physical, EnumSuppressPosResBit_asconfigured, EnumVerdictOnInvalidValues_fail))
        break;
    }

    __res = DiagErrCodeTestStep(__res, "Can't retrieve last response for request! No check possible.") < 0;
    if(__res)
    {
	  __bVerdict = __eVerdictFail;
      break;
    }
    {
      __res = DiagInterpretAs(__resp, "DSC_PR");
      if(__res != 0)
      {
        __bVerdict = __eVerdictFail;
        DiagErrCodeTestStep(__res, "Can't interpret response as diagnostic primitive 'DSC_PR'.");
        break;
      }
      else
      {
        TestStepPass( "Received primitive can be interpreted as diagnostic primitive 'DSC_PR'.");
      }
    }
  }
  while(0);


  // Response, check & read aspect
  {
    __res = 1;
    __tableHandle = ReportTableHead5Columns(__cCheckCaption, __cTSym, __cTOp, __cRefVal, __cActual, __cRes);
    {
      double __nDiagValue;
      DiagGetParameterErrorHandled(__resp, "DiagSessionType", __nDiagValue);
      __csr = CheckSignalMatch(__nDiagValue, 03, "==") == 1;
      snprintf(__cArray, 8192, "%s", "Diagnostic parameter \'DiagSessionType\'");
      snprintf(__cArray2, 8192, "%s", __cArray);
      snprintf(__cArray3, 8192, "%s", "");
      ReportTableRow(__tableHandle, 0, __cArray2, "==", 03, __cArray3, __oneOfFlag, __bSetInCheckAlignment);
      ReportCell(__tableHandle, __nDiagValue);
      ReportCellResult(__tableHandle, __csr, __ePassFail);
    
      __res = __res && __csr;
    
    }
    ReportTableEndVerdict(__tableHandle, __cEvaluateResponse, __res);
	__bVerdict = __bVerdict && __res;
  }
  if (__bVerdict == __eVerdictFail)
    TestReportWriteDiagObjectList();
}
  
void __diagServicevccmce9_80(DiagRequest * __req, DiagResponse * __resp )
{
  stack long __tableHandle;
  long __res, __paramLen, __bytePos;

   __bVerdict = __eVerdictPass;

  do {
    TestReportResetDiagObjectList();
    DiagSetReportDetailLevel("CVADAS_0001_00000000_000", EnumServiceDetails_onfail);
    // Request aspect
    {

      if (0 >= DiagSendReqAndWaitForResp("CVADAS_0001_00000000_000", __req, __resp, __res, -1, -1, -1, -1, -1, EnumResult_pos, EnumServiceDetails_onfail, EnumSendingMode_physical, EnumSuppressPosResBit_asconfigured, EnumVerdictOnInvalidValues_fail))
        break;
    }

    __res = DiagErrCodeTestStep(__res, "Can't retrieve last response for request! No check possible.") < 0;
    if(__res)
    {
	  __bVerdict = __eVerdictFail;
      break;
    }
    {
      __res = DiagInterpretAs(__resp, "RDBI_PR");
      if(__res != 0)
      {
        __bVerdict = __eVerdictFail;
        DiagErrCodeTestStep(__res, "Can't interpret response as diagnostic primitive 'RDBI_PR'.");
        break;
      }
      else
      {
        TestStepPass( "Received primitive can be interpreted as diagnostic primitive 'RDBI_PR'.");
      }
    }
  }
  while(0);


  // Response, check & read aspect
  {
    __res = 1;
    __tableHandle = ReportTableHead5Columns(__cCheckCaption, __cTSym, __cTOp, __cRefVal, __cActual, __cRes);
    {
      __bDiagValueArrayCtr = DiagGetParameterErrorHandled(__resp, "_EBOM_Assembly_Part_Number_24", __bDiagValueArray, elcount(__bDiagValueArray), __cDiagValueArray, elcount(__cDiagValueArray));
      {
        __bSetInCheckAlignment = 1;	
        {
          __bArrayCtr = __CopyBytes(__bDiagValueArray, __bDiagValueArrayCtr, __bArray);
          {
            sysvar * __systemVariable;
            __systemVariable = sysvarData::`PartNumber::`Part_Number;
            CheckSysVarSetBufferConsistency(sysSetVariableData(sysvarData::`PartNumber::`Part_Number, __bArray, __bArrayCtr), __systemVariable.name);
          }
          snprintf(__cArray, 8192, "%s", "Part_Number");
          snprintf(__cArray2, 8192, "%s '%s'", __cSysVar, __cArray);
          snprintf(__cArray3, 8192, "%s", "_EBOM_Assembly_Part_Number_24");
          
          ReportTableRow(__tableHandle, 0, __cArray2, __cAOp, __bArray, __bArrayCtr, __cArray3, __oneOfFlag, __bSetInCheckAlignment);
        
        }
    
        __bSetInCheckAlignment = 0;
      }
    }
    ReportTableEndVerdict(__tableHandle, __cEvaluateResponse, __res);
	__bVerdict = __bVerdict && __res;
  }
  if (__bVerdict == __eVerdictFail)
    TestReportWriteDiagObjectList();
}

void Ttvccmce9_Tet_Tc13()
{
  CreateTTEIFFunction("Ttvccmce9_Tc13", __eTcDef, __eLocal);  
  AddIFParameterTestCaseAttribute("TC_ID", "");
  AddIFParameterTestCaseAttribute("Test Case ID", "");
  CallInterfaceFunction("2.5.5.4_F154", __cEmpty , __cEmpty );
}
testcase Ttvccmce9_Tc13()
{
  stack long __tableHandle;
  SetBreakOnFail(0);

  TestCommandBegin(__eDiagService, __cDiagService, "", "0");
  {
    if (DiagIsFunctionalGroup("CVADAS_0001_00000000_000"))
    {
      DiagResponse * __resp;
      DiagRequest CVADAS_0001_00000000_000.Default_Session_Start __req;
      __diagServicevccmce9_81(__req, __resp);
    }
    else
    {
      DiagResponse CVADAS_0001_00000000_000.* __resp;
      DiagRequest CVADAS_0001_00000000_000.Default_Session_Start __req;
      __diagServicevccmce9_81(__req, __resp);
    }
  }
  TestCommandEnd();


  TestCommandBegin(__eWait, __cWait, "", "1");
  {
    Wait("1", (syspar::`sleep * 1000000LL), 1000000, "sleep");
  }
  TestCommandEnd();

  TestCommandBegin(__eDiagService, __cDiagService, "", "2");
  {
    if (DiagIsFunctionalGroup("CVADAS_0001_00000000_000"))
    {
      DiagResponse * __resp;
      DiagRequest CVADAS_0001_00000000_000._22F154_Hardware_Supplier_Identification __req;
      __diagServicevccmce9_82(__req, __resp);
    }
    else
    {
      DiagResponse CVADAS_0001_00000000_000.* __resp;
      DiagRequest CVADAS_0001_00000000_000._22F154_Hardware_Supplier_Identification __req;
      __diagServicevccmce9_82(__req, __resp);
    }
  }
  TestCommandEnd();


  TestCommandBegin(__eDiagService, __cDiagService, "", "3");
  {
    if (DiagIsFunctionalGroup("CVADAS_0001_00000000_000"))
    {
      DiagResponse * __resp;
      DiagRequest CVADAS_0001_00000000_000.Extended_Diagnostic_Session_Start __req;
      __diagServicevccmce9_83(__req, __resp);
    }
    else
    {
      DiagResponse CVADAS_0001_00000000_000.* __resp;
      DiagRequest CVADAS_0001_00000000_000.Extended_Diagnostic_Session_Start __req;
      __diagServicevccmce9_83(__req, __resp);
    }
  }
  TestCommandEnd();


  TestCommandBegin(__eWait, __cWait, "", "4");
  {
    Wait("1", (syspar::`sleep * 1000000LL), 1000000, "sleep");
  }
  TestCommandEnd();

  TestCommandBegin(__eDiagService, __cDiagService, "", "5");
  {
    if (DiagIsFunctionalGroup("CVADAS_0001_00000000_000"))
    {
      DiagResponse * __resp;
      DiagRequest CVADAS_0001_00000000_000._22F154_Hardware_Supplier_Identification __req;
      __diagServicevccmce9_84(__req, __resp);
    }
    else
    {
      DiagResponse CVADAS_0001_00000000_000.* __resp;
      DiagRequest CVADAS_0001_00000000_000._22F154_Hardware_Supplier_Identification __req;
      __diagServicevccmce9_84(__req, __resp);
    }
  }
  TestCommandEnd();


}

  
void __diagServicevccmce9_81(DiagRequest * __req, DiagResponse * __resp )
{
  stack long __tableHandle;
  long __res, __paramLen, __bytePos;

   __bVerdict = __eVerdictPass;

  do {
    TestReportResetDiagObjectList();
    DiagSetReportDetailLevel("CVADAS_0001_00000000_000", EnumServiceDetails_onfail);
    // Request aspect
    {
      {
        __res = DiagSetParameterErrorHandled(__req, "DiagSessionType", 01);
        if(__res < 0)
        {
          __bVerdict = __eVerdictFail;
          DiagErrCodeTestStep(__res, "Cannot set diagnostic parameter 'DiagSessionType'");
          break;
        }
      }

      if (0 >= DiagSendReqAndWaitForResp("CVADAS_0001_00000000_000", __req, __resp, __res, -1, -1, -1, -1, -1, EnumResult_pos, EnumServiceDetails_onfail, EnumSendingMode_physical, EnumSuppressPosResBit_asconfigured, EnumVerdictOnInvalidValues_fail))
        break;
    }

    __res = DiagErrCodeTestStep(__res, "Can't retrieve last response for request! No check possible.") < 0;
    if(__res)
    {
	  __bVerdict = __eVerdictFail;
      break;
    }
    {
      __res = DiagInterpretAs(__resp, "DSC_PR");
      if(__res != 0)
      {
        __bVerdict = __eVerdictFail;
        DiagErrCodeTestStep(__res, "Can't interpret response as diagnostic primitive 'DSC_PR'.");
        break;
      }
      else
      {
        TestStepPass( "Received primitive can be interpreted as diagnostic primitive 'DSC_PR'.");
      }
    }
  }
  while(0);


  // Response, check & read aspect
  {
    __res = 1;
    __tableHandle = ReportTableHead5Columns(__cCheckCaption, __cTSym, __cTOp, __cRefVal, __cActual, __cRes);
    {
      double __nDiagValue;
      DiagGetParameterErrorHandled(__resp, "DiagSessionType", __nDiagValue);
      __csr = CheckSignalMatch(__nDiagValue, 01, "==") == 1;
      snprintf(__cArray, 8192, "%s", "Diagnostic parameter \'DiagSessionType\'");
      snprintf(__cArray2, 8192, "%s", __cArray);
      snprintf(__cArray3, 8192, "%s", "");
      ReportTableRow(__tableHandle, 0, __cArray2, "==", 01, __cArray3, __oneOfFlag, __bSetInCheckAlignment);
      ReportCell(__tableHandle, __nDiagValue);
      ReportCellResult(__tableHandle, __csr, __ePassFail);
    
      __res = __res && __csr;
    
    }
    ReportTableEndVerdict(__tableHandle, __cEvaluateResponse, __res);
	__bVerdict = __bVerdict && __res;
  }
  if (__bVerdict == __eVerdictFail)
    TestReportWriteDiagObjectList();
}
  
void __diagServicevccmce9_82(DiagRequest * __req, DiagResponse * __resp )
{
  stack long __tableHandle;
  long __res, __paramLen, __bytePos;

   __bVerdict = __eVerdictPass;

  do {
    TestReportResetDiagObjectList();
    DiagSetReportDetailLevel("CVADAS_0001_00000000_000", EnumServiceDetails_onfail);
    // Request aspect
    {

      if (0 >= DiagSendReqAndWaitForResp("CVADAS_0001_00000000_000", __req, __resp, __res, -1, -1, -1, -1, -1, EnumResult_pos, EnumServiceDetails_onfail, EnumSendingMode_physical, EnumSuppressPosResBit_asconfigured, EnumVerdictOnInvalidValues_fail))
        break;
    }

    __res = DiagErrCodeTestStep(__res, "Can't retrieve last response for request! No check possible.") < 0;
    if(__res)
    {
	  __bVerdict = __eVerdictFail;
      break;
    }
    {
      __res = DiagInterpretAs(__resp, "RDBI_PR");
      if(__res != 0)
      {
        __bVerdict = __eVerdictFail;
        DiagErrCodeTestStep(__res, "Can't interpret response as diagnostic primitive 'RDBI_PR'.");
        break;
      }
      else
      {
        TestStepPass( "Received primitive can be interpreted as diagnostic primitive 'RDBI_PR'.");
      }
    }
  }
  while(0);


  // Response, check & read aspect
  {
    __res = 1;
    __tableHandle = ReportTableHead5Columns(__cCheckCaption, __cTSym, __cTOp, __cRefVal, __cActual, __cRes);
    {
      __bDiagValueArrayCtr = DiagGetParameterErrorHandled(__resp, "_Hardware_Supplier_Identification_24", __bDiagValueArray, elcount(__bDiagValueArray), __cDiagValueArray, elcount(__cDiagValueArray));
      {
        __bSetInCheckAlignment = 1;	
        {
          __bArrayCtr = __CopyBytes(__bDiagValueArray, __bDiagValueArrayCtr, __bArray);
          {
            sysvar * __systemVariable;
            __systemVariable = sysvarData::`PartNumber::`Part_Number;
            CheckSysVarSetBufferConsistency(sysSetVariableData(sysvarData::`PartNumber::`Part_Number, __bArray, __bArrayCtr), __systemVariable.name);
          }
          snprintf(__cArray, 8192, "%s", "Part_Number");
          snprintf(__cArray2, 8192, "%s '%s'", __cSysVar, __cArray);
          snprintf(__cArray3, 8192, "%s", "_Hardware_Supplier_Identification_24");
          
          ReportTableRow(__tableHandle, 0, __cArray2, __cAOp, __bArray, __bArrayCtr, __cArray3, __oneOfFlag, __bSetInCheckAlignment);
        
        }
    
        __bSetInCheckAlignment = 0;
      }
    }
    ReportTableEndVerdict(__tableHandle, __cEvaluateResponse, __res);
	__bVerdict = __bVerdict && __res;
  }
  if (__bVerdict == __eVerdictFail)
    TestReportWriteDiagObjectList();
}
  
void __diagServicevccmce9_83(DiagRequest * __req, DiagResponse * __resp )
{
  stack long __tableHandle;
  long __res, __paramLen, __bytePos;

   __bVerdict = __eVerdictPass;

  do {
    TestReportResetDiagObjectList();
    DiagSetReportDetailLevel("CVADAS_0001_00000000_000", EnumServiceDetails_onfail);
    // Request aspect
    {
      {
        __res = DiagSetParameterErrorHandled(__req, "DiagSessionType", 03);
        if(__res < 0)
        {
          __bVerdict = __eVerdictFail;
          DiagErrCodeTestStep(__res, "Cannot set diagnostic parameter 'DiagSessionType'");
          break;
        }
      }

      if (0 >= DiagSendReqAndWaitForResp("CVADAS_0001_00000000_000", __req, __resp, __res, -1, -1, -1, -1, -1, EnumResult_pos, EnumServiceDetails_onfail, EnumSendingMode_physical, EnumSuppressPosResBit_asconfigured, EnumVerdictOnInvalidValues_fail))
        break;
    }

    __res = DiagErrCodeTestStep(__res, "Can't retrieve last response for request! No check possible.") < 0;
    if(__res)
    {
	  __bVerdict = __eVerdictFail;
      break;
    }
    {
      __res = DiagInterpretAs(__resp, "DSC_PR");
      if(__res != 0)
      {
        __bVerdict = __eVerdictFail;
        DiagErrCodeTestStep(__res, "Can't interpret response as diagnostic primitive 'DSC_PR'.");
        break;
      }
      else
      {
        TestStepPass( "Received primitive can be interpreted as diagnostic primitive 'DSC_PR'.");
      }
    }
  }
  while(0);


  // Response, check & read aspect
  {
    __res = 1;
    __tableHandle = ReportTableHead5Columns(__cCheckCaption, __cTSym, __cTOp, __cRefVal, __cActual, __cRes);
    {
      double __nDiagValue;
      DiagGetParameterErrorHandled(__resp, "DiagSessionType", __nDiagValue);
      __csr = CheckSignalMatch(__nDiagValue, 03, "==") == 1;
      snprintf(__cArray, 8192, "%s", "Diagnostic parameter \'DiagSessionType\'");
      snprintf(__cArray2, 8192, "%s", __cArray);
      snprintf(__cArray3, 8192, "%s", "");
      ReportTableRow(__tableHandle, 0, __cArray2, "==", 03, __cArray3, __oneOfFlag, __bSetInCheckAlignment);
      ReportCell(__tableHandle, __nDiagValue);
      ReportCellResult(__tableHandle, __csr, __ePassFail);
    
      __res = __res && __csr;
    
    }
    ReportTableEndVerdict(__tableHandle, __cEvaluateResponse, __res);
	__bVerdict = __bVerdict && __res;
  }
  if (__bVerdict == __eVerdictFail)
    TestReportWriteDiagObjectList();
}
  
void __diagServicevccmce9_84(DiagRequest * __req, DiagResponse * __resp )
{
  stack long __tableHandle;
  long __res, __paramLen, __bytePos;

   __bVerdict = __eVerdictPass;

  do {
    TestReportResetDiagObjectList();
    DiagSetReportDetailLevel("CVADAS_0001_00000000_000", EnumServiceDetails_onfail);
    // Request aspect
    {

      if (0 >= DiagSendReqAndWaitForResp("CVADAS_0001_00000000_000", __req, __resp, __res, -1, -1, -1, -1, -1, EnumResult_pos, EnumServiceDetails_onfail, EnumSendingMode_physical, EnumSuppressPosResBit_asconfigured, EnumVerdictOnInvalidValues_fail))
        break;
    }

    __res = DiagErrCodeTestStep(__res, "Can't retrieve last response for request! No check possible.") < 0;
    if(__res)
    {
	  __bVerdict = __eVerdictFail;
      break;
    }
    {
      __res = DiagInterpretAs(__resp, "RDBI_PR");
      if(__res != 0)
      {
        __bVerdict = __eVerdictFail;
        DiagErrCodeTestStep(__res, "Can't interpret response as diagnostic primitive 'RDBI_PR'.");
        break;
      }
      else
      {
        TestStepPass( "Received primitive can be interpreted as diagnostic primitive 'RDBI_PR'.");
      }
    }
  }
  while(0);


  // Response, check & read aspect
  {
    __res = 1;
    __tableHandle = ReportTableHead5Columns(__cCheckCaption, __cTSym, __cTOp, __cRefVal, __cActual, __cRes);
    {
      __bDiagValueArrayCtr = DiagGetParameterErrorHandled(__resp, "_Hardware_Supplier_Identification_24", __bDiagValueArray, elcount(__bDiagValueArray), __cDiagValueArray, elcount(__cDiagValueArray));
      {
        __bSetInCheckAlignment = 1;	
        {
          __bArrayCtr = __CopyBytes(__bDiagValueArray, __bDiagValueArrayCtr, __bArray);
          {
            sysvar * __systemVariable;
            __systemVariable = sysvarData::`PartNumber::`Part_Number;
            CheckSysVarSetBufferConsistency(sysSetVariableData(sysvarData::`PartNumber::`Part_Number, __bArray, __bArrayCtr), __systemVariable.name);
          }
          snprintf(__cArray, 8192, "%s", "Part_Number");
          snprintf(__cArray2, 8192, "%s '%s'", __cSysVar, __cArray);
          snprintf(__cArray3, 8192, "%s", "_Hardware_Supplier_Identification_24");
          
          ReportTableRow(__tableHandle, 0, __cArray2, __cAOp, __bArray, __bArrayCtr, __cArray3, __oneOfFlag, __bSetInCheckAlignment);
        
        }
    
        __bSetInCheckAlignment = 0;
      }
    }
    ReportTableEndVerdict(__tableHandle, __cEvaluateResponse, __res);
	__bVerdict = __bVerdict && __res;
  }
  if (__bVerdict == __eVerdictFail)
    TestReportWriteDiagObjectList();
}

void Ttvccmce9_Tet_Tc14()
{
  CreateTTEIFFunction("Ttvccmce9_Tc14", __eTcDef, __eLocal);  
  AddIFParameterTestCaseAttribute("TC_ID", "");
  AddIFParameterTestCaseAttribute("Test Case ID", "");
  CallInterfaceFunction("2.5.5.5_F155", __cEmpty , __cEmpty );
}
testcase Ttvccmce9_Tc14()
{
  stack long __tableHandle;
  SetBreakOnFail(0);

  TestCommandBegin(__eDiagService, __cDiagService, "", "0");
  {
    if (DiagIsFunctionalGroup("CVADAS_0001_00000000_000"))
    {
      DiagResponse * __resp;
      DiagRequest CVADAS_0001_00000000_000.Default_Session_Start __req;
      __diagServicevccmce9_85(__req, __resp);
    }
    else
    {
      DiagResponse CVADAS_0001_00000000_000.* __resp;
      DiagRequest CVADAS_0001_00000000_000.Default_Session_Start __req;
      __diagServicevccmce9_85(__req, __resp);
    }
  }
  TestCommandEnd();


  TestCommandBegin(__eWait, __cWait, "", "1");
  {
    Wait("1", (syspar::`sleep * 1000000LL), 1000000, "sleep");
  }
  TestCommandEnd();

  TestCommandBegin(__eDiagService, __cDiagService, "", "2");
  {
    if (DiagIsFunctionalGroup("CVADAS_0001_00000000_000"))
    {
      DiagResponse * __resp;
      DiagRequest CVADAS_0001_00000000_000._22F155_Software_Supplier_Identification __req;
      __diagServicevccmce9_86(__req, __resp);
    }
    else
    {
      DiagResponse CVADAS_0001_00000000_000.* __resp;
      DiagRequest CVADAS_0001_00000000_000._22F155_Software_Supplier_Identification __req;
      __diagServicevccmce9_86(__req, __resp);
    }
  }
  TestCommandEnd();


  TestCommandBegin(__eDiagService, __cDiagService, "", "3");
  {
    if (DiagIsFunctionalGroup("CVADAS_0001_00000000_000"))
    {
      DiagResponse * __resp;
      DiagRequest CVADAS_0001_00000000_000.Extended_Diagnostic_Session_Start __req;
      __diagServicevccmce9_87(__req, __resp);
    }
    else
    {
      DiagResponse CVADAS_0001_00000000_000.* __resp;
      DiagRequest CVADAS_0001_00000000_000.Extended_Diagnostic_Session_Start __req;
      __diagServicevccmce9_87(__req, __resp);
    }
  }
  TestCommandEnd();


  TestCommandBegin(__eWait, __cWait, "", "4");
  {
    Wait("1", (syspar::`sleep * 1000000LL), 1000000, "sleep");
  }
  TestCommandEnd();

  TestCommandBegin(__eDiagService, __cDiagService, "", "5");
  {
    if (DiagIsFunctionalGroup("CVADAS_0001_00000000_000"))
    {
      DiagResponse * __resp;
      DiagRequest CVADAS_0001_00000000_000._22F155_Software_Supplier_Identification __req;
      __diagServicevccmce9_88(__req, __resp);
    }
    else
    {
      DiagResponse CVADAS_0001_00000000_000.* __resp;
      DiagRequest CVADAS_0001_00000000_000._22F155_Software_Supplier_Identification __req;
      __diagServicevccmce9_88(__req, __resp);
    }
  }
  TestCommandEnd();


}

  
void __diagServicevccmce9_85(DiagRequest * __req, DiagResponse * __resp )
{
  stack long __tableHandle;
  long __res, __paramLen, __bytePos;

   __bVerdict = __eVerdictPass;

  do {
    TestReportResetDiagObjectList();
    DiagSetReportDetailLevel("CVADAS_0001_00000000_000", EnumServiceDetails_onfail);
    // Request aspect
    {
      {
        __res = DiagSetParameterErrorHandled(__req, "DiagSessionType", 01);
        if(__res < 0)
        {
          __bVerdict = __eVerdictFail;
          DiagErrCodeTestStep(__res, "Cannot set diagnostic parameter 'DiagSessionType'");
          break;
        }
      }

      if (0 >= DiagSendReqAndWaitForResp("CVADAS_0001_00000000_000", __req, __resp, __res, -1, -1, -1, -1, -1, EnumResult_pos, EnumServiceDetails_onfail, EnumSendingMode_physical, EnumSuppressPosResBit_asconfigured, EnumVerdictOnInvalidValues_fail))
        break;
    }

    __res = DiagErrCodeTestStep(__res, "Can't retrieve last response for request! No check possible.") < 0;
    if(__res)
    {
	  __bVerdict = __eVerdictFail;
      break;
    }
    {
      __res = DiagInterpretAs(__resp, "DSC_PR");
      if(__res != 0)
      {
        __bVerdict = __eVerdictFail;
        DiagErrCodeTestStep(__res, "Can't interpret response as diagnostic primitive 'DSC_PR'.");
        break;
      }
      else
      {
        TestStepPass( "Received primitive can be interpreted as diagnostic primitive 'DSC_PR'.");
      }
    }
  }
  while(0);


  // Response, check & read aspect
  {
    __res = 1;
    __tableHandle = ReportTableHead5Columns(__cCheckCaption, __cTSym, __cTOp, __cRefVal, __cActual, __cRes);
    {
      double __nDiagValue;
      DiagGetParameterErrorHandled(__resp, "DiagSessionType", __nDiagValue);
      __csr = CheckSignalMatch(__nDiagValue, 01, "==") == 1;
      snprintf(__cArray, 8192, "%s", "Diagnostic parameter \'DiagSessionType\'");
      snprintf(__cArray2, 8192, "%s", __cArray);
      snprintf(__cArray3, 8192, "%s", "");
      ReportTableRow(__tableHandle, 0, __cArray2, "==", 01, __cArray3, __oneOfFlag, __bSetInCheckAlignment);
      ReportCell(__tableHandle, __nDiagValue);
      ReportCellResult(__tableHandle, __csr, __ePassFail);
    
      __res = __res && __csr;
    
    }
    ReportTableEndVerdict(__tableHandle, __cEvaluateResponse, __res);
	__bVerdict = __bVerdict && __res;
  }
  if (__bVerdict == __eVerdictFail)
    TestReportWriteDiagObjectList();
}
  
void __diagServicevccmce9_86(DiagRequest * __req, DiagResponse * __resp )
{
  stack long __tableHandle;
  long __res, __paramLen, __bytePos;

   __bVerdict = __eVerdictPass;

  do {
    TestReportResetDiagObjectList();
    DiagSetReportDetailLevel("CVADAS_0001_00000000_000", EnumServiceDetails_onfail);
    // Request aspect
    {

      if (0 >= DiagSendReqAndWaitForResp("CVADAS_0001_00000000_000", __req, __resp, __res, -1, -1, -1, -1, -1, EnumResult_pos, EnumServiceDetails_onfail, EnumSendingMode_physical, EnumSuppressPosResBit_asconfigured, EnumVerdictOnInvalidValues_fail))
        break;
    }

    __res = DiagErrCodeTestStep(__res, "Can't retrieve last response for request! No check possible.") < 0;
    if(__res)
    {
	  __bVerdict = __eVerdictFail;
      break;
    }
    {
      __res = DiagInterpretAs(__resp, "RDBI_PR");
      if(__res != 0)
      {
        __bVerdict = __eVerdictFail;
        DiagErrCodeTestStep(__res, "Can't interpret response as diagnostic primitive 'RDBI_PR'.");
        break;
      }
      else
      {
        TestStepPass( "Received primitive can be interpreted as diagnostic primitive 'RDBI_PR'.");
      }
    }
  }
  while(0);


  // Response, check & read aspect
  {
    __res = 1;
    __tableHandle = ReportTableHead5Columns(__cCheckCaption, __cTSym, __cTOp, __cRefVal, __cActual, __cRes);
    {
      __bDiagValueArrayCtr = DiagGetParameterErrorHandled(__resp, "_Software_Supplier_Identification_24", __bDiagValueArray, elcount(__bDiagValueArray), __cDiagValueArray, elcount(__cDiagValueArray));
      {
        __bSetInCheckAlignment = 1;	
        {
          __bArrayCtr = __CopyBytes(__bDiagValueArray, __bDiagValueArrayCtr, __bArray);
          {
            sysvar * __systemVariable;
            __systemVariable = sysvarData::`PartNumber::`Part_Number;
            CheckSysVarSetBufferConsistency(sysSetVariableData(sysvarData::`PartNumber::`Part_Number, __bArray, __bArrayCtr), __systemVariable.name);
          }
          snprintf(__cArray, 8192, "%s", "Part_Number");
          snprintf(__cArray2, 8192, "%s '%s'", __cSysVar, __cArray);
          snprintf(__cArray3, 8192, "%s", "_Software_Supplier_Identification_24");
          
          ReportTableRow(__tableHandle, 0, __cArray2, __cAOp, __bArray, __bArrayCtr, __cArray3, __oneOfFlag, __bSetInCheckAlignment);
        
        }
    
        __bSetInCheckAlignment = 0;
      }
    }
    ReportTableEndVerdict(__tableHandle, __cEvaluateResponse, __res);
	__bVerdict = __bVerdict && __res;
  }
  if (__bVerdict == __eVerdictFail)
    TestReportWriteDiagObjectList();
}
  
void __diagServicevccmce9_87(DiagRequest * __req, DiagResponse * __resp )
{
  stack long __tableHandle;
  long __res, __paramLen, __bytePos;

   __bVerdict = __eVerdictPass;

  do {
    TestReportResetDiagObjectList();
    DiagSetReportDetailLevel("CVADAS_0001_00000000_000", EnumServiceDetails_onfail);
    // Request aspect
    {
      {
        __res = DiagSetParameterErrorHandled(__req, "DiagSessionType", 03);
        if(__res < 0)
        {
          __bVerdict = __eVerdictFail;
          DiagErrCodeTestStep(__res, "Cannot set diagnostic parameter 'DiagSessionType'");
          break;
        }
      }

      if (0 >= DiagSendReqAndWaitForResp("CVADAS_0001_00000000_000", __req, __resp, __res, -1, -1, -1, -1, -1, EnumResult_pos, EnumServiceDetails_onfail, EnumSendingMode_physical, EnumSuppressPosResBit_asconfigured, EnumVerdictOnInvalidValues_fail))
        break;
    }

    __res = DiagErrCodeTestStep(__res, "Can't retrieve last response for request! No check possible.") < 0;
    if(__res)
    {
	  __bVerdict = __eVerdictFail;
      break;
    }
    {
      __res = DiagInterpretAs(__resp, "DSC_PR");
      if(__res != 0)
      {
        __bVerdict = __eVerdictFail;
        DiagErrCodeTestStep(__res, "Can't interpret response as diagnostic primitive 'DSC_PR'.");
        break;
      }
      else
      {
        TestStepPass( "Received primitive can be interpreted as diagnostic primitive 'DSC_PR'.");
      }
    }
  }
  while(0);


  // Response, check & read aspect
  {
    __res = 1;
    __tableHandle = ReportTableHead5Columns(__cCheckCaption, __cTSym, __cTOp, __cRefVal, __cActual, __cRes);
    {
      double __nDiagValue;
      DiagGetParameterErrorHandled(__resp, "DiagSessionType", __nDiagValue);
      __csr = CheckSignalMatch(__nDiagValue, 03, "==") == 1;
      snprintf(__cArray, 8192, "%s", "Diagnostic parameter \'DiagSessionType\'");
      snprintf(__cArray2, 8192, "%s", __cArray);
      snprintf(__cArray3, 8192, "%s", "");
      ReportTableRow(__tableHandle, 0, __cArray2, "==", 03, __cArray3, __oneOfFlag, __bSetInCheckAlignment);
      ReportCell(__tableHandle, __nDiagValue);
      ReportCellResult(__tableHandle, __csr, __ePassFail);
    
      __res = __res && __csr;
    
    }
    ReportTableEndVerdict(__tableHandle, __cEvaluateResponse, __res);
	__bVerdict = __bVerdict && __res;
  }
  if (__bVerdict == __eVerdictFail)
    TestReportWriteDiagObjectList();
}
  
void __diagServicevccmce9_88(DiagRequest * __req, DiagResponse * __resp )
{
  stack long __tableHandle;
  long __res, __paramLen, __bytePos;

   __bVerdict = __eVerdictPass;

  do {
    TestReportResetDiagObjectList();
    DiagSetReportDetailLevel("CVADAS_0001_00000000_000", EnumServiceDetails_onfail);
    // Request aspect
    {

      if (0 >= DiagSendReqAndWaitForResp("CVADAS_0001_00000000_000", __req, __resp, __res, -1, -1, -1, -1, -1, EnumResult_pos, EnumServiceDetails_onfail, EnumSendingMode_physical, EnumSuppressPosResBit_asconfigured, EnumVerdictOnInvalidValues_fail))
        break;
    }

    __res = DiagErrCodeTestStep(__res, "Can't retrieve last response for request! No check possible.") < 0;
    if(__res)
    {
	  __bVerdict = __eVerdictFail;
      break;
    }
    {
      __res = DiagInterpretAs(__resp, "RDBI_PR");
      if(__res != 0)
      {
        __bVerdict = __eVerdictFail;
        DiagErrCodeTestStep(__res, "Can't interpret response as diagnostic primitive 'RDBI_PR'.");
        break;
      }
      else
      {
        TestStepPass( "Received primitive can be interpreted as diagnostic primitive 'RDBI_PR'.");
      }
    }
  }
  while(0);


  // Response, check & read aspect
  {
    __res = 1;
    __tableHandle = ReportTableHead5Columns(__cCheckCaption, __cTSym, __cTOp, __cRefVal, __cActual, __cRes);
    {
      __bDiagValueArrayCtr = DiagGetParameterErrorHandled(__resp, "_Software_Supplier_Identification_24", __bDiagValueArray, elcount(__bDiagValueArray), __cDiagValueArray, elcount(__cDiagValueArray));
      {
        __bSetInCheckAlignment = 1;	
        {
          __bArrayCtr = __CopyBytes(__bDiagValueArray, __bDiagValueArrayCtr, __bArray);
          {
            sysvar * __systemVariable;
            __systemVariable = sysvarData::`PartNumber::`Part_Number;
            CheckSysVarSetBufferConsistency(sysSetVariableData(sysvarData::`PartNumber::`Part_Number, __bArray, __bArrayCtr), __systemVariable.name);
          }
          snprintf(__cArray, 8192, "%s", "Part_Number");
          snprintf(__cArray2, 8192, "%s '%s'", __cSysVar, __cArray);
          snprintf(__cArray3, 8192, "%s", "_Software_Supplier_Identification_24");
          
          ReportTableRow(__tableHandle, 0, __cArray2, __cAOp, __bArray, __bArrayCtr, __cArray3, __oneOfFlag, __bSetInCheckAlignment);
        
        }
    
        __bSetInCheckAlignment = 0;
      }
    }
    ReportTableEndVerdict(__tableHandle, __cEvaluateResponse, __res);
	__bVerdict = __bVerdict && __res;
  }
  if (__bVerdict == __eVerdictFail)
    TestReportWriteDiagObjectList();
}

void Ttvccmce9_Tet_Tc15()
{
  CreateTTEIFFunction("Ttvccmce9_Tc15", __eTcDef, __eLocal);  
  AddIFParameterTestCaseAttribute("TC_ID", "");
  AddIFParameterTestCaseAttribute("Test Case ID", "");
  CallInterfaceFunction("2.5.5.6_F180", __cEmpty , __cEmpty );
}
testcase Ttvccmce9_Tc15()
{
  stack long __tableHandle;
  SetBreakOnFail(0);

  TestCommandBegin(__eDiagService, __cDiagService, "", "0");
  {
    if (DiagIsFunctionalGroup("CVADAS_0001_00000000_000"))
    {
      DiagResponse * __resp;
      DiagRequest CVADAS_0001_00000000_000.Default_Session_Start __req;
      __diagServicevccmce9_89(__req, __resp);
    }
    else
    {
      DiagResponse CVADAS_0001_00000000_000.* __resp;
      DiagRequest CVADAS_0001_00000000_000.Default_Session_Start __req;
      __diagServicevccmce9_89(__req, __resp);
    }
  }
  TestCommandEnd();


  TestCommandBegin(__eWait, __cWait, "", "1");
  {
    Wait("1", (syspar::`sleep * 1000000LL), 1000000, "sleep");
  }
  TestCommandEnd();

  TestCommandBegin(__eDiagService, __cDiagService, "", "2");
  {
    if (DiagIsFunctionalGroup("CVADAS_0001_00000000_000"))
    {
      DiagResponse * __resp;
      DiagRequest CVADAS_0001_00000000_000._22F180_Boot_Software_Version_Information __req;
      __diagServicevccmce9_90(__req, __resp);
    }
    else
    {
      DiagResponse CVADAS_0001_00000000_000.* __resp;
      DiagRequest CVADAS_0001_00000000_000._22F180_Boot_Software_Version_Information __req;
      __diagServicevccmce9_90(__req, __resp);
    }
  }
  TestCommandEnd();


  TestCommandBegin(__eDiagService, __cDiagService, "", "3");
  {
    if (DiagIsFunctionalGroup("CVADAS_0001_00000000_000"))
    {
      DiagResponse * __resp;
      DiagRequest CVADAS_0001_00000000_000.Extended_Diagnostic_Session_Start __req;
      __diagServicevccmce9_91(__req, __resp);
    }
    else
    {
      DiagResponse CVADAS_0001_00000000_000.* __resp;
      DiagRequest CVADAS_0001_00000000_000.Extended_Diagnostic_Session_Start __req;
      __diagServicevccmce9_91(__req, __resp);
    }
  }
  TestCommandEnd();


  TestCommandBegin(__eWait, __cWait, "", "4");
  {
    Wait("1", (syspar::`sleep * 1000000LL), 1000000, "sleep");
  }
  TestCommandEnd();

  TestCommandBegin(__eDiagService, __cDiagService, "", "5");
  {
    if (DiagIsFunctionalGroup("CVADAS_0001_00000000_000"))
    {
      DiagResponse * __resp;
      DiagRequest CVADAS_0001_00000000_000._22F180_Boot_Software_Version_Information __req;
      __diagServicevccmce9_92(__req, __resp);
    }
    else
    {
      DiagResponse CVADAS_0001_00000000_000.* __resp;
      DiagRequest CVADAS_0001_00000000_000._22F180_Boot_Software_Version_Information __req;
      __diagServicevccmce9_92(__req, __resp);
    }
  }
  TestCommandEnd();


}

  
void __diagServicevccmce9_89(DiagRequest * __req, DiagResponse * __resp )
{
  stack long __tableHandle;
  long __res, __paramLen, __bytePos;

   __bVerdict = __eVerdictPass;

  do {
    TestReportResetDiagObjectList();
    DiagSetReportDetailLevel("CVADAS_0001_00000000_000", EnumServiceDetails_onfail);
    // Request aspect
    {
      {
        __res = DiagSetParameterErrorHandled(__req, "DiagSessionType", 01);
        if(__res < 0)
        {
          __bVerdict = __eVerdictFail;
          DiagErrCodeTestStep(__res, "Cannot set diagnostic parameter 'DiagSessionType'");
          break;
        }
      }

      if (0 >= DiagSendReqAndWaitForResp("CVADAS_0001_00000000_000", __req, __resp, __res, -1, -1, -1, -1, -1, EnumResult_pos, EnumServiceDetails_onfail, EnumSendingMode_physical, EnumSuppressPosResBit_asconfigured, EnumVerdictOnInvalidValues_fail))
        break;
    }

    __res = DiagErrCodeTestStep(__res, "Can't retrieve last response for request! No check possible.") < 0;
    if(__res)
    {
	  __bVerdict = __eVerdictFail;
      break;
    }
    {
      __res = DiagInterpretAs(__resp, "DSC_PR");
      if(__res != 0)
      {
        __bVerdict = __eVerdictFail;
        DiagErrCodeTestStep(__res, "Can't interpret response as diagnostic primitive 'DSC_PR'.");
        break;
      }
      else
      {
        TestStepPass( "Received primitive can be interpreted as diagnostic primitive 'DSC_PR'.");
      }
    }
  }
  while(0);


  // Response, check & read aspect
  {
    __res = 1;
    __tableHandle = ReportTableHead5Columns(__cCheckCaption, __cTSym, __cTOp, __cRefVal, __cActual, __cRes);
    {
      double __nDiagValue;
      DiagGetParameterErrorHandled(__resp, "DiagSessionType", __nDiagValue);
      __csr = CheckSignalMatch(__nDiagValue, 01, "==") == 1;
      snprintf(__cArray, 8192, "%s", "Diagnostic parameter \'DiagSessionType\'");
      snprintf(__cArray2, 8192, "%s", __cArray);
      snprintf(__cArray3, 8192, "%s", "");
      ReportTableRow(__tableHandle, 0, __cArray2, "==", 01, __cArray3, __oneOfFlag, __bSetInCheckAlignment);
      ReportCell(__tableHandle, __nDiagValue);
      ReportCellResult(__tableHandle, __csr, __ePassFail);
    
      __res = __res && __csr;
    
    }
    ReportTableEndVerdict(__tableHandle, __cEvaluateResponse, __res);
	__bVerdict = __bVerdict && __res;
  }
  if (__bVerdict == __eVerdictFail)
    TestReportWriteDiagObjectList();
}
  
void __diagServicevccmce9_90(DiagRequest * __req, DiagResponse * __resp )
{
  stack long __tableHandle;
  long __res, __paramLen, __bytePos;

   __bVerdict = __eVerdictPass;

  do {
    TestReportResetDiagObjectList();
    DiagSetReportDetailLevel("CVADAS_0001_00000000_000", EnumServiceDetails_onfail);
    // Request aspect
    {

      if (0 >= DiagSendReqAndWaitForResp("CVADAS_0001_00000000_000", __req, __resp, __res, -1, -1, -1, -1, -1, EnumResult_pos, EnumServiceDetails_onfail, EnumSendingMode_physical, EnumSuppressPosResBit_asconfigured, EnumVerdictOnInvalidValues_fail))
        break;
    }

    __res = DiagErrCodeTestStep(__res, "Can't retrieve last response for request! No check possible.") < 0;
    if(__res)
    {
	  __bVerdict = __eVerdictFail;
      break;
    }
    {
      __res = DiagInterpretAs(__resp, "RDBI_PR");
      if(__res != 0)
      {
        __bVerdict = __eVerdictFail;
        DiagErrCodeTestStep(__res, "Can't interpret response as diagnostic primitive 'RDBI_PR'.");
        break;
      }
      else
      {
        TestStepPass( "Received primitive can be interpreted as diagnostic primitive 'RDBI_PR'.");
      }
    }
  }
  while(0);


  // Response, check & read aspect
  {
    __res = 1;
    __tableHandle = ReportTableHead5Columns(__cCheckCaption, __cTSym, __cTOp, __cRefVal, __cActual, __cRes);
    {
      __bDiagValueArrayCtr = DiagGetParameterErrorHandled(__resp, "_Number_of_Boot_Software_Logical_Blocks_24", __bDiagValueArray, elcount(__bDiagValueArray), __cDiagValueArray, elcount(__cDiagValueArray));
      {
        __bSetInCheckAlignment = 1;	
        {
          __bArrayCtr = __CopyBytes(__bDiagValueArray, __bDiagValueArrayCtr, __bArray);
          {
            sysvar * __systemVariable;
            __systemVariable = sysvarData::`PartNumber::`Part_Number;
            CheckSysVarSetBufferConsistency(sysSetVariableData(sysvarData::`PartNumber::`Part_Number, __bArray, __bArrayCtr), __systemVariable.name);
          }
          snprintf(__cArray, 8192, "%s", "Part_Number");
          snprintf(__cArray2, 8192, "%s '%s'", __cSysVar, __cArray);
          snprintf(__cArray3, 8192, "%s", "_Number_of_Boot_Software_Logical_Blocks_24");
          
          ReportTableRow(__tableHandle, 0, __cArray2, __cAOp, __bArray, __bArrayCtr, __cArray3, __oneOfFlag, __bSetInCheckAlignment);
        
        }
    
        __bSetInCheckAlignment = 0;
      }
    }
    {
      __bDiagValueArrayCtr = DiagGetParameterErrorHandled(__resp, "_SW_Year_32", __bDiagValueArray, elcount(__bDiagValueArray), __cDiagValueArray, elcount(__cDiagValueArray));
      {
        __bSetInCheckAlignment = 1;	
        {
          __bArrayCtr = __CopyBytes(__bDiagValueArray, __bDiagValueArrayCtr, __bArray);
          {
            sysvar * __systemVariable;
            __systemVariable = sysvarData::`PartNumber::`Part_Number;
            CheckSysVarSetBufferConsistency(sysSetVariableData(sysvarData::`PartNumber::`Part_Number, __bArray, __bArrayCtr), __systemVariable.name);
          }
          snprintf(__cArray, 8192, "%s", "Part_Number");
          snprintf(__cArray2, 8192, "%s '%s'", __cSysVar, __cArray);
          snprintf(__cArray3, 8192, "%s", "_SW_Year_32");
          
          ReportTableRow(__tableHandle, 0, __cArray2, __cAOp, __bArray, __bArrayCtr, __cArray3, __oneOfFlag, __bSetInCheckAlignment);
        
        }
    
        __bSetInCheckAlignment = 0;
      }
    }
    {
      __bDiagValueArrayCtr = DiagGetParameterErrorHandled(__resp, "_SW__Identification_56", __bDiagValueArray, elcount(__bDiagValueArray), __cDiagValueArray, elcount(__cDiagValueArray));
      {
        __bSetInCheckAlignment = 1;	
        {
          __bArrayCtr = __CopyBytes(__bDiagValueArray, __bDiagValueArrayCtr, __bArray);
          {
            sysvar * __systemVariable;
            __systemVariable = sysvarData::`PartNumber::`Part_Number;
            CheckSysVarSetBufferConsistency(sysSetVariableData(sysvarData::`PartNumber::`Part_Number, __bArray, __bArrayCtr), __systemVariable.name);
          }
          snprintf(__cArray, 8192, "%s", "Part_Number");
          snprintf(__cArray2, 8192, "%s '%s'", __cSysVar, __cArray);
          snprintf(__cArray3, 8192, "%s", "_SW__Identification_56");
          
          ReportTableRow(__tableHandle, 0, __cArray2, __cAOp, __bArray, __bArrayCtr, __cArray3, __oneOfFlag, __bSetInCheckAlignment);
        
        }
    
        __bSetInCheckAlignment = 0;
      }
    }
    {
      __bDiagValueArrayCtr = DiagGetParameterErrorHandled(__resp, "_SW__Patch_Level_48", __bDiagValueArray, elcount(__bDiagValueArray), __cDiagValueArray, elcount(__cDiagValueArray));
      {
        __bSetInCheckAlignment = 1;	
        {
          __bArrayCtr = __CopyBytes(__bDiagValueArray, __bDiagValueArrayCtr, __bArray);
          {
            sysvar * __systemVariable;
            __systemVariable = sysvarData::`PartNumber::`Part_Number;
            CheckSysVarSetBufferConsistency(sysSetVariableData(sysvarData::`PartNumber::`Part_Number, __bArray, __bArrayCtr), __systemVariable.name);
          }
          snprintf(__cArray, 8192, "%s", "Part_Number");
          snprintf(__cArray2, 8192, "%s '%s'", __cSysVar, __cArray);
          snprintf(__cArray3, 8192, "%s", "_SW__Patch_Level_48");
          
          ReportTableRow(__tableHandle, 0, __cArray2, __cAOp, __bArray, __bArrayCtr, __cArray3, __oneOfFlag, __bSetInCheckAlignment);
        
        }
    
        __bSetInCheckAlignment = 0;
      }
    }
    {
      __bDiagValueArrayCtr = DiagGetParameterErrorHandled(__resp, "_SW__Week_40", __bDiagValueArray, elcount(__bDiagValueArray), __cDiagValueArray, elcount(__cDiagValueArray));
      {
        __bSetInCheckAlignment = 1;	
        {
          __bArrayCtr = __CopyBytes(__bDiagValueArray, __bDiagValueArrayCtr, __bArray);
          {
            sysvar * __systemVariable;
            __systemVariable = sysvarData::`PartNumber::`Part_Number;
            CheckSysVarSetBufferConsistency(sysSetVariableData(sysvarData::`PartNumber::`Part_Number, __bArray, __bArrayCtr), __systemVariable.name);
          }
          snprintf(__cArray, 8192, "%s", "Part_Number");
          snprintf(__cArray2, 8192, "%s '%s'", __cSysVar, __cArray);
          snprintf(__cArray3, 8192, "%s", "_SW__Week_40");
          
          ReportTableRow(__tableHandle, 0, __cArray2, __cAOp, __bArray, __bArrayCtr, __cArray3, __oneOfFlag, __bSetInCheckAlignment);
        
        }
    
        __bSetInCheckAlignment = 0;
      }
    }
    ReportTableEndVerdict(__tableHandle, __cEvaluateResponse, __res);
	__bVerdict = __bVerdict && __res;
  }
  if (__bVerdict == __eVerdictFail)
    TestReportWriteDiagObjectList();
}
  
void __diagServicevccmce9_91(DiagRequest * __req, DiagResponse * __resp )
{
  stack long __tableHandle;
  long __res, __paramLen, __bytePos;

   __bVerdict = __eVerdictPass;

  do {
    TestReportResetDiagObjectList();
    DiagSetReportDetailLevel("CVADAS_0001_00000000_000", EnumServiceDetails_onfail);
    // Request aspect
    {
      {
        __res = DiagSetParameterErrorHandled(__req, "DiagSessionType", 03);
        if(__res < 0)
        {
          __bVerdict = __eVerdictFail;
          DiagErrCodeTestStep(__res, "Cannot set diagnostic parameter 'DiagSessionType'");
          break;
        }
      }

      if (0 >= DiagSendReqAndWaitForResp("CVADAS_0001_00000000_000", __req, __resp, __res, -1, -1, -1, -1, -1, EnumResult_pos, EnumServiceDetails_onfail, EnumSendingMode_physical, EnumSuppressPosResBit_asconfigured, EnumVerdictOnInvalidValues_fail))
        break;
    }

    __res = DiagErrCodeTestStep(__res, "Can't retrieve last response for request! No check possible.") < 0;
    if(__res)
    {
	  __bVerdict = __eVerdictFail;
      break;
    }
    {
      __res = DiagInterpretAs(__resp, "DSC_PR");
      if(__res != 0)
      {
        __bVerdict = __eVerdictFail;
        DiagErrCodeTestStep(__res, "Can't interpret response as diagnostic primitive 'DSC_PR'.");
        break;
      }
      else
      {
        TestStepPass( "Received primitive can be interpreted as diagnostic primitive 'DSC_PR'.");
      }
    }
  }
  while(0);


  // Response, check & read aspect
  {
    __res = 1;
    __tableHandle = ReportTableHead5Columns(__cCheckCaption, __cTSym, __cTOp, __cRefVal, __cActual, __cRes);
    {
      double __nDiagValue;
      DiagGetParameterErrorHandled(__resp, "DiagSessionType", __nDiagValue);
      __csr = CheckSignalMatch(__nDiagValue, 03, "==") == 1;
      snprintf(__cArray, 8192, "%s", "Diagnostic parameter \'DiagSessionType\'");
      snprintf(__cArray2, 8192, "%s", __cArray);
      snprintf(__cArray3, 8192, "%s", "");
      ReportTableRow(__tableHandle, 0, __cArray2, "==", 03, __cArray3, __oneOfFlag, __bSetInCheckAlignment);
      ReportCell(__tableHandle, __nDiagValue);
      ReportCellResult(__tableHandle, __csr, __ePassFail);
    
      __res = __res && __csr;
    
    }
    ReportTableEndVerdict(__tableHandle, __cEvaluateResponse, __res);
	__bVerdict = __bVerdict && __res;
  }
  if (__bVerdict == __eVerdictFail)
    TestReportWriteDiagObjectList();
}
  
void __diagServicevccmce9_92(DiagRequest * __req, DiagResponse * __resp )
{
  stack long __tableHandle;
  long __res, __paramLen, __bytePos;

   __bVerdict = __eVerdictPass;

  do {
    TestReportResetDiagObjectList();
    DiagSetReportDetailLevel("CVADAS_0001_00000000_000", EnumServiceDetails_onfail);
    // Request aspect
    {

      if (0 >= DiagSendReqAndWaitForResp("CVADAS_0001_00000000_000", __req, __resp, __res, -1, -1, -1, -1, -1, EnumResult_pos, EnumServiceDetails_onfail, EnumSendingMode_physical, EnumSuppressPosResBit_asconfigured, EnumVerdictOnInvalidValues_fail))
        break;
    }

    __res = DiagErrCodeTestStep(__res, "Can't retrieve last response for request! No check possible.") < 0;
    if(__res)
    {
	  __bVerdict = __eVerdictFail;
      break;
    }
    {
      __res = DiagInterpretAs(__resp, "RDBI_PR");
      if(__res != 0)
      {
        __bVerdict = __eVerdictFail;
        DiagErrCodeTestStep(__res, "Can't interpret response as diagnostic primitive 'RDBI_PR'.");
        break;
      }
      else
      {
        TestStepPass( "Received primitive can be interpreted as diagnostic primitive 'RDBI_PR'.");
      }
    }
  }
  while(0);


  // Response, check & read aspect
  {
    __res = 1;
    __tableHandle = ReportTableHead5Columns(__cCheckCaption, __cTSym, __cTOp, __cRefVal, __cActual, __cRes);
    {
      __bDiagValueArrayCtr = DiagGetParameterErrorHandled(__resp, "_Number_of_Boot_Software_Logical_Blocks_24", __bDiagValueArray, elcount(__bDiagValueArray), __cDiagValueArray, elcount(__cDiagValueArray));
      {
        __bSetInCheckAlignment = 1;	
        {
          __bArrayCtr = __CopyBytes(__bDiagValueArray, __bDiagValueArrayCtr, __bArray);
          {
            sysvar * __systemVariable;
            __systemVariable = sysvarData::`PartNumber::`Part_Number;
            CheckSysVarSetBufferConsistency(sysSetVariableData(sysvarData::`PartNumber::`Part_Number, __bArray, __bArrayCtr), __systemVariable.name);
          }
          snprintf(__cArray, 8192, "%s", "Part_Number");
          snprintf(__cArray2, 8192, "%s '%s'", __cSysVar, __cArray);
          snprintf(__cArray3, 8192, "%s", "_Number_of_Boot_Software_Logical_Blocks_24");
          
          ReportTableRow(__tableHandle, 0, __cArray2, __cAOp, __bArray, __bArrayCtr, __cArray3, __oneOfFlag, __bSetInCheckAlignment);
        
        }
    
        __bSetInCheckAlignment = 0;
      }
    }
    {
      __bDiagValueArrayCtr = DiagGetParameterErrorHandled(__resp, "_SW_Year_32", __bDiagValueArray, elcount(__bDiagValueArray), __cDiagValueArray, elcount(__cDiagValueArray));
      {
        __bSetInCheckAlignment = 1;	
        {
          __bArrayCtr = __CopyBytes(__bDiagValueArray, __bDiagValueArrayCtr, __bArray);
          {
            sysvar * __systemVariable;
            __systemVariable = sysvarData::`PartNumber::`Part_Number;
            CheckSysVarSetBufferConsistency(sysSetVariableData(sysvarData::`PartNumber::`Part_Number, __bArray, __bArrayCtr), __systemVariable.name);
          }
          snprintf(__cArray, 8192, "%s", "Part_Number");
          snprintf(__cArray2, 8192, "%s '%s'", __cSysVar, __cArray);
          snprintf(__cArray3, 8192, "%s", "_SW_Year_32");
          
          ReportTableRow(__tableHandle, 0, __cArray2, __cAOp, __bArray, __bArrayCtr, __cArray3, __oneOfFlag, __bSetInCheckAlignment);
        
        }
    
        __bSetInCheckAlignment = 0;
      }
    }
    {
      __bDiagValueArrayCtr = DiagGetParameterErrorHandled(__resp, "_SW__Identification_56", __bDiagValueArray, elcount(__bDiagValueArray), __cDiagValueArray, elcount(__cDiagValueArray));
      {
        __bSetInCheckAlignment = 1;	
        {
          __bArrayCtr = __CopyBytes(__bDiagValueArray, __bDiagValueArrayCtr, __bArray);
          {
            sysvar * __systemVariable;
            __systemVariable = sysvarData::`PartNumber::`Part_Number;
            CheckSysVarSetBufferConsistency(sysSetVariableData(sysvarData::`PartNumber::`Part_Number, __bArray, __bArrayCtr), __systemVariable.name);
          }
          snprintf(__cArray, 8192, "%s", "Part_Number");
          snprintf(__cArray2, 8192, "%s '%s'", __cSysVar, __cArray);
          snprintf(__cArray3, 8192, "%s", "_SW__Identification_56");
          
          ReportTableRow(__tableHandle, 0, __cArray2, __cAOp, __bArray, __bArrayCtr, __cArray3, __oneOfFlag, __bSetInCheckAlignment);
        
        }
    
        __bSetInCheckAlignment = 0;
      }
    }
    {
      __bDiagValueArrayCtr = DiagGetParameterErrorHandled(__resp, "_SW__Patch_Level_48", __bDiagValueArray, elcount(__bDiagValueArray), __cDiagValueArray, elcount(__cDiagValueArray));
      {
        __bSetInCheckAlignment = 1;	
        {
          __bArrayCtr = __CopyBytes(__bDiagValueArray, __bDiagValueArrayCtr, __bArray);
          {
            sysvar * __systemVariable;
            __systemVariable = sysvarData::`PartNumber::`Part_Number;
            CheckSysVarSetBufferConsistency(sysSetVariableData(sysvarData::`PartNumber::`Part_Number, __bArray, __bArrayCtr), __systemVariable.name);
          }
          snprintf(__cArray, 8192, "%s", "Part_Number");
          snprintf(__cArray2, 8192, "%s '%s'", __cSysVar, __cArray);
          snprintf(__cArray3, 8192, "%s", "_SW__Patch_Level_48");
          
          ReportTableRow(__tableHandle, 0, __cArray2, __cAOp, __bArray, __bArrayCtr, __cArray3, __oneOfFlag, __bSetInCheckAlignment);
        
        }
    
        __bSetInCheckAlignment = 0;
      }
    }
    {
      __bDiagValueArrayCtr = DiagGetParameterErrorHandled(__resp, "_SW__Week_40", __bDiagValueArray, elcount(__bDiagValueArray), __cDiagValueArray, elcount(__cDiagValueArray));
      {
        __bSetInCheckAlignment = 1;	
        {
          __bArrayCtr = __CopyBytes(__bDiagValueArray, __bDiagValueArrayCtr, __bArray);
          {
            sysvar * __systemVariable;
            __systemVariable = sysvarData::`PartNumber::`Part_Number;
            CheckSysVarSetBufferConsistency(sysSetVariableData(sysvarData::`PartNumber::`Part_Number, __bArray, __bArrayCtr), __systemVariable.name);
          }
          snprintf(__cArray, 8192, "%s", "Part_Number");
          snprintf(__cArray2, 8192, "%s '%s'", __cSysVar, __cArray);
          snprintf(__cArray3, 8192, "%s", "_SW__Week_40");
          
          ReportTableRow(__tableHandle, 0, __cArray2, __cAOp, __bArray, __bArrayCtr, __cArray3, __oneOfFlag, __bSetInCheckAlignment);
        
        }
    
        __bSetInCheckAlignment = 0;
      }
    }
    ReportTableEndVerdict(__tableHandle, __cEvaluateResponse, __res);
	__bVerdict = __bVerdict && __res;
  }
  if (__bVerdict == __eVerdictFail)
    TestReportWriteDiagObjectList();
}

void Ttvccmce9_Tet_Tc16()
{
  CreateTTEIFFunction("Ttvccmce9_Tc16", __eTcDef, __eLocal);  
  AddIFParameterTestCaseAttribute("TC_ID", "");
  AddIFParameterTestCaseAttribute("Test Case ID", "");
  CallInterfaceFunction("2.5.5.7_F181", __cEmpty , __cEmpty );
}
testcase Ttvccmce9_Tc16()
{
  stack long __tableHandle;
  SetBreakOnFail(0);

  TestCommandBegin(__eDiagService, __cDiagService, "", "0");
  {
    if (DiagIsFunctionalGroup("CVADAS_0001_00000000_000"))
    {
      DiagResponse * __resp;
      DiagRequest CVADAS_0001_00000000_000.Default_Session_Start __req;
      __diagServicevccmce9_93(__req, __resp);
    }
    else
    {
      DiagResponse CVADAS_0001_00000000_000.* __resp;
      DiagRequest CVADAS_0001_00000000_000.Default_Session_Start __req;
      __diagServicevccmce9_93(__req, __resp);
    }
  }
  TestCommandEnd();


  TestCommandBegin(__eWait, __cWait, "", "1");
  {
    Wait("1", (syspar::`sleep * 1000000LL), 1000000, "sleep");
  }
  TestCommandEnd();

  TestCommandBegin(__eDiagService, __cDiagService, "", "2");
  {
    if (DiagIsFunctionalGroup("CVADAS_0001_00000000_000"))
    {
      DiagResponse * __resp;
      DiagRequest CVADAS_0001_00000000_000._22F181_Application_Software_Identification __req;
      __diagServicevccmce9_94(__req, __resp);
    }
    else
    {
      DiagResponse CVADAS_0001_00000000_000.* __resp;
      DiagRequest CVADAS_0001_00000000_000._22F181_Application_Software_Identification __req;
      __diagServicevccmce9_94(__req, __resp);
    }
  }
  TestCommandEnd();


  TestCommandBegin(__eDiagService, __cDiagService, "", "3");
  {
    if (DiagIsFunctionalGroup("CVADAS_0001_00000000_000"))
    {
      DiagResponse * __resp;
      DiagRequest CVADAS_0001_00000000_000.Extended_Diagnostic_Session_Start __req;
      __diagServicevccmce9_95(__req, __resp);
    }
    else
    {
      DiagResponse CVADAS_0001_00000000_000.* __resp;
      DiagRequest CVADAS_0001_00000000_000.Extended_Diagnostic_Session_Start __req;
      __diagServicevccmce9_95(__req, __resp);
    }
  }
  TestCommandEnd();


  TestCommandBegin(__eWait, __cWait, "", "4");
  {
    Wait("1", (syspar::`sleep * 1000000LL), 1000000, "sleep");
  }
  TestCommandEnd();

  TestCommandBegin(__eDiagService, __cDiagService, "", "5");
  {
    if (DiagIsFunctionalGroup("CVADAS_0001_00000000_000"))
    {
      DiagResponse * __resp;
      DiagRequest CVADAS_0001_00000000_000._22F181_Application_Software_Identification __req;
      __diagServicevccmce9_96(__req, __resp);
    }
    else
    {
      DiagResponse CVADAS_0001_00000000_000.* __resp;
      DiagRequest CVADAS_0001_00000000_000._22F181_Application_Software_Identification __req;
      __diagServicevccmce9_96(__req, __resp);
    }
  }
  TestCommandEnd();


}

  
void __diagServicevccmce9_93(DiagRequest * __req, DiagResponse * __resp )
{
  stack long __tableHandle;
  long __res, __paramLen, __bytePos;

   __bVerdict = __eVerdictPass;

  do {
    TestReportResetDiagObjectList();
    DiagSetReportDetailLevel("CVADAS_0001_00000000_000", EnumServiceDetails_onfail);
    // Request aspect
    {
      {
        __res = DiagSetParameterErrorHandled(__req, "DiagSessionType", 01);
        if(__res < 0)
        {
          __bVerdict = __eVerdictFail;
          DiagErrCodeTestStep(__res, "Cannot set diagnostic parameter 'DiagSessionType'");
          break;
        }
      }

      if (0 >= DiagSendReqAndWaitForResp("CVADAS_0001_00000000_000", __req, __resp, __res, -1, -1, -1, -1, -1, EnumResult_pos, EnumServiceDetails_onfail, EnumSendingMode_physical, EnumSuppressPosResBit_asconfigured, EnumVerdictOnInvalidValues_fail))
        break;
    }

    __res = DiagErrCodeTestStep(__res, "Can't retrieve last response for request! No check possible.") < 0;
    if(__res)
    {
	  __bVerdict = __eVerdictFail;
      break;
    }
    {
      __res = DiagInterpretAs(__resp, "DSC_PR");
      if(__res != 0)
      {
        __bVerdict = __eVerdictFail;
        DiagErrCodeTestStep(__res, "Can't interpret response as diagnostic primitive 'DSC_PR'.");
        break;
      }
      else
      {
        TestStepPass( "Received primitive can be interpreted as diagnostic primitive 'DSC_PR'.");
      }
    }
  }
  while(0);


  // Response, check & read aspect
  {
    __res = 1;
    __tableHandle = ReportTableHead5Columns(__cCheckCaption, __cTSym, __cTOp, __cRefVal, __cActual, __cRes);
    {
      double __nDiagValue;
      DiagGetParameterErrorHandled(__resp, "DiagSessionType", __nDiagValue);
      __csr = CheckSignalMatch(__nDiagValue, 01, "==") == 1;
      snprintf(__cArray, 8192, "%s", "Diagnostic parameter \'DiagSessionType\'");
      snprintf(__cArray2, 8192, "%s", __cArray);
      snprintf(__cArray3, 8192, "%s", "");
      ReportTableRow(__tableHandle, 0, __cArray2, "==", 01, __cArray3, __oneOfFlag, __bSetInCheckAlignment);
      ReportCell(__tableHandle, __nDiagValue);
      ReportCellResult(__tableHandle, __csr, __ePassFail);
    
      __res = __res && __csr;
    
    }
    ReportTableEndVerdict(__tableHandle, __cEvaluateResponse, __res);
	__bVerdict = __bVerdict && __res;
  }
  if (__bVerdict == __eVerdictFail)
    TestReportWriteDiagObjectList();
}
  
void __diagServicevccmce9_94(DiagRequest * __req, DiagResponse * __resp )
{
  stack long __tableHandle;
  long __res, __paramLen, __bytePos;

   __bVerdict = __eVerdictPass;

  do {
    TestReportResetDiagObjectList();
    DiagSetReportDetailLevel("CVADAS_0001_00000000_000", EnumServiceDetails_onfail);
    // Request aspect
    {

      if (0 >= DiagSendReqAndWaitForResp("CVADAS_0001_00000000_000", __req, __resp, __res, -1, -1, -1, -1, -1, EnumResult_pos, EnumServiceDetails_onfail, EnumSendingMode_physical, EnumSuppressPosResBit_asconfigured, EnumVerdictOnInvalidValues_fail))
        break;
    }

    __res = DiagErrCodeTestStep(__res, "Can't retrieve last response for request! No check possible.") < 0;
    if(__res)
    {
	  __bVerdict = __eVerdictFail;
      break;
    }
    {
      __res = DiagInterpretAs(__resp, "RDBI_PR");
      if(__res != 0)
      {
        __bVerdict = __eVerdictFail;
        DiagErrCodeTestStep(__res, "Can't interpret response as diagnostic primitive 'RDBI_PR'.");
        break;
      }
      else
      {
        TestStepPass( "Received primitive can be interpreted as diagnostic primitive 'RDBI_PR'.");
      }
    }
  }
  while(0);


  // Response, check & read aspect
  {
    __res = 1;
    __tableHandle = ReportTableHead5Columns(__cCheckCaption, __cTSym, __cTOp, __cRefVal, __cActual, __cRes);
    {
      __bDiagValueArrayCtr = DiagGetParameterErrorHandled(__resp, "Application_Software_Logical_Block_0_Version_Information_Ident_1", __bDiagValueArray, elcount(__bDiagValueArray), __cDiagValueArray, elcount(__cDiagValueArray));
      {
        __bSetInCheckAlignment = 1;	
        {
          __bArrayCtr = __CopyBytes(__bDiagValueArray, __bDiagValueArrayCtr, __bArray);
          {
            sysvar * __systemVariable;
            __systemVariable = sysvarData::`PartNumber::`Part_Number;
            CheckSysVarSetBufferConsistency(sysSetVariableData(sysvarData::`PartNumber::`Part_Number, __bArray, __bArrayCtr), __systemVariable.name);
          }
          snprintf(__cArray, 8192, "%s", "Part_Number");
          snprintf(__cArray2, 8192, "%s '%s'", __cSysVar, __cArray);
          snprintf(__cArray3, 8192, "%s", "Application_Software_Logical_Block_0_Version_Information_Ident_1");
          
          ReportTableRow(__tableHandle, 0, __cArray2, __cAOp, __bArray, __bArrayCtr, __cArray3, __oneOfFlag, __bSetInCheckAlignment);
        
        }
    
        __bSetInCheckAlignment = 0;
      }
    }
    {
      __bDiagValueArrayCtr = DiagGetParameterErrorHandled(__resp, "Application_Software_Logical_Block_0_Version_Information_Ident_2", __bDiagValueArray, elcount(__bDiagValueArray), __cDiagValueArray, elcount(__cDiagValueArray));
      {
        __bSetInCheckAlignment = 1;	
        {
          __bArrayCtr = __CopyBytes(__bDiagValueArray, __bDiagValueArrayCtr, __bArray);
          {
            sysvar * __systemVariable;
            __systemVariable = sysvarData::`PartNumber::`Part_Number;
            CheckSysVarSetBufferConsistency(sysSetVariableData(sysvarData::`PartNumber::`Part_Number, __bArray, __bArrayCtr), __systemVariable.name);
          }
          snprintf(__cArray, 8192, "%s", "Part_Number");
          snprintf(__cArray2, 8192, "%s '%s'", __cSysVar, __cArray);
          snprintf(__cArray3, 8192, "%s", "Application_Software_Logical_Block_0_Version_Information_Ident_2");
          
          ReportTableRow(__tableHandle, 0, __cArray2, __cAOp, __bArray, __bArrayCtr, __cArray3, __oneOfFlag, __bSetInCheckAlignment);
        
        }
    
        __bSetInCheckAlignment = 0;
      }
    }
    {
      __bDiagValueArrayCtr = DiagGetParameterErrorHandled(__resp, "Application_Software_Logical_Block_0_Version_Information_Patch_1", __bDiagValueArray, elcount(__bDiagValueArray), __cDiagValueArray, elcount(__cDiagValueArray));
      {
        __bSetInCheckAlignment = 1;	
        {
          __bArrayCtr = __CopyBytes(__bDiagValueArray, __bDiagValueArrayCtr, __bArray);
          {
            sysvar * __systemVariable;
            __systemVariable = sysvarData::`PartNumber::`Part_Number;
            CheckSysVarSetBufferConsistency(sysSetVariableData(sysvarData::`PartNumber::`Part_Number, __bArray, __bArrayCtr), __systemVariable.name);
          }
          snprintf(__cArray, 8192, "%s", "Part_Number");
          snprintf(__cArray2, 8192, "%s '%s'", __cSysVar, __cArray);
          snprintf(__cArray3, 8192, "%s", "Application_Software_Logical_Block_0_Version_Information_Patch_1");
          
          ReportTableRow(__tableHandle, 0, __cArray2, __cAOp, __bArray, __bArrayCtr, __cArray3, __oneOfFlag, __bSetInCheckAlignment);
        
        }
    
        __bSetInCheckAlignment = 0;
      }
    }
    {
      __bDiagValueArrayCtr = DiagGetParameterErrorHandled(__resp, "Application_Software_Logical_Block_0_Version_Information_Patch_2", __bDiagValueArray, elcount(__bDiagValueArray), __cDiagValueArray, elcount(__cDiagValueArray));
      {
        __bSetInCheckAlignment = 1;	
        {
          __bArrayCtr = __CopyBytes(__bDiagValueArray, __bDiagValueArrayCtr, __bArray);
          {
            sysvar * __systemVariable;
            __systemVariable = sysvarData::`PartNumber::`Part_Number;
            CheckSysVarSetBufferConsistency(sysSetVariableData(sysvarData::`PartNumber::`Part_Number, __bArray, __bArrayCtr), __systemVariable.name);
          }
          snprintf(__cArray, 8192, "%s", "Part_Number");
          snprintf(__cArray2, 8192, "%s '%s'", __cSysVar, __cArray);
          snprintf(__cArray3, 8192, "%s", "Application_Software_Logical_Block_0_Version_Information_Patch_2");
          
          ReportTableRow(__tableHandle, 0, __cArray2, __cAOp, __bArray, __bArrayCtr, __cArray3, __oneOfFlag, __bSetInCheckAlignment);
        
        }
    
        __bSetInCheckAlignment = 0;
      }
    }
    {
      __bDiagValueArrayCtr = DiagGetParameterErrorHandled(__resp, "Application_Software_Logical_Block_2_Week", __bDiagValueArray, elcount(__bDiagValueArray), __cDiagValueArray, elcount(__cDiagValueArray));
      {
        __bSetInCheckAlignment = 1;	
        {
          __bArrayCtr = __CopyBytes(__bDiagValueArray, __bDiagValueArrayCtr, __bArray);
          {
            sysvar * __systemVariable;
            __systemVariable = sysvarData::`PartNumber::`Part_Number;
            CheckSysVarSetBufferConsistency(sysSetVariableData(sysvarData::`PartNumber::`Part_Number, __bArray, __bArrayCtr), __systemVariable.name);
          }
          snprintf(__cArray, 8192, "%s", "Part_Number");
          snprintf(__cArray2, 8192, "%s '%s'", __cSysVar, __cArray);
          snprintf(__cArray3, 8192, "%s", "Application_Software_Logical_Block_2_Week");
          
          ReportTableRow(__tableHandle, 0, __cArray2, __cAOp, __bArray, __bArrayCtr, __cArray3, __oneOfFlag, __bSetInCheckAlignment);
        
        }
    
        __bSetInCheckAlignment = 0;
      }
    }
    {
      __bDiagValueArrayCtr = DiagGetParameterErrorHandled(__resp, "Application_Software_Logical_Block_2_Year", __bDiagValueArray, elcount(__bDiagValueArray), __cDiagValueArray, elcount(__cDiagValueArray));
      {
        __bSetInCheckAlignment = 1;	
        {
          __bArrayCtr = __CopyBytes(__bDiagValueArray, __bDiagValueArrayCtr, __bArray);
          {
            sysvar * __systemVariable;
            __systemVariable = sysvarData::`PartNumber::`Part_Number;
            CheckSysVarSetBufferConsistency(sysSetVariableData(sysvarData::`PartNumber::`Part_Number, __bArray, __bArrayCtr), __systemVariable.name);
          }
          snprintf(__cArray, 8192, "%s", "Part_Number");
          snprintf(__cArray2, 8192, "%s '%s'", __cSysVar, __cArray);
          snprintf(__cArray3, 8192, "%s", "Application_Software_Logical_Block_2_Year");
          
          ReportTableRow(__tableHandle, 0, __cArray2, __cAOp, __bArray, __bArrayCtr, __cArray3, __oneOfFlag, __bSetInCheckAlignment);
        
        }
    
        __bSetInCheckAlignment = 0;
      }
    }
    {
      __bDiagValueArrayCtr = DiagGetParameterErrorHandled(__resp, "Application_Software_Logical_Block_3_Week", __bDiagValueArray, elcount(__bDiagValueArray), __cDiagValueArray, elcount(__cDiagValueArray));
      {
        __bSetInCheckAlignment = 1;	
        {
          __bArrayCtr = __CopyBytes(__bDiagValueArray, __bDiagValueArrayCtr, __bArray);
          {
            sysvar * __systemVariable;
            __systemVariable = sysvarData::`PartNumber::`Part_Number;
            CheckSysVarSetBufferConsistency(sysSetVariableData(sysvarData::`PartNumber::`Part_Number, __bArray, __bArrayCtr), __systemVariable.name);
          }
          snprintf(__cArray, 8192, "%s", "Part_Number");
          snprintf(__cArray2, 8192, "%s '%s'", __cSysVar, __cArray);
          snprintf(__cArray3, 8192, "%s", "Application_Software_Logical_Block_3_Week");
          
          ReportTableRow(__tableHandle, 0, __cArray2, __cAOp, __bArray, __bArrayCtr, __cArray3, __oneOfFlag, __bSetInCheckAlignment);
        
        }
    
        __bSetInCheckAlignment = 0;
      }
    }
    {
      __bDiagValueArrayCtr = DiagGetParameterErrorHandled(__resp, "Application_Software_Logical_Block_4_Identification", __bDiagValueArray, elcount(__bDiagValueArray), __cDiagValueArray, elcount(__cDiagValueArray));
      {
        __bSetInCheckAlignment = 1;	
        {
          __bArrayCtr = __CopyBytes(__bDiagValueArray, __bDiagValueArrayCtr, __bArray);
          {
            sysvar * __systemVariable;
            __systemVariable = sysvarData::`PartNumber::`Part_Number;
            CheckSysVarSetBufferConsistency(sysSetVariableData(sysvarData::`PartNumber::`Part_Number, __bArray, __bArrayCtr), __systemVariable.name);
          }
          snprintf(__cArray, 8192, "%s", "Part_Number");
          snprintf(__cArray2, 8192, "%s '%s'", __cSysVar, __cArray);
          snprintf(__cArray3, 8192, "%s", "Application_Software_Logical_Block_4_Identification");
          
          ReportTableRow(__tableHandle, 0, __cArray2, __cAOp, __bArray, __bArrayCtr, __cArray3, __oneOfFlag, __bSetInCheckAlignment);
        
        }
    
        __bSetInCheckAlignment = 0;
      }
    }
    {
      __bDiagValueArrayCtr = DiagGetParameterErrorHandled(__resp, "Application_Software_Logical_Block_4_Patch_Level", __bDiagValueArray, elcount(__bDiagValueArray), __cDiagValueArray, elcount(__cDiagValueArray));
      {
        __bSetInCheckAlignment = 1;	
        {
          __bArrayCtr = __CopyBytes(__bDiagValueArray, __bDiagValueArrayCtr, __bArray);
          {
            sysvar * __systemVariable;
            __systemVariable = sysvarData::`PartNumber::`Part_Number;
            CheckSysVarSetBufferConsistency(sysSetVariableData(sysvarData::`PartNumber::`Part_Number, __bArray, __bArrayCtr), __systemVariable.name);
          }
          snprintf(__cArray, 8192, "%s", "Part_Number");
          snprintf(__cArray2, 8192, "%s '%s'", __cSysVar, __cArray);
          snprintf(__cArray3, 8192, "%s", "Application_Software_Logical_Block_4_Patch_Level");
          
          ReportTableRow(__tableHandle, 0, __cArray2, __cAOp, __bArray, __bArrayCtr, __cArray3, __oneOfFlag, __bSetInCheckAlignment);
        
        }
    
        __bSetInCheckAlignment = 0;
      }
    }
    {
      __bDiagValueArrayCtr = DiagGetParameterErrorHandled(__resp, "Application_Software_Logical_Block_4_Week", __bDiagValueArray, elcount(__bDiagValueArray), __cDiagValueArray, elcount(__cDiagValueArray));
      {
        __bSetInCheckAlignment = 1;	
        {
          __bArrayCtr = __CopyBytes(__bDiagValueArray, __bDiagValueArrayCtr, __bArray);
          {
            sysvar * __systemVariable;
            __systemVariable = sysvarData::`PartNumber::`Part_Number;
            CheckSysVarSetBufferConsistency(sysSetVariableData(sysvarData::`PartNumber::`Part_Number, __bArray, __bArrayCtr), __systemVariable.name);
          }
          snprintf(__cArray, 8192, "%s", "Part_Number");
          snprintf(__cArray2, 8192, "%s '%s'", __cSysVar, __cArray);
          snprintf(__cArray3, 8192, "%s", "Application_Software_Logical_Block_4_Week");
          
          ReportTableRow(__tableHandle, 0, __cArray2, __cAOp, __bArray, __bArrayCtr, __cArray3, __oneOfFlag, __bSetInCheckAlignment);
        
        }
    
        __bSetInCheckAlignment = 0;
      }
    }
    {
      __bDiagValueArrayCtr = DiagGetParameterErrorHandled(__resp, "Application_Software_Logical_Block_4_Year", __bDiagValueArray, elcount(__bDiagValueArray), __cDiagValueArray, elcount(__cDiagValueArray));
      {
        __bSetInCheckAlignment = 1;	
        {
          __bArrayCtr = __CopyBytes(__bDiagValueArray, __bDiagValueArrayCtr, __bArray);
          {
            sysvar * __systemVariable;
            __systemVariable = sysvarData::`PartNumber::`Part_Number;
            CheckSysVarSetBufferConsistency(sysSetVariableData(sysvarData::`PartNumber::`Part_Number, __bArray, __bArrayCtr), __systemVariable.name);
          }
          snprintf(__cArray, 8192, "%s", "Part_Number");
          snprintf(__cArray2, 8192, "%s '%s'", __cSysVar, __cArray);
          snprintf(__cArray3, 8192, "%s", "Application_Software_Logical_Block_4_Year");
          
          ReportTableRow(__tableHandle, 0, __cArray2, __cAOp, __bArray, __bArrayCtr, __cArray3, __oneOfFlag, __bSetInCheckAlignment);
        
        }
    
        __bSetInCheckAlignment = 0;
      }
    }
    {
      __bDiagValueArrayCtr = DiagGetParameterErrorHandled(__resp, "Application_Software_Logical_Block_5_Identification", __bDiagValueArray, elcount(__bDiagValueArray), __cDiagValueArray, elcount(__cDiagValueArray));
      {
        __bSetInCheckAlignment = 1;	
        {
          __bArrayCtr = __CopyBytes(__bDiagValueArray, __bDiagValueArrayCtr, __bArray);
          {
            sysvar * __systemVariable;
            __systemVariable = sysvarData::`PartNumber::`Part_Number;
            CheckSysVarSetBufferConsistency(sysSetVariableData(sysvarData::`PartNumber::`Part_Number, __bArray, __bArrayCtr), __systemVariable.name);
          }
          snprintf(__cArray, 8192, "%s", "Part_Number");
          snprintf(__cArray2, 8192, "%s '%s'", __cSysVar, __cArray);
          snprintf(__cArray3, 8192, "%s", "Application_Software_Logical_Block_5_Identification");
          
          ReportTableRow(__tableHandle, 0, __cArray2, __cAOp, __bArray, __bArrayCtr, __cArray3, __oneOfFlag, __bSetInCheckAlignment);
        
        }
    
        __bSetInCheckAlignment = 0;
      }
    }
    {
      __bDiagValueArrayCtr = DiagGetParameterErrorHandled(__resp, "Application_Software_Logical_Block_5_Patch_Level", __bDiagValueArray, elcount(__bDiagValueArray), __cDiagValueArray, elcount(__cDiagValueArray));
      {
        __bSetInCheckAlignment = 1;	
        {
          __bArrayCtr = __CopyBytes(__bDiagValueArray, __bDiagValueArrayCtr, __bArray);
          {
            sysvar * __systemVariable;
            __systemVariable = sysvarData::`PartNumber::`Part_Number;
            CheckSysVarSetBufferConsistency(sysSetVariableData(sysvarData::`PartNumber::`Part_Number, __bArray, __bArrayCtr), __systemVariable.name);
          }
          snprintf(__cArray, 8192, "%s", "Part_Number");
          snprintf(__cArray2, 8192, "%s '%s'", __cSysVar, __cArray);
          snprintf(__cArray3, 8192, "%s", "Application_Software_Logical_Block_5_Patch_Level");
          
          ReportTableRow(__tableHandle, 0, __cArray2, __cAOp, __bArray, __bArrayCtr, __cArray3, __oneOfFlag, __bSetInCheckAlignment);
        
        }
    
        __bSetInCheckAlignment = 0;
      }
    }
    {
      __bDiagValueArrayCtr = DiagGetParameterErrorHandled(__resp, "Application_Software_Logical_Block_5_Week", __bDiagValueArray, elcount(__bDiagValueArray), __cDiagValueArray, elcount(__cDiagValueArray));
      {
        __bSetInCheckAlignment = 1;	
        {
          __bArrayCtr = __CopyBytes(__bDiagValueArray, __bDiagValueArrayCtr, __bArray);
          {
            sysvar * __systemVariable;
            __systemVariable = sysvarData::`PartNumber::`Part_Number;
            CheckSysVarSetBufferConsistency(sysSetVariableData(sysvarData::`PartNumber::`Part_Number, __bArray, __bArrayCtr), __systemVariable.name);
          }
          snprintf(__cArray, 8192, "%s", "Part_Number");
          snprintf(__cArray2, 8192, "%s '%s'", __cSysVar, __cArray);
          snprintf(__cArray3, 8192, "%s", "Application_Software_Logical_Block_5_Week");
          
          ReportTableRow(__tableHandle, 0, __cArray2, __cAOp, __bArray, __bArrayCtr, __cArray3, __oneOfFlag, __bSetInCheckAlignment);
        
        }
    
        __bSetInCheckAlignment = 0;
      }
    }
    {
      __bDiagValueArrayCtr = DiagGetParameterErrorHandled(__resp, "Application_Software_Logical_Block_5_Year", __bDiagValueArray, elcount(__bDiagValueArray), __cDiagValueArray, elcount(__cDiagValueArray));
      {
        __bSetInCheckAlignment = 1;	
        {
          __bArrayCtr = __CopyBytes(__bDiagValueArray, __bDiagValueArrayCtr, __bArray);
          {
            sysvar * __systemVariable;
            __systemVariable = sysvarData::`PartNumber::`Part_Number;
            CheckSysVarSetBufferConsistency(sysSetVariableData(sysvarData::`PartNumber::`Part_Number, __bArray, __bArrayCtr), __systemVariable.name);
          }
          snprintf(__cArray, 8192, "%s", "Part_Number");
          snprintf(__cArray2, 8192, "%s '%s'", __cSysVar, __cArray);
          snprintf(__cArray3, 8192, "%s", "Application_Software_Logical_Block_5_Year");
          
          ReportTableRow(__tableHandle, 0, __cArray2, __cAOp, __bArray, __bArrayCtr, __cArray3, __oneOfFlag, __bSetInCheckAlignment);
        
        }
    
        __bSetInCheckAlignment = 0;
      }
    }
    ReportTableEndVerdict(__tableHandle, __cEvaluateResponse, __res);
	__bVerdict = __bVerdict && __res;
  }
  if (__bVerdict == __eVerdictFail)
    TestReportWriteDiagObjectList();
}
  
void __diagServicevccmce9_95(DiagRequest * __req, DiagResponse * __resp )
{
  stack long __tableHandle;
  long __res, __paramLen, __bytePos;

   __bVerdict = __eVerdictPass;

  do {
    TestReportResetDiagObjectList();
    DiagSetReportDetailLevel("CVADAS_0001_00000000_000", EnumServiceDetails_onfail);
    // Request aspect
    {
      {
        __res = DiagSetParameterErrorHandled(__req, "DiagSessionType", 03);
        if(__res < 0)
        {
          __bVerdict = __eVerdictFail;
          DiagErrCodeTestStep(__res, "Cannot set diagnostic parameter 'DiagSessionType'");
          break;
        }
      }

      if (0 >= DiagSendReqAndWaitForResp("CVADAS_0001_00000000_000", __req, __resp, __res, -1, -1, -1, -1, -1, EnumResult_pos, EnumServiceDetails_onfail, EnumSendingMode_physical, EnumSuppressPosResBit_asconfigured, EnumVerdictOnInvalidValues_fail))
        break;
    }

    __res = DiagErrCodeTestStep(__res, "Can't retrieve last response for request! No check possible.") < 0;
    if(__res)
    {
	  __bVerdict = __eVerdictFail;
      break;
    }
    {
      __res = DiagInterpretAs(__resp, "DSC_PR");
      if(__res != 0)
      {
        __bVerdict = __eVerdictFail;
        DiagErrCodeTestStep(__res, "Can't interpret response as diagnostic primitive 'DSC_PR'.");
        break;
      }
      else
      {
        TestStepPass( "Received primitive can be interpreted as diagnostic primitive 'DSC_PR'.");
      }
    }
  }
  while(0);


  // Response, check & read aspect
  {
    __res = 1;
    __tableHandle = ReportTableHead5Columns(__cCheckCaption, __cTSym, __cTOp, __cRefVal, __cActual, __cRes);
    {
      double __nDiagValue;
      DiagGetParameterErrorHandled(__resp, "DiagSessionType", __nDiagValue);
      __csr = CheckSignalMatch(__nDiagValue, 03, "==") == 1;
      snprintf(__cArray, 8192, "%s", "Diagnostic parameter \'DiagSessionType\'");
      snprintf(__cArray2, 8192, "%s", __cArray);
      snprintf(__cArray3, 8192, "%s", "");
      ReportTableRow(__tableHandle, 0, __cArray2, "==", 03, __cArray3, __oneOfFlag, __bSetInCheckAlignment);
      ReportCell(__tableHandle, __nDiagValue);
      ReportCellResult(__tableHandle, __csr, __ePassFail);
    
      __res = __res && __csr;
    
    }
    ReportTableEndVerdict(__tableHandle, __cEvaluateResponse, __res);
	__bVerdict = __bVerdict && __res;
  }
  if (__bVerdict == __eVerdictFail)
    TestReportWriteDiagObjectList();
}
  
void __diagServicevccmce9_96(DiagRequest * __req, DiagResponse * __resp )
{
  stack long __tableHandle;
  long __res, __paramLen, __bytePos;

   __bVerdict = __eVerdictPass;

  do {
    TestReportResetDiagObjectList();
    DiagSetReportDetailLevel("CVADAS_0001_00000000_000", EnumServiceDetails_onfail);
    // Request aspect
    {

      if (0 >= DiagSendReqAndWaitForResp("CVADAS_0001_00000000_000", __req, __resp, __res, -1, -1, -1, -1, -1, EnumResult_pos, EnumServiceDetails_onfail, EnumSendingMode_physical, EnumSuppressPosResBit_asconfigured, EnumVerdictOnInvalidValues_fail))
        break;
    }

    __res = DiagErrCodeTestStep(__res, "Can't retrieve last response for request! No check possible.") < 0;
    if(__res)
    {
	  __bVerdict = __eVerdictFail;
      break;
    }
    {
      __res = DiagInterpretAs(__resp, "RDBI_PR");
      if(__res != 0)
      {
        __bVerdict = __eVerdictFail;
        DiagErrCodeTestStep(__res, "Can't interpret response as diagnostic primitive 'RDBI_PR'.");
        break;
      }
      else
      {
        TestStepPass( "Received primitive can be interpreted as diagnostic primitive 'RDBI_PR'.");
      }
    }
  }
  while(0);


  // Response, check & read aspect
  {
    __res = 1;
    __tableHandle = ReportTableHead5Columns(__cCheckCaption, __cTSym, __cTOp, __cRefVal, __cActual, __cRes);
    {
      __bDiagValueArrayCtr = DiagGetParameterErrorHandled(__resp, "Application_Software_Logical_Block_0_Version_Information_Ident_1", __bDiagValueArray, elcount(__bDiagValueArray), __cDiagValueArray, elcount(__cDiagValueArray));
      {
        __bSetInCheckAlignment = 1;	
        {
          __bArrayCtr = __CopyBytes(__bDiagValueArray, __bDiagValueArrayCtr, __bArray);
          {
            sysvar * __systemVariable;
            __systemVariable = sysvarData::`PartNumber::`Part_Number;
            CheckSysVarSetBufferConsistency(sysSetVariableData(sysvarData::`PartNumber::`Part_Number, __bArray, __bArrayCtr), __systemVariable.name);
          }
          snprintf(__cArray, 8192, "%s", "Part_Number");
          snprintf(__cArray2, 8192, "%s '%s'", __cSysVar, __cArray);
          snprintf(__cArray3, 8192, "%s", "Application_Software_Logical_Block_0_Version_Information_Ident_1");
          
          ReportTableRow(__tableHandle, 0, __cArray2, __cAOp, __bArray, __bArrayCtr, __cArray3, __oneOfFlag, __bSetInCheckAlignment);
        
        }
    
        __bSetInCheckAlignment = 0;
      }
    }
    {
      __bDiagValueArrayCtr = DiagGetParameterErrorHandled(__resp, "Application_Software_Logical_Block_0_Version_Information_Ident_2", __bDiagValueArray, elcount(__bDiagValueArray), __cDiagValueArray, elcount(__cDiagValueArray));
      {
        __bSetInCheckAlignment = 1;	
        {
          __bArrayCtr = __CopyBytes(__bDiagValueArray, __bDiagValueArrayCtr, __bArray);
          {
            sysvar * __systemVariable;
            __systemVariable = sysvarData::`PartNumber::`Part_Number;
            CheckSysVarSetBufferConsistency(sysSetVariableData(sysvarData::`PartNumber::`Part_Number, __bArray, __bArrayCtr), __systemVariable.name);
          }
          snprintf(__cArray, 8192, "%s", "Part_Number");
          snprintf(__cArray2, 8192, "%s '%s'", __cSysVar, __cArray);
          snprintf(__cArray3, 8192, "%s", "Application_Software_Logical_Block_0_Version_Information_Ident_2");
          
          ReportTableRow(__tableHandle, 0, __cArray2, __cAOp, __bArray, __bArrayCtr, __cArray3, __oneOfFlag, __bSetInCheckAlignment);
        
        }
    
        __bSetInCheckAlignment = 0;
      }
    }
    {
      __bDiagValueArrayCtr = DiagGetParameterErrorHandled(__resp, "Application_Software_Logical_Block_0_Version_Information_Patch_1", __bDiagValueArray, elcount(__bDiagValueArray), __cDiagValueArray, elcount(__cDiagValueArray));
      {
        __bSetInCheckAlignment = 1;	
        {
          __bArrayCtr = __CopyBytes(__bDiagValueArray, __bDiagValueArrayCtr, __bArray);
          {
            sysvar * __systemVariable;
            __systemVariable = sysvarData::`PartNumber::`Part_Number;
            CheckSysVarSetBufferConsistency(sysSetVariableData(sysvarData::`PartNumber::`Part_Number, __bArray, __bArrayCtr), __systemVariable.name);
          }
          snprintf(__cArray, 8192, "%s", "Part_Number");
          snprintf(__cArray2, 8192, "%s '%s'", __cSysVar, __cArray);
          snprintf(__cArray3, 8192, "%s", "Application_Software_Logical_Block_0_Version_Information_Patch_1");
          
          ReportTableRow(__tableHandle, 0, __cArray2, __cAOp, __bArray, __bArrayCtr, __cArray3, __oneOfFlag, __bSetInCheckAlignment);
        
        }
    
        __bSetInCheckAlignment = 0;
      }
    }
    {
      __bDiagValueArrayCtr = DiagGetParameterErrorHandled(__resp, "Application_Software_Logical_Block_0_Version_Information_Patch_2", __bDiagValueArray, elcount(__bDiagValueArray), __cDiagValueArray, elcount(__cDiagValueArray));
      {
        __bSetInCheckAlignment = 1;	
        {
          __bArrayCtr = __CopyBytes(__bDiagValueArray, __bDiagValueArrayCtr, __bArray);
          {
            sysvar * __systemVariable;
            __systemVariable = sysvarData::`PartNumber::`Part_Number;
            CheckSysVarSetBufferConsistency(sysSetVariableData(sysvarData::`PartNumber::`Part_Number, __bArray, __bArrayCtr), __systemVariable.name);
          }
          snprintf(__cArray, 8192, "%s", "Part_Number");
          snprintf(__cArray2, 8192, "%s '%s'", __cSysVar, __cArray);
          snprintf(__cArray3, 8192, "%s", "Application_Software_Logical_Block_0_Version_Information_Patch_2");
          
          ReportTableRow(__tableHandle, 0, __cArray2, __cAOp, __bArray, __bArrayCtr, __cArray3, __oneOfFlag, __bSetInCheckAlignment);
        
        }
    
        __bSetInCheckAlignment = 0;
      }
    }
    {
      __bDiagValueArrayCtr = DiagGetParameterErrorHandled(__resp, "Application_Software_Logical_Block_2_Week", __bDiagValueArray, elcount(__bDiagValueArray), __cDiagValueArray, elcount(__cDiagValueArray));
      {
        __bSetInCheckAlignment = 1;	
        {
          __bArrayCtr = __CopyBytes(__bDiagValueArray, __bDiagValueArrayCtr, __bArray);
          {
            sysvar * __systemVariable;
            __systemVariable = sysvarData::`PartNumber::`Part_Number;
            CheckSysVarSetBufferConsistency(sysSetVariableData(sysvarData::`PartNumber::`Part_Number, __bArray, __bArrayCtr), __systemVariable.name);
          }
          snprintf(__cArray, 8192, "%s", "Part_Number");
          snprintf(__cArray2, 8192, "%s '%s'", __cSysVar, __cArray);
          snprintf(__cArray3, 8192, "%s", "Application_Software_Logical_Block_2_Week");
          
          ReportTableRow(__tableHandle, 0, __cArray2, __cAOp, __bArray, __bArrayCtr, __cArray3, __oneOfFlag, __bSetInCheckAlignment);
        
        }
    
        __bSetInCheckAlignment = 0;
      }
    }
    {
      __bDiagValueArrayCtr = DiagGetParameterErrorHandled(__resp, "Application_Software_Logical_Block_2_Year", __bDiagValueArray, elcount(__bDiagValueArray), __cDiagValueArray, elcount(__cDiagValueArray));
      {
        __bSetInCheckAlignment = 1;	
        {
          __bArrayCtr = __CopyBytes(__bDiagValueArray, __bDiagValueArrayCtr, __bArray);
          {
            sysvar * __systemVariable;
            __systemVariable = sysvarData::`PartNumber::`Part_Number;
            CheckSysVarSetBufferConsistency(sysSetVariableData(sysvarData::`PartNumber::`Part_Number, __bArray, __bArrayCtr), __systemVariable.name);
          }
          snprintf(__cArray, 8192, "%s", "Part_Number");
          snprintf(__cArray2, 8192, "%s '%s'", __cSysVar, __cArray);
          snprintf(__cArray3, 8192, "%s", "Application_Software_Logical_Block_2_Year");
          
          ReportTableRow(__tableHandle, 0, __cArray2, __cAOp, __bArray, __bArrayCtr, __cArray3, __oneOfFlag, __bSetInCheckAlignment);
        
        }
    
        __bSetInCheckAlignment = 0;
      }
    }
    {
      __bDiagValueArrayCtr = DiagGetParameterErrorHandled(__resp, "Application_Software_Logical_Block_3_Week", __bDiagValueArray, elcount(__bDiagValueArray), __cDiagValueArray, elcount(__cDiagValueArray));
      {
        __bSetInCheckAlignment = 1;	
        {
          __bArrayCtr = __CopyBytes(__bDiagValueArray, __bDiagValueArrayCtr, __bArray);
          {
            sysvar * __systemVariable;
            __systemVariable = sysvarData::`PartNumber::`Part_Number;
            CheckSysVarSetBufferConsistency(sysSetVariableData(sysvarData::`PartNumber::`Part_Number, __bArray, __bArrayCtr), __systemVariable.name);
          }
          snprintf(__cArray, 8192, "%s", "Part_Number");
          snprintf(__cArray2, 8192, "%s '%s'", __cSysVar, __cArray);
          snprintf(__cArray3, 8192, "%s", "Application_Software_Logical_Block_3_Week");
          
          ReportTableRow(__tableHandle, 0, __cArray2, __cAOp, __bArray, __bArrayCtr, __cArray3, __oneOfFlag, __bSetInCheckAlignment);
        
        }
    
        __bSetInCheckAlignment = 0;
      }
    }
    {
      __bDiagValueArrayCtr = DiagGetParameterErrorHandled(__resp, "Application_Software_Logical_Block_4_Identification", __bDiagValueArray, elcount(__bDiagValueArray), __cDiagValueArray, elcount(__cDiagValueArray));
      {
        __bSetInCheckAlignment = 1;	
        {
          __bArrayCtr = __CopyBytes(__bDiagValueArray, __bDiagValueArrayCtr, __bArray);
          {
            sysvar * __systemVariable;
            __systemVariable = sysvarData::`PartNumber::`Part_Number;
            CheckSysVarSetBufferConsistency(sysSetVariableData(sysvarData::`PartNumber::`Part_Number, __bArray, __bArrayCtr), __systemVariable.name);
          }
          snprintf(__cArray, 8192, "%s", "Part_Number");
          snprintf(__cArray2, 8192, "%s '%s'", __cSysVar, __cArray);
          snprintf(__cArray3, 8192, "%s", "Application_Software_Logical_Block_4_Identification");
          
          ReportTableRow(__tableHandle, 0, __cArray2, __cAOp, __bArray, __bArrayCtr, __cArray3, __oneOfFlag, __bSetInCheckAlignment);
        
        }
    
        __bSetInCheckAlignment = 0;
      }
    }
    {
      __bDiagValueArrayCtr = DiagGetParameterErrorHandled(__resp, "Application_Software_Logical_Block_4_Patch_Level", __bDiagValueArray, elcount(__bDiagValueArray), __cDiagValueArray, elcount(__cDiagValueArray));
      {
        __bSetInCheckAlignment = 1;	
        {
          __bArrayCtr = __CopyBytes(__bDiagValueArray, __bDiagValueArrayCtr, __bArray);
          {
            sysvar * __systemVariable;
            __systemVariable = sysvarData::`PartNumber::`Part_Number;
            CheckSysVarSetBufferConsistency(sysSetVariableData(sysvarData::`PartNumber::`Part_Number, __bArray, __bArrayCtr), __systemVariable.name);
          }
          snprintf(__cArray, 8192, "%s", "Part_Number");
          snprintf(__cArray2, 8192, "%s '%s'", __cSysVar, __cArray);
          snprintf(__cArray3, 8192, "%s", "Application_Software_Logical_Block_4_Patch_Level");
          
          ReportTableRow(__tableHandle, 0, __cArray2, __cAOp, __bArray, __bArrayCtr, __cArray3, __oneOfFlag, __bSetInCheckAlignment);
        
        }
    
        __bSetInCheckAlignment = 0;
      }
    }
    {
      __bDiagValueArrayCtr = DiagGetParameterErrorHandled(__resp, "Application_Software_Logical_Block_4_Week", __bDiagValueArray, elcount(__bDiagValueArray), __cDiagValueArray, elcount(__cDiagValueArray));
      {
        __bSetInCheckAlignment = 1;	
        {
          __bArrayCtr = __CopyBytes(__bDiagValueArray, __bDiagValueArrayCtr, __bArray);
          {
            sysvar * __systemVariable;
            __systemVariable = sysvarData::`PartNumber::`Part_Number;
            CheckSysVarSetBufferConsistency(sysSetVariableData(sysvarData::`PartNumber::`Part_Number, __bArray, __bArrayCtr), __systemVariable.name);
          }
          snprintf(__cArray, 8192, "%s", "Part_Number");
          snprintf(__cArray2, 8192, "%s '%s'", __cSysVar, __cArray);
          snprintf(__cArray3, 8192, "%s", "Application_Software_Logical_Block_4_Week");
          
          ReportTableRow(__tableHandle, 0, __cArray2, __cAOp, __bArray, __bArrayCtr, __cArray3, __oneOfFlag, __bSetInCheckAlignment);
        
        }
    
        __bSetInCheckAlignment = 0;
      }
    }
    {
      __bDiagValueArrayCtr = DiagGetParameterErrorHandled(__resp, "Application_Software_Logical_Block_4_Year", __bDiagValueArray, elcount(__bDiagValueArray), __cDiagValueArray, elcount(__cDiagValueArray));
      {
        __bSetInCheckAlignment = 1;	
        {
          __bArrayCtr = __CopyBytes(__bDiagValueArray, __bDiagValueArrayCtr, __bArray);
          {
            sysvar * __systemVariable;
            __systemVariable = sysvarData::`PartNumber::`Part_Number;
            CheckSysVarSetBufferConsistency(sysSetVariableData(sysvarData::`PartNumber::`Part_Number, __bArray, __bArrayCtr), __systemVariable.name);
          }
          snprintf(__cArray, 8192, "%s", "Part_Number");
          snprintf(__cArray2, 8192, "%s '%s'", __cSysVar, __cArray);
          snprintf(__cArray3, 8192, "%s", "Application_Software_Logical_Block_4_Year");
          
          ReportTableRow(__tableHandle, 0, __cArray2, __cAOp, __bArray, __bArrayCtr, __cArray3, __oneOfFlag, __bSetInCheckAlignment);
        
        }
    
        __bSetInCheckAlignment = 0;
      }
    }
    {
      __bDiagValueArrayCtr = DiagGetParameterErrorHandled(__resp, "Application_Software_Logical_Block_5_Identification", __bDiagValueArray, elcount(__bDiagValueArray), __cDiagValueArray, elcount(__cDiagValueArray));
      {
        __bSetInCheckAlignment = 1;	
        {
          __bArrayCtr = __CopyBytes(__bDiagValueArray, __bDiagValueArrayCtr, __bArray);
          {
            sysvar * __systemVariable;
            __systemVariable = sysvarData::`PartNumber::`Part_Number;
            CheckSysVarSetBufferConsistency(sysSetVariableData(sysvarData::`PartNumber::`Part_Number, __bArray, __bArrayCtr), __systemVariable.name);
          }
          snprintf(__cArray, 8192, "%s", "Part_Number");
          snprintf(__cArray2, 8192, "%s '%s'", __cSysVar, __cArray);
          snprintf(__cArray3, 8192, "%s", "Application_Software_Logical_Block_5_Identification");
          
          ReportTableRow(__tableHandle, 0, __cArray2, __cAOp, __bArray, __bArrayCtr, __cArray3, __oneOfFlag, __bSetInCheckAlignment);
        
        }
    
        __bSetInCheckAlignment = 0;
      }
    }
    {
      __bDiagValueArrayCtr = DiagGetParameterErrorHandled(__resp, "Application_Software_Logical_Block_5_Patch_Level", __bDiagValueArray, elcount(__bDiagValueArray), __cDiagValueArray, elcount(__cDiagValueArray));
      {
        __bSetInCheckAlignment = 1;	
        {
          __bArrayCtr = __CopyBytes(__bDiagValueArray, __bDiagValueArrayCtr, __bArray);
          {
            sysvar * __systemVariable;
            __systemVariable = sysvarData::`PartNumber::`Part_Number;
            CheckSysVarSetBufferConsistency(sysSetVariableData(sysvarData::`PartNumber::`Part_Number, __bArray, __bArrayCtr), __systemVariable.name);
          }
          snprintf(__cArray, 8192, "%s", "Part_Number");
          snprintf(__cArray2, 8192, "%s '%s'", __cSysVar, __cArray);
          snprintf(__cArray3, 8192, "%s", "Application_Software_Logical_Block_5_Patch_Level");
          
          ReportTableRow(__tableHandle, 0, __cArray2, __cAOp, __bArray, __bArrayCtr, __cArray3, __oneOfFlag, __bSetInCheckAlignment);
        
        }
    
        __bSetInCheckAlignment = 0;
      }
    }
    {
      __bDiagValueArrayCtr = DiagGetParameterErrorHandled(__resp, "Application_Software_Logical_Block_5_Week", __bDiagValueArray, elcount(__bDiagValueArray), __cDiagValueArray, elcount(__cDiagValueArray));
      {
        __bSetInCheckAlignment = 1;	
        {
          __bArrayCtr = __CopyBytes(__bDiagValueArray, __bDiagValueArrayCtr, __bArray);
          {
            sysvar * __systemVariable;
            __systemVariable = sysvarData::`PartNumber::`Part_Number;
            CheckSysVarSetBufferConsistency(sysSetVariableData(sysvarData::`PartNumber::`Part_Number, __bArray, __bArrayCtr), __systemVariable.name);
          }
          snprintf(__cArray, 8192, "%s", "Part_Number");
          snprintf(__cArray2, 8192, "%s '%s'", __cSysVar, __cArray);
          snprintf(__cArray3, 8192, "%s", "Application_Software_Logical_Block_5_Week");
          
          ReportTableRow(__tableHandle, 0, __cArray2, __cAOp, __bArray, __bArrayCtr, __cArray3, __oneOfFlag, __bSetInCheckAlignment);
        
        }
    
        __bSetInCheckAlignment = 0;
      }
    }
    {
      __bDiagValueArrayCtr = DiagGetParameterErrorHandled(__resp, "Application_Software_Logical_Block_5_Year", __bDiagValueArray, elcount(__bDiagValueArray), __cDiagValueArray, elcount(__cDiagValueArray));
      {
        __bSetInCheckAlignment = 1;	
        {
          __bArrayCtr = __CopyBytes(__bDiagValueArray, __bDiagValueArrayCtr, __bArray);
          {
            sysvar * __systemVariable;
            __systemVariable = sysvarData::`PartNumber::`Part_Number;
            CheckSysVarSetBufferConsistency(sysSetVariableData(sysvarData::`PartNumber::`Part_Number, __bArray, __bArrayCtr), __systemVariable.name);
          }
          snprintf(__cArray, 8192, "%s", "Part_Number");
          snprintf(__cArray2, 8192, "%s '%s'", __cSysVar, __cArray);
          snprintf(__cArray3, 8192, "%s", "Application_Software_Logical_Block_5_Year");
          
          ReportTableRow(__tableHandle, 0, __cArray2, __cAOp, __bArray, __bArrayCtr, __cArray3, __oneOfFlag, __bSetInCheckAlignment);
        
        }
    
        __bSetInCheckAlignment = 0;
      }
    }
    ReportTableEndVerdict(__tableHandle, __cEvaluateResponse, __res);
	__bVerdict = __bVerdict && __res;
  }
  if (__bVerdict == __eVerdictFail)
    TestReportWriteDiagObjectList();
}

void Ttvccmce9_Tet_Tc17()
{
  CreateTTEIFFunction("Ttvccmce9_Tc17", __eTcDef, __eLocal);  
  AddIFParameterTestCaseAttribute("TC_ID", "");
  AddIFParameterTestCaseAttribute("Test Case ID", "");
  CallInterfaceFunction("2.5.5.8_F192", __cEmpty , __cEmpty );
}
testcase Ttvccmce9_Tc17()
{
  stack long __tableHandle;
  SetBreakOnFail(0);

  TestCommandBegin(__eDiagService, __cDiagService, "", "0");
  {
    if (DiagIsFunctionalGroup("CVADAS_0001_00000000_000"))
    {
      DiagResponse * __resp;
      DiagRequest CVADAS_0001_00000000_000.Default_Session_Start __req;
      __diagServicevccmce9_97(__req, __resp);
    }
    else
    {
      DiagResponse CVADAS_0001_00000000_000.* __resp;
      DiagRequest CVADAS_0001_00000000_000.Default_Session_Start __req;
      __diagServicevccmce9_97(__req, __resp);
    }
  }
  TestCommandEnd();


  TestCommandBegin(__eWait, __cWait, "", "1");
  {
    Wait("1", (syspar::`sleep * 1000000LL), 1000000, "sleep");
  }
  TestCommandEnd();

  TestCommandBegin(__eDiagService, __cDiagService, "", "2");
  {
    if (DiagIsFunctionalGroup("CVADAS_0001_00000000_000"))
    {
      DiagResponse * __resp;
      DiagRequest CVADAS_0001_00000000_000._22F192_Supplier_ECU_Hardware_Part_Number __req;
      __diagServicevccmce9_98(__req, __resp);
    }
    else
    {
      DiagResponse CVADAS_0001_00000000_000.* __resp;
      DiagRequest CVADAS_0001_00000000_000._22F192_Supplier_ECU_Hardware_Part_Number __req;
      __diagServicevccmce9_98(__req, __resp);
    }
  }
  TestCommandEnd();


  TestCommandBegin(__eDiagService, __cDiagService, "", "3");
  {
    if (DiagIsFunctionalGroup("CVADAS_0001_00000000_000"))
    {
      DiagResponse * __resp;
      DiagRequest CVADAS_0001_00000000_000.Extended_Diagnostic_Session_Start __req;
      __diagServicevccmce9_99(__req, __resp);
    }
    else
    {
      DiagResponse CVADAS_0001_00000000_000.* __resp;
      DiagRequest CVADAS_0001_00000000_000.Extended_Diagnostic_Session_Start __req;
      __diagServicevccmce9_99(__req, __resp);
    }
  }
  TestCommandEnd();


  TestCommandBegin(__eWait, __cWait, "", "4");
  {
    Wait("1", (syspar::`sleep * 1000000LL), 1000000, "sleep");
  }
  TestCommandEnd();

  TestCommandBegin(__eDiagService, __cDiagService, "", "5");
  {
    if (DiagIsFunctionalGroup("CVADAS_0001_00000000_000"))
    {
      DiagResponse * __resp;
      DiagRequest CVADAS_0001_00000000_000._22F192_Supplier_ECU_Hardware_Part_Number __req;
      __diagServicevccmce9_100(__req, __resp);
    }
    else
    {
      DiagResponse CVADAS_0001_00000000_000.* __resp;
      DiagRequest CVADAS_0001_00000000_000._22F192_Supplier_ECU_Hardware_Part_Number __req;
      __diagServicevccmce9_100(__req, __resp);
    }
  }
  TestCommandEnd();


}

  
void __diagServicevccmce9_97(DiagRequest * __req, DiagResponse * __resp )
{
  stack long __tableHandle;
  long __res, __paramLen, __bytePos;

   __bVerdict = __eVerdictPass;

  do {
    TestReportResetDiagObjectList();
    DiagSetReportDetailLevel("CVADAS_0001_00000000_000", EnumServiceDetails_onfail);
    // Request aspect
    {
      {
        __res = DiagSetParameterErrorHandled(__req, "DiagSessionType", 01);
        if(__res < 0)
        {
          __bVerdict = __eVerdictFail;
          DiagErrCodeTestStep(__res, "Cannot set diagnostic parameter 'DiagSessionType'");
          break;
        }
      }

      if (0 >= DiagSendReqAndWaitForResp("CVADAS_0001_00000000_000", __req, __resp, __res, -1, -1, -1, -1, -1, EnumResult_pos, EnumServiceDetails_onfail, EnumSendingMode_physical, EnumSuppressPosResBit_asconfigured, EnumVerdictOnInvalidValues_fail))
        break;
    }

    __res = DiagErrCodeTestStep(__res, "Can't retrieve last response for request! No check possible.") < 0;
    if(__res)
    {
	  __bVerdict = __eVerdictFail;
      break;
    }
    {
      __res = DiagInterpretAs(__resp, "DSC_PR");
      if(__res != 0)
      {
        __bVerdict = __eVerdictFail;
        DiagErrCodeTestStep(__res, "Can't interpret response as diagnostic primitive 'DSC_PR'.");
        break;
      }
      else
      {
        TestStepPass( "Received primitive can be interpreted as diagnostic primitive 'DSC_PR'.");
      }
    }
  }
  while(0);


  // Response, check & read aspect
  {
    __res = 1;
    __tableHandle = ReportTableHead5Columns(__cCheckCaption, __cTSym, __cTOp, __cRefVal, __cActual, __cRes);
    {
      double __nDiagValue;
      DiagGetParameterErrorHandled(__resp, "DiagSessionType", __nDiagValue);
      __csr = CheckSignalMatch(__nDiagValue, 01, "==") == 1;
      snprintf(__cArray, 8192, "%s", "Diagnostic parameter \'DiagSessionType\'");
      snprintf(__cArray2, 8192, "%s", __cArray);
      snprintf(__cArray3, 8192, "%s", "");
      ReportTableRow(__tableHandle, 0, __cArray2, "==", 01, __cArray3, __oneOfFlag, __bSetInCheckAlignment);
      ReportCell(__tableHandle, __nDiagValue);
      ReportCellResult(__tableHandle, __csr, __ePassFail);
    
      __res = __res && __csr;
    
    }
    ReportTableEndVerdict(__tableHandle, __cEvaluateResponse, __res);
	__bVerdict = __bVerdict && __res;
  }
  if (__bVerdict == __eVerdictFail)
    TestReportWriteDiagObjectList();
}
  
void __diagServicevccmce9_98(DiagRequest * __req, DiagResponse * __resp )
{
  stack long __tableHandle;
  long __res, __paramLen, __bytePos;

   __bVerdict = __eVerdictPass;

  do {
    TestReportResetDiagObjectList();
    DiagSetReportDetailLevel("CVADAS_0001_00000000_000", EnumServiceDetails_onfail);
    // Request aspect
    {

      if (0 >= DiagSendReqAndWaitForResp("CVADAS_0001_00000000_000", __req, __resp, __res, -1, -1, -1, -1, -1, EnumResult_pos, EnumServiceDetails_onfail, EnumSendingMode_physical, EnumSuppressPosResBit_asconfigured, EnumVerdictOnInvalidValues_fail))
        break;
    }

    __res = DiagErrCodeTestStep(__res, "Can't retrieve last response for request! No check possible.") < 0;
    if(__res)
    {
	  __bVerdict = __eVerdictFail;
      break;
    }
    {
      __res = DiagInterpretAs(__resp, "RDBI_PR");
      if(__res != 0)
      {
        __bVerdict = __eVerdictFail;
        DiagErrCodeTestStep(__res, "Can't interpret response as diagnostic primitive 'RDBI_PR'.");
        break;
      }
      else
      {
        TestStepPass( "Received primitive can be interpreted as diagnostic primitive 'RDBI_PR'.");
      }
    }
  }
  while(0);


  // Response, check & read aspect
  {
    __res = 1;
    __tableHandle = ReportTableHead5Columns(__cCheckCaption, __cTSym, __cTOp, __cRefVal, __cActual, __cRes);
    {
      __bDiagValueArrayCtr = DiagGetParameterErrorHandled(__resp, "_Supplier_Manufacturer_ECU_Hardware_Part_Number_24", __bDiagValueArray, elcount(__bDiagValueArray), __cDiagValueArray, elcount(__cDiagValueArray));
      {
        __bSetInCheckAlignment = 1;	
        {
          __bArrayCtr = __CopyBytes(__bDiagValueArray, __bDiagValueArrayCtr, __bArray);
          {
            sysvar * __systemVariable;
            __systemVariable = sysvarData::`PartNumber::`Part_Number;
            CheckSysVarSetBufferConsistency(sysSetVariableData(sysvarData::`PartNumber::`Part_Number, __bArray, __bArrayCtr), __systemVariable.name);
          }
          snprintf(__cArray, 8192, "%s", "Part_Number");
          snprintf(__cArray2, 8192, "%s '%s'", __cSysVar, __cArray);
          snprintf(__cArray3, 8192, "%s", "_Supplier_Manufacturer_ECU_Hardware_Part_Number_24");
          
          ReportTableRow(__tableHandle, 0, __cArray2, __cAOp, __bArray, __bArrayCtr, __cArray3, __oneOfFlag, __bSetInCheckAlignment);
        
        }
    
        __bSetInCheckAlignment = 0;
      }
    }
    ReportTableEndVerdict(__tableHandle, __cEvaluateResponse, __res);
	__bVerdict = __bVerdict && __res;
  }
  if (__bVerdict == __eVerdictFail)
    TestReportWriteDiagObjectList();
}
  
void __diagServicevccmce9_99(DiagRequest * __req, DiagResponse * __resp )
{
  stack long __tableHandle;
  long __res, __paramLen, __bytePos;

   __bVerdict = __eVerdictPass;

  do {
    TestReportResetDiagObjectList();
    DiagSetReportDetailLevel("CVADAS_0001_00000000_000", EnumServiceDetails_onfail);
    // Request aspect
    {
      {
        __res = DiagSetParameterErrorHandled(__req, "DiagSessionType", 03);
        if(__res < 0)
        {
          __bVerdict = __eVerdictFail;
          DiagErrCodeTestStep(__res, "Cannot set diagnostic parameter 'DiagSessionType'");
          break;
        }
      }

      if (0 >= DiagSendReqAndWaitForResp("CVADAS_0001_00000000_000", __req, __resp, __res, -1, -1, -1, -1, -1, EnumResult_pos, EnumServiceDetails_onfail, EnumSendingMode_physical, EnumSuppressPosResBit_asconfigured, EnumVerdictOnInvalidValues_fail))
        break;
    }

    __res = DiagErrCodeTestStep(__res, "Can't retrieve last response for request! No check possible.") < 0;
    if(__res)
    {
	  __bVerdict = __eVerdictFail;
      break;
    }
    {
      __res = DiagInterpretAs(__resp, "DSC_PR");
      if(__res != 0)
      {
        __bVerdict = __eVerdictFail;
        DiagErrCodeTestStep(__res, "Can't interpret response as diagnostic primitive 'DSC_PR'.");
        break;
      }
      else
      {
        TestStepPass( "Received primitive can be interpreted as diagnostic primitive 'DSC_PR'.");
      }
    }
  }
  while(0);


  // Response, check & read aspect
  {
    __res = 1;
    __tableHandle = ReportTableHead5Columns(__cCheckCaption, __cTSym, __cTOp, __cRefVal, __cActual, __cRes);
    {
      double __nDiagValue;
      DiagGetParameterErrorHandled(__resp, "DiagSessionType", __nDiagValue);
      __csr = CheckSignalMatch(__nDiagValue, 03, "==") == 1;
      snprintf(__cArray, 8192, "%s", "Diagnostic parameter \'DiagSessionType\'");
      snprintf(__cArray2, 8192, "%s", __cArray);
      snprintf(__cArray3, 8192, "%s", "");
      ReportTableRow(__tableHandle, 0, __cArray2, "==", 03, __cArray3, __oneOfFlag, __bSetInCheckAlignment);
      ReportCell(__tableHandle, __nDiagValue);
      ReportCellResult(__tableHandle, __csr, __ePassFail);
    
      __res = __res && __csr;
    
    }
    ReportTableEndVerdict(__tableHandle, __cEvaluateResponse, __res);
	__bVerdict = __bVerdict && __res;
  }
  if (__bVerdict == __eVerdictFail)
    TestReportWriteDiagObjectList();
}
  
void __diagServicevccmce9_100(DiagRequest * __req, DiagResponse * __resp )
{
  stack long __tableHandle;
  long __res, __paramLen, __bytePos;

   __bVerdict = __eVerdictPass;

  do {
    TestReportResetDiagObjectList();
    DiagSetReportDetailLevel("CVADAS_0001_00000000_000", EnumServiceDetails_onfail);
    // Request aspect
    {

      if (0 >= DiagSendReqAndWaitForResp("CVADAS_0001_00000000_000", __req, __resp, __res, -1, -1, -1, -1, -1, EnumResult_pos, EnumServiceDetails_onfail, EnumSendingMode_physical, EnumSuppressPosResBit_asconfigured, EnumVerdictOnInvalidValues_fail))
        break;
    }

    __res = DiagErrCodeTestStep(__res, "Can't retrieve last response for request! No check possible.") < 0;
    if(__res)
    {
	  __bVerdict = __eVerdictFail;
      break;
    }
    {
      __res = DiagInterpretAs(__resp, "RDBI_PR");
      if(__res != 0)
      {
        __bVerdict = __eVerdictFail;
        DiagErrCodeTestStep(__res, "Can't interpret response as diagnostic primitive 'RDBI_PR'.");
        break;
      }
      else
      {
        TestStepPass( "Received primitive can be interpreted as diagnostic primitive 'RDBI_PR'.");
      }
    }
  }
  while(0);


  // Response, check & read aspect
  {
    __res = 1;
    __tableHandle = ReportTableHead5Columns(__cCheckCaption, __cTSym, __cTOp, __cRefVal, __cActual, __cRes);
    {
      __bDiagValueArrayCtr = DiagGetParameterErrorHandled(__resp, "_Supplier_Manufacturer_ECU_Hardware_Part_Number_24", __bDiagValueArray, elcount(__bDiagValueArray), __cDiagValueArray, elcount(__cDiagValueArray));
      {
        __bSetInCheckAlignment = 1;	
        {
          __bArrayCtr = __CopyBytes(__bDiagValueArray, __bDiagValueArrayCtr, __bArray);
          {
            sysvar * __systemVariable;
            __systemVariable = sysvarData::`PartNumber::`Part_Number;
            CheckSysVarSetBufferConsistency(sysSetVariableData(sysvarData::`PartNumber::`Part_Number, __bArray, __bArrayCtr), __systemVariable.name);
          }
          snprintf(__cArray, 8192, "%s", "Part_Number");
          snprintf(__cArray2, 8192, "%s '%s'", __cSysVar, __cArray);
          snprintf(__cArray3, 8192, "%s", "_Supplier_Manufacturer_ECU_Hardware_Part_Number_24");
          
          ReportTableRow(__tableHandle, 0, __cArray2, __cAOp, __bArray, __bArrayCtr, __cArray3, __oneOfFlag, __bSetInCheckAlignment);
        
        }
    
        __bSetInCheckAlignment = 0;
      }
    }
    ReportTableEndVerdict(__tableHandle, __cEvaluateResponse, __res);
	__bVerdict = __bVerdict && __res;
  }
  if (__bVerdict == __eVerdictFail)
    TestReportWriteDiagObjectList();
}

void Ttvccmce9_Tet_Tc18()
{
  CreateTTEIFFunction("Ttvccmce9_Tc18", __eTcDef, __eLocal);  
  AddIFParameterTestCaseAttribute("TC_ID", "");
  AddIFParameterTestCaseAttribute("Test Case ID", "");
  CallInterfaceFunction("2.5.5.9_F193", __cEmpty , __cEmpty );
}
testcase Ttvccmce9_Tc18()
{
  stack long __tableHandle;
  SetBreakOnFail(0);

  TestCommandBegin(__eDiagService, __cDiagService, "", "0");
  {
    if (DiagIsFunctionalGroup("CVADAS_0001_00000000_000"))
    {
      DiagResponse * __resp;
      DiagRequest CVADAS_0001_00000000_000.Default_Session_Start __req;
      __diagServicevccmce9_101(__req, __resp);
    }
    else
    {
      DiagResponse CVADAS_0001_00000000_000.* __resp;
      DiagRequest CVADAS_0001_00000000_000.Default_Session_Start __req;
      __diagServicevccmce9_101(__req, __resp);
    }
  }
  TestCommandEnd();


  TestCommandBegin(__eWait, __cWait, "", "1");
  {
    Wait("1", (syspar::`sleep * 1000000LL), 1000000, "sleep");
  }
  TestCommandEnd();

  TestCommandBegin(__eDiagService, __cDiagService, "", "2");
  {
    if (DiagIsFunctionalGroup("CVADAS_0001_00000000_000"))
    {
      DiagResponse * __resp;
      DiagRequest CVADAS_0001_00000000_000._22F193_Supplier_ECU_Hardware_Version_Number __req;
      __diagServicevccmce9_102(__req, __resp);
    }
    else
    {
      DiagResponse CVADAS_0001_00000000_000.* __resp;
      DiagRequest CVADAS_0001_00000000_000._22F193_Supplier_ECU_Hardware_Version_Number __req;
      __diagServicevccmce9_102(__req, __resp);
    }
  }
  TestCommandEnd();


  TestCommandBegin(__eDiagService, __cDiagService, "", "3");
  {
    if (DiagIsFunctionalGroup("CVADAS_0001_00000000_000"))
    {
      DiagResponse * __resp;
      DiagRequest CVADAS_0001_00000000_000.Extended_Diagnostic_Session_Start __req;
      __diagServicevccmce9_103(__req, __resp);
    }
    else
    {
      DiagResponse CVADAS_0001_00000000_000.* __resp;
      DiagRequest CVADAS_0001_00000000_000.Extended_Diagnostic_Session_Start __req;
      __diagServicevccmce9_103(__req, __resp);
    }
  }
  TestCommandEnd();


  TestCommandBegin(__eWait, __cWait, "", "4");
  {
    Wait("1", (syspar::`sleep * 1000000LL), 1000000, "sleep");
  }
  TestCommandEnd();

  TestCommandBegin(__eDiagService, __cDiagService, "", "5");
  {
    if (DiagIsFunctionalGroup("CVADAS_0001_00000000_000"))
    {
      DiagResponse * __resp;
      DiagRequest CVADAS_0001_00000000_000._22F193_Supplier_ECU_Hardware_Version_Number __req;
      __diagServicevccmce9_104(__req, __resp);
    }
    else
    {
      DiagResponse CVADAS_0001_00000000_000.* __resp;
      DiagRequest CVADAS_0001_00000000_000._22F193_Supplier_ECU_Hardware_Version_Number __req;
      __diagServicevccmce9_104(__req, __resp);
    }
  }
  TestCommandEnd();


}

  
void __diagServicevccmce9_101(DiagRequest * __req, DiagResponse * __resp )
{
  stack long __tableHandle;
  long __res, __paramLen, __bytePos;

   __bVerdict = __eVerdictPass;

  do {
    TestReportResetDiagObjectList();
    DiagSetReportDetailLevel("CVADAS_0001_00000000_000", EnumServiceDetails_onfail);
    // Request aspect
    {
      {
        __res = DiagSetParameterErrorHandled(__req, "DiagSessionType", 01);
        if(__res < 0)
        {
          __bVerdict = __eVerdictFail;
          DiagErrCodeTestStep(__res, "Cannot set diagnostic parameter 'DiagSessionType'");
          break;
        }
      }

      if (0 >= DiagSendReqAndWaitForResp("CVADAS_0001_00000000_000", __req, __resp, __res, -1, -1, -1, -1, -1, EnumResult_pos, EnumServiceDetails_onfail, EnumSendingMode_physical, EnumSuppressPosResBit_asconfigured, EnumVerdictOnInvalidValues_fail))
        break;
    }

    __res = DiagErrCodeTestStep(__res, "Can't retrieve last response for request! No check possible.") < 0;
    if(__res)
    {
	  __bVerdict = __eVerdictFail;
      break;
    }
    {
      __res = DiagInterpretAs(__resp, "DSC_PR");
      if(__res != 0)
      {
        __bVerdict = __eVerdictFail;
        DiagErrCodeTestStep(__res, "Can't interpret response as diagnostic primitive 'DSC_PR'.");
        break;
      }
      else
      {
        TestStepPass( "Received primitive can be interpreted as diagnostic primitive 'DSC_PR'.");
      }
    }
  }
  while(0);


  // Response, check & read aspect
  {
    __res = 1;
    __tableHandle = ReportTableHead5Columns(__cCheckCaption, __cTSym, __cTOp, __cRefVal, __cActual, __cRes);
    {
      double __nDiagValue;
      DiagGetParameterErrorHandled(__resp, "DiagSessionType", __nDiagValue);
      __csr = CheckSignalMatch(__nDiagValue, 01, "==") == 1;
      snprintf(__cArray, 8192, "%s", "Diagnostic parameter \'DiagSessionType\'");
      snprintf(__cArray2, 8192, "%s", __cArray);
      snprintf(__cArray3, 8192, "%s", "");
      ReportTableRow(__tableHandle, 0, __cArray2, "==", 01, __cArray3, __oneOfFlag, __bSetInCheckAlignment);
      ReportCell(__tableHandle, __nDiagValue);
      ReportCellResult(__tableHandle, __csr, __ePassFail);
    
      __res = __res && __csr;
    
    }
    ReportTableEndVerdict(__tableHandle, __cEvaluateResponse, __res);
	__bVerdict = __bVerdict && __res;
  }
  if (__bVerdict == __eVerdictFail)
    TestReportWriteDiagObjectList();
}
  
void __diagServicevccmce9_102(DiagRequest * __req, DiagResponse * __resp )
{
  stack long __tableHandle;
  long __res, __paramLen, __bytePos;

   __bVerdict = __eVerdictPass;

  do {
    TestReportResetDiagObjectList();
    DiagSetReportDetailLevel("CVADAS_0001_00000000_000", EnumServiceDetails_onfail);
    // Request aspect
    {

      if (0 >= DiagSendReqAndWaitForResp("CVADAS_0001_00000000_000", __req, __resp, __res, -1, -1, -1, -1, -1, EnumResult_pos, EnumServiceDetails_onfail, EnumSendingMode_physical, EnumSuppressPosResBit_asconfigured, EnumVerdictOnInvalidValues_fail))
        break;
    }

    __res = DiagErrCodeTestStep(__res, "Can't retrieve last response for request! No check possible.") < 0;
    if(__res)
    {
	  __bVerdict = __eVerdictFail;
      break;
    }
    {
      __res = DiagInterpretAs(__resp, "RDBI_PR");
      if(__res != 0)
      {
        __bVerdict = __eVerdictFail;
        DiagErrCodeTestStep(__res, "Can't interpret response as diagnostic primitive 'RDBI_PR'.");
        break;
      }
      else
      {
        TestStepPass( "Received primitive can be interpreted as diagnostic primitive 'RDBI_PR'.");
      }
    }
  }
  while(0);


  // Response, check & read aspect
  {
    __res = 1;
    __tableHandle = ReportTableHead5Columns(__cCheckCaption, __cTSym, __cTOp, __cRefVal, __cActual, __cRes);
    {
      __bDiagValueArrayCtr = DiagGetParameterErrorHandled(__resp, "_Supplier_Manufacturer_ECU_Hardware_Version_Number_24", __bDiagValueArray, elcount(__bDiagValueArray), __cDiagValueArray, elcount(__cDiagValueArray));
      {
        __bSetInCheckAlignment = 1;	
        {
          __bArrayCtr = __CopyBytes(__bDiagValueArray, __bDiagValueArrayCtr, __bArray);
          {
            sysvar * __systemVariable;
            __systemVariable = sysvarData::`PartNumber::`Part_Number;
            CheckSysVarSetBufferConsistency(sysSetVariableData(sysvarData::`PartNumber::`Part_Number, __bArray, __bArrayCtr), __systemVariable.name);
          }
          snprintf(__cArray, 8192, "%s", "Part_Number");
          snprintf(__cArray2, 8192, "%s '%s'", __cSysVar, __cArray);
          snprintf(__cArray3, 8192, "%s", "_Supplier_Manufacturer_ECU_Hardware_Version_Number_24");
          
          ReportTableRow(__tableHandle, 0, __cArray2, __cAOp, __bArray, __bArrayCtr, __cArray3, __oneOfFlag, __bSetInCheckAlignment);
        
        }
    
        __bSetInCheckAlignment = 0;
      }
    }
    ReportTableEndVerdict(__tableHandle, __cEvaluateResponse, __res);
	__bVerdict = __bVerdict && __res;
  }
  if (__bVerdict == __eVerdictFail)
    TestReportWriteDiagObjectList();
}
  
void __diagServicevccmce9_103(DiagRequest * __req, DiagResponse * __resp )
{
  stack long __tableHandle;
  long __res, __paramLen, __bytePos;

   __bVerdict = __eVerdictPass;

  do {
    TestReportResetDiagObjectList();
    DiagSetReportDetailLevel("CVADAS_0001_00000000_000", EnumServiceDetails_onfail);
    // Request aspect
    {
      {
        __res = DiagSetParameterErrorHandled(__req, "DiagSessionType", 03);
        if(__res < 0)
        {
          __bVerdict = __eVerdictFail;
          DiagErrCodeTestStep(__res, "Cannot set diagnostic parameter 'DiagSessionType'");
          break;
        }
      }

      if (0 >= DiagSendReqAndWaitForResp("CVADAS_0001_00000000_000", __req, __resp, __res, -1, -1, -1, -1, -1, EnumResult_pos, EnumServiceDetails_onfail, EnumSendingMode_physical, EnumSuppressPosResBit_asconfigured, EnumVerdictOnInvalidValues_fail))
        break;
    }

    __res = DiagErrCodeTestStep(__res, "Can't retrieve last response for request! No check possible.") < 0;
    if(__res)
    {
	  __bVerdict = __eVerdictFail;
      break;
    }
    {
      __res = DiagInterpretAs(__resp, "DSC_PR");
      if(__res != 0)
      {
        __bVerdict = __eVerdictFail;
        DiagErrCodeTestStep(__res, "Can't interpret response as diagnostic primitive 'DSC_PR'.");
        break;
      }
      else
      {
        TestStepPass( "Received primitive can be interpreted as diagnostic primitive 'DSC_PR'.");
      }
    }
  }
  while(0);


  // Response, check & read aspect
  {
    __res = 1;
    __tableHandle = ReportTableHead5Columns(__cCheckCaption, __cTSym, __cTOp, __cRefVal, __cActual, __cRes);
    {
      double __nDiagValue;
      DiagGetParameterErrorHandled(__resp, "DiagSessionType", __nDiagValue);
      __csr = CheckSignalMatch(__nDiagValue, 03, "==") == 1;
      snprintf(__cArray, 8192, "%s", "Diagnostic parameter \'DiagSessionType\'");
      snprintf(__cArray2, 8192, "%s", __cArray);
      snprintf(__cArray3, 8192, "%s", "");
      ReportTableRow(__tableHandle, 0, __cArray2, "==", 03, __cArray3, __oneOfFlag, __bSetInCheckAlignment);
      ReportCell(__tableHandle, __nDiagValue);
      ReportCellResult(__tableHandle, __csr, __ePassFail);
    
      __res = __res && __csr;
    
    }
    ReportTableEndVerdict(__tableHandle, __cEvaluateResponse, __res);
	__bVerdict = __bVerdict && __res;
  }
  if (__bVerdict == __eVerdictFail)
    TestReportWriteDiagObjectList();
}
  
void __diagServicevccmce9_104(DiagRequest * __req, DiagResponse * __resp )
{
  stack long __tableHandle;
  long __res, __paramLen, __bytePos;

   __bVerdict = __eVerdictPass;

  do {
    TestReportResetDiagObjectList();
    DiagSetReportDetailLevel("CVADAS_0001_00000000_000", EnumServiceDetails_onfail);
    // Request aspect
    {

      if (0 >= DiagSendReqAndWaitForResp("CVADAS_0001_00000000_000", __req, __resp, __res, -1, -1, -1, -1, -1, EnumResult_pos, EnumServiceDetails_onfail, EnumSendingMode_physical, EnumSuppressPosResBit_asconfigured, EnumVerdictOnInvalidValues_fail))
        break;
    }

    __res = DiagErrCodeTestStep(__res, "Can't retrieve last response for request! No check possible.") < 0;
    if(__res)
    {
	  __bVerdict = __eVerdictFail;
      break;
    }
    {
      __res = DiagInterpretAs(__resp, "RDBI_PR");
      if(__res != 0)
      {
        __bVerdict = __eVerdictFail;
        DiagErrCodeTestStep(__res, "Can't interpret response as diagnostic primitive 'RDBI_PR'.");
        break;
      }
      else
      {
        TestStepPass( "Received primitive can be interpreted as diagnostic primitive 'RDBI_PR'.");
      }
    }
  }
  while(0);


  // Response, check & read aspect
  {
    __res = 1;
    __tableHandle = ReportTableHead5Columns(__cCheckCaption, __cTSym, __cTOp, __cRefVal, __cActual, __cRes);
    {
      __bDiagValueArrayCtr = DiagGetParameterErrorHandled(__resp, "_Supplier_Manufacturer_ECU_Hardware_Version_Number_24", __bDiagValueArray, elcount(__bDiagValueArray), __cDiagValueArray, elcount(__cDiagValueArray));
      {
        __bSetInCheckAlignment = 1;	
        {
          __bArrayCtr = __CopyBytes(__bDiagValueArray, __bDiagValueArrayCtr, __bArray);
          {
            sysvar * __systemVariable;
            __systemVariable = sysvarData::`PartNumber::`Part_Number;
            CheckSysVarSetBufferConsistency(sysSetVariableData(sysvarData::`PartNumber::`Part_Number, __bArray, __bArrayCtr), __systemVariable.name);
          }
          snprintf(__cArray, 8192, "%s", "Part_Number");
          snprintf(__cArray2, 8192, "%s '%s'", __cSysVar, __cArray);
          snprintf(__cArray3, 8192, "%s", "_Supplier_Manufacturer_ECU_Hardware_Version_Number_24");
          
          ReportTableRow(__tableHandle, 0, __cArray2, __cAOp, __bArray, __bArrayCtr, __cArray3, __oneOfFlag, __bSetInCheckAlignment);
        
        }
    
        __bSetInCheckAlignment = 0;
      }
    }
    ReportTableEndVerdict(__tableHandle, __cEvaluateResponse, __res);
	__bVerdict = __bVerdict && __res;
  }
  if (__bVerdict == __eVerdictFail)
    TestReportWriteDiagObjectList();
}

void Ttvccmce9_Tet_Tc19()
{
  CreateTTEIFFunction("Ttvccmce9_Tc19", __eTcDef, __eLocal);  
  AddIFParameterTestCaseAttribute("TC_ID", "");
  AddIFParameterTestCaseAttribute("Test Case ID", "");
  CallInterfaceFunction("2.5.5.10_F194", __cEmpty , __cEmpty );
}
testcase Ttvccmce9_Tc19()
{
  stack long __tableHandle;
  SetBreakOnFail(0);

  TestCommandBegin(__eDiagService, __cDiagService, "", "0");
  {
    if (DiagIsFunctionalGroup("CVADAS_0001_00000000_000"))
    {
      DiagResponse * __resp;
      DiagRequest CVADAS_0001_00000000_000.Default_Session_Start __req;
      __diagServicevccmce9_105(__req, __resp);
    }
    else
    {
      DiagResponse CVADAS_0001_00000000_000.* __resp;
      DiagRequest CVADAS_0001_00000000_000.Default_Session_Start __req;
      __diagServicevccmce9_105(__req, __resp);
    }
  }
  TestCommandEnd();


  TestCommandBegin(__eWait, __cWait, "", "1");
  {
    Wait("1", (syspar::`sleep * 1000000LL), 1000000, "sleep");
  }
  TestCommandEnd();

  TestCommandBegin(__eDiagService, __cDiagService, "", "2");
  {
    if (DiagIsFunctionalGroup("CVADAS_0001_00000000_000"))
    {
      DiagResponse * __resp;
      DiagRequest CVADAS_0001_00000000_000._22F194_Supplier_ECU_Software_Part_Number __req;
      __diagServicevccmce9_106(__req, __resp);
    }
    else
    {
      DiagResponse CVADAS_0001_00000000_000.* __resp;
      DiagRequest CVADAS_0001_00000000_000._22F194_Supplier_ECU_Software_Part_Number __req;
      __diagServicevccmce9_106(__req, __resp);
    }
  }
  TestCommandEnd();


  TestCommandBegin(__eDiagService, __cDiagService, "", "3");
  {
    if (DiagIsFunctionalGroup("CVADAS_0001_00000000_000"))
    {
      DiagResponse * __resp;
      DiagRequest CVADAS_0001_00000000_000.Extended_Diagnostic_Session_Start __req;
      __diagServicevccmce9_107(__req, __resp);
    }
    else
    {
      DiagResponse CVADAS_0001_00000000_000.* __resp;
      DiagRequest CVADAS_0001_00000000_000.Extended_Diagnostic_Session_Start __req;
      __diagServicevccmce9_107(__req, __resp);
    }
  }
  TestCommandEnd();


  TestCommandBegin(__eWait, __cWait, "", "4");
  {
    Wait("1", (syspar::`sleep * 1000000LL), 1000000, "sleep");
  }
  TestCommandEnd();

  TestCommandBegin(__eDiagService, __cDiagService, "", "5");
  {
    if (DiagIsFunctionalGroup("CVADAS_0001_00000000_000"))
    {
      DiagResponse * __resp;
      DiagRequest CVADAS_0001_00000000_000._22F194_Supplier_ECU_Software_Part_Number __req;
      __diagServicevccmce9_108(__req, __resp);
    }
    else
    {
      DiagResponse CVADAS_0001_00000000_000.* __resp;
      DiagRequest CVADAS_0001_00000000_000._22F194_Supplier_ECU_Software_Part_Number __req;
      __diagServicevccmce9_108(__req, __resp);
    }
  }
  TestCommandEnd();


}

  
void __diagServicevccmce9_105(DiagRequest * __req, DiagResponse * __resp )
{
  stack long __tableHandle;
  long __res, __paramLen, __bytePos;

   __bVerdict = __eVerdictPass;

  do {
    TestReportResetDiagObjectList();
    DiagSetReportDetailLevel("CVADAS_0001_00000000_000", EnumServiceDetails_onfail);
    // Request aspect
    {
      {
        __res = DiagSetParameterErrorHandled(__req, "DiagSessionType", 01);
        if(__res < 0)
        {
          __bVerdict = __eVerdictFail;
          DiagErrCodeTestStep(__res, "Cannot set diagnostic parameter 'DiagSessionType'");
          break;
        }
      }

      if (0 >= DiagSendReqAndWaitForResp("CVADAS_0001_00000000_000", __req, __resp, __res, -1, -1, -1, -1, -1, EnumResult_pos, EnumServiceDetails_onfail, EnumSendingMode_physical, EnumSuppressPosResBit_asconfigured, EnumVerdictOnInvalidValues_fail))
        break;
    }

    __res = DiagErrCodeTestStep(__res, "Can't retrieve last response for request! No check possible.") < 0;
    if(__res)
    {
	  __bVerdict = __eVerdictFail;
      break;
    }
    {
      __res = DiagInterpretAs(__resp, "DSC_PR");
      if(__res != 0)
      {
        __bVerdict = __eVerdictFail;
        DiagErrCodeTestStep(__res, "Can't interpret response as diagnostic primitive 'DSC_PR'.");
        break;
      }
      else
      {
        TestStepPass( "Received primitive can be interpreted as diagnostic primitive 'DSC_PR'.");
      }
    }
  }
  while(0);


  // Response, check & read aspect
  {
    __res = 1;
    __tableHandle = ReportTableHead5Columns(__cCheckCaption, __cTSym, __cTOp, __cRefVal, __cActual, __cRes);
    {
      double __nDiagValue;
      DiagGetParameterErrorHandled(__resp, "DiagSessionType", __nDiagValue);
      __csr = CheckSignalMatch(__nDiagValue, 01, "==") == 1;
      snprintf(__cArray, 8192, "%s", "Diagnostic parameter \'DiagSessionType\'");
      snprintf(__cArray2, 8192, "%s", __cArray);
      snprintf(__cArray3, 8192, "%s", "");
      ReportTableRow(__tableHandle, 0, __cArray2, "==", 01, __cArray3, __oneOfFlag, __bSetInCheckAlignment);
      ReportCell(__tableHandle, __nDiagValue);
      ReportCellResult(__tableHandle, __csr, __ePassFail);
    
      __res = __res && __csr;
    
    }
    ReportTableEndVerdict(__tableHandle, __cEvaluateResponse, __res);
	__bVerdict = __bVerdict && __res;
  }
  if (__bVerdict == __eVerdictFail)
    TestReportWriteDiagObjectList();
}
  
void __diagServicevccmce9_106(DiagRequest * __req, DiagResponse * __resp )
{
  stack long __tableHandle;
  long __res, __paramLen, __bytePos;

   __bVerdict = __eVerdictPass;

  do {
    TestReportResetDiagObjectList();
    DiagSetReportDetailLevel("CVADAS_0001_00000000_000", EnumServiceDetails_onfail);
    // Request aspect
    {

      if (0 >= DiagSendReqAndWaitForResp("CVADAS_0001_00000000_000", __req, __resp, __res, -1, -1, -1, -1, -1, EnumResult_pos, EnumServiceDetails_onfail, EnumSendingMode_physical, EnumSuppressPosResBit_asconfigured, EnumVerdictOnInvalidValues_fail))
        break;
    }

    __res = DiagErrCodeTestStep(__res, "Can't retrieve last response for request! No check possible.") < 0;
    if(__res)
    {
	  __bVerdict = __eVerdictFail;
      break;
    }
    {
      __res = DiagInterpretAs(__resp, "RDBI_PR");
      if(__res != 0)
      {
        __bVerdict = __eVerdictFail;
        DiagErrCodeTestStep(__res, "Can't interpret response as diagnostic primitive 'RDBI_PR'.");
        break;
      }
      else
      {
        TestStepPass( "Received primitive can be interpreted as diagnostic primitive 'RDBI_PR'.");
      }
    }
  }
  while(0);


  // Response, check & read aspect
  {
    __res = 1;
    __tableHandle = ReportTableHead5Columns(__cCheckCaption, __cTSym, __cTOp, __cRefVal, __cActual, __cRes);
    {
      __bDiagValueArrayCtr = DiagGetParameterErrorHandled(__resp, "_Supplier_Manufacturer_ECU_Software_Part_Number_24", __bDiagValueArray, elcount(__bDiagValueArray), __cDiagValueArray, elcount(__cDiagValueArray));
      {
        __bSetInCheckAlignment = 1;	
        {
          __bArrayCtr = __CopyBytes(__bDiagValueArray, __bDiagValueArrayCtr, __bArray);
          {
            sysvar * __systemVariable;
            __systemVariable = sysvarData::`PartNumber::`Part_Number;
            CheckSysVarSetBufferConsistency(sysSetVariableData(sysvarData::`PartNumber::`Part_Number, __bArray, __bArrayCtr), __systemVariable.name);
          }
          snprintf(__cArray, 8192, "%s", "Part_Number");
          snprintf(__cArray2, 8192, "%s '%s'", __cSysVar, __cArray);
          snprintf(__cArray3, 8192, "%s", "_Supplier_Manufacturer_ECU_Software_Part_Number_24");
          
          ReportTableRow(__tableHandle, 0, __cArray2, __cAOp, __bArray, __bArrayCtr, __cArray3, __oneOfFlag, __bSetInCheckAlignment);
        
        }
    
        __bSetInCheckAlignment = 0;
      }
    }
    ReportTableEndVerdict(__tableHandle, __cEvaluateResponse, __res);
	__bVerdict = __bVerdict && __res;
  }
  if (__bVerdict == __eVerdictFail)
    TestReportWriteDiagObjectList();
}
  
void __diagServicevccmce9_107(DiagRequest * __req, DiagResponse * __resp )
{
  stack long __tableHandle;
  long __res, __paramLen, __bytePos;

   __bVerdict = __eVerdictPass;

  do {
    TestReportResetDiagObjectList();
    DiagSetReportDetailLevel("CVADAS_0001_00000000_000", EnumServiceDetails_onfail);
    // Request aspect
    {
      {
        __res = DiagSetParameterErrorHandled(__req, "DiagSessionType", 03);
        if(__res < 0)
        {
          __bVerdict = __eVerdictFail;
          DiagErrCodeTestStep(__res, "Cannot set diagnostic parameter 'DiagSessionType'");
          break;
        }
      }

      if (0 >= DiagSendReqAndWaitForResp("CVADAS_0001_00000000_000", __req, __resp, __res, -1, -1, -1, -1, -1, EnumResult_pos, EnumServiceDetails_onfail, EnumSendingMode_physical, EnumSuppressPosResBit_asconfigured, EnumVerdictOnInvalidValues_fail))
        break;
    }

    __res = DiagErrCodeTestStep(__res, "Can't retrieve last response for request! No check possible.") < 0;
    if(__res)
    {
	  __bVerdict = __eVerdictFail;
      break;
    }
    {
      __res = DiagInterpretAs(__resp, "DSC_PR");
      if(__res != 0)
      {
        __bVerdict = __eVerdictFail;
        DiagErrCodeTestStep(__res, "Can't interpret response as diagnostic primitive 'DSC_PR'.");
        break;
      }
      else
      {
        TestStepPass( "Received primitive can be interpreted as diagnostic primitive 'DSC_PR'.");
      }
    }
  }
  while(0);


  // Response, check & read aspect
  {
    __res = 1;
    __tableHandle = ReportTableHead5Columns(__cCheckCaption, __cTSym, __cTOp, __cRefVal, __cActual, __cRes);
    {
      double __nDiagValue;
      DiagGetParameterErrorHandled(__resp, "DiagSessionType", __nDiagValue);
      __csr = CheckSignalMatch(__nDiagValue, 03, "==") == 1;
      snprintf(__cArray, 8192, "%s", "Diagnostic parameter \'DiagSessionType\'");
      snprintf(__cArray2, 8192, "%s", __cArray);
      snprintf(__cArray3, 8192, "%s", "");
      ReportTableRow(__tableHandle, 0, __cArray2, "==", 03, __cArray3, __oneOfFlag, __bSetInCheckAlignment);
      ReportCell(__tableHandle, __nDiagValue);
      ReportCellResult(__tableHandle, __csr, __ePassFail);
    
      __res = __res && __csr;
    
    }
    ReportTableEndVerdict(__tableHandle, __cEvaluateResponse, __res);
	__bVerdict = __bVerdict && __res;
  }
  if (__bVerdict == __eVerdictFail)
    TestReportWriteDiagObjectList();
}
  
void __diagServicevccmce9_108(DiagRequest * __req, DiagResponse * __resp )
{
  stack long __tableHandle;
  long __res, __paramLen, __bytePos;

   __bVerdict = __eVerdictPass;

  do {
    TestReportResetDiagObjectList();
    DiagSetReportDetailLevel("CVADAS_0001_00000000_000", EnumServiceDetails_onfail);
    // Request aspect
    {

      if (0 >= DiagSendReqAndWaitForResp("CVADAS_0001_00000000_000", __req, __resp, __res, -1, -1, -1, -1, -1, EnumResult_pos, EnumServiceDetails_onfail, EnumSendingMode_physical, EnumSuppressPosResBit_asconfigured, EnumVerdictOnInvalidValues_fail))
        break;
    }

    __res = DiagErrCodeTestStep(__res, "Can't retrieve last response for request! No check possible.") < 0;
    if(__res)
    {
	  __bVerdict = __eVerdictFail;
      break;
    }
    {
      __res = DiagInterpretAs(__resp, "RDBI_PR");
      if(__res != 0)
      {
        __bVerdict = __eVerdictFail;
        DiagErrCodeTestStep(__res, "Can't interpret response as diagnostic primitive 'RDBI_PR'.");
        break;
      }
      else
      {
        TestStepPass( "Received primitive can be interpreted as diagnostic primitive 'RDBI_PR'.");
      }
    }
  }
  while(0);


  // Response, check & read aspect
  {
    __res = 1;
    __tableHandle = ReportTableHead5Columns(__cCheckCaption, __cTSym, __cTOp, __cRefVal, __cActual, __cRes);
    {
      __bDiagValueArrayCtr = DiagGetParameterErrorHandled(__resp, "_Supplier_Manufacturer_ECU_Software_Part_Number_24", __bDiagValueArray, elcount(__bDiagValueArray), __cDiagValueArray, elcount(__cDiagValueArray));
      {
        __bSetInCheckAlignment = 1;	
        {
          __bArrayCtr = __CopyBytes(__bDiagValueArray, __bDiagValueArrayCtr, __bArray);
          {
            sysvar * __systemVariable;
            __systemVariable = sysvarData::`PartNumber::`Part_Number;
            CheckSysVarSetBufferConsistency(sysSetVariableData(sysvarData::`PartNumber::`Part_Number, __bArray, __bArrayCtr), __systemVariable.name);
          }
          snprintf(__cArray, 8192, "%s", "Part_Number");
          snprintf(__cArray2, 8192, "%s '%s'", __cSysVar, __cArray);
          snprintf(__cArray3, 8192, "%s", "_Supplier_Manufacturer_ECU_Software_Part_Number_24");
          
          ReportTableRow(__tableHandle, 0, __cArray2, __cAOp, __bArray, __bArrayCtr, __cArray3, __oneOfFlag, __bSetInCheckAlignment);
        
        }
    
        __bSetInCheckAlignment = 0;
      }
    }
    ReportTableEndVerdict(__tableHandle, __cEvaluateResponse, __res);
	__bVerdict = __bVerdict && __res;
  }
  if (__bVerdict == __eVerdictFail)
    TestReportWriteDiagObjectList();
}

void Ttvccmce9_Tet_Tc20()
{
  CreateTTEIFFunction("Ttvccmce9_Tc20", __eTcDef, __eLocal);  
  AddIFParameterTestCaseAttribute("TC_ID", "");
  AddIFParameterTestCaseAttribute("Test Case ID", "");
  CallInterfaceFunction("2.6.5.11_F195", __cEmpty , __cEmpty );
}
testcase Ttvccmce9_Tc20()
{
  stack long __tableHandle;
  SetBreakOnFail(0);

  TestCommandBegin(__eDiagService, __cDiagService, "", "0");
  {
    if (DiagIsFunctionalGroup("CVADAS_0001_00000000_000"))
    {
      DiagResponse * __resp;
      DiagRequest CVADAS_0001_00000000_000.Default_Session_Start __req;
      __diagServicevccmce9_109(__req, __resp);
    }
    else
    {
      DiagResponse CVADAS_0001_00000000_000.* __resp;
      DiagRequest CVADAS_0001_00000000_000.Default_Session_Start __req;
      __diagServicevccmce9_109(__req, __resp);
    }
  }
  TestCommandEnd();


  TestCommandBegin(__eWait, __cWait, "", "1");
  {
    Wait("1", (syspar::`sleep * 1000000LL), 1000000, "sleep");
  }
  TestCommandEnd();

  TestCommandBegin(__eDiagService, __cDiagService, "", "2");
  {
    if (DiagIsFunctionalGroup("CVADAS_0001_00000000_000"))
    {
      DiagResponse * __resp;
      DiagRequest CVADAS_0001_00000000_000._22F195_Supplier_ECU_Software_Version_Number __req;
      __diagServicevccmce9_110(__req, __resp);
    }
    else
    {
      DiagResponse CVADAS_0001_00000000_000.* __resp;
      DiagRequest CVADAS_0001_00000000_000._22F195_Supplier_ECU_Software_Version_Number __req;
      __diagServicevccmce9_110(__req, __resp);
    }
  }
  TestCommandEnd();


  TestCommandBegin(__eDiagService, __cDiagService, "", "3");
  {
    if (DiagIsFunctionalGroup("CVADAS_0001_00000000_000"))
    {
      DiagResponse * __resp;
      DiagRequest CVADAS_0001_00000000_000.Extended_Diagnostic_Session_Start __req;
      __diagServicevccmce9_111(__req, __resp);
    }
    else
    {
      DiagResponse CVADAS_0001_00000000_000.* __resp;
      DiagRequest CVADAS_0001_00000000_000.Extended_Diagnostic_Session_Start __req;
      __diagServicevccmce9_111(__req, __resp);
    }
  }
  TestCommandEnd();


  TestCommandBegin(__eWait, __cWait, "", "4");
  {
    Wait("1", (syspar::`sleep * 1000000LL), 1000000, "sleep");
  }
  TestCommandEnd();

  TestCommandBegin(__eDiagService, __cDiagService, "", "5");
  {
    if (DiagIsFunctionalGroup("CVADAS_0001_00000000_000"))
    {
      DiagResponse * __resp;
      DiagRequest CVADAS_0001_00000000_000._22F195_Supplier_ECU_Software_Version_Number __req;
      __diagServicevccmce9_112(__req, __resp);
    }
    else
    {
      DiagResponse CVADAS_0001_00000000_000.* __resp;
      DiagRequest CVADAS_0001_00000000_000._22F195_Supplier_ECU_Software_Version_Number __req;
      __diagServicevccmce9_112(__req, __resp);
    }
  }
  TestCommandEnd();


}

  
void __diagServicevccmce9_109(DiagRequest * __req, DiagResponse * __resp )
{
  stack long __tableHandle;
  long __res, __paramLen, __bytePos;

   __bVerdict = __eVerdictPass;

  do {
    TestReportResetDiagObjectList();
    DiagSetReportDetailLevel("CVADAS_0001_00000000_000", EnumServiceDetails_onfail);
    // Request aspect
    {
      {
        __res = DiagSetParameterErrorHandled(__req, "DiagSessionType", 01);
        if(__res < 0)
        {
          __bVerdict = __eVerdictFail;
          DiagErrCodeTestStep(__res, "Cannot set diagnostic parameter 'DiagSessionType'");
          break;
        }
      }

      if (0 >= DiagSendReqAndWaitForResp("CVADAS_0001_00000000_000", __req, __resp, __res, -1, -1, -1, -1, -1, EnumResult_pos, EnumServiceDetails_onfail, EnumSendingMode_physical, EnumSuppressPosResBit_asconfigured, EnumVerdictOnInvalidValues_fail))
        break;
    }

    __res = DiagErrCodeTestStep(__res, "Can't retrieve last response for request! No check possible.") < 0;
    if(__res)
    {
	  __bVerdict = __eVerdictFail;
      break;
    }
    {
      __res = DiagInterpretAs(__resp, "DSC_PR");
      if(__res != 0)
      {
        __bVerdict = __eVerdictFail;
        DiagErrCodeTestStep(__res, "Can't interpret response as diagnostic primitive 'DSC_PR'.");
        break;
      }
      else
      {
        TestStepPass( "Received primitive can be interpreted as diagnostic primitive 'DSC_PR'.");
      }
    }
  }
  while(0);


  // Response, check & read aspect
  {
    __res = 1;
    __tableHandle = ReportTableHead5Columns(__cCheckCaption, __cTSym, __cTOp, __cRefVal, __cActual, __cRes);
    {
      double __nDiagValue;
      DiagGetParameterErrorHandled(__resp, "DiagSessionType", __nDiagValue);
      __csr = CheckSignalMatch(__nDiagValue, 01, "==") == 1;
      snprintf(__cArray, 8192, "%s", "Diagnostic parameter \'DiagSessionType\'");
      snprintf(__cArray2, 8192, "%s", __cArray);
      snprintf(__cArray3, 8192, "%s", "");
      ReportTableRow(__tableHandle, 0, __cArray2, "==", 01, __cArray3, __oneOfFlag, __bSetInCheckAlignment);
      ReportCell(__tableHandle, __nDiagValue);
      ReportCellResult(__tableHandle, __csr, __ePassFail);
    
      __res = __res && __csr;
    
    }
    ReportTableEndVerdict(__tableHandle, __cEvaluateResponse, __res);
	__bVerdict = __bVerdict && __res;
  }
  if (__bVerdict == __eVerdictFail)
    TestReportWriteDiagObjectList();
}
  
void __diagServicevccmce9_110(DiagRequest * __req, DiagResponse * __resp )
{
  stack long __tableHandle;
  long __res, __paramLen, __bytePos;

   __bVerdict = __eVerdictPass;

  do {
    TestReportResetDiagObjectList();
    DiagSetReportDetailLevel("CVADAS_0001_00000000_000", EnumServiceDetails_onfail);
    // Request aspect
    {

      if (0 >= DiagSendReqAndWaitForResp("CVADAS_0001_00000000_000", __req, __resp, __res, -1, -1, -1, -1, -1, EnumResult_pos, EnumServiceDetails_onfail, EnumSendingMode_physical, EnumSuppressPosResBit_asconfigured, EnumVerdictOnInvalidValues_fail))
        break;
    }

    __res = DiagErrCodeTestStep(__res, "Can't retrieve last response for request! No check possible.") < 0;
    if(__res)
    {
	  __bVerdict = __eVerdictFail;
      break;
    }
    {
      __res = DiagInterpretAs(__resp, "RDBI_PR");
      if(__res != 0)
      {
        __bVerdict = __eVerdictFail;
        DiagErrCodeTestStep(__res, "Can't interpret response as diagnostic primitive 'RDBI_PR'.");
        break;
      }
      else
      {
        TestStepPass( "Received primitive can be interpreted as diagnostic primitive 'RDBI_PR'.");
      }
    }
  }
  while(0);


  // Response, check & read aspect
  {
    __res = 1;
    __tableHandle = ReportTableHead5Columns(__cCheckCaption, __cTSym, __cTOp, __cRefVal, __cActual, __cRes);
    {
      __bDiagValueArrayCtr = DiagGetParameterErrorHandled(__resp, "_Supplier_Manufacturer_ECU_Software_Version_Number_24", __bDiagValueArray, elcount(__bDiagValueArray), __cDiagValueArray, elcount(__cDiagValueArray));
      {
        __bSetInCheckAlignment = 1;	
        {
          __bArrayCtr = __CopyBytes(__bDiagValueArray, __bDiagValueArrayCtr, __bArray);
          {
            sysvar * __systemVariable;
            __systemVariable = sysvarData::`PartNumber::`Part_Number;
            CheckSysVarSetBufferConsistency(sysSetVariableData(sysvarData::`PartNumber::`Part_Number, __bArray, __bArrayCtr), __systemVariable.name);
          }
          snprintf(__cArray, 8192, "%s", "Part_Number");
          snprintf(__cArray2, 8192, "%s '%s'", __cSysVar, __cArray);
          snprintf(__cArray3, 8192, "%s", "_Supplier_Manufacturer_ECU_Software_Version_Number_24");
          
          ReportTableRow(__tableHandle, 0, __cArray2, __cAOp, __bArray, __bArrayCtr, __cArray3, __oneOfFlag, __bSetInCheckAlignment);
        
        }
    
        __bSetInCheckAlignment = 0;
      }
    }
    ReportTableEndVerdict(__tableHandle, __cEvaluateResponse, __res);
	__bVerdict = __bVerdict && __res;
  }
  if (__bVerdict == __eVerdictFail)
    TestReportWriteDiagObjectList();
}
  
void __diagServicevccmce9_111(DiagRequest * __req, DiagResponse * __resp )
{
  stack long __tableHandle;
  long __res, __paramLen, __bytePos;

   __bVerdict = __eVerdictPass;

  do {
    TestReportResetDiagObjectList();
    DiagSetReportDetailLevel("CVADAS_0001_00000000_000", EnumServiceDetails_onfail);
    // Request aspect
    {
      {
        __res = DiagSetParameterErrorHandled(__req, "DiagSessionType", 03);
        if(__res < 0)
        {
          __bVerdict = __eVerdictFail;
          DiagErrCodeTestStep(__res, "Cannot set diagnostic parameter 'DiagSessionType'");
          break;
        }
      }

      if (0 >= DiagSendReqAndWaitForResp("CVADAS_0001_00000000_000", __req, __resp, __res, -1, -1, -1, -1, -1, EnumResult_pos, EnumServiceDetails_onfail, EnumSendingMode_physical, EnumSuppressPosResBit_asconfigured, EnumVerdictOnInvalidValues_fail))
        break;
    }

    __res = DiagErrCodeTestStep(__res, "Can't retrieve last response for request! No check possible.") < 0;
    if(__res)
    {
	  __bVerdict = __eVerdictFail;
      break;
    }
    {
      __res = DiagInterpretAs(__resp, "DSC_PR");
      if(__res != 0)
      {
        __bVerdict = __eVerdictFail;
        DiagErrCodeTestStep(__res, "Can't interpret response as diagnostic primitive 'DSC_PR'.");
        break;
      }
      else
      {
        TestStepPass( "Received primitive can be interpreted as diagnostic primitive 'DSC_PR'.");
      }
    }
  }
  while(0);


  // Response, check & read aspect
  {
    __res = 1;
    __tableHandle = ReportTableHead5Columns(__cCheckCaption, __cTSym, __cTOp, __cRefVal, __cActual, __cRes);
    {
      double __nDiagValue;
      DiagGetParameterErrorHandled(__resp, "DiagSessionType", __nDiagValue);
      __csr = CheckSignalMatch(__nDiagValue, 03, "==") == 1;
      snprintf(__cArray, 8192, "%s", "Diagnostic parameter \'DiagSessionType\'");
      snprintf(__cArray2, 8192, "%s", __cArray);
      snprintf(__cArray3, 8192, "%s", "");
      ReportTableRow(__tableHandle, 0, __cArray2, "==", 03, __cArray3, __oneOfFlag, __bSetInCheckAlignment);
      ReportCell(__tableHandle, __nDiagValue);
      ReportCellResult(__tableHandle, __csr, __ePassFail);
    
      __res = __res && __csr;
    
    }
    ReportTableEndVerdict(__tableHandle, __cEvaluateResponse, __res);
	__bVerdict = __bVerdict && __res;
  }
  if (__bVerdict == __eVerdictFail)
    TestReportWriteDiagObjectList();
}
  
void __diagServicevccmce9_112(DiagRequest * __req, DiagResponse * __resp )
{
  stack long __tableHandle;
  long __res, __paramLen, __bytePos;

   __bVerdict = __eVerdictPass;

  do {
    TestReportResetDiagObjectList();
    DiagSetReportDetailLevel("CVADAS_0001_00000000_000", EnumServiceDetails_onfail);
    // Request aspect
    {

      if (0 >= DiagSendReqAndWaitForResp("CVADAS_0001_00000000_000", __req, __resp, __res, -1, -1, -1, -1, -1, EnumResult_pos, EnumServiceDetails_onfail, EnumSendingMode_physical, EnumSuppressPosResBit_asconfigured, EnumVerdictOnInvalidValues_fail))
        break;
    }

    __res = DiagErrCodeTestStep(__res, "Can't retrieve last response for request! No check possible.") < 0;
    if(__res)
    {
	  __bVerdict = __eVerdictFail;
      break;
    }
    {
      __res = DiagInterpretAs(__resp, "RDBI_PR");
      if(__res != 0)
      {
        __bVerdict = __eVerdictFail;
        DiagErrCodeTestStep(__res, "Can't interpret response as diagnostic primitive 'RDBI_PR'.");
        break;
      }
      else
      {
        TestStepPass( "Received primitive can be interpreted as diagnostic primitive 'RDBI_PR'.");
      }
    }
  }
  while(0);


  // Response, check & read aspect
  {
    __res = 1;
    __tableHandle = ReportTableHead5Columns(__cCheckCaption, __cTSym, __cTOp, __cRefVal, __cActual, __cRes);
    {
      __bDiagValueArrayCtr = DiagGetParameterErrorHandled(__resp, "_Supplier_Manufacturer_ECU_Software_Version_Number_24", __bDiagValueArray, elcount(__bDiagValueArray), __cDiagValueArray, elcount(__cDiagValueArray));
      {
        __bSetInCheckAlignment = 1;	
        {
          __bArrayCtr = __CopyBytes(__bDiagValueArray, __bDiagValueArrayCtr, __bArray);
          {
            sysvar * __systemVariable;
            __systemVariable = sysvarData::`PartNumber::`Part_Number;
            CheckSysVarSetBufferConsistency(sysSetVariableData(sysvarData::`PartNumber::`Part_Number, __bArray, __bArrayCtr), __systemVariable.name);
          }
          snprintf(__cArray, 8192, "%s", "Part_Number");
          snprintf(__cArray2, 8192, "%s '%s'", __cSysVar, __cArray);
          snprintf(__cArray3, 8192, "%s", "_Supplier_Manufacturer_ECU_Software_Version_Number_24");
          
          ReportTableRow(__tableHandle, 0, __cArray2, __cAOp, __bArray, __bArrayCtr, __cArray3, __oneOfFlag, __bSetInCheckAlignment);
        
        }
    
        __bSetInCheckAlignment = 0;
      }
    }
    ReportTableEndVerdict(__tableHandle, __cEvaluateResponse, __res);
	__bVerdict = __bVerdict && __res;
  }
  if (__bVerdict == __eVerdictFail)
    TestReportWriteDiagObjectList();
}

void Ttvccmce9_Tet_Tc21()
{
  CreateTTEIFFunction("Ttvccmce9_Tc21", __eTcDef, __eLocal);  
  AddIFParameterTestCaseAttribute("TC_ID", "");
  AddIFParameterTestCaseAttribute("Test Case ID", "");
  CallInterfaceFunction("2.6.6.1_FD15", __cEmpty , __cEmpty );
}
testcase Ttvccmce9_Tc21()
{
  stack long __tableHandle;
  SetBreakOnFail(0);

  TestCommandBegin(__eDiagService, __cDiagService, "", "0");
  {
    if (DiagIsFunctionalGroup("CVADAS_0001_00000000_000"))
    {
      DiagResponse * __resp;
      DiagRequest CVADAS_0001_00000000_000.Default_Session_Start __req;
      __diagServicevccmce9_113(__req, __resp);
    }
    else
    {
      DiagResponse CVADAS_0001_00000000_000.* __resp;
      DiagRequest CVADAS_0001_00000000_000.Default_Session_Start __req;
      __diagServicevccmce9_113(__req, __resp);
    }
  }
  TestCommandEnd();


  TestCommandBegin(__eWait, __cWait, "", "1");
  {
    Wait("1", (syspar::`sleep * 1000000LL), 1000000, "sleep");
  }
  TestCommandEnd();

  TestCommandBegin(__eDiagService, __cDiagService, "", "2");
  {
    if (DiagIsFunctionalGroup("CVADAS_0001_00000000_000"))
    {
      DiagResponse * __resp;
      DiagRequest CVADAS_0001_00000000_000._22FD15_Magna_Production_HW_Number_Read __req;
      __diagServicevccmce9_114(__req, __resp);
    }
    else
    {
      DiagResponse CVADAS_0001_00000000_000.* __resp;
      DiagRequest CVADAS_0001_00000000_000._22FD15_Magna_Production_HW_Number_Read __req;
      __diagServicevccmce9_114(__req, __resp);
    }
  }
  TestCommandEnd();


  TestCommandBegin(__eDiagService, __cDiagService, "", "3");
  {
    if (DiagIsFunctionalGroup("CVADAS_0001_00000000_000"))
    {
      DiagResponse * __resp;
      DiagRequest CVADAS_0001_00000000_000.Extended_Diagnostic_Session_Start __req;
      __diagServicevccmce9_115(__req, __resp);
    }
    else
    {
      DiagResponse CVADAS_0001_00000000_000.* __resp;
      DiagRequest CVADAS_0001_00000000_000.Extended_Diagnostic_Session_Start __req;
      __diagServicevccmce9_115(__req, __resp);
    }
  }
  TestCommandEnd();


  TestCommandBegin(__eWait, __cWait, "", "4");
  {
    Wait("1", (syspar::`sleep * 1000000LL), 1000000, "sleep");
  }
  TestCommandEnd();

  TestCommandBegin(__eDiagService, __cDiagService, "", "5");
  {
    if (DiagIsFunctionalGroup("CVADAS_0001_00000000_000"))
    {
      DiagResponse * __resp;
      DiagRequest CVADAS_0001_00000000_000._22FD15_Magna_Production_HW_Number_Read __req;
      __diagServicevccmce9_116(__req, __resp);
    }
    else
    {
      DiagResponse CVADAS_0001_00000000_000.* __resp;
      DiagRequest CVADAS_0001_00000000_000._22FD15_Magna_Production_HW_Number_Read __req;
      __diagServicevccmce9_116(__req, __resp);
    }
  }
  TestCommandEnd();


}

  
void __diagServicevccmce9_113(DiagRequest * __req, DiagResponse * __resp )
{
  stack long __tableHandle;
  long __res, __paramLen, __bytePos;

   __bVerdict = __eVerdictPass;

  do {
    TestReportResetDiagObjectList();
    DiagSetReportDetailLevel("CVADAS_0001_00000000_000", EnumServiceDetails_onfail);
    // Request aspect
    {
      {
        __res = DiagSetParameterErrorHandled(__req, "DiagSessionType", 01);
        if(__res < 0)
        {
          __bVerdict = __eVerdictFail;
          DiagErrCodeTestStep(__res, "Cannot set diagnostic parameter 'DiagSessionType'");
          break;
        }
      }

      if (0 >= DiagSendReqAndWaitForResp("CVADAS_0001_00000000_000", __req, __resp, __res, -1, -1, -1, -1, -1, EnumResult_pos, EnumServiceDetails_onfail, EnumSendingMode_physical, EnumSuppressPosResBit_asconfigured, EnumVerdictOnInvalidValues_fail))
        break;
    }

    __res = DiagErrCodeTestStep(__res, "Can't retrieve last response for request! No check possible.") < 0;
    if(__res)
    {
	  __bVerdict = __eVerdictFail;
      break;
    }
    {
      __res = DiagInterpretAs(__resp, "DSC_PR");
      if(__res != 0)
      {
        __bVerdict = __eVerdictFail;
        DiagErrCodeTestStep(__res, "Can't interpret response as diagnostic primitive 'DSC_PR'.");
        break;
      }
      else
      {
        TestStepPass( "Received primitive can be interpreted as diagnostic primitive 'DSC_PR'.");
      }
    }
  }
  while(0);


  // Response, check & read aspect
  {
    __res = 1;
    __tableHandle = ReportTableHead5Columns(__cCheckCaption, __cTSym, __cTOp, __cRefVal, __cActual, __cRes);
    {
      double __nDiagValue;
      DiagGetParameterErrorHandled(__resp, "DiagSessionType", __nDiagValue);
      __csr = CheckSignalMatch(__nDiagValue, 01, "==") == 1;
      snprintf(__cArray, 8192, "%s", "Diagnostic parameter \'DiagSessionType\'");
      snprintf(__cArray2, 8192, "%s", __cArray);
      snprintf(__cArray3, 8192, "%s", "");
      ReportTableRow(__tableHandle, 0, __cArray2, "==", 01, __cArray3, __oneOfFlag, __bSetInCheckAlignment);
      ReportCell(__tableHandle, __nDiagValue);
      ReportCellResult(__tableHandle, __csr, __ePassFail);
    
      __res = __res && __csr;
    
    }
    ReportTableEndVerdict(__tableHandle, __cEvaluateResponse, __res);
	__bVerdict = __bVerdict && __res;
  }
  if (__bVerdict == __eVerdictFail)
    TestReportWriteDiagObjectList();
}
  
void __diagServicevccmce9_114(DiagRequest * __req, DiagResponse * __resp )
{
  stack long __tableHandle;
  long __res, __paramLen, __bytePos;

   __bVerdict = __eVerdictPass;

  do {
    TestReportResetDiagObjectList();
    DiagSetReportDetailLevel("CVADAS_0001_00000000_000", EnumServiceDetails_onfail);
    // Request aspect
    {

      if (0 >= DiagSendReqAndWaitForResp("CVADAS_0001_00000000_000", __req, __resp, __res, -1, -1, -1, -1, -1, EnumResult_pos, EnumServiceDetails_onfail, EnumSendingMode_physical, EnumSuppressPosResBit_asconfigured, EnumVerdictOnInvalidValues_fail))
        break;
    }

    __res = DiagErrCodeTestStep(__res, "Can't retrieve last response for request! No check possible.") < 0;
    if(__res)
    {
	  __bVerdict = __eVerdictFail;
      break;
    }
    {
      __res = DiagInterpretAs(__resp, "RDBI_PR");
      if(__res != 0)
      {
        __bVerdict = __eVerdictFail;
        DiagErrCodeTestStep(__res, "Can't interpret response as diagnostic primitive 'RDBI_PR'.");
        break;
      }
      else
      {
        TestStepPass( "Received primitive can be interpreted as diagnostic primitive 'RDBI_PR'.");
      }
    }
  }
  while(0);


  // Response, check & read aspect
  {
    __res = 1;
    __tableHandle = ReportTableHead5Columns(__cCheckCaption, __cTSym, __cTOp, __cRefVal, __cActual, __cRes);
    {
      __bDiagValueArrayCtr = DiagGetParameterErrorHandled(__resp, "Magna_ProdHWNum", __bDiagValueArray, elcount(__bDiagValueArray), __cDiagValueArray, elcount(__cDiagValueArray));
      {
        __bSetInCheckAlignment = 1;	
        {
          __bArrayCtr = __CopyBytes(__bDiagValueArray, __bDiagValueArrayCtr, __bArray);
          {
            sysvar * __systemVariable;
            __systemVariable = sysvarData::`PartNumber::`Part_Number;
            CheckSysVarSetBufferConsistency(sysSetVariableData(sysvarData::`PartNumber::`Part_Number, __bArray, __bArrayCtr), __systemVariable.name);
          }
          snprintf(__cArray, 8192, "%s", "Part_Number");
          snprintf(__cArray2, 8192, "%s '%s'", __cSysVar, __cArray);
          snprintf(__cArray3, 8192, "%s", "Magna_ProdHWNum");
          
          ReportTableRow(__tableHandle, 0, __cArray2, __cAOp, __bArray, __bArrayCtr, __cArray3, __oneOfFlag, __bSetInCheckAlignment);
        
        }
    
        __bSetInCheckAlignment = 0;
      }
    }
    ReportTableEndVerdict(__tableHandle, __cEvaluateResponse, __res);
	__bVerdict = __bVerdict && __res;
  }
  if (__bVerdict == __eVerdictFail)
    TestReportWriteDiagObjectList();
}
  
void __diagServicevccmce9_115(DiagRequest * __req, DiagResponse * __resp )
{
  stack long __tableHandle;
  long __res, __paramLen, __bytePos;

   __bVerdict = __eVerdictPass;

  do {
    TestReportResetDiagObjectList();
    DiagSetReportDetailLevel("CVADAS_0001_00000000_000", EnumServiceDetails_onfail);
    // Request aspect
    {
      {
        __res = DiagSetParameterErrorHandled(__req, "DiagSessionType", 03);
        if(__res < 0)
        {
          __bVerdict = __eVerdictFail;
          DiagErrCodeTestStep(__res, "Cannot set diagnostic parameter 'DiagSessionType'");
          break;
        }
      }

      if (0 >= DiagSendReqAndWaitForResp("CVADAS_0001_00000000_000", __req, __resp, __res, -1, -1, -1, -1, -1, EnumResult_pos, EnumServiceDetails_onfail, EnumSendingMode_physical, EnumSuppressPosResBit_asconfigured, EnumVerdictOnInvalidValues_fail))
        break;
    }

    __res = DiagErrCodeTestStep(__res, "Can't retrieve last response for request! No check possible.") < 0;
    if(__res)
    {
	  __bVerdict = __eVerdictFail;
      break;
    }
    {
      __res = DiagInterpretAs(__resp, "DSC_PR");
      if(__res != 0)
      {
        __bVerdict = __eVerdictFail;
        DiagErrCodeTestStep(__res, "Can't interpret response as diagnostic primitive 'DSC_PR'.");
        break;
      }
      else
      {
        TestStepPass( "Received primitive can be interpreted as diagnostic primitive 'DSC_PR'.");
      }
    }
  }
  while(0);


  // Response, check & read aspect
  {
    __res = 1;
    __tableHandle = ReportTableHead5Columns(__cCheckCaption, __cTSym, __cTOp, __cRefVal, __cActual, __cRes);
    {
      double __nDiagValue;
      DiagGetParameterErrorHandled(__resp, "DiagSessionType", __nDiagValue);
      __csr = CheckSignalMatch(__nDiagValue, 03, "==") == 1;
      snprintf(__cArray, 8192, "%s", "Diagnostic parameter \'DiagSessionType\'");
      snprintf(__cArray2, 8192, "%s", __cArray);
      snprintf(__cArray3, 8192, "%s", "");
      ReportTableRow(__tableHandle, 0, __cArray2, "==", 03, __cArray3, __oneOfFlag, __bSetInCheckAlignment);
      ReportCell(__tableHandle, __nDiagValue);
      ReportCellResult(__tableHandle, __csr, __ePassFail);
    
      __res = __res && __csr;
    
    }
    ReportTableEndVerdict(__tableHandle, __cEvaluateResponse, __res);
	__bVerdict = __bVerdict && __res;
  }
  if (__bVerdict == __eVerdictFail)
    TestReportWriteDiagObjectList();
}
  
void __diagServicevccmce9_116(DiagRequest * __req, DiagResponse * __resp )
{
  stack long __tableHandle;
  long __res, __paramLen, __bytePos;

   __bVerdict = __eVerdictPass;

  do {
    TestReportResetDiagObjectList();
    DiagSetReportDetailLevel("CVADAS_0001_00000000_000", EnumServiceDetails_onfail);
    // Request aspect
    {

      if (0 >= DiagSendReqAndWaitForResp("CVADAS_0001_00000000_000", __req, __resp, __res, -1, -1, -1, -1, -1, EnumResult_pos, EnumServiceDetails_onfail, EnumSendingMode_physical, EnumSuppressPosResBit_asconfigured, EnumVerdictOnInvalidValues_fail))
        break;
    }

    __res = DiagErrCodeTestStep(__res, "Can't retrieve last response for request! No check possible.") < 0;
    if(__res)
    {
	  __bVerdict = __eVerdictFail;
      break;
    }
    {
      __res = DiagInterpretAs(__resp, "RDBI_PR");
      if(__res != 0)
      {
        __bVerdict = __eVerdictFail;
        DiagErrCodeTestStep(__res, "Can't interpret response as diagnostic primitive 'RDBI_PR'.");
        break;
      }
      else
      {
        TestStepPass( "Received primitive can be interpreted as diagnostic primitive 'RDBI_PR'.");
      }
    }
  }
  while(0);


  // Response, check & read aspect
  {
    __res = 1;
    __tableHandle = ReportTableHead5Columns(__cCheckCaption, __cTSym, __cTOp, __cRefVal, __cActual, __cRes);
    {
      __bDiagValueArrayCtr = DiagGetParameterErrorHandled(__resp, "Magna_ProdHWNum", __bDiagValueArray, elcount(__bDiagValueArray), __cDiagValueArray, elcount(__cDiagValueArray));
      {
        __bSetInCheckAlignment = 1;	
        {
          __bArrayCtr = __CopyBytes(__bDiagValueArray, __bDiagValueArrayCtr, __bArray);
          {
            sysvar * __systemVariable;
            __systemVariable = sysvarData::`PartNumber::`Part_Number;
            CheckSysVarSetBufferConsistency(sysSetVariableData(sysvarData::`PartNumber::`Part_Number, __bArray, __bArrayCtr), __systemVariable.name);
          }
          snprintf(__cArray, 8192, "%s", "Part_Number");
          snprintf(__cArray2, 8192, "%s '%s'", __cSysVar, __cArray);
          snprintf(__cArray3, 8192, "%s", "Magna_ProdHWNum");
          
          ReportTableRow(__tableHandle, 0, __cArray2, __cAOp, __bArray, __bArrayCtr, __cArray3, __oneOfFlag, __bSetInCheckAlignment);
        
        }
    
        __bSetInCheckAlignment = 0;
      }
    }
    ReportTableEndVerdict(__tableHandle, __cEvaluateResponse, __res);
	__bVerdict = __bVerdict && __res;
  }
  if (__bVerdict == __eVerdictFail)
    TestReportWriteDiagObjectList();
}

void Ttvccmce9_Tet_Tc22()
{
  CreateTTEIFFunction("Ttvccmce9_Tc22", __eTcDef, __eLocal);  
  AddIFParameterTestCaseAttribute("TC_ID", "");
  AddIFParameterTestCaseAttribute("Test Case ID", "");
  CallInterfaceFunction("2.6.6.2_FD16", __cEmpty , __cEmpty );
}
testcase Ttvccmce9_Tc22()
{
  stack long __tableHandle;
  SetBreakOnFail(0);

  TestCommandBegin(__eDiagService, __cDiagService, "", "0");
  {
    if (DiagIsFunctionalGroup("CVADAS_0001_00000000_000"))
    {
      DiagResponse * __resp;
      DiagRequest CVADAS_0001_00000000_000.Default_Session_Start __req;
      __diagServicevccmce9_117(__req, __resp);
    }
    else
    {
      DiagResponse CVADAS_0001_00000000_000.* __resp;
      DiagRequest CVADAS_0001_00000000_000.Default_Session_Start __req;
      __diagServicevccmce9_117(__req, __resp);
    }
  }
  TestCommandEnd();


  TestCommandBegin(__eWait, __cWait, "", "1");
  {
    Wait("1", (syspar::`sleep * 1000000LL), 1000000, "sleep");
  }
  TestCommandEnd();

  TestCommandBegin(__eDiagService, __cDiagService, "", "2");
  {
    if (DiagIsFunctionalGroup("CVADAS_0001_00000000_000"))
    {
      DiagResponse * __resp;
      DiagRequest CVADAS_0001_00000000_000._22FD16_Magna_Production_ICT_Data_Read __req;
      __diagServicevccmce9_118(__req, __resp);
    }
    else
    {
      DiagResponse CVADAS_0001_00000000_000.* __resp;
      DiagRequest CVADAS_0001_00000000_000._22FD16_Magna_Production_ICT_Data_Read __req;
      __diagServicevccmce9_118(__req, __resp);
    }
  }
  TestCommandEnd();


  TestCommandBegin(__eDiagService, __cDiagService, "", "3");
  {
    if (DiagIsFunctionalGroup("CVADAS_0001_00000000_000"))
    {
      DiagResponse * __resp;
      DiagRequest CVADAS_0001_00000000_000.Extended_Diagnostic_Session_Start __req;
      __diagServicevccmce9_119(__req, __resp);
    }
    else
    {
      DiagResponse CVADAS_0001_00000000_000.* __resp;
      DiagRequest CVADAS_0001_00000000_000.Extended_Diagnostic_Session_Start __req;
      __diagServicevccmce9_119(__req, __resp);
    }
  }
  TestCommandEnd();


  TestCommandBegin(__eWait, __cWait, "", "4");
  {
    Wait("1", (syspar::`sleep * 1000000LL), 1000000, "sleep");
  }
  TestCommandEnd();

  TestCommandBegin(__eDiagService, __cDiagService, "", "5");
  {
    if (DiagIsFunctionalGroup("CVADAS_0001_00000000_000"))
    {
      DiagResponse * __resp;
      DiagRequest CVADAS_0001_00000000_000._22FD16_Magna_Production_ICT_Data_Read __req;
      __diagServicevccmce9_120(__req, __resp);
    }
    else
    {
      DiagResponse CVADAS_0001_00000000_000.* __resp;
      DiagRequest CVADAS_0001_00000000_000._22FD16_Magna_Production_ICT_Data_Read __req;
      __diagServicevccmce9_120(__req, __resp);
    }
  }
  TestCommandEnd();


}

  
void __diagServicevccmce9_117(DiagRequest * __req, DiagResponse * __resp )
{
  stack long __tableHandle;
  long __res, __paramLen, __bytePos;

   __bVerdict = __eVerdictPass;

  do {
    TestReportResetDiagObjectList();
    DiagSetReportDetailLevel("CVADAS_0001_00000000_000", EnumServiceDetails_onfail);
    // Request aspect
    {
      {
        __res = DiagSetParameterErrorHandled(__req, "DiagSessionType", 01);
        if(__res < 0)
        {
          __bVerdict = __eVerdictFail;
          DiagErrCodeTestStep(__res, "Cannot set diagnostic parameter 'DiagSessionType'");
          break;
        }
      }

      if (0 >= DiagSendReqAndWaitForResp("CVADAS_0001_00000000_000", __req, __resp, __res, -1, -1, -1, -1, -1, EnumResult_pos, EnumServiceDetails_onfail, EnumSendingMode_physical, EnumSuppressPosResBit_asconfigured, EnumVerdictOnInvalidValues_fail))
        break;
    }

    __res = DiagErrCodeTestStep(__res, "Can't retrieve last response for request! No check possible.") < 0;
    if(__res)
    {
	  __bVerdict = __eVerdictFail;
      break;
    }
    {
      __res = DiagInterpretAs(__resp, "DSC_PR");
      if(__res != 0)
      {
        __bVerdict = __eVerdictFail;
        DiagErrCodeTestStep(__res, "Can't interpret response as diagnostic primitive 'DSC_PR'.");
        break;
      }
      else
      {
        TestStepPass( "Received primitive can be interpreted as diagnostic primitive 'DSC_PR'.");
      }
    }
  }
  while(0);


  // Response, check & read aspect
  {
    __res = 1;
    __tableHandle = ReportTableHead5Columns(__cCheckCaption, __cTSym, __cTOp, __cRefVal, __cActual, __cRes);
    {
      double __nDiagValue;
      DiagGetParameterErrorHandled(__resp, "DiagSessionType", __nDiagValue);
      __csr = CheckSignalMatch(__nDiagValue, 01, "==") == 1;
      snprintf(__cArray, 8192, "%s", "Diagnostic parameter \'DiagSessionType\'");
      snprintf(__cArray2, 8192, "%s", __cArray);
      snprintf(__cArray3, 8192, "%s", "");
      ReportTableRow(__tableHandle, 0, __cArray2, "==", 01, __cArray3, __oneOfFlag, __bSetInCheckAlignment);
      ReportCell(__tableHandle, __nDiagValue);
      ReportCellResult(__tableHandle, __csr, __ePassFail);
    
      __res = __res && __csr;
    
    }
    ReportTableEndVerdict(__tableHandle, __cEvaluateResponse, __res);
	__bVerdict = __bVerdict && __res;
  }
  if (__bVerdict == __eVerdictFail)
    TestReportWriteDiagObjectList();
}
  
void __diagServicevccmce9_118(DiagRequest * __req, DiagResponse * __resp )
{
  stack long __tableHandle;
  long __res, __paramLen, __bytePos;

   __bVerdict = __eVerdictPass;

  do {
    TestReportResetDiagObjectList();
    DiagSetReportDetailLevel("CVADAS_0001_00000000_000", EnumServiceDetails_onfail);
    // Request aspect
    {

      if (0 >= DiagSendReqAndWaitForResp("CVADAS_0001_00000000_000", __req, __resp, __res, -1, -1, -1, -1, -1, EnumResult_pos, EnumServiceDetails_onfail, EnumSendingMode_physical, EnumSuppressPosResBit_asconfigured, EnumVerdictOnInvalidValues_fail))
        break;
    }

    __res = DiagErrCodeTestStep(__res, "Can't retrieve last response for request! No check possible.") < 0;
    if(__res)
    {
	  __bVerdict = __eVerdictFail;
      break;
    }
    {
      __res = DiagInterpretAs(__resp, "RDBI_PR");
      if(__res != 0)
      {
        __bVerdict = __eVerdictFail;
        DiagErrCodeTestStep(__res, "Can't interpret response as diagnostic primitive 'RDBI_PR'.");
        break;
      }
      else
      {
        TestStepPass( "Received primitive can be interpreted as diagnostic primitive 'RDBI_PR'.");
      }
    }
  }
  while(0);


  // Response, check & read aspect
  {
    __res = 1;
    __tableHandle = ReportTableHead5Columns(__cCheckCaption, __cTSym, __cTOp, __cRefVal, __cActual, __cRes);
    {
      __bDiagValueArrayCtr = DiagGetParameterErrorHandled(__resp, "Magna_ProdHWNum", __bDiagValueArray, elcount(__bDiagValueArray), __cDiagValueArray, elcount(__cDiagValueArray));
      {
        __bSetInCheckAlignment = 1;	
        {
          __bArrayCtr = __CopyBytes(__bDiagValueArray, __bDiagValueArrayCtr, __bArray);
          {
            sysvar * __systemVariable;
            __systemVariable = sysvarData::`PartNumber::`Part_Number;
            CheckSysVarSetBufferConsistency(sysSetVariableData(sysvarData::`PartNumber::`Part_Number, __bArray, __bArrayCtr), __systemVariable.name);
          }
          snprintf(__cArray, 8192, "%s", "Part_Number");
          snprintf(__cArray2, 8192, "%s '%s'", __cSysVar, __cArray);
          snprintf(__cArray3, 8192, "%s", "Magna_ProdHWNum");
          
          ReportTableRow(__tableHandle, 0, __cArray2, __cAOp, __bArray, __bArrayCtr, __cArray3, __oneOfFlag, __bSetInCheckAlignment);
        
        }
    
        __bSetInCheckAlignment = 0;
      }
    }
    ReportTableEndVerdict(__tableHandle, __cEvaluateResponse, __res);
	__bVerdict = __bVerdict && __res;
  }
  if (__bVerdict == __eVerdictFail)
    TestReportWriteDiagObjectList();
}
  
void __diagServicevccmce9_119(DiagRequest * __req, DiagResponse * __resp )
{
  stack long __tableHandle;
  long __res, __paramLen, __bytePos;

   __bVerdict = __eVerdictPass;

  do {
    TestReportResetDiagObjectList();
    DiagSetReportDetailLevel("CVADAS_0001_00000000_000", EnumServiceDetails_onfail);
    // Request aspect
    {
      {
        __res = DiagSetParameterErrorHandled(__req, "DiagSessionType", 03);
        if(__res < 0)
        {
          __bVerdict = __eVerdictFail;
          DiagErrCodeTestStep(__res, "Cannot set diagnostic parameter 'DiagSessionType'");
          break;
        }
      }

      if (0 >= DiagSendReqAndWaitForResp("CVADAS_0001_00000000_000", __req, __resp, __res, -1, -1, -1, -1, -1, EnumResult_pos, EnumServiceDetails_onfail, EnumSendingMode_physical, EnumSuppressPosResBit_asconfigured, EnumVerdictOnInvalidValues_fail))
        break;
    }

    __res = DiagErrCodeTestStep(__res, "Can't retrieve last response for request! No check possible.") < 0;
    if(__res)
    {
	  __bVerdict = __eVerdictFail;
      break;
    }
    {
      __res = DiagInterpretAs(__resp, "DSC_PR");
      if(__res != 0)
      {
        __bVerdict = __eVerdictFail;
        DiagErrCodeTestStep(__res, "Can't interpret response as diagnostic primitive 'DSC_PR'.");
        break;
      }
      else
      {
        TestStepPass( "Received primitive can be interpreted as diagnostic primitive 'DSC_PR'.");
      }
    }
  }
  while(0);


  // Response, check & read aspect
  {
    __res = 1;
    __tableHandle = ReportTableHead5Columns(__cCheckCaption, __cTSym, __cTOp, __cRefVal, __cActual, __cRes);
    {
      double __nDiagValue;
      DiagGetParameterErrorHandled(__resp, "DiagSessionType", __nDiagValue);
      __csr = CheckSignalMatch(__nDiagValue, 03, "==") == 1;
      snprintf(__cArray, 8192, "%s", "Diagnostic parameter \'DiagSessionType\'");
      snprintf(__cArray2, 8192, "%s", __cArray);
      snprintf(__cArray3, 8192, "%s", "");
      ReportTableRow(__tableHandle, 0, __cArray2, "==", 03, __cArray3, __oneOfFlag, __bSetInCheckAlignment);
      ReportCell(__tableHandle, __nDiagValue);
      ReportCellResult(__tableHandle, __csr, __ePassFail);
    
      __res = __res && __csr;
    
    }
    ReportTableEndVerdict(__tableHandle, __cEvaluateResponse, __res);
	__bVerdict = __bVerdict && __res;
  }
  if (__bVerdict == __eVerdictFail)
    TestReportWriteDiagObjectList();
}
  
void __diagServicevccmce9_120(DiagRequest * __req, DiagResponse * __resp )
{
  stack long __tableHandle;
  long __res, __paramLen, __bytePos;

   __bVerdict = __eVerdictPass;

  do {
    TestReportResetDiagObjectList();
    DiagSetReportDetailLevel("CVADAS_0001_00000000_000", EnumServiceDetails_onfail);
    // Request aspect
    {

      if (0 >= DiagSendReqAndWaitForResp("CVADAS_0001_00000000_000", __req, __resp, __res, -1, -1, -1, -1, -1, EnumResult_pos, EnumServiceDetails_onfail, EnumSendingMode_physical, EnumSuppressPosResBit_asconfigured, EnumVerdictOnInvalidValues_fail))
        break;
    }

    __res = DiagErrCodeTestStep(__res, "Can't retrieve last response for request! No check possible.") < 0;
    if(__res)
    {
	  __bVerdict = __eVerdictFail;
      break;
    }
    {
      __res = DiagInterpretAs(__resp, "RDBI_PR");
      if(__res != 0)
      {
        __bVerdict = __eVerdictFail;
        DiagErrCodeTestStep(__res, "Can't interpret response as diagnostic primitive 'RDBI_PR'.");
        break;
      }
      else
      {
        TestStepPass( "Received primitive can be interpreted as diagnostic primitive 'RDBI_PR'.");
      }
    }
  }
  while(0);


  // Response, check & read aspect
  {
    __res = 1;
    __tableHandle = ReportTableHead5Columns(__cCheckCaption, __cTSym, __cTOp, __cRefVal, __cActual, __cRes);
    {
      __bDiagValueArrayCtr = DiagGetParameterErrorHandled(__resp, "Magna_ProdHWNum", __bDiagValueArray, elcount(__bDiagValueArray), __cDiagValueArray, elcount(__cDiagValueArray));
      {
        __bSetInCheckAlignment = 1;	
        {
          __bArrayCtr = __CopyBytes(__bDiagValueArray, __bDiagValueArrayCtr, __bArray);
          {
            sysvar * __systemVariable;
            __systemVariable = sysvarData::`PartNumber::`Part_Number;
            CheckSysVarSetBufferConsistency(sysSetVariableData(sysvarData::`PartNumber::`Part_Number, __bArray, __bArrayCtr), __systemVariable.name);
          }
          snprintf(__cArray, 8192, "%s", "Part_Number");
          snprintf(__cArray2, 8192, "%s '%s'", __cSysVar, __cArray);
          snprintf(__cArray3, 8192, "%s", "Magna_ProdHWNum");
          
          ReportTableRow(__tableHandle, 0, __cArray2, __cAOp, __bArray, __bArrayCtr, __cArray3, __oneOfFlag, __bSetInCheckAlignment);
        
        }
    
        __bSetInCheckAlignment = 0;
      }
    }
    ReportTableEndVerdict(__tableHandle, __cEvaluateResponse, __res);
	__bVerdict = __bVerdict && __res;
  }
  if (__bVerdict == __eVerdictFail)
    TestReportWriteDiagObjectList();
}

void Ttvccmce9_Tet_Tc23()
{
  CreateTTEIFFunction("Ttvccmce9_Tc23", __eTcDef, __eLocal);  
  AddIFParameterTestCaseAttribute("TC_ID", "");
  AddIFParameterTestCaseAttribute("Test Case ID", "");
  CallInterfaceFunction("2.6.6.3_FD17", __cEmpty , __cEmpty );
}
testcase Ttvccmce9_Tc23()
{
  stack long __tableHandle;
  SetBreakOnFail(0);

  TestCommandBegin(__eDiagService, __cDiagService, "", "0");
  {
    if (DiagIsFunctionalGroup("CVADAS_0001_00000000_000"))
    {
      DiagResponse * __resp;
      DiagRequest CVADAS_0001_00000000_000.Default_Session_Start __req;
      __diagServicevccmce9_121(__req, __resp);
    }
    else
    {
      DiagResponse CVADAS_0001_00000000_000.* __resp;
      DiagRequest CVADAS_0001_00000000_000.Default_Session_Start __req;
      __diagServicevccmce9_121(__req, __resp);
    }
  }
  TestCommandEnd();


  TestCommandBegin(__eWait, __cWait, "", "1");
  {
    Wait("1", (syspar::`sleep * 1000000LL), 1000000, "sleep");
  }
  TestCommandEnd();

  TestCommandBegin(__eDiagService, __cDiagService, "", "2");
  {
    if (DiagIsFunctionalGroup("CVADAS_0001_00000000_000"))
    {
      DiagResponse * __resp;
      DiagRequest CVADAS_0001_00000000_000._22FD17_Magna_Production_HW_Version_information_Read __req;
      __diagServicevccmce9_122(__req, __resp);
    }
    else
    {
      DiagResponse CVADAS_0001_00000000_000.* __resp;
      DiagRequest CVADAS_0001_00000000_000._22FD17_Magna_Production_HW_Version_information_Read __req;
      __diagServicevccmce9_122(__req, __resp);
    }
  }
  TestCommandEnd();


  TestCommandBegin(__eDiagService, __cDiagService, "", "3");
  {
    if (DiagIsFunctionalGroup("CVADAS_0001_00000000_000"))
    {
      DiagResponse * __resp;
      DiagRequest CVADAS_0001_00000000_000.Extended_Diagnostic_Session_Start __req;
      __diagServicevccmce9_123(__req, __resp);
    }
    else
    {
      DiagResponse CVADAS_0001_00000000_000.* __resp;
      DiagRequest CVADAS_0001_00000000_000.Extended_Diagnostic_Session_Start __req;
      __diagServicevccmce9_123(__req, __resp);
    }
  }
  TestCommandEnd();


  TestCommandBegin(__eWait, __cWait, "", "4");
  {
    Wait("1", (syspar::`sleep * 1000000LL), 1000000, "sleep");
  }
  TestCommandEnd();

  TestCommandBegin(__eDiagService, __cDiagService, "", "5");
  {
    if (DiagIsFunctionalGroup("CVADAS_0001_00000000_000"))
    {
      DiagResponse * __resp;
      DiagRequest CVADAS_0001_00000000_000._22FD17_Magna_Production_HW_Version_information_Read __req;
      __diagServicevccmce9_124(__req, __resp);
    }
    else
    {
      DiagResponse CVADAS_0001_00000000_000.* __resp;
      DiagRequest CVADAS_0001_00000000_000._22FD17_Magna_Production_HW_Version_information_Read __req;
      __diagServicevccmce9_124(__req, __resp);
    }
  }
  TestCommandEnd();


}

  
void __diagServicevccmce9_121(DiagRequest * __req, DiagResponse * __resp )
{
  stack long __tableHandle;
  long __res, __paramLen, __bytePos;

   __bVerdict = __eVerdictPass;

  do {
    TestReportResetDiagObjectList();
    DiagSetReportDetailLevel("CVADAS_0001_00000000_000", EnumServiceDetails_onfail);
    // Request aspect
    {
      {
        __res = DiagSetParameterErrorHandled(__req, "DiagSessionType", 01);
        if(__res < 0)
        {
          __bVerdict = __eVerdictFail;
          DiagErrCodeTestStep(__res, "Cannot set diagnostic parameter 'DiagSessionType'");
          break;
        }
      }

      if (0 >= DiagSendReqAndWaitForResp("CVADAS_0001_00000000_000", __req, __resp, __res, -1, -1, -1, -1, -1, EnumResult_pos, EnumServiceDetails_onfail, EnumSendingMode_physical, EnumSuppressPosResBit_asconfigured, EnumVerdictOnInvalidValues_fail))
        break;
    }

    __res = DiagErrCodeTestStep(__res, "Can't retrieve last response for request! No check possible.") < 0;
    if(__res)
    {
	  __bVerdict = __eVerdictFail;
      break;
    }
    {
      __res = DiagInterpretAs(__resp, "DSC_PR");
      if(__res != 0)
      {
        __bVerdict = __eVerdictFail;
        DiagErrCodeTestStep(__res, "Can't interpret response as diagnostic primitive 'DSC_PR'.");
        break;
      }
      else
      {
        TestStepPass( "Received primitive can be interpreted as diagnostic primitive 'DSC_PR'.");
      }
    }
  }
  while(0);


  // Response, check & read aspect
  {
    __res = 1;
    __tableHandle = ReportTableHead5Columns(__cCheckCaption, __cTSym, __cTOp, __cRefVal, __cActual, __cRes);
    {
      double __nDiagValue;
      DiagGetParameterErrorHandled(__resp, "DiagSessionType", __nDiagValue);
      __csr = CheckSignalMatch(__nDiagValue, 01, "==") == 1;
      snprintf(__cArray, 8192, "%s", "Diagnostic parameter \'DiagSessionType\'");
      snprintf(__cArray2, 8192, "%s", __cArray);
      snprintf(__cArray3, 8192, "%s", "");
      ReportTableRow(__tableHandle, 0, __cArray2, "==", 01, __cArray3, __oneOfFlag, __bSetInCheckAlignment);
      ReportCell(__tableHandle, __nDiagValue);
      ReportCellResult(__tableHandle, __csr, __ePassFail);
    
      __res = __res && __csr;
    
    }
    ReportTableEndVerdict(__tableHandle, __cEvaluateResponse, __res);
	__bVerdict = __bVerdict && __res;
  }
  if (__bVerdict == __eVerdictFail)
    TestReportWriteDiagObjectList();
}
  
void __diagServicevccmce9_122(DiagRequest * __req, DiagResponse * __resp )
{
  stack long __tableHandle;
  long __res, __paramLen, __bytePos;

   __bVerdict = __eVerdictPass;

  do {
    TestReportResetDiagObjectList();
    DiagSetReportDetailLevel("CVADAS_0001_00000000_000", EnumServiceDetails_onfail);
    // Request aspect
    {

      if (0 >= DiagSendReqAndWaitForResp("CVADAS_0001_00000000_000", __req, __resp, __res, -1, -1, -1, -1, -1, EnumResult_pos, EnumServiceDetails_onfail, EnumSendingMode_physical, EnumSuppressPosResBit_asconfigured, EnumVerdictOnInvalidValues_fail))
        break;
    }

    __res = DiagErrCodeTestStep(__res, "Can't retrieve last response for request! No check possible.") < 0;
    if(__res)
    {
	  __bVerdict = __eVerdictFail;
      break;
    }
    {
      __res = DiagInterpretAs(__resp, "RDBI_PR");
      if(__res != 0)
      {
        __bVerdict = __eVerdictFail;
        DiagErrCodeTestStep(__res, "Can't interpret response as diagnostic primitive 'RDBI_PR'.");
        break;
      }
      else
      {
        TestStepPass( "Received primitive can be interpreted as diagnostic primitive 'RDBI_PR'.");
      }
    }
  }
  while(0);


  // Response, check & read aspect
  {
    __res = 1;
    __tableHandle = ReportTableHead5Columns(__cCheckCaption, __cTSym, __cTOp, __cRefVal, __cActual, __cRes);
    {
      double __nDiagValue;
      DiagGetParameterErrorHandled(__resp, "Magna_ProdHwVerInfo_HW_PatchLvl", __nDiagValue);
      __csr = CheckSignalMatch(__nDiagValue, 0, ">") == 1;
      snprintf(__cArray, 8192, "%s", "Diagnostic parameter \'Magna_ProdHwVerInfo_HW_PatchLvl\'");
      snprintf(__cArray2, 8192, "%s", __cArray);
      snprintf(__cArray3, 8192, "%s", "");
      ReportTableRow(__tableHandle, 0, __cArray2, ">", 0, __cArray3, __oneOfFlag, __bSetInCheckAlignment);
      ReportCell(__tableHandle, __nDiagValue);
      ReportCellResult(__tableHandle, __csr, __ePassFail);
    
      __res = __res && __csr;
    
    }
    {
      double __nDiagValue;
      DiagGetParameterErrorHandled(__resp, "Magna_ProdHwVerInfo_HW_Week", __nDiagValue);
      __csr = CheckSignalMatch(__nDiagValue, 0, ">") == 1;
      snprintf(__cArray, 8192, "%s", "Diagnostic parameter \'Magna_ProdHwVerInfo_HW_Week\'");
      snprintf(__cArray2, 8192, "%s", __cArray);
      snprintf(__cArray3, 8192, "%s", "");
      ReportTableRow(__tableHandle, 0, __cArray2, ">", 0, __cArray3, __oneOfFlag, __bSetInCheckAlignment);
      ReportCell(__tableHandle, __nDiagValue);
      ReportCellResult(__tableHandle, __csr, __ePassFail);
    
      __res = __res && __csr;
    
    }
    {
      double __nDiagValue;
      DiagGetParameterErrorHandled(__resp, "Magna_ProdHwVerInfo_HW_Year", __nDiagValue);
      __csr = CheckSignalMatch(__nDiagValue, 0, ">") == 1;
      snprintf(__cArray, 8192, "%s", "Diagnostic parameter \'Magna_ProdHwVerInfo_HW_Year\'");
      snprintf(__cArray2, 8192, "%s", __cArray);
      snprintf(__cArray3, 8192, "%s", "");
      ReportTableRow(__tableHandle, 0, __cArray2, ">", 0, __cArray3, __oneOfFlag, __bSetInCheckAlignment);
      ReportCell(__tableHandle, __nDiagValue);
      ReportCellResult(__tableHandle, __csr, __ePassFail);
    
      __res = __res && __csr;
    
    }
    ReportTableEndVerdict(__tableHandle, __cEvaluateResponse, __res);
	__bVerdict = __bVerdict && __res;
  }
  if (__bVerdict == __eVerdictFail)
    TestReportWriteDiagObjectList();
}
  
void __diagServicevccmce9_123(DiagRequest * __req, DiagResponse * __resp )
{
  stack long __tableHandle;
  long __res, __paramLen, __bytePos;

   __bVerdict = __eVerdictPass;

  do {
    TestReportResetDiagObjectList();
    DiagSetReportDetailLevel("CVADAS_0001_00000000_000", EnumServiceDetails_onfail);
    // Request aspect
    {
      {
        __res = DiagSetParameterErrorHandled(__req, "DiagSessionType", 03);
        if(__res < 0)
        {
          __bVerdict = __eVerdictFail;
          DiagErrCodeTestStep(__res, "Cannot set diagnostic parameter 'DiagSessionType'");
          break;
        }
      }

      if (0 >= DiagSendReqAndWaitForResp("CVADAS_0001_00000000_000", __req, __resp, __res, -1, -1, -1, -1, -1, EnumResult_pos, EnumServiceDetails_onfail, EnumSendingMode_physical, EnumSuppressPosResBit_asconfigured, EnumVerdictOnInvalidValues_fail))
        break;
    }

    __res = DiagErrCodeTestStep(__res, "Can't retrieve last response for request! No check possible.") < 0;
    if(__res)
    {
	  __bVerdict = __eVerdictFail;
      break;
    }
    {
      __res = DiagInterpretAs(__resp, "DSC_PR");
      if(__res != 0)
      {
        __bVerdict = __eVerdictFail;
        DiagErrCodeTestStep(__res, "Can't interpret response as diagnostic primitive 'DSC_PR'.");
        break;
      }
      else
      {
        TestStepPass( "Received primitive can be interpreted as diagnostic primitive 'DSC_PR'.");
      }
    }
  }
  while(0);


  // Response, check & read aspect
  {
    __res = 1;
    __tableHandle = ReportTableHead5Columns(__cCheckCaption, __cTSym, __cTOp, __cRefVal, __cActual, __cRes);
    {
      double __nDiagValue;
      DiagGetParameterErrorHandled(__resp, "DiagSessionType", __nDiagValue);
      __csr = CheckSignalMatch(__nDiagValue, 03, "==") == 1;
      snprintf(__cArray, 8192, "%s", "Diagnostic parameter \'DiagSessionType\'");
      snprintf(__cArray2, 8192, "%s", __cArray);
      snprintf(__cArray3, 8192, "%s", "");
      ReportTableRow(__tableHandle, 0, __cArray2, "==", 03, __cArray3, __oneOfFlag, __bSetInCheckAlignment);
      ReportCell(__tableHandle, __nDiagValue);
      ReportCellResult(__tableHandle, __csr, __ePassFail);
    
      __res = __res && __csr;
    
    }
    ReportTableEndVerdict(__tableHandle, __cEvaluateResponse, __res);
	__bVerdict = __bVerdict && __res;
  }
  if (__bVerdict == __eVerdictFail)
    TestReportWriteDiagObjectList();
}
  
void __diagServicevccmce9_124(DiagRequest * __req, DiagResponse * __resp )
{
  stack long __tableHandle;
  long __res, __paramLen, __bytePos;

   __bVerdict = __eVerdictPass;

  do {
    TestReportResetDiagObjectList();
    DiagSetReportDetailLevel("CVADAS_0001_00000000_000", EnumServiceDetails_onfail);
    // Request aspect
    {

      if (0 >= DiagSendReqAndWaitForResp("CVADAS_0001_00000000_000", __req, __resp, __res, -1, -1, -1, -1, -1, EnumResult_pos, EnumServiceDetails_onfail, EnumSendingMode_physical, EnumSuppressPosResBit_asconfigured, EnumVerdictOnInvalidValues_fail))
        break;
    }

    __res = DiagErrCodeTestStep(__res, "Can't retrieve last response for request! No check possible.") < 0;
    if(__res)
    {
	  __bVerdict = __eVerdictFail;
      break;
    }
    {
      __res = DiagInterpretAs(__resp, "RDBI_PR");
      if(__res != 0)
      {
        __bVerdict = __eVerdictFail;
        DiagErrCodeTestStep(__res, "Can't interpret response as diagnostic primitive 'RDBI_PR'.");
        break;
      }
      else
      {
        TestStepPass( "Received primitive can be interpreted as diagnostic primitive 'RDBI_PR'.");
      }
    }
  }
  while(0);


  // Response, check & read aspect
  {
    __res = 1;
    __tableHandle = ReportTableHead5Columns(__cCheckCaption, __cTSym, __cTOp, __cRefVal, __cActual, __cRes);
    {
      double __nDiagValue;
      DiagGetParameterErrorHandled(__resp, "Magna_ProdHwVerInfo_HW_PatchLvl", __nDiagValue);
      __csr = CheckSignalMatch(__nDiagValue, 0, ">") == 1;
      snprintf(__cArray, 8192, "%s", "Diagnostic parameter \'Magna_ProdHwVerInfo_HW_PatchLvl\'");
      snprintf(__cArray2, 8192, "%s", __cArray);
      snprintf(__cArray3, 8192, "%s", "");
      ReportTableRow(__tableHandle, 0, __cArray2, ">", 0, __cArray3, __oneOfFlag, __bSetInCheckAlignment);
      ReportCell(__tableHandle, __nDiagValue);
      ReportCellResult(__tableHandle, __csr, __ePassFail);
    
      __res = __res && __csr;
    
    }
    {
      double __nDiagValue;
      DiagGetParameterErrorHandled(__resp, "Magna_ProdHwVerInfo_HW_Week", __nDiagValue);
      __csr = CheckSignalMatch(__nDiagValue, 0, ">") == 1;
      snprintf(__cArray, 8192, "%s", "Diagnostic parameter \'Magna_ProdHwVerInfo_HW_Week\'");
      snprintf(__cArray2, 8192, "%s", __cArray);
      snprintf(__cArray3, 8192, "%s", "");
      ReportTableRow(__tableHandle, 0, __cArray2, ">", 0, __cArray3, __oneOfFlag, __bSetInCheckAlignment);
      ReportCell(__tableHandle, __nDiagValue);
      ReportCellResult(__tableHandle, __csr, __ePassFail);
    
      __res = __res && __csr;
    
    }
    {
      double __nDiagValue;
      DiagGetParameterErrorHandled(__resp, "Magna_ProdHwVerInfo_HW_Year", __nDiagValue);
      __csr = CheckSignalMatch(__nDiagValue, 0, ">") == 1;
      snprintf(__cArray, 8192, "%s", "Diagnostic parameter \'Magna_ProdHwVerInfo_HW_Year\'");
      snprintf(__cArray2, 8192, "%s", __cArray);
      snprintf(__cArray3, 8192, "%s", "");
      ReportTableRow(__tableHandle, 0, __cArray2, ">", 0, __cArray3, __oneOfFlag, __bSetInCheckAlignment);
      ReportCell(__tableHandle, __nDiagValue);
      ReportCellResult(__tableHandle, __csr, __ePassFail);
    
      __res = __res && __csr;
    
    }
    ReportTableEndVerdict(__tableHandle, __cEvaluateResponse, __res);
	__bVerdict = __bVerdict && __res;
  }
  if (__bVerdict == __eVerdictFail)
    TestReportWriteDiagObjectList();
}

void Ttvccmce9_Tet_Tc24()
{
  CreateTTEIFFunction("Ttvccmce9_Tc24", __eTcDef, __eLocal);  
  AddIFParameterTestCaseAttribute("TC_ID", "");
  AddIFParameterTestCaseAttribute("Test Case ID", "");
  CallInterfaceFunction("2.6.6.4_FD38", __cEmpty , __cEmpty );
}
testcase Ttvccmce9_Tc24()
{
  stack long __tableHandle;
  SetBreakOnFail(0);

  TestCommandBegin(__eDiagService, __cDiagService, "", "0");
  {
    if (DiagIsFunctionalGroup("CVADAS_0001_00000000_000"))
    {
      DiagResponse * __resp;
      DiagRequest CVADAS_0001_00000000_000.Default_Session_Start __req;
      __diagServicevccmce9_125(__req, __resp);
    }
    else
    {
      DiagResponse CVADAS_0001_00000000_000.* __resp;
      DiagRequest CVADAS_0001_00000000_000.Default_Session_Start __req;
      __diagServicevccmce9_125(__req, __resp);
    }
  }
  TestCommandEnd();


  TestCommandBegin(__eWait, __cWait, "", "1");
  {
    Wait("1", (syspar::`sleep * 1000000LL), 1000000, "sleep");
  }
  TestCommandEnd();

  TestCommandBegin(__eDiagService, __cDiagService, "", "2");
  {
    if (DiagIsFunctionalGroup("CVADAS_0001_00000000_000"))
    {
      DiagResponse * __resp;
      DiagRequest CVADAS_0001_00000000_000._22FD38_Programmed_Assembly __req;
      __diagServicevccmce9_126(__req, __resp);
    }
    else
    {
      DiagResponse CVADAS_0001_00000000_000.* __resp;
      DiagRequest CVADAS_0001_00000000_000._22FD38_Programmed_Assembly __req;
      __diagServicevccmce9_126(__req, __resp);
    }
  }
  TestCommandEnd();


  TestCommandBegin(__eDiagService, __cDiagService, "", "3");
  {
    if (DiagIsFunctionalGroup("CVADAS_0001_00000000_000"))
    {
      DiagResponse * __resp;
      DiagRequest CVADAS_0001_00000000_000.Extended_Diagnostic_Session_Start __req;
      __diagServicevccmce9_127(__req, __resp);
    }
    else
    {
      DiagResponse CVADAS_0001_00000000_000.* __resp;
      DiagRequest CVADAS_0001_00000000_000.Extended_Diagnostic_Session_Start __req;
      __diagServicevccmce9_127(__req, __resp);
    }
  }
  TestCommandEnd();


  TestCommandBegin(__eWait, __cWait, "", "4");
  {
    Wait("1", (syspar::`sleep * 1000000LL), 1000000, "sleep");
  }
  TestCommandEnd();

  TestCommandBegin(__eDiagService, __cDiagService, "", "5");
  {
    if (DiagIsFunctionalGroup("CVADAS_0001_00000000_000"))
    {
      DiagResponse * __resp;
      DiagRequest CVADAS_0001_00000000_000._22FD38_Programmed_Assembly __req;
      __diagServicevccmce9_128(__req, __resp);
    }
    else
    {
      DiagResponse CVADAS_0001_00000000_000.* __resp;
      DiagRequest CVADAS_0001_00000000_000._22FD38_Programmed_Assembly __req;
      __diagServicevccmce9_128(__req, __resp);
    }
  }
  TestCommandEnd();


}

  
void __diagServicevccmce9_125(DiagRequest * __req, DiagResponse * __resp )
{
  stack long __tableHandle;
  long __res, __paramLen, __bytePos;

   __bVerdict = __eVerdictPass;

  do {
    TestReportResetDiagObjectList();
    DiagSetReportDetailLevel("CVADAS_0001_00000000_000", EnumServiceDetails_onfail);
    // Request aspect
    {
      {
        __res = DiagSetParameterErrorHandled(__req, "DiagSessionType", 01);
        if(__res < 0)
        {
          __bVerdict = __eVerdictFail;
          DiagErrCodeTestStep(__res, "Cannot set diagnostic parameter 'DiagSessionType'");
          break;
        }
      }

      if (0 >= DiagSendReqAndWaitForResp("CVADAS_0001_00000000_000", __req, __resp, __res, -1, -1, -1, -1, -1, EnumResult_pos, EnumServiceDetails_onfail, EnumSendingMode_physical, EnumSuppressPosResBit_asconfigured, EnumVerdictOnInvalidValues_fail))
        break;
    }

    __res = DiagErrCodeTestStep(__res, "Can't retrieve last response for request! No check possible.") < 0;
    if(__res)
    {
	  __bVerdict = __eVerdictFail;
      break;
    }
    {
      __res = DiagInterpretAs(__resp, "DSC_PR");
      if(__res != 0)
      {
        __bVerdict = __eVerdictFail;
        DiagErrCodeTestStep(__res, "Can't interpret response as diagnostic primitive 'DSC_PR'.");
        break;
      }
      else
      {
        TestStepPass( "Received primitive can be interpreted as diagnostic primitive 'DSC_PR'.");
      }
    }
  }
  while(0);


  // Response, check & read aspect
  {
    __res = 1;
    __tableHandle = ReportTableHead5Columns(__cCheckCaption, __cTSym, __cTOp, __cRefVal, __cActual, __cRes);
    {
      double __nDiagValue;
      DiagGetParameterErrorHandled(__resp, "DiagSessionType", __nDiagValue);
      __csr = CheckSignalMatch(__nDiagValue, 01, "==") == 1;
      snprintf(__cArray, 8192, "%s", "Diagnostic parameter \'DiagSessionType\'");
      snprintf(__cArray2, 8192, "%s", __cArray);
      snprintf(__cArray3, 8192, "%s", "");
      ReportTableRow(__tableHandle, 0, __cArray2, "==", 01, __cArray3, __oneOfFlag, __bSetInCheckAlignment);
      ReportCell(__tableHandle, __nDiagValue);
      ReportCellResult(__tableHandle, __csr, __ePassFail);
    
      __res = __res && __csr;
    
    }
    ReportTableEndVerdict(__tableHandle, __cEvaluateResponse, __res);
	__bVerdict = __bVerdict && __res;
  }
  if (__bVerdict == __eVerdictFail)
    TestReportWriteDiagObjectList();
}
  
void __diagServicevccmce9_126(DiagRequest * __req, DiagResponse * __resp )
{
  stack long __tableHandle;
  long __res, __paramLen, __bytePos;

   __bVerdict = __eVerdictPass;

  do {
    TestReportResetDiagObjectList();
    DiagSetReportDetailLevel("CVADAS_0001_00000000_000", EnumServiceDetails_onfail);
    // Request aspect
    {

      if (0 >= DiagSendReqAndWaitForResp("CVADAS_0001_00000000_000", __req, __resp, __res, -1, -1, -1, -1, -1, EnumResult_pos, EnumServiceDetails_onfail, EnumSendingMode_physical, EnumSuppressPosResBit_asconfigured, EnumVerdictOnInvalidValues_fail))
        break;
    }

    __res = DiagErrCodeTestStep(__res, "Can't retrieve last response for request! No check possible.") < 0;
    if(__res)
    {
	  __bVerdict = __eVerdictFail;
      break;
    }
    {
      __res = DiagInterpretAs(__resp, "RDBI_PR");
      if(__res != 0)
      {
        __bVerdict = __eVerdictFail;
        DiagErrCodeTestStep(__res, "Can't interpret response as diagnostic primitive 'RDBI_PR'.");
        break;
      }
      else
      {
        TestStepPass( "Received primitive can be interpreted as diagnostic primitive 'RDBI_PR'.");
      }
    }
  }
  while(0);


  // Response, check & read aspect
  {
    __res = 1;
    __tableHandle = ReportTableHead5Columns(__cCheckCaption, __cTSym, __cTOp, __cRefVal, __cActual, __cRes);
    {
      __bDiagValueArrayCtr = DiagGetParameterErrorHandled(__resp, "Programmed_Assembly_0xFD38/Programmed_Assembly", __bDiagValueArray, elcount(__bDiagValueArray), __cDiagValueArray, elcount(__cDiagValueArray));
      {
        byte __bArray2[16] = { 0x00, 0x00, 0x00, 0x00, 0x00, 0x00, 0x00, 0x00, 0x00, 0x00, 0x00, 0x00, 0x00, 0x00, 0x00, 0x00 };
        __bArrayCtr = __CopyBytes(__bDiagValueArray, __bDiagValueArrayCtr, __bArray);
        __bArrayCtr2 = elCount(__bArray2);
        __csr = CompareBytes(__bArray, __bArrayCtr, __bArray2, __bArrayCtr2) == 0;
        snprintf(__cArray, 8192, "%s", "Diagnostic parameter \'Programmed_Assembly_0xFD38/Programmed_Assembly\'");
        snprintf(__cArray2, 8192, "%s", __cArray);
        snprintf(__cArray3, 8192, "%s", "");
        ReportTableRow(__tableHandle, 0, __cArray2, "Bytes", __bArray2, __bArrayCtr2, __cArray3, __oneOfFlag, __bSetInCheckAlignment);
        ReportCell(__tableHandle, __bArray, __bArrayCtr);
        ReportCellResult(__tableHandle, __csr, __ePassFail);
      }
    
      __res = __res && __csr;
    
    }
    {
      __bDiagValueArrayCtr = DiagGetParameterErrorHandled(__resp, "Programmed_Assembly_0xFD38", __bDiagValueArray, elcount(__bDiagValueArray), __cDiagValueArray, elcount(__cDiagValueArray));
      {
        byte __bArray2[16] = { 0x00, 0x00, 0x00, 0x00, 0x00, 0x00, 0x00, 0x00, 0x00, 0x00, 0x00, 0x00, 0x00, 0x00, 0x00, 0x00 };
        __bArrayCtr = __CopyBytes(__bDiagValueArray, __bDiagValueArrayCtr, __bArray);
        __bArrayCtr2 = elCount(__bArray2);
        __csr = CompareBytes(__bArray, __bArrayCtr, __bArray2, __bArrayCtr2) == 0;
        snprintf(__cArray, 8192, "%s", "Diagnostic parameter \'Programmed_Assembly_0xFD38\'");
        snprintf(__cArray2, 8192, "%s", __cArray);
        snprintf(__cArray3, 8192, "%s", "");
        ReportTableRow(__tableHandle, 0, __cArray2, "Bytes", __bArray2, __bArrayCtr2, __cArray3, __oneOfFlag, __bSetInCheckAlignment);
        ReportCell(__tableHandle, __bArray, __bArrayCtr);
        ReportCellResult(__tableHandle, __csr, __ePassFail);
      }
    
      __res = __res && __csr;
    
    }
    ReportTableEndVerdict(__tableHandle, __cEvaluateResponse, __res);
	__bVerdict = __bVerdict && __res;
  }
  if (__bVerdict == __eVerdictFail)
    TestReportWriteDiagObjectList();
}
  
void __diagServicevccmce9_127(DiagRequest * __req, DiagResponse * __resp )
{
  stack long __tableHandle;
  long __res, __paramLen, __bytePos;

   __bVerdict = __eVerdictPass;

  do {
    TestReportResetDiagObjectList();
    DiagSetReportDetailLevel("CVADAS_0001_00000000_000", EnumServiceDetails_onfail);
    // Request aspect
    {
      {
        __res = DiagSetParameterErrorHandled(__req, "DiagSessionType", 03);
        if(__res < 0)
        {
          __bVerdict = __eVerdictFail;
          DiagErrCodeTestStep(__res, "Cannot set diagnostic parameter 'DiagSessionType'");
          break;
        }
      }

      if (0 >= DiagSendReqAndWaitForResp("CVADAS_0001_00000000_000", __req, __resp, __res, -1, -1, -1, -1, -1, EnumResult_pos, EnumServiceDetails_onfail, EnumSendingMode_physical, EnumSuppressPosResBit_asconfigured, EnumVerdictOnInvalidValues_fail))
        break;
    }

    __res = DiagErrCodeTestStep(__res, "Can't retrieve last response for request! No check possible.") < 0;
    if(__res)
    {
	  __bVerdict = __eVerdictFail;
      break;
    }
    {
      __res = DiagInterpretAs(__resp, "DSC_PR");
      if(__res != 0)
      {
        __bVerdict = __eVerdictFail;
        DiagErrCodeTestStep(__res, "Can't interpret response as diagnostic primitive 'DSC_PR'.");
        break;
      }
      else
      {
        TestStepPass( "Received primitive can be interpreted as diagnostic primitive 'DSC_PR'.");
      }
    }
  }
  while(0);


  // Response, check & read aspect
  {
    __res = 1;
    __tableHandle = ReportTableHead5Columns(__cCheckCaption, __cTSym, __cTOp, __cRefVal, __cActual, __cRes);
    {
      double __nDiagValue;
      DiagGetParameterErrorHandled(__resp, "DiagSessionType", __nDiagValue);
      __csr = CheckSignalMatch(__nDiagValue, 03, "==") == 1;
      snprintf(__cArray, 8192, "%s", "Diagnostic parameter \'DiagSessionType\'");
      snprintf(__cArray2, 8192, "%s", __cArray);
      snprintf(__cArray3, 8192, "%s", "");
      ReportTableRow(__tableHandle, 0, __cArray2, "==", 03, __cArray3, __oneOfFlag, __bSetInCheckAlignment);
      ReportCell(__tableHandle, __nDiagValue);
      ReportCellResult(__tableHandle, __csr, __ePassFail);
    
      __res = __res && __csr;
    
    }
    ReportTableEndVerdict(__tableHandle, __cEvaluateResponse, __res);
	__bVerdict = __bVerdict && __res;
  }
  if (__bVerdict == __eVerdictFail)
    TestReportWriteDiagObjectList();
}
  
void __diagServicevccmce9_128(DiagRequest * __req, DiagResponse * __resp )
{
  stack long __tableHandle;
  long __res, __paramLen, __bytePos;

   __bVerdict = __eVerdictPass;

  do {
    TestReportResetDiagObjectList();
    DiagSetReportDetailLevel("CVADAS_0001_00000000_000", EnumServiceDetails_onfail);
    // Request aspect
    {

      if (0 >= DiagSendReqAndWaitForResp("CVADAS_0001_00000000_000", __req, __resp, __res, -1, -1, -1, -1, -1, EnumResult_pos, EnumServiceDetails_onfail, EnumSendingMode_physical, EnumSuppressPosResBit_asconfigured, EnumVerdictOnInvalidValues_fail))
        break;
    }

    __res = DiagErrCodeTestStep(__res, "Can't retrieve last response for request! No check possible.") < 0;
    if(__res)
    {
	  __bVerdict = __eVerdictFail;
      break;
    }
    {
      __res = DiagInterpretAs(__resp, "RDBI_PR");
      if(__res != 0)
      {
        __bVerdict = __eVerdictFail;
        DiagErrCodeTestStep(__res, "Can't interpret response as diagnostic primitive 'RDBI_PR'.");
        break;
      }
      else
      {
        TestStepPass( "Received primitive can be interpreted as diagnostic primitive 'RDBI_PR'.");
      }
    }
  }
  while(0);


  // Response, check & read aspect
  {
    __res = 1;
    __tableHandle = ReportTableHead5Columns(__cCheckCaption, __cTSym, __cTOp, __cRefVal, __cActual, __cRes);
    {
      __bDiagValueArrayCtr = DiagGetParameterErrorHandled(__resp, "Programmed_Assembly_0xFD38/Programmed_Assembly", __bDiagValueArray, elcount(__bDiagValueArray), __cDiagValueArray, elcount(__cDiagValueArray));
      {
        byte __bArray2[16] = { 0x00, 0x00, 0x00, 0x00, 0x00, 0x00, 0x00, 0x00, 0x00, 0x00, 0x00, 0x00, 0x00, 0x00, 0x00, 0x00 };
        __bArrayCtr = __CopyBytes(__bDiagValueArray, __bDiagValueArrayCtr, __bArray);
        __bArrayCtr2 = elCount(__bArray2);
        __csr = CompareBytes(__bArray, __bArrayCtr, __bArray2, __bArrayCtr2) == 0;
        snprintf(__cArray, 8192, "%s", "Diagnostic parameter \'Programmed_Assembly_0xFD38/Programmed_Assembly\'");
        snprintf(__cArray2, 8192, "%s", __cArray);
        snprintf(__cArray3, 8192, "%s", "");
        ReportTableRow(__tableHandle, 0, __cArray2, "Bytes", __bArray2, __bArrayCtr2, __cArray3, __oneOfFlag, __bSetInCheckAlignment);
        ReportCell(__tableHandle, __bArray, __bArrayCtr);
        ReportCellResult(__tableHandle, __csr, __ePassFail);
      }
    
      __res = __res && __csr;
    
    }
    {
      __bDiagValueArrayCtr = DiagGetParameterErrorHandled(__resp, "Programmed_Assembly_0xFD38", __bDiagValueArray, elcount(__bDiagValueArray), __cDiagValueArray, elcount(__cDiagValueArray));
      {
        byte __bArray2[16] = { 0x00, 0x00, 0x00, 0x00, 0x00, 0x00, 0x00, 0x00, 0x00, 0x00, 0x00, 0x00, 0x00, 0x00, 0x00, 0x00 };
        __bArrayCtr = __CopyBytes(__bDiagValueArray, __bDiagValueArrayCtr, __bArray);
        __bArrayCtr2 = elCount(__bArray2);
        __csr = CompareBytes(__bArray, __bArrayCtr, __bArray2, __bArrayCtr2) == 0;
        snprintf(__cArray, 8192, "%s", "Diagnostic parameter \'Programmed_Assembly_0xFD38\'");
        snprintf(__cArray2, 8192, "%s", __cArray);
        snprintf(__cArray3, 8192, "%s", "");
        ReportTableRow(__tableHandle, 0, __cArray2, "Bytes", __bArray2, __bArrayCtr2, __cArray3, __oneOfFlag, __bSetInCheckAlignment);
        ReportCell(__tableHandle, __bArray, __bArrayCtr);
        ReportCellResult(__tableHandle, __csr, __ePassFail);
      }
    
      __res = __res && __csr;
    
    }
    ReportTableEndVerdict(__tableHandle, __cEvaluateResponse, __res);
	__bVerdict = __bVerdict && __res;
  }
  if (__bVerdict == __eVerdictFail)
    TestReportWriteDiagObjectList();
}

void Ttvccmce9_Tet_Tc25()
{
  CreateTTEIFFunction("Ttvccmce9_Tc25", __eTcDef, __eLocal);  
  AddIFParameterTestCaseAttribute("TC_ID", "");
  AddIFParameterTestCaseAttribute("Test Case ID", "");
  CallInterfaceFunction("2.5.6.5_FD14_Production_Date", __cEmpty , __cEmpty );
}
testcase Ttvccmce9_Tc25()
{
  stack long __tableHandle;
  SetBreakOnFail(0);

  TestCommandBegin(__eDiagService, __cDiagService, "", "0");
  {
    if (DiagIsFunctionalGroup("CVADAS_0001_00000000_000"))
    {
      DiagResponse * __resp;
      DiagRequest CVADAS_0001_00000000_000._22FD14_FD14_Magna_Production_Date_Read __req;
      __diagServicevccmce9_129(__req, __resp);
    }
    else
    {
      DiagResponse CVADAS_0001_00000000_000.* __resp;
      DiagRequest CVADAS_0001_00000000_000._22FD14_FD14_Magna_Production_Date_Read __req;
      __diagServicevccmce9_129(__req, __resp);
    }
  }
  TestCommandEnd();


}

  
void __diagServicevccmce9_129(DiagRequest * __req, DiagResponse * __resp )
{
  stack long __tableHandle;
  long __res, __paramLen, __bytePos;

   __bVerdict = __eVerdictPass;

  do {
    TestReportResetDiagObjectList();
    DiagSetReportDetailLevel("CVADAS_0001_00000000_000", EnumServiceDetails_onfail);
    // Request aspect
    {

      if (0 >= DiagSendReqAndWaitForResp("CVADAS_0001_00000000_000", __req, __resp, __res, -1, -1, -1, -1, -1, EnumResult_pos, EnumServiceDetails_onfail, EnumSendingMode_physical, EnumSuppressPosResBit_asconfigured, EnumVerdictOnInvalidValues_fail))
        break;
    }

    __res = DiagErrCodeTestStep(__res, "Can't retrieve last response for request! No check possible.") < 0;
    if(__res)
    {
	  __bVerdict = __eVerdictFail;
      break;
    }
    {
      __res = DiagInterpretAs(__resp, "RDBI_PR");
      if(__res != 0)
      {
        __bVerdict = __eVerdictFail;
        DiagErrCodeTestStep(__res, "Can't interpret response as diagnostic primitive 'RDBI_PR'.");
        break;
      }
      else
      {
        TestStepPass( "Received primitive can be interpreted as diagnostic primitive 'RDBI_PR'.");
      }
    }
  }
  while(0);


  // Response, check & read aspect
  {
    __res = 1;
    __tableHandle = ReportTableHead5Columns(__cCheckCaption, __cTSym, __cTOp, __cRefVal, __cActual, __cRes);
    {
      DiagGetParameterErrorHandled(__resp, "Day_of_the_year_Julian_Format", __bDiagValueArray, elcount(__bDiagValueArray), __cDiagValueArray, elcount(__cDiagValueArray));
      CheckCaplGenVarStringBufferConsistency(__cDiagValueArray, 8192);
      snprintf(__cArray, 8192, "%s", __cDiagValueArray);
      CheckLiteralGetStringBufferConsistency("24", 8192);
      snprintf(__cArray2, 8192, "%s", "24");
      __csr = strncmp(__cArray, __cArray2, 8192) >= 0;
      snprintf(__cArray3, 8192, "%s", "Diagnostic parameter \'Day_of_the_year_Julian_Format\'");
      snprintf(__cArray4, 8192, "%s", __cArray3);
      snprintf(__cArray5, 8192, "%s", "");
      ReportTableRow(__tableHandle, 0, __cArray4, ">=", __cArray2, __cArray5, __oneOfFlag, __bSetInCheckAlignment);
      ReportCell(__tableHandle, __cArray);
      ReportCellResult(__tableHandle, __csr, __ePassFail);
    
      __res = __res && __csr;
    
    }
    {
      DiagGetParameterErrorHandled(__resp, "Last_two_digits_of_the_year", __bDiagValueArray, elcount(__bDiagValueArray), __cDiagValueArray, elcount(__cDiagValueArray));
      CheckCaplGenVarStringBufferConsistency(__cDiagValueArray, 8192);
      snprintf(__cArray, 8192, "%s", __cDiagValueArray);
      CheckLiteralGetStringBufferConsistency("22", 8192);
      snprintf(__cArray2, 8192, "%s", "22");
      __csr = strncmp(__cArray, __cArray2, 8192) >= 0;
      snprintf(__cArray3, 8192, "%s", "Diagnostic parameter \'Last_two_digits_of_the_year\'");
      snprintf(__cArray4, 8192, "%s", __cArray3);
      snprintf(__cArray5, 8192, "%s", "");
      ReportTableRow(__tableHandle, 0, __cArray4, ">=", __cArray2, __cArray5, __oneOfFlag, __bSetInCheckAlignment);
      ReportCell(__tableHandle, __cArray);
      ReportCellResult(__tableHandle, __csr, __ePassFail);
    
      __res = __res && __csr;
    
    }
    ReportTableEndVerdict(__tableHandle, __cEvaluateResponse, __res);
	__bVerdict = __bVerdict && __res;
  }
  if (__bVerdict == __eVerdictFail)
    TestReportWriteDiagObjectList();
}

void Ttvccmce9_Tet_Tc26()
{
  CreateTTEIFFunction("Ttvccmce9_Tc26", __eTcDef, __eLocal);  
  AddIFParameterTestCaseAttribute("TC_ID", "");
  AddIFParameterTestCaseAttribute("Test Case ID", "");
  CallInterfaceFunction("2.5.7.1_FD47", __cEmpty , __cEmpty );
}
testcase Ttvccmce9_Tc26()
{
  stack long __tableHandle;
  SetBreakOnFail(0);

  TestCommandBegin(__eDiagService, __cDiagService, "", "0");
  {
    if (DiagIsFunctionalGroup("CVADAS_0001_00000000_000"))
    {
      DiagResponse * __resp;
      DiagRequest CVADAS_0001_00000000_000._22FD47_SoC_Temperature_0xFD47_Read __req;
      __diagServicevccmce9_130(__req, __resp);
    }
    else
    {
      DiagResponse CVADAS_0001_00000000_000.* __resp;
      DiagRequest CVADAS_0001_00000000_000._22FD47_SoC_Temperature_0xFD47_Read __req;
      __diagServicevccmce9_130(__req, __resp);
    }
  }
  TestCommandEnd();


  TestCommandBegin(__eWait, __cWait, "", "1");
  {
    Wait("1", (syspar::`sleep * 1000000LL), 1000000, "sleep");
  }
  TestCommandEnd();

  TestCommandBegin(__eDiagService, __cDiagService, "", "2");
  {
    if (DiagIsFunctionalGroup("CVADAS_0001_00000000_000"))
    {
      DiagResponse * __resp;
      DiagRequest CVADAS_0001_00000000_000.Default_Session_Start __req;
      __diagServicevccmce9_131(__req, __resp);
    }
    else
    {
      DiagResponse CVADAS_0001_00000000_000.* __resp;
      DiagRequest CVADAS_0001_00000000_000.Default_Session_Start __req;
      __diagServicevccmce9_131(__req, __resp);
    }
  }
  TestCommandEnd();


  TestCommandBegin(__eWait, __cWait, "", "3");
  {
    Wait("1", (syspar::`sleep * 1000000LL), 1000000, "sleep");
  }
  TestCommandEnd();

  TestCommandBegin(__eDiagService, __cDiagService, "", "4");
  {
    if (DiagIsFunctionalGroup("CVADAS_0001_00000000_000"))
    {
      DiagResponse * __resp;
      DiagRequest CVADAS_0001_00000000_000.Extended_Diagnostic_Session_Start __req;
      __diagServicevccmce9_132(__req, __resp);
    }
    else
    {
      DiagResponse CVADAS_0001_00000000_000.* __resp;
      DiagRequest CVADAS_0001_00000000_000.Extended_Diagnostic_Session_Start __req;
      __diagServicevccmce9_132(__req, __resp);
    }
  }
  TestCommandEnd();


  TestCommandBegin(__eWait, __cWait, "", "5");
  {
    Wait("1", (syspar::`sleep * 1000000LL), 1000000, "sleep");
  }
  TestCommandEnd();

  TestCommandBegin(__eDiagService, __cDiagService, "", "6");
  {
    if (DiagIsFunctionalGroup("CVADAS_0001_00000000_000"))
    {
      DiagResponse * __resp;
      DiagRequest CVADAS_0001_00000000_000._22FD47_SoC_Temperature_0xFD47_Read __req;
      __diagServicevccmce9_133(__req, __resp);
    }
    else
    {
      DiagResponse CVADAS_0001_00000000_000.* __resp;
      DiagRequest CVADAS_0001_00000000_000._22FD47_SoC_Temperature_0xFD47_Read __req;
      __diagServicevccmce9_133(__req, __resp);
    }
  }
  TestCommandEnd();


}

  
void __diagServicevccmce9_130(DiagRequest * __req, DiagResponse * __resp )
{
  stack long __tableHandle;
  long __res, __paramLen, __bytePos;

   __bVerdict = __eVerdictPass;

  do {
    TestReportResetDiagObjectList();
    DiagSetReportDetailLevel("CVADAS_0001_00000000_000", EnumServiceDetails_onfail);
    // Request aspect
    {

      if (0 >= DiagSendReqAndWaitForResp("CVADAS_0001_00000000_000", __req, __resp, __res, -1, -1, -1, -1, -1, EnumResult_pos, EnumServiceDetails_onfail, EnumSendingMode_physical, EnumSuppressPosResBit_asconfigured, EnumVerdictOnInvalidValues_fail))
        break;
    }

    __res = DiagErrCodeTestStep(__res, "Can't retrieve last response for request! No check possible.") < 0;
    if(__res)
    {
	  __bVerdict = __eVerdictFail;
      break;
    }
    {
      __res = DiagInterpretAs(__resp, "RDBI_PR");
      if(__res != 0)
      {
        __bVerdict = __eVerdictFail;
        DiagErrCodeTestStep(__res, "Can't interpret response as diagnostic primitive 'RDBI_PR'.");
        break;
      }
      else
      {
        TestStepPass( "Received primitive can be interpreted as diagnostic primitive 'RDBI_PR'.");
      }
    }
  }
  while(0);


  // Response, check & read aspect
  {
    __res = 1;
    __tableHandle = ReportTableHead5Columns(__cCheckCaption, __cTSym, __cTOp, __cRefVal, __cActual, __cRes);
    {
      double __nDiagValue;
      DiagGetParameterErrorHandled(__resp, "DID_0xFD47/SoC_Temperature/SOC_Temperatue_1", __nDiagValue);
      __csr = CheckSignalMatch(__nDiagValue, 90, "<") == 1;
      snprintf(__cArray, 8192, "%s", "Diagnostic parameter \'DID_0xFD47/SoC_Temperature/SOC_Temperatue_1\'");
      snprintf(__cArray2, 8192, "%s", __cArray);
      snprintf(__cArray3, 8192, "%s", "");
      ReportTableRow(__tableHandle, 0, __cArray2, "<", 90, __cArray3, __oneOfFlag, __bSetInCheckAlignment);
      ReportCell(__tableHandle, __nDiagValue);
      ReportCellResult(__tableHandle, __csr, __ePassFail);
    
      __res = __res && __csr;
    
    }
    {
      double __nDiagValue;
      DiagGetParameterErrorHandled(__resp, "DID_0xFD47/SoC_Temperature/SOC_Temperature_2", __nDiagValue);
      __csr = CheckSignalMatch(__nDiagValue, 90, "<") == 1;
      snprintf(__cArray, 8192, "%s", "Diagnostic parameter \'DID_0xFD47/SoC_Temperature/SOC_Temperature_2\'");
      snprintf(__cArray2, 8192, "%s", __cArray);
      snprintf(__cArray3, 8192, "%s", "");
      ReportTableRow(__tableHandle, 0, __cArray2, "<", 90, __cArray3, __oneOfFlag, __bSetInCheckAlignment);
      ReportCell(__tableHandle, __nDiagValue);
      ReportCellResult(__tableHandle, __csr, __ePassFail);
    
      __res = __res && __csr;
    
    }
    {
      double __nDiagValue;
      DiagGetParameterErrorHandled(__resp, "DID_0xFD47/SoC_Temperature/SOC_Temperature_3", __nDiagValue);
      __csr = CheckSignalMatch(__nDiagValue, 90, "<") == 1;
      snprintf(__cArray, 8192, "%s", "Diagnostic parameter \'DID_0xFD47/SoC_Temperature/SOC_Temperature_3\'");
      snprintf(__cArray2, 8192, "%s", __cArray);
      snprintf(__cArray3, 8192, "%s", "");
      ReportTableRow(__tableHandle, 0, __cArray2, "<", 90, __cArray3, __oneOfFlag, __bSetInCheckAlignment);
      ReportCell(__tableHandle, __nDiagValue);
      ReportCellResult(__tableHandle, __csr, __ePassFail);
    
      __res = __res && __csr;
    
    }
    {
      double __nDiagValue;
      DiagGetParameterErrorHandled(__resp, "DID_0xFD47/SoC_Temperature/SOC_Temperature_4", __nDiagValue);
      __csr = CheckSignalMatch(__nDiagValue, 90, "<") == 1;
      snprintf(__cArray, 8192, "%s", "Diagnostic parameter \'DID_0xFD47/SoC_Temperature/SOC_Temperature_4\'");
      snprintf(__cArray2, 8192, "%s", __cArray);
      snprintf(__cArray3, 8192, "%s", "");
      ReportTableRow(__tableHandle, 0, __cArray2, "<", 90, __cArray3, __oneOfFlag, __bSetInCheckAlignment);
      ReportCell(__tableHandle, __nDiagValue);
      ReportCellResult(__tableHandle, __csr, __ePassFail);
    
      __res = __res && __csr;
    
    }
    ReportTableEndVerdict(__tableHandle, __cEvaluateResponse, __res);
	__bVerdict = __bVerdict && __res;
  }
  if (__bVerdict == __eVerdictFail)
    TestReportWriteDiagObjectList();
}
  
void __diagServicevccmce9_131(DiagRequest * __req, DiagResponse * __resp )
{
  stack long __tableHandle;
  long __res, __paramLen, __bytePos;

   __bVerdict = __eVerdictPass;

  do {
    TestReportResetDiagObjectList();
    DiagSetReportDetailLevel("CVADAS_0001_00000000_000", EnumServiceDetails_onfail);
    // Request aspect
    {
      {
        __res = DiagSetParameterErrorHandled(__req, "DiagSessionType", 01);
        if(__res < 0)
        {
          __bVerdict = __eVerdictFail;
          DiagErrCodeTestStep(__res, "Cannot set diagnostic parameter 'DiagSessionType'");
          break;
        }
      }

      if (0 >= DiagSendReqAndWaitForResp("CVADAS_0001_00000000_000", __req, __resp, __res, -1, -1, -1, -1, -1, EnumResult_pos, EnumServiceDetails_onfail, EnumSendingMode_physical, EnumSuppressPosResBit_asconfigured, EnumVerdictOnInvalidValues_fail))
        break;
    }

    __res = DiagErrCodeTestStep(__res, "Can't retrieve last response for request! No check possible.") < 0;
    if(__res)
    {
	  __bVerdict = __eVerdictFail;
      break;
    }
    {
      __res = DiagInterpretAs(__resp, "DSC_PR");
      if(__res != 0)
      {
        __bVerdict = __eVerdictFail;
        DiagErrCodeTestStep(__res, "Can't interpret response as diagnostic primitive 'DSC_PR'.");
        break;
      }
      else
      {
        TestStepPass( "Received primitive can be interpreted as diagnostic primitive 'DSC_PR'.");
      }
    }
  }
  while(0);


  // Response, check & read aspect
  {
    __res = 1;
    __tableHandle = ReportTableHead5Columns(__cCheckCaption, __cTSym, __cTOp, __cRefVal, __cActual, __cRes);
    {
      double __nDiagValue;
      DiagGetParameterErrorHandled(__resp, "DiagSessionType", __nDiagValue);
      __csr = CheckSignalMatch(__nDiagValue, 01, "==") == 1;
      snprintf(__cArray, 8192, "%s", "Diagnostic parameter \'DiagSessionType\'");
      snprintf(__cArray2, 8192, "%s", __cArray);
      snprintf(__cArray3, 8192, "%s", "");
      ReportTableRow(__tableHandle, 0, __cArray2, "==", 01, __cArray3, __oneOfFlag, __bSetInCheckAlignment);
      ReportCell(__tableHandle, __nDiagValue);
      ReportCellResult(__tableHandle, __csr, __ePassFail);
    
      __res = __res && __csr;
    
    }
    ReportTableEndVerdict(__tableHandle, __cEvaluateResponse, __res);
	__bVerdict = __bVerdict && __res;
  }
  if (__bVerdict == __eVerdictFail)
    TestReportWriteDiagObjectList();
}
  
void __diagServicevccmce9_132(DiagRequest * __req, DiagResponse * __resp )
{
  stack long __tableHandle;
  long __res, __paramLen, __bytePos;

   __bVerdict = __eVerdictPass;

  do {
    TestReportResetDiagObjectList();
    DiagSetReportDetailLevel("CVADAS_0001_00000000_000", EnumServiceDetails_onfail);
    // Request aspect
    {
      {
        __res = DiagSetParameterErrorHandled(__req, "DiagSessionType", 03);
        if(__res < 0)
        {
          __bVerdict = __eVerdictFail;
          DiagErrCodeTestStep(__res, "Cannot set diagnostic parameter 'DiagSessionType'");
          break;
        }
      }

      if (0 >= DiagSendReqAndWaitForResp("CVADAS_0001_00000000_000", __req, __resp, __res, -1, -1, -1, -1, -1, EnumResult_pos, EnumServiceDetails_onfail, EnumSendingMode_physical, EnumSuppressPosResBit_asconfigured, EnumVerdictOnInvalidValues_fail))
        break;
    }

    __res = DiagErrCodeTestStep(__res, "Can't retrieve last response for request! No check possible.") < 0;
    if(__res)
    {
	  __bVerdict = __eVerdictFail;
      break;
    }
    {
      __res = DiagInterpretAs(__resp, "DSC_PR");
      if(__res != 0)
      {
        __bVerdict = __eVerdictFail;
        DiagErrCodeTestStep(__res, "Can't interpret response as diagnostic primitive 'DSC_PR'.");
        break;
      }
      else
      {
        TestStepPass( "Received primitive can be interpreted as diagnostic primitive 'DSC_PR'.");
      }
    }
  }
  while(0);


  // Response, check & read aspect
  {
    __res = 1;
    __tableHandle = ReportTableHead5Columns(__cCheckCaption, __cTSym, __cTOp, __cRefVal, __cActual, __cRes);
    {
      double __nDiagValue;
      DiagGetParameterErrorHandled(__resp, "DiagSessionType", __nDiagValue);
      __csr = CheckSignalMatch(__nDiagValue, 03, "==") == 1;
      snprintf(__cArray, 8192, "%s", "Diagnostic parameter \'DiagSessionType\'");
      snprintf(__cArray2, 8192, "%s", __cArray);
      snprintf(__cArray3, 8192, "%s", "");
      ReportTableRow(__tableHandle, 0, __cArray2, "==", 03, __cArray3, __oneOfFlag, __bSetInCheckAlignment);
      ReportCell(__tableHandle, __nDiagValue);
      ReportCellResult(__tableHandle, __csr, __ePassFail);
    
      __res = __res && __csr;
    
    }
    ReportTableEndVerdict(__tableHandle, __cEvaluateResponse, __res);
	__bVerdict = __bVerdict && __res;
  }
  if (__bVerdict == __eVerdictFail)
    TestReportWriteDiagObjectList();
}
  
void __diagServicevccmce9_133(DiagRequest * __req, DiagResponse * __resp )
{
  stack long __tableHandle;
  long __res, __paramLen, __bytePos;

   __bVerdict = __eVerdictPass;

  do {
    TestReportResetDiagObjectList();
    DiagSetReportDetailLevel("CVADAS_0001_00000000_000", EnumServiceDetails_onfail);
    // Request aspect
    {

      if (0 >= DiagSendReqAndWaitForResp("CVADAS_0001_00000000_000", __req, __resp, __res, -1, -1, -1, -1, -1, EnumResult_pos, EnumServiceDetails_onfail, EnumSendingMode_physical, EnumSuppressPosResBit_asconfigured, EnumVerdictOnInvalidValues_fail))
        break;
    }

    __res = DiagErrCodeTestStep(__res, "Can't retrieve last response for request! No check possible.") < 0;
    if(__res)
    {
	  __bVerdict = __eVerdictFail;
      break;
    }
    {
      __res = DiagInterpretAs(__resp, "RDBI_PR");
      if(__res != 0)
      {
        __bVerdict = __eVerdictFail;
        DiagErrCodeTestStep(__res, "Can't interpret response as diagnostic primitive 'RDBI_PR'.");
        break;
      }
      else
      {
        TestStepPass( "Received primitive can be interpreted as diagnostic primitive 'RDBI_PR'.");
      }
    }
  }
  while(0);


  // Response, check & read aspect
  {
    __res = 1;
    __tableHandle = ReportTableHead5Columns(__cCheckCaption, __cTSym, __cTOp, __cRefVal, __cActual, __cRes);
    {
      double __nDiagValue;
      DiagGetParameterErrorHandled(__resp, "DID_0xFD47/SoC_Temperature/SOC_Temperatue_1", __nDiagValue);
      __csr = CheckSignalMatch(__nDiagValue, 90, "<") == 1;
      snprintf(__cArray, 8192, "%s", "Diagnostic parameter \'DID_0xFD47/SoC_Temperature/SOC_Temperatue_1\'");
      snprintf(__cArray2, 8192, "%s", __cArray);
      snprintf(__cArray3, 8192, "%s", "");
      ReportTableRow(__tableHandle, 0, __cArray2, "<", 90, __cArray3, __oneOfFlag, __bSetInCheckAlignment);
      ReportCell(__tableHandle, __nDiagValue);
      ReportCellResult(__tableHandle, __csr, __ePassFail);
    
      __res = __res && __csr;
    
    }
    {
      double __nDiagValue;
      DiagGetParameterErrorHandled(__resp, "DID_0xFD47/SoC_Temperature/SOC_Temperature_2", __nDiagValue);
      __csr = CheckSignalMatch(__nDiagValue, 90, "<") == 1;
      snprintf(__cArray, 8192, "%s", "Diagnostic parameter \'DID_0xFD47/SoC_Temperature/SOC_Temperature_2\'");
      snprintf(__cArray2, 8192, "%s", __cArray);
      snprintf(__cArray3, 8192, "%s", "");
      ReportTableRow(__tableHandle, 0, __cArray2, "<", 90, __cArray3, __oneOfFlag, __bSetInCheckAlignment);
      ReportCell(__tableHandle, __nDiagValue);
      ReportCellResult(__tableHandle, __csr, __ePassFail);
    
      __res = __res && __csr;
    
    }
    {
      double __nDiagValue;
      DiagGetParameterErrorHandled(__resp, "DID_0xFD47/SoC_Temperature/SOC_Temperature_3", __nDiagValue);
      __csr = CheckSignalMatch(__nDiagValue, 90, "<") == 1;
      snprintf(__cArray, 8192, "%s", "Diagnostic parameter \'DID_0xFD47/SoC_Temperature/SOC_Temperature_3\'");
      snprintf(__cArray2, 8192, "%s", __cArray);
      snprintf(__cArray3, 8192, "%s", "");
      ReportTableRow(__tableHandle, 0, __cArray2, "<", 90, __cArray3, __oneOfFlag, __bSetInCheckAlignment);
      ReportCell(__tableHandle, __nDiagValue);
      ReportCellResult(__tableHandle, __csr, __ePassFail);
    
      __res = __res && __csr;
    
    }
    {
      double __nDiagValue;
      DiagGetParameterErrorHandled(__resp, "DID_0xFD47/SoC_Temperature/SOC_Temperature_4", __nDiagValue);
      __csr = CheckSignalMatch(__nDiagValue, 90, "<") == 1;
      snprintf(__cArray, 8192, "%s", "Diagnostic parameter \'DID_0xFD47/SoC_Temperature/SOC_Temperature_4\'");
      snprintf(__cArray2, 8192, "%s", __cArray);
      snprintf(__cArray3, 8192, "%s", "");
      ReportTableRow(__tableHandle, 0, __cArray2, "<", 90, __cArray3, __oneOfFlag, __bSetInCheckAlignment);
      ReportCell(__tableHandle, __nDiagValue);
      ReportCellResult(__tableHandle, __csr, __ePassFail);
    
      __res = __res && __csr;
    
    }
    ReportTableEndVerdict(__tableHandle, __cEvaluateResponse, __res);
	__bVerdict = __bVerdict && __res;
  }
  if (__bVerdict == __eVerdictFail)
    TestReportWriteDiagObjectList();
}

void Ttvccmce9_Tet_Tc27()
{
  CreateTTEIFFunction("Ttvccmce9_Tc27", __eTcDef, __eLocal);  
  AddIFParameterTestCaseAttribute("TC_ID", "");
  AddIFParameterTestCaseAttribute("Test Case ID", "");
  CallInterfaceFunction("2.5.7.2_FD48", __cEmpty , __cEmpty );
}
testcase Ttvccmce9_Tc27()
{
  stack long __tableHandle;
  SetBreakOnFail(0);

  TestCommandBegin(__eDiagService, __cDiagService, "", "0");
  {
    if (DiagIsFunctionalGroup("CVADAS_0001_00000000_000"))
    {
      DiagResponse * __resp;
      DiagRequest CVADAS_0001_00000000_000.Default_Session_Start __req;
      __diagServicevccmce9_134(__req, __resp);
    }
    else
    {
      DiagResponse CVADAS_0001_00000000_000.* __resp;
      DiagRequest CVADAS_0001_00000000_000.Default_Session_Start __req;
      __diagServicevccmce9_134(__req, __resp);
    }
  }
  TestCommandEnd();


  TestCommandBegin(__eWait, __cWait, "", "1");
  {
    Wait("1", (syspar::`sleep * 1000000LL), 1000000, "sleep");
  }
  TestCommandEnd();

  TestCommandBegin(__eDiagService, __cDiagService, "", "2");
  {
    if (DiagIsFunctionalGroup("CVADAS_0001_00000000_000"))
    {
      DiagResponse * __resp;
      DiagRequest CVADAS_0001_00000000_000._22FD48_PCBA_Temperature_Read __req;
      __diagServicevccmce9_135(__req, __resp);
    }
    else
    {
      DiagResponse CVADAS_0001_00000000_000.* __resp;
      DiagRequest CVADAS_0001_00000000_000._22FD48_PCBA_Temperature_Read __req;
      __diagServicevccmce9_135(__req, __resp);
    }
  }
  TestCommandEnd();


  TestCommandBegin(__eDiagService, __cDiagService, "", "3");
  {
    if (DiagIsFunctionalGroup("CVADAS_0001_00000000_000"))
    {
      DiagResponse * __resp;
      DiagRequest CVADAS_0001_00000000_000.Extended_Diagnostic_Session_Start __req;
      __diagServicevccmce9_136(__req, __resp);
    }
    else
    {
      DiagResponse CVADAS_0001_00000000_000.* __resp;
      DiagRequest CVADAS_0001_00000000_000.Extended_Diagnostic_Session_Start __req;
      __diagServicevccmce9_136(__req, __resp);
    }
  }
  TestCommandEnd();


  TestCommandBegin(__eWait, __cWait, "", "4");
  {
    Wait("1", (syspar::`sleep * 1000000LL), 1000000, "sleep");
  }
  TestCommandEnd();

  TestCommandBegin(__eDiagService, __cDiagService, "", "5");
  {
    if (DiagIsFunctionalGroup("CVADAS_0001_00000000_000"))
    {
      DiagResponse * __resp;
      DiagRequest CVADAS_0001_00000000_000._22FD48_PCBA_Temperature_Read __req;
      __diagServicevccmce9_137(__req, __resp);
    }
    else
    {
      DiagResponse CVADAS_0001_00000000_000.* __resp;
      DiagRequest CVADAS_0001_00000000_000._22FD48_PCBA_Temperature_Read __req;
      __diagServicevccmce9_137(__req, __resp);
    }
  }
  TestCommandEnd();


}

  
void __diagServicevccmce9_134(DiagRequest * __req, DiagResponse * __resp )
{
  stack long __tableHandle;
  long __res, __paramLen, __bytePos;

   __bVerdict = __eVerdictPass;

  do {
    TestReportResetDiagObjectList();
    DiagSetReportDetailLevel("CVADAS_0001_00000000_000", EnumServiceDetails_onfail);
    // Request aspect
    {
      {
        __res = DiagSetParameterErrorHandled(__req, "DiagSessionType", 01);
        if(__res < 0)
        {
          __bVerdict = __eVerdictFail;
          DiagErrCodeTestStep(__res, "Cannot set diagnostic parameter 'DiagSessionType'");
          break;
        }
      }

      if (0 >= DiagSendReqAndWaitForResp("CVADAS_0001_00000000_000", __req, __resp, __res, -1, -1, -1, -1, -1, EnumResult_pos, EnumServiceDetails_onfail, EnumSendingMode_physical, EnumSuppressPosResBit_asconfigured, EnumVerdictOnInvalidValues_fail))
        break;
    }

    __res = DiagErrCodeTestStep(__res, "Can't retrieve last response for request! No check possible.") < 0;
    if(__res)
    {
	  __bVerdict = __eVerdictFail;
      break;
    }
    {
      __res = DiagInterpretAs(__resp, "DSC_PR");
      if(__res != 0)
      {
        __bVerdict = __eVerdictFail;
        DiagErrCodeTestStep(__res, "Can't interpret response as diagnostic primitive 'DSC_PR'.");
        break;
      }
      else
      {
        TestStepPass( "Received primitive can be interpreted as diagnostic primitive 'DSC_PR'.");
      }
    }
  }
  while(0);


  // Response, check & read aspect
  {
    __res = 1;
    __tableHandle = ReportTableHead5Columns(__cCheckCaption, __cTSym, __cTOp, __cRefVal, __cActual, __cRes);
    {
      double __nDiagValue;
      DiagGetParameterErrorHandled(__resp, "DiagSessionType", __nDiagValue);
      __csr = CheckSignalMatch(__nDiagValue, 01, "==") == 1;
      snprintf(__cArray, 8192, "%s", "Diagnostic parameter \'DiagSessionType\'");
      snprintf(__cArray2, 8192, "%s", __cArray);
      snprintf(__cArray3, 8192, "%s", "");
      ReportTableRow(__tableHandle, 0, __cArray2, "==", 01, __cArray3, __oneOfFlag, __bSetInCheckAlignment);
      ReportCell(__tableHandle, __nDiagValue);
      ReportCellResult(__tableHandle, __csr, __ePassFail);
    
      __res = __res && __csr;
    
    }
    ReportTableEndVerdict(__tableHandle, __cEvaluateResponse, __res);
	__bVerdict = __bVerdict && __res;
  }
  if (__bVerdict == __eVerdictFail)
    TestReportWriteDiagObjectList();
}
  
void __diagServicevccmce9_135(DiagRequest * __req, DiagResponse * __resp )
{
  stack long __tableHandle;
  long __res, __paramLen, __bytePos;

   __bVerdict = __eVerdictPass;

  do {
    TestReportResetDiagObjectList();
    DiagSetReportDetailLevel("CVADAS_0001_00000000_000", EnumServiceDetails_onfail);
    // Request aspect
    {

      if (0 >= DiagSendReqAndWaitForResp("CVADAS_0001_00000000_000", __req, __resp, __res, -1, -1, -1, -1, -1, EnumResult_pos, EnumServiceDetails_onfail, EnumSendingMode_physical, EnumSuppressPosResBit_asconfigured, EnumVerdictOnInvalidValues_fail))
        break;
    }

    __res = DiagErrCodeTestStep(__res, "Can't retrieve last response for request! No check possible.") < 0;
    if(__res)
    {
	  __bVerdict = __eVerdictFail;
      break;
    }
    {
      __res = DiagInterpretAs(__resp, "RDBI_PR");
      if(__res != 0)
      {
        __bVerdict = __eVerdictFail;
        DiagErrCodeTestStep(__res, "Can't interpret response as diagnostic primitive 'RDBI_PR'.");
        break;
      }
      else
      {
        TestStepPass( "Received primitive can be interpreted as diagnostic primitive 'RDBI_PR'.");
      }
    }
  }
  while(0);


  // Response, check & read aspect
  {
    __res = 1;
    __tableHandle = ReportTableHead5Columns(__cCheckCaption, __cTSym, __cTOp, __cRefVal, __cActual, __cRes);
    {
      double __nDiagValue;
      DiagGetParameterErrorHandled(__resp, "Thermistor_1_Data", __nDiagValue);
      __csr = CheckSignalMatch(__nDiagValue, 0, ">") == 1;
      snprintf(__cArray, 8192, "%s", "Diagnostic parameter \'Thermistor_1_Data\'");
      snprintf(__cArray2, 8192, "%s", __cArray);
      snprintf(__cArray3, 8192, "%s", "");
      ReportTableRow(__tableHandle, 0, __cArray2, ">", 0, __cArray3, __oneOfFlag, __bSetInCheckAlignment);
      ReportCell(__tableHandle, __nDiagValue);
      ReportCellResult(__tableHandle, __csr, __ePassFail);
    
      __res = __res && __csr;
    
    }
    {
      double __nDiagValue;
      DiagGetParameterErrorHandled(__resp, "Thermistor_2_Data", __nDiagValue);
      __csr = CheckSignalMatch(__nDiagValue, 0, ">") == 1;
      snprintf(__cArray, 8192, "%s", "Diagnostic parameter \'Thermistor_2_Data\'");
      snprintf(__cArray2, 8192, "%s", __cArray);
      snprintf(__cArray3, 8192, "%s", "");
      ReportTableRow(__tableHandle, 0, __cArray2, ">", 0, __cArray3, __oneOfFlag, __bSetInCheckAlignment);
      ReportCell(__tableHandle, __nDiagValue);
      ReportCellResult(__tableHandle, __csr, __ePassFail);
    
      __res = __res && __csr;
    
    }
    ReportTableEndVerdict(__tableHandle, __cEvaluateResponse, __res);
	__bVerdict = __bVerdict && __res;
  }
  if (__bVerdict == __eVerdictFail)
    TestReportWriteDiagObjectList();
}
  
void __diagServicevccmce9_136(DiagRequest * __req, DiagResponse * __resp )
{
  stack long __tableHandle;
  long __res, __paramLen, __bytePos;

   __bVerdict = __eVerdictPass;

  do {
    TestReportResetDiagObjectList();
    DiagSetReportDetailLevel("CVADAS_0001_00000000_000", EnumServiceDetails_onfail);
    // Request aspect
    {
      {
        __res = DiagSetParameterErrorHandled(__req, "DiagSessionType", 03);
        if(__res < 0)
        {
          __bVerdict = __eVerdictFail;
          DiagErrCodeTestStep(__res, "Cannot set diagnostic parameter 'DiagSessionType'");
          break;
        }
      }

      if (0 >= DiagSendReqAndWaitForResp("CVADAS_0001_00000000_000", __req, __resp, __res, -1, -1, -1, -1, -1, EnumResult_pos, EnumServiceDetails_onfail, EnumSendingMode_physical, EnumSuppressPosResBit_asconfigured, EnumVerdictOnInvalidValues_fail))
        break;
    }

    __res = DiagErrCodeTestStep(__res, "Can't retrieve last response for request! No check possible.") < 0;
    if(__res)
    {
	  __bVerdict = __eVerdictFail;
      break;
    }
    {
      __res = DiagInterpretAs(__resp, "DSC_PR");
      if(__res != 0)
      {
        __bVerdict = __eVerdictFail;
        DiagErrCodeTestStep(__res, "Can't interpret response as diagnostic primitive 'DSC_PR'.");
        break;
      }
      else
      {
        TestStepPass( "Received primitive can be interpreted as diagnostic primitive 'DSC_PR'.");
      }
    }
  }
  while(0);


  // Response, check & read aspect
  {
    __res = 1;
    __tableHandle = ReportTableHead5Columns(__cCheckCaption, __cTSym, __cTOp, __cRefVal, __cActual, __cRes);
    {
      double __nDiagValue;
      DiagGetParameterErrorHandled(__resp, "DiagSessionType", __nDiagValue);
      __csr = CheckSignalMatch(__nDiagValue, 03, "==") == 1;
      snprintf(__cArray, 8192, "%s", "Diagnostic parameter \'DiagSessionType\'");
      snprintf(__cArray2, 8192, "%s", __cArray);
      snprintf(__cArray3, 8192, "%s", "");
      ReportTableRow(__tableHandle, 0, __cArray2, "==", 03, __cArray3, __oneOfFlag, __bSetInCheckAlignment);
      ReportCell(__tableHandle, __nDiagValue);
      ReportCellResult(__tableHandle, __csr, __ePassFail);
    
      __res = __res && __csr;
    
    }
    ReportTableEndVerdict(__tableHandle, __cEvaluateResponse, __res);
	__bVerdict = __bVerdict && __res;
  }
  if (__bVerdict == __eVerdictFail)
    TestReportWriteDiagObjectList();
}
  
void __diagServicevccmce9_137(DiagRequest * __req, DiagResponse * __resp )
{
  stack long __tableHandle;
  long __res, __paramLen, __bytePos;

   __bVerdict = __eVerdictPass;

  do {
    TestReportResetDiagObjectList();
    DiagSetReportDetailLevel("CVADAS_0001_00000000_000", EnumServiceDetails_onfail);
    // Request aspect
    {

      if (0 >= DiagSendReqAndWaitForResp("CVADAS_0001_00000000_000", __req, __resp, __res, -1, -1, -1, -1, -1, EnumResult_pos, EnumServiceDetails_onfail, EnumSendingMode_physical, EnumSuppressPosResBit_asconfigured, EnumVerdictOnInvalidValues_fail))
        break;
    }

    __res = DiagErrCodeTestStep(__res, "Can't retrieve last response for request! No check possible.") < 0;
    if(__res)
    {
	  __bVerdict = __eVerdictFail;
      break;
    }
    {
      __res = DiagInterpretAs(__resp, "RDBI_PR");
      if(__res != 0)
      {
        __bVerdict = __eVerdictFail;
        DiagErrCodeTestStep(__res, "Can't interpret response as diagnostic primitive 'RDBI_PR'.");
        break;
      }
      else
      {
        TestStepPass( "Received primitive can be interpreted as diagnostic primitive 'RDBI_PR'.");
      }
    }
  }
  while(0);


  // Response, check & read aspect
  {
    __res = 1;
    __tableHandle = ReportTableHead5Columns(__cCheckCaption, __cTSym, __cTOp, __cRefVal, __cActual, __cRes);
    {
      double __nDiagValue;
      DiagGetParameterErrorHandled(__resp, "Thermistor_1_Data", __nDiagValue);
      __csr = CheckSignalMatch(__nDiagValue, 0, ">") == 1;
      snprintf(__cArray, 8192, "%s", "Diagnostic parameter \'Thermistor_1_Data\'");
      snprintf(__cArray2, 8192, "%s", __cArray);
      snprintf(__cArray3, 8192, "%s", "");
      ReportTableRow(__tableHandle, 0, __cArray2, ">", 0, __cArray3, __oneOfFlag, __bSetInCheckAlignment);
      ReportCell(__tableHandle, __nDiagValue);
      ReportCellResult(__tableHandle, __csr, __ePassFail);
    
      __res = __res && __csr;
    
    }
    {
      double __nDiagValue;
      DiagGetParameterErrorHandled(__resp, "Thermistor_2_Data", __nDiagValue);
      __csr = CheckSignalMatch(__nDiagValue, 0, ">") == 1;
      snprintf(__cArray, 8192, "%s", "Diagnostic parameter \'Thermistor_2_Data\'");
      snprintf(__cArray2, 8192, "%s", __cArray);
      snprintf(__cArray3, 8192, "%s", "");
      ReportTableRow(__tableHandle, 0, __cArray2, ">", 0, __cArray3, __oneOfFlag, __bSetInCheckAlignment);
      ReportCell(__tableHandle, __nDiagValue);
      ReportCellResult(__tableHandle, __csr, __ePassFail);
    
      __res = __res && __csr;
    
    }
    ReportTableEndVerdict(__tableHandle, __cEvaluateResponse, __res);
	__bVerdict = __bVerdict && __res;
  }
  if (__bVerdict == __eVerdictFail)
    TestReportWriteDiagObjectList();
}

void Ttvccmce9_Tet_Tc28()
{
  CreateTTEIFFunction("Ttvccmce9_Tc28", __eTcDef, __eLocal);  
  AddIFParameterTestCaseAttribute("TC_ID", "");
  AddIFParameterTestCaseAttribute("Test Case ID", "");
  CallInterfaceFunction("2.5.8.1_FD4A", __cEmpty , __cEmpty );
}
testcase Ttvccmce9_Tc28()
{
  stack long __tableHandle;
  SetBreakOnFail(0);

  TestCommandBegin(__eDiagService, __cDiagService, "", "0");
  {
    if (DiagIsFunctionalGroup("CVADAS_0001_00000000_000"))
    {
      DiagResponse * __resp;
      DiagRequest CVADAS_0001_00000000_000.Default_Session_Start __req;
      __diagServicevccmce9_138(__req, __resp);
    }
    else
    {
      DiagResponse CVADAS_0001_00000000_000.* __resp;
      DiagRequest CVADAS_0001_00000000_000.Default_Session_Start __req;
      __diagServicevccmce9_138(__req, __resp);
    }
  }
  TestCommandEnd();


  TestCommandBegin(__eWait, __cWait, "", "1");
  {
    Wait("1", (syspar::`sleep * 1000000LL), 1000000, "sleep");
  }
  TestCommandEnd();

  TestCommandBegin(__eDiagService, __cDiagService, "", "2");
  {
    if (DiagIsFunctionalGroup("CVADAS_0001_00000000_000"))
    {
      DiagResponse * __resp;
      DiagRequest CVADAS_0001_00000000_000._22FD4A_Ultrasonic_Sensors_Power_supply_and_Current_Level_Read __req;
      __diagServicevccmce9_139(__req, __resp);
    }
    else
    {
      DiagResponse CVADAS_0001_00000000_000.* __resp;
      DiagRequest CVADAS_0001_00000000_000._22FD4A_Ultrasonic_Sensors_Power_supply_and_Current_Level_Read __req;
      __diagServicevccmce9_139(__req, __resp);
    }
  }
  TestCommandEnd();


  TestCommandBegin(__eDiagService, __cDiagService, "", "3");
  {
    if (DiagIsFunctionalGroup("CVADAS_0001_00000000_000"))
    {
      DiagResponse * __resp;
      DiagRequest CVADAS_0001_00000000_000.Extended_Diagnostic_Session_Start __req;
      __diagServicevccmce9_140(__req, __resp);
    }
    else
    {
      DiagResponse CVADAS_0001_00000000_000.* __resp;
      DiagRequest CVADAS_0001_00000000_000.Extended_Diagnostic_Session_Start __req;
      __diagServicevccmce9_140(__req, __resp);
    }
  }
  TestCommandEnd();


  TestCommandBegin(__eWait, __cWait, "", "4");
  {
    Wait("1", (syspar::`sleep * 1000000LL), 1000000, "sleep");
  }
  TestCommandEnd();

  TestCommandBegin(__eDiagService, __cDiagService, "", "5");
  {
    if (DiagIsFunctionalGroup("CVADAS_0001_00000000_000"))
    {
      DiagResponse * __resp;
      DiagRequest CVADAS_0001_00000000_000._22FD4A_Ultrasonic_Sensors_Power_supply_and_Current_Level_Read __req;
      __diagServicevccmce9_141(__req, __resp);
    }
    else
    {
      DiagResponse CVADAS_0001_00000000_000.* __resp;
      DiagRequest CVADAS_0001_00000000_000._22FD4A_Ultrasonic_Sensors_Power_supply_and_Current_Level_Read __req;
      __diagServicevccmce9_141(__req, __resp);
    }
  }
  TestCommandEnd();


}

  
void __diagServicevccmce9_138(DiagRequest * __req, DiagResponse * __resp )
{
  stack long __tableHandle;
  long __res, __paramLen, __bytePos;

   __bVerdict = __eVerdictPass;

  do {
    TestReportResetDiagObjectList();
    DiagSetReportDetailLevel("CVADAS_0001_00000000_000", EnumServiceDetails_onfail);
    // Request aspect
    {
      {
        __res = DiagSetParameterErrorHandled(__req, "DiagSessionType", 01);
        if(__res < 0)
        {
          __bVerdict = __eVerdictFail;
          DiagErrCodeTestStep(__res, "Cannot set diagnostic parameter 'DiagSessionType'");
          break;
        }
      }

      if (0 >= DiagSendReqAndWaitForResp("CVADAS_0001_00000000_000", __req, __resp, __res, -1, -1, -1, -1, -1, EnumResult_pos, EnumServiceDetails_onfail, EnumSendingMode_physical, EnumSuppressPosResBit_asconfigured, EnumVerdictOnInvalidValues_fail))
        break;
    }

    __res = DiagErrCodeTestStep(__res, "Can't retrieve last response for request! No check possible.") < 0;
    if(__res)
    {
	  __bVerdict = __eVerdictFail;
      break;
    }
    {
      __res = DiagInterpretAs(__resp, "DSC_PR");
      if(__res != 0)
      {
        __bVerdict = __eVerdictFail;
        DiagErrCodeTestStep(__res, "Can't interpret response as diagnostic primitive 'DSC_PR'.");
        break;
      }
      else
      {
        TestStepPass( "Received primitive can be interpreted as diagnostic primitive 'DSC_PR'.");
      }
    }
  }
  while(0);


  // Response, check & read aspect
  {
    __res = 1;
    __tableHandle = ReportTableHead5Columns(__cCheckCaption, __cTSym, __cTOp, __cRefVal, __cActual, __cRes);
    {
      double __nDiagValue;
      DiagGetParameterErrorHandled(__resp, "DiagSessionType", __nDiagValue);
      __csr = CheckSignalMatch(__nDiagValue, 01, "==") == 1;
      snprintf(__cArray, 8192, "%s", "Diagnostic parameter \'DiagSessionType\'");
      snprintf(__cArray2, 8192, "%s", __cArray);
      snprintf(__cArray3, 8192, "%s", "");
      ReportTableRow(__tableHandle, 0, __cArray2, "==", 01, __cArray3, __oneOfFlag, __bSetInCheckAlignment);
      ReportCell(__tableHandle, __nDiagValue);
      ReportCellResult(__tableHandle, __csr, __ePassFail);
    
      __res = __res && __csr;
    
    }
    ReportTableEndVerdict(__tableHandle, __cEvaluateResponse, __res);
	__bVerdict = __bVerdict && __res;
  }
  if (__bVerdict == __eVerdictFail)
    TestReportWriteDiagObjectList();
}
  
void __diagServicevccmce9_139(DiagRequest * __req, DiagResponse * __resp )
{
  stack long __tableHandle;
  long __res, __paramLen, __bytePos;

   __bVerdict = __eVerdictPass;

  do {
    TestReportResetDiagObjectList();
    DiagSetReportDetailLevel("CVADAS_0001_00000000_000", EnumServiceDetails_onfail);
    // Request aspect
    {

      if (0 >= DiagSendReqAndWaitForResp("CVADAS_0001_00000000_000", __req, __resp, __res, -1, -1, -1, -1, -1, EnumResult_pos, EnumServiceDetails_onfail, EnumSendingMode_physical, EnumSuppressPosResBit_asconfigured, EnumVerdictOnInvalidValues_fail))
        break;
    }

    __res = DiagErrCodeTestStep(__res, "Can't retrieve last response for request! No check possible.") < 0;
    if(__res)
    {
	  __bVerdict = __eVerdictFail;
      break;
    }
    {
      __res = DiagInterpretAs(__resp, "RDBI_PR");
      if(__res != 0)
      {
        __bVerdict = __eVerdictFail;
        DiagErrCodeTestStep(__res, "Can't interpret response as diagnostic primitive 'RDBI_PR'.");
        break;
      }
      else
      {
        TestStepPass( "Received primitive can be interpreted as diagnostic primitive 'RDBI_PR'.");
      }
    }
  }
  while(0);


  // Response, check & read aspect
  {
    __res = 1;
    __tableHandle = ReportTableHead5Columns(__cCheckCaption, __cTSym, __cTOp, __cRefVal, __cActual, __cRes);
    {
      double __nDiagValue;
      DiagGetParameterErrorHandled(__resp, "USS_Power_Supply_for_Stack_A", __nDiagValue);
      __csr = CheckSignalMatch(__nDiagValue, 0, ">") == 1;
      snprintf(__cArray, 8192, "%s", "Diagnostic parameter \'USS_Power_Supply_for_Stack_A\'");
      snprintf(__cArray2, 8192, "%s", __cArray);
      snprintf(__cArray3, 8192, "%s", "");
      ReportTableRow(__tableHandle, 0, __cArray2, ">", 0, __cArray3, __oneOfFlag, __bSetInCheckAlignment);
      ReportCell(__tableHandle, __nDiagValue);
      ReportCellResult(__tableHandle, __csr, __ePassFail);
    
      __res = __res && __csr;
    
    }
    {
      double __nDiagValue;
      DiagGetParameterErrorHandled(__resp, "USS_Power_Supply_for_Stack_B", __nDiagValue);
      __csr = CheckSignalMatch(__nDiagValue, 0, ">") == 1;
      snprintf(__cArray, 8192, "%s", "Diagnostic parameter \'USS_Power_Supply_for_Stack_B\'");
      snprintf(__cArray2, 8192, "%s", __cArray);
      snprintf(__cArray3, 8192, "%s", "");
      ReportTableRow(__tableHandle, 0, __cArray2, ">", 0, __cArray3, __oneOfFlag, __bSetInCheckAlignment);
      ReportCell(__tableHandle, __nDiagValue);
      ReportCellResult(__tableHandle, __csr, __ePassFail);
    
      __res = __res && __csr;
    
    }
    {
      double __nDiagValue;
      DiagGetParameterErrorHandled(__resp, "USS_current_Front", __nDiagValue);
      __csr = CheckSignalMatch(__nDiagValue, 0, ">") == 1;
      snprintf(__cArray, 8192, "%s", "Diagnostic parameter \'USS_current_Front\'");
      snprintf(__cArray2, 8192, "%s", __cArray);
      snprintf(__cArray3, 8192, "%s", "");
      ReportTableRow(__tableHandle, 0, __cArray2, ">", 0, __cArray3, __oneOfFlag, __bSetInCheckAlignment);
      ReportCell(__tableHandle, __nDiagValue);
      ReportCellResult(__tableHandle, __csr, __ePassFail);
    
      __res = __res && __csr;
    
    }
    {
      double __nDiagValue;
      DiagGetParameterErrorHandled(__resp, "USS_current_Rear", __nDiagValue);
      __csr = CheckSignalMatch(__nDiagValue, 0, ">") == 1;
      snprintf(__cArray, 8192, "%s", "Diagnostic parameter \'USS_current_Rear\'");
      snprintf(__cArray2, 8192, "%s", __cArray);
      snprintf(__cArray3, 8192, "%s", "");
      ReportTableRow(__tableHandle, 0, __cArray2, ">", 0, __cArray3, __oneOfFlag, __bSetInCheckAlignment);
      ReportCell(__tableHandle, __nDiagValue);
      ReportCellResult(__tableHandle, __csr, __ePassFail);
    
      __res = __res && __csr;
    
    }
    ReportTableEndVerdict(__tableHandle, __cEvaluateResponse, __res);
	__bVerdict = __bVerdict && __res;
  }
  if (__bVerdict == __eVerdictFail)
    TestReportWriteDiagObjectList();
}
  
void __diagServicevccmce9_140(DiagRequest * __req, DiagResponse * __resp )
{
  stack long __tableHandle;
  long __res, __paramLen, __bytePos;

   __bVerdict = __eVerdictPass;

  do {
    TestReportResetDiagObjectList();
    DiagSetReportDetailLevel("CVADAS_0001_00000000_000", EnumServiceDetails_onfail);
    // Request aspect
    {
      {
        __res = DiagSetParameterErrorHandled(__req, "DiagSessionType", 03);
        if(__res < 0)
        {
          __bVerdict = __eVerdictFail;
          DiagErrCodeTestStep(__res, "Cannot set diagnostic parameter 'DiagSessionType'");
          break;
        }
      }

      if (0 >= DiagSendReqAndWaitForResp("CVADAS_0001_00000000_000", __req, __resp, __res, -1, -1, -1, -1, -1, EnumResult_pos, EnumServiceDetails_onfail, EnumSendingMode_physical, EnumSuppressPosResBit_asconfigured, EnumVerdictOnInvalidValues_fail))
        break;
    }

    __res = DiagErrCodeTestStep(__res, "Can't retrieve last response for request! No check possible.") < 0;
    if(__res)
    {
	  __bVerdict = __eVerdictFail;
      break;
    }
    {
      __res = DiagInterpretAs(__resp, "DSC_PR");
      if(__res != 0)
      {
        __bVerdict = __eVerdictFail;
        DiagErrCodeTestStep(__res, "Can't interpret response as diagnostic primitive 'DSC_PR'.");
        break;
      }
      else
      {
        TestStepPass( "Received primitive can be interpreted as diagnostic primitive 'DSC_PR'.");
      }
    }
  }
  while(0);


  // Response, check & read aspect
  {
    __res = 1;
    __tableHandle = ReportTableHead5Columns(__cCheckCaption, __cTSym, __cTOp, __cRefVal, __cActual, __cRes);
    {
      double __nDiagValue;
      DiagGetParameterErrorHandled(__resp, "DiagSessionType", __nDiagValue);
      __csr = CheckSignalMatch(__nDiagValue, 03, "==") == 1;
      snprintf(__cArray, 8192, "%s", "Diagnostic parameter \'DiagSessionType\'");
      snprintf(__cArray2, 8192, "%s", __cArray);
      snprintf(__cArray3, 8192, "%s", "");
      ReportTableRow(__tableHandle, 0, __cArray2, "==", 03, __cArray3, __oneOfFlag, __bSetInCheckAlignment);
      ReportCell(__tableHandle, __nDiagValue);
      ReportCellResult(__tableHandle, __csr, __ePassFail);
    
      __res = __res && __csr;
    
    }
    ReportTableEndVerdict(__tableHandle, __cEvaluateResponse, __res);
	__bVerdict = __bVerdict && __res;
  }
  if (__bVerdict == __eVerdictFail)
    TestReportWriteDiagObjectList();
}
  
void __diagServicevccmce9_141(DiagRequest * __req, DiagResponse * __resp )
{
  stack long __tableHandle;
  long __res, __paramLen, __bytePos;

   __bVerdict = __eVerdictPass;

  do {
    TestReportResetDiagObjectList();
    DiagSetReportDetailLevel("CVADAS_0001_00000000_000", EnumServiceDetails_onfail);
    // Request aspect
    {

      if (0 >= DiagSendReqAndWaitForResp("CVADAS_0001_00000000_000", __req, __resp, __res, -1, -1, -1, -1, -1, EnumResult_pos, EnumServiceDetails_onfail, EnumSendingMode_physical, EnumSuppressPosResBit_asconfigured, EnumVerdictOnInvalidValues_no_impact))
        break;
    }

    __res = DiagErrCodeTestStep(__res, "Can't retrieve last response for request! No check possible.") < 0;
    if(__res)
    {
	  __bVerdict = __eVerdictFail;
      break;
    }
    {
      __res = DiagInterpretAs(__resp, "RDBI_PR");
      if(__res != 0)
      {
        __bVerdict = __eVerdictFail;
        DiagErrCodeTestStep(__res, "Can't interpret response as diagnostic primitive 'RDBI_PR'.");
        break;
      }
      else
      {
        TestStepPass( "Received primitive can be interpreted as diagnostic primitive 'RDBI_PR'.");
      }
    }
  }
  while(0);


  // Response, check & read aspect
  {
    __res = 1;
    __tableHandle = ReportTableHead5Columns(__cCheckCaption, __cTSym, __cTOp, __cRefVal, __cActual, __cRes);
    {
      double __nDiagValue;
      DiagGetParameterErrorHandled(__resp, "USS_Power_Supply_for_Stack_A", __nDiagValue);
      __csr = CheckSignalMatch(__nDiagValue, 0, ">") == 1;
      snprintf(__cArray, 8192, "%s", "Diagnostic parameter \'USS_Power_Supply_for_Stack_A\'");
      snprintf(__cArray2, 8192, "%s", __cArray);
      snprintf(__cArray3, 8192, "%s", "");
      ReportTableRow(__tableHandle, 0, __cArray2, ">", 0, __cArray3, __oneOfFlag, __bSetInCheckAlignment);
      ReportCell(__tableHandle, __nDiagValue);
      ReportCellResult(__tableHandle, __csr, __ePassFail);
    
      __res = __res && __csr;
    
    }
    {
      double __nDiagValue;
      DiagGetParameterErrorHandled(__resp, "USS_Power_Supply_for_Stack_B", __nDiagValue);
      __csr = CheckSignalMatch(__nDiagValue, 0, ">") == 1;
      snprintf(__cArray, 8192, "%s", "Diagnostic parameter \'USS_Power_Supply_for_Stack_B\'");
      snprintf(__cArray2, 8192, "%s", __cArray);
      snprintf(__cArray3, 8192, "%s", "");
      ReportTableRow(__tableHandle, 0, __cArray2, ">", 0, __cArray3, __oneOfFlag, __bSetInCheckAlignment);
      ReportCell(__tableHandle, __nDiagValue);
      ReportCellResult(__tableHandle, __csr, __ePassFail);
    
      __res = __res && __csr;
    
    }
    {
      double __nDiagValue;
      DiagGetParameterErrorHandled(__resp, "USS_current_Front", __nDiagValue);
      __csr = CheckSignalMatch(__nDiagValue, 0, ">") == 1;
      snprintf(__cArray, 8192, "%s", "Diagnostic parameter \'USS_current_Front\'");
      snprintf(__cArray2, 8192, "%s", __cArray);
      snprintf(__cArray3, 8192, "%s", "");
      ReportTableRow(__tableHandle, 0, __cArray2, ">", 0, __cArray3, __oneOfFlag, __bSetInCheckAlignment);
      ReportCell(__tableHandle, __nDiagValue);
      ReportCellResult(__tableHandle, __csr, __ePassFail);
    
      __res = __res && __csr;
    
    }
    {
      double __nDiagValue;
      DiagGetParameterErrorHandled(__resp, "USS_current_Rear", __nDiagValue);
      __csr = CheckSignalMatch(__nDiagValue, 0, ">") == 1;
      snprintf(__cArray, 8192, "%s", "Diagnostic parameter \'USS_current_Rear\'");
      snprintf(__cArray2, 8192, "%s", __cArray);
      snprintf(__cArray3, 8192, "%s", "");
      ReportTableRow(__tableHandle, 0, __cArray2, ">", 0, __cArray3, __oneOfFlag, __bSetInCheckAlignment);
      ReportCell(__tableHandle, __nDiagValue);
      ReportCellResult(__tableHandle, __csr, __ePassFail);
    
      __res = __res && __csr;
    
    }
    ReportTableEndVerdict(__tableHandle, __cEvaluateResponse, __res);
	__bVerdict = __bVerdict && __res;
  }
  if (__bVerdict == __eVerdictFail)
    TestReportWriteDiagObjectList();
}

void Ttvccmce9_Tet_Tc29()
{
  CreateTTEIFFunction("Ttvccmce9_Tc29", __eTcDef, __eLocal);  
  AddIFParameterTestCaseAttribute("TC_ID", "");
  AddIFParameterTestCaseAttribute("Test Case ID", "");
  CallInterfaceFunction("2.5.8.3_FD46", __cEmpty , __cEmpty );
}
testcase Ttvccmce9_Tc29()
{
  stack long __tableHandle;
  SetBreakOnFail(0);

  TestCommandBegin(__eWait, __cWait, "", "0");
  {
    Wait("1", (syspar::`sleep * 1000000LL), 1000000, "sleep");
  }
  TestCommandEnd();

  TestCommandBegin(__eDiagService, __cDiagService, "", "1");
  {
    if (DiagIsFunctionalGroup("CVADAS_0001_00000000_000"))
    {
      DiagResponse * __resp;
      DiagRequest CVADAS_0001_00000000_000.Extended_Diagnostic_Session_Start __req;
      __diagServicevccmce9_142(__req, __resp);
    }
    else
    {
      DiagResponse CVADAS_0001_00000000_000.* __resp;
      DiagRequest CVADAS_0001_00000000_000.Extended_Diagnostic_Session_Start __req;
      __diagServicevccmce9_142(__req, __resp);
    }
  }
  TestCommandEnd();


  TestCommandBegin(__eWait, __cWait, "", "2");
  {
    Wait("1", (syspar::`sleep * 1000000LL), 1000000, "sleep");
  }
  TestCommandEnd();

  TestCommandBegin(__eDiagService, __cDiagService, "", "3");
  {
    if (DiagIsFunctionalGroup("CVADAS_0001_00000000_000"))
    {
      DiagResponse * __resp;
      DiagRequest CVADAS_0001_00000000_000._22FD46_Camera_Power_Supply_Read __req;
      __diagServicevccmce9_143(__req, __resp);
    }
    else
    {
      DiagResponse CVADAS_0001_00000000_000.* __resp;
      DiagRequest CVADAS_0001_00000000_000._22FD46_Camera_Power_Supply_Read __req;
      __diagServicevccmce9_143(__req, __resp);
    }
  }
  TestCommandEnd();


}

  
void __diagServicevccmce9_142(DiagRequest * __req, DiagResponse * __resp )
{
  stack long __tableHandle;
  long __res, __paramLen, __bytePos;

   __bVerdict = __eVerdictPass;

  do {
    TestReportResetDiagObjectList();
    DiagSetReportDetailLevel("CVADAS_0001_00000000_000", EnumServiceDetails_onfail);
    // Request aspect
    {
      {
        __res = DiagSetParameterErrorHandled(__req, "DiagSessionType", 03);
        if(__res < 0)
        {
          __bVerdict = __eVerdictFail;
          DiagErrCodeTestStep(__res, "Cannot set diagnostic parameter 'DiagSessionType'");
          break;
        }
      }

      if (0 >= DiagSendReqAndWaitForResp("CVADAS_0001_00000000_000", __req, __resp, __res, -1, -1, -1, -1, -1, EnumResult_pos, EnumServiceDetails_onfail, EnumSendingMode_physical, EnumSuppressPosResBit_asconfigured, EnumVerdictOnInvalidValues_fail))
        break;
    }

    __res = DiagErrCodeTestStep(__res, "Can't retrieve last response for request! No check possible.") < 0;
    if(__res)
    {
	  __bVerdict = __eVerdictFail;
      break;
    }
    {
      __res = DiagInterpretAs(__resp, "DSC_PR");
      if(__res != 0)
      {
        __bVerdict = __eVerdictFail;
        DiagErrCodeTestStep(__res, "Can't interpret response as diagnostic primitive 'DSC_PR'.");
        break;
      }
      else
      {
        TestStepPass( "Received primitive can be interpreted as diagnostic primitive 'DSC_PR'.");
      }
    }
  }
  while(0);


  // Response, check & read aspect
  {
    __res = 1;
    __tableHandle = ReportTableHead5Columns(__cCheckCaption, __cTSym, __cTOp, __cRefVal, __cActual, __cRes);
    {
      double __nDiagValue;
      DiagGetParameterErrorHandled(__resp, "DiagSessionType", __nDiagValue);
      __csr = CheckSignalMatch(__nDiagValue, 03, "==") == 1;
      snprintf(__cArray, 8192, "%s", "Diagnostic parameter \'DiagSessionType\'");
      snprintf(__cArray2, 8192, "%s", __cArray);
      snprintf(__cArray3, 8192, "%s", "");
      ReportTableRow(__tableHandle, 0, __cArray2, "==", 03, __cArray3, __oneOfFlag, __bSetInCheckAlignment);
      ReportCell(__tableHandle, __nDiagValue);
      ReportCellResult(__tableHandle, __csr, __ePassFail);
    
      __res = __res && __csr;
    
    }
    ReportTableEndVerdict(__tableHandle, __cEvaluateResponse, __res);
	__bVerdict = __bVerdict && __res;
  }
  if (__bVerdict == __eVerdictFail)
    TestReportWriteDiagObjectList();
}
  
void __diagServicevccmce9_143(DiagRequest * __req, DiagResponse * __resp )
{
  stack long __tableHandle;
  long __res, __paramLen, __bytePos;

   __bVerdict = __eVerdictPass;

  do {
    TestReportResetDiagObjectList();
    DiagSetReportDetailLevel("CVADAS_0001_00000000_000", EnumServiceDetails_onfail);
    // Request aspect
    {

      if (0 >= DiagSendReqAndWaitForResp("CVADAS_0001_00000000_000", __req, __resp, __res, -1, -1, -1, -1, -1, EnumResult_pos, EnumServiceDetails_onfail, EnumSendingMode_physical, EnumSuppressPosResBit_asconfigured, EnumVerdictOnInvalidValues_no_impact))
        break;
    }

    __res = DiagErrCodeTestStep(__res, "Can't retrieve last response for request! No check possible.") < 0;
    if(__res)
    {
	  __bVerdict = __eVerdictFail;
      break;
    }
    {
      __res = DiagInterpretAs(__resp, "RDBI_PR");
      if(__res != 0)
      {
        __bVerdict = __eVerdictFail;
        DiagErrCodeTestStep(__res, "Can't interpret response as diagnostic primitive 'RDBI_PR'.");
        break;
      }
      else
      {
        TestStepPass( "Received primitive can be interpreted as diagnostic primitive 'RDBI_PR'.");
      }
    }
  }
  while(0);


  // Response, check & read aspect
  {
    __res = 1;
    __tableHandle = ReportTableHead5Columns(__cCheckCaption, __cTSym, __cTOp, __cRefVal, __cActual, __cRes);
    {
      double __nDiagValue;
      DiagGetParameterErrorHandled(__resp, "s_Right_CAM_CS_A", __nDiagValue);
      __csr = CheckSignalMatch(__nDiagValue, 10, ">") == 1;
      snprintf(__cArray, 8192, "%s", "Diagnostic parameter \'s_Right_CAM_CS_A\'");
      snprintf(__cArray2, 8192, "%s", __cArray);
      snprintf(__cArray3, 8192, "%s", "");
      ReportTableRow(__tableHandle, 0, __cArray2, ">", 10, __cArray3, __oneOfFlag, __bSetInCheckAlignment);
      ReportCell(__tableHandle, __nDiagValue);
      ReportCellResult(__tableHandle, __csr, __ePassFail);
    
      __res = __res && __csr;
    
    }
    {
      double __nDiagValue;
      DiagGetParameterErrorHandled(__resp, "s_Left_CAM_CS_A", __nDiagValue);
      __csr = CheckSignalMatch(__nDiagValue, 10, ">") == 1;
      snprintf(__cArray, 8192, "%s", "Diagnostic parameter \'s_Left_CAM_CS_A\'");
      snprintf(__cArray2, 8192, "%s", __cArray);
      snprintf(__cArray3, 8192, "%s", "");
      ReportTableRow(__tableHandle, 0, __cArray2, ">", 10, __cArray3, __oneOfFlag, __bSetInCheckAlignment);
      ReportCell(__tableHandle, __nDiagValue);
      ReportCellResult(__tableHandle, __csr, __ePassFail);
    
      __res = __res && __csr;
    
    }
    {
      double __nDiagValue;
      DiagGetParameterErrorHandled(__resp, "s_Rear_CAM_CS_A", __nDiagValue);
      __csr = CheckSignalMatch(__nDiagValue, 10, ">") == 1;
      snprintf(__cArray, 8192, "%s", "Diagnostic parameter \'s_Rear_CAM_CS_A\'");
      snprintf(__cArray2, 8192, "%s", __cArray);
      snprintf(__cArray3, 8192, "%s", "");
      ReportTableRow(__tableHandle, 0, __cArray2, ">", 10, __cArray3, __oneOfFlag, __bSetInCheckAlignment);
      ReportCell(__tableHandle, __nDiagValue);
      ReportCellResult(__tableHandle, __csr, __ePassFail);
    
      __res = __res && __csr;
    
    }
    {
      double __nDiagValue;
      DiagGetParameterErrorHandled(__resp, "_Camera_Quad_Stack_A_Switch_Current", __nDiagValue);
      __csr = CheckSignalMatch(__nDiagValue, 10, ">") == 1;
      snprintf(__cArray, 8192, "%s", "Diagnostic parameter \'_Camera_Quad_Stack_A_Switch_Current\'");
      snprintf(__cArray2, 8192, "%s", __cArray);
      snprintf(__cArray3, 8192, "%s", "");
      ReportTableRow(__tableHandle, 0, __cArray2, ">", 10, __cArray3, __oneOfFlag, __bSetInCheckAlignment);
      ReportCell(__tableHandle, __nDiagValue);
      ReportCellResult(__tableHandle, __csr, __ePassFail);
    
      __res = __res && __csr;
    
    }
    ReportTableEndVerdict(__tableHandle, __cEvaluateResponse, __res);
	__bVerdict = __bVerdict && __res;
  }
  if (__bVerdict == __eVerdictFail)
    TestReportWriteDiagObjectList();
}

void Ttvccmce9_Tet_Tc30()
{
  CreateTTEIFFunction("Ttvccmce9_Tc30", __eTcDef, __eLocal);  
  AddIFParameterTestCaseAttribute("TC_ID", "");
  AddIFParameterTestCaseAttribute("Test Case ID", "");
  CallInterfaceFunction("2.5.11_DTCs", __cEmpty , __cEmpty );
}
testcase Ttvccmce9_Tc30()
{
  stack long __tableHandle;
  SetBreakOnFail(0);

  TestCommandBegin(__eWait, __cWait, "", "0");
  {
    Wait("1", (500 * 1000000LL), 1000000, "");
  }
  TestCommandEnd();

  TestCommandBegin(__eDiagService, __cDiagService, "", "1");
  {
    if (DiagIsFunctionalGroup("CVADAS_0001_00000000_000"))
    {
      DiagResponse * __resp;
      DiagRequest CVADAS_0001_00000000_000.Extended_Diagnostic_Session_Start __req;
      __diagServicevccmce9_144(__req, __resp);
    }
    else
    {
      DiagResponse CVADAS_0001_00000000_000.* __resp;
      DiagRequest CVADAS_0001_00000000_000.Extended_Diagnostic_Session_Start __req;
      __diagServicevccmce9_144(__req, __resp);
    }
  }
  TestCommandEnd();


  TestCommandBegin(__eWait, __cWait, "", "2");
  {
    Wait("1", (500 * 1000000LL), 1000000, "");
  }
  TestCommandEnd();

  TestCommandBegin(__eDiagService, __cDiagService, "", "3");
  {
    if (DiagIsFunctionalGroup("CVADAS_0001_00000000_000"))
    {
      DiagResponse * __resp;
      DiagRequest CVADAS_0001_00000000_000.DtcSettingOn_Ctrl __req;
      __diagServicevccmce9_145(__req, __resp);
    }
    else
    {
      DiagResponse CVADAS_0001_00000000_000.* __resp;
      DiagRequest CVADAS_0001_00000000_000.DtcSettingOn_Ctrl __req;
      __diagServicevccmce9_145(__req, __resp);
    }
  }
  TestCommandEnd();


  TestCommandBegin(__eWait, __cWait, "", "4");
  {
    Wait("1", (500 * 1000000LL), 1000000, "");
  }
  TestCommandEnd();

  TestCommandBegin(__eDiagService, __cDiagService, "", "5");
  {
    if (DiagIsFunctionalGroup("CVADAS_0001_00000000_000"))
    {
      DiagResponse * __resp;
      DiagRequest CVADAS_0001_00000000_000.FaultMemory_Clear __req;
      __diagServicevccmce9_146(__req, __resp);
    }
    else
    {
      DiagResponse CVADAS_0001_00000000_000.* __resp;
      DiagRequest CVADAS_0001_00000000_000.FaultMemory_Clear __req;
      __diagServicevccmce9_146(__req, __resp);
    }
  }
  TestCommandEnd();


  TestCommandBegin(__eWait, __cWait, "", "6");
  {
    Wait("1", (5000 * 1000000LL), 1000000, "");
  }
  TestCommandEnd();

  TestCommandBegin(__eDiagService, __cDiagService, "", "7");
  {
    if (DiagIsFunctionalGroup("CVADAS_0001_00000000_000"))
    {
      DiagResponse * __resp;
      DiagRequest CVADAS_0001_00000000_000.FaultMemory_Report_DTC_Extended_Data_Record_By_DTC_Number __req;
      __diagServicevccmce9_147(__req, __resp);
    }
    else
    {
      DiagResponse CVADAS_0001_00000000_000.* __resp;
      DiagRequest CVADAS_0001_00000000_000.FaultMemory_Report_DTC_Extended_Data_Record_By_DTC_Number __req;
      __diagServicevccmce9_147(__req, __resp);
    }
  }
  TestCommandEnd();


}

  
void __diagServicevccmce9_144(DiagRequest * __req, DiagResponse * __resp )
{
  stack long __tableHandle;
  long __res, __paramLen, __bytePos;

   __bVerdict = __eVerdictPass;

  do {
    TestReportResetDiagObjectList();
    DiagSetReportDetailLevel("CVADAS_0001_00000000_000", EnumServiceDetails_onfail);
    // Request aspect
    {
      {
        __res = DiagSetParameterErrorHandled(__req, "DiagSessionType", 03);
        if(__res < 0)
        {
          __bVerdict = __eVerdictFail;
          DiagErrCodeTestStep(__res, "Cannot set diagnostic parameter 'DiagSessionType'");
          break;
        }
      }

      if (0 >= DiagSendReqAndWaitForResp("CVADAS_0001_00000000_000", __req, __resp, __res, -1, -1, -1, -1, -1, EnumResult_pos, EnumServiceDetails_onfail, EnumSendingMode_physical, EnumSuppressPosResBit_asconfigured, EnumVerdictOnInvalidValues_fail))
        break;
    }

    __res = DiagErrCodeTestStep(__res, "Can't retrieve last response for request! No check possible.") < 0;
    if(__res)
    {
	  __bVerdict = __eVerdictFail;
      break;
    }
    {
      __res = DiagInterpretAs(__resp, "DSC_PR");
      if(__res != 0)
      {
        __bVerdict = __eVerdictFail;
        DiagErrCodeTestStep(__res, "Can't interpret response as diagnostic primitive 'DSC_PR'.");
        break;
      }
      else
      {
        TestStepPass( "Received primitive can be interpreted as diagnostic primitive 'DSC_PR'.");
      }
    }
  }
  while(0);


  // Response, check & read aspect
  {
    __res = 1;
    __tableHandle = ReportTableHead5Columns(__cCheckCaption, __cTSym, __cTOp, __cRefVal, __cActual, __cRes);
    {
      double __nDiagValue;
      DiagGetParameterErrorHandled(__resp, "DiagSessionType", __nDiagValue);
      __csr = CheckSignalMatch(__nDiagValue, 03, "==") == 1;
      snprintf(__cArray, 8192, "%s", "Diagnostic parameter \'DiagSessionType\'");
      snprintf(__cArray2, 8192, "%s", __cArray);
      snprintf(__cArray3, 8192, "%s", "");
      ReportTableRow(__tableHandle, 0, __cArray2, "==", 03, __cArray3, __oneOfFlag, __bSetInCheckAlignment);
      ReportCell(__tableHandle, __nDiagValue);
      ReportCellResult(__tableHandle, __csr, __ePassFail);
    
      __res = __res && __csr;
    
    }
    ReportTableEndVerdict(__tableHandle, __cEvaluateResponse, __res);
	__bVerdict = __bVerdict && __res;
  }
  if (__bVerdict == __eVerdictFail)
    TestReportWriteDiagObjectList();
}
  
void __diagServicevccmce9_145(DiagRequest * __req, DiagResponse * __resp )
{
  stack long __tableHandle;
  long __res, __paramLen, __bytePos;

   __bVerdict = __eVerdictPass;

  do {
    TestReportResetDiagObjectList();
    DiagSetReportDetailLevel("CVADAS_0001_00000000_000", EnumServiceDetails_onfail);
    // Request aspect
    {

      if (0 >= DiagSendReqAndWaitForResp("CVADAS_0001_00000000_000", __req, __resp, __res, -1, -1, -1, -1, -1, EnumResult_pos, EnumServiceDetails_onfail, EnumSendingMode_physical, EnumSuppressPosResBit_asconfigured, EnumVerdictOnInvalidValues_fail))
        break;
    }

    __res = DiagErrCodeTestStep(__res, "Can't retrieve last response for request! No check possible.") < 0;
    if(__res)
    {
	  __bVerdict = __eVerdictFail;
      break;
    }
    {
      __res = DiagInterpretAs(__resp, "CDTCS_PR");
      if(__res != 0)
      {
        __bVerdict = __eVerdictFail;
        DiagErrCodeTestStep(__res, "Can't interpret response as diagnostic primitive 'CDTCS_PR'.");
        break;
      }
      else
      {
        TestStepPass( "Received primitive can be interpreted as diagnostic primitive 'CDTCS_PR'.");
      }
    }
  }
  while(0);


  if (__bVerdict == __eVerdictFail)
    TestReportWriteDiagObjectList();
}
  
void __diagServicevccmce9_146(DiagRequest * __req, DiagResponse * __resp )
{
  stack long __tableHandle;
  long __res, __paramLen, __bytePos;

   __bVerdict = __eVerdictPass;

  do {
    TestReportResetDiagObjectList();
    DiagSetReportDetailLevel("CVADAS_0001_00000000_000", EnumServiceDetails_onfail);
    // Request aspect
    {

      if (0 >= DiagSendReqAndWaitForResp("CVADAS_0001_00000000_000", __req, __resp, __res, -1, -1, -1, -1, -1, EnumResult_pos, EnumServiceDetails_onfail, EnumSendingMode_physical, EnumSuppressPosResBit_asconfigured, EnumVerdictOnInvalidValues_fail))
        break;
    }

    __res = DiagErrCodeTestStep(__res, "Can't retrieve last response for request! No check possible.") < 0;
    if(__res)
    {
	  __bVerdict = __eVerdictFail;
      break;
    }
    {
      __res = DiagInterpretAs(__resp, "CDI_PR");
      if(__res != 0)
      {
        __bVerdict = __eVerdictFail;
        DiagErrCodeTestStep(__res, "Can't interpret response as diagnostic primitive 'CDI_PR'.");
        break;
      }
      else
      {
        TestStepPass( "Received primitive can be interpreted as diagnostic primitive 'CDI_PR'.");
      }
    }
  }
  while(0);


  if (__bVerdict == __eVerdictFail)
    TestReportWriteDiagObjectList();
}
  
void __diagServicevccmce9_147(DiagRequest * __req, DiagResponse * __resp )
{
  stack long __tableHandle;
  long __res, __paramLen, __bytePos;

   __bVerdict = __eVerdictPass;

  do {
    TestReportResetDiagObjectList();
    DiagSetReportDetailLevel("CVADAS_0001_00000000_000", EnumServiceDetails_onfail);
    // Request aspect
    {

      if (0 >= DiagSendReqAndWaitForResp("CVADAS_0001_00000000_000", __req, __resp, __res, -1, -1, -1, -1, -1, EnumResult_pos, EnumServiceDetails_onfail, EnumSendingMode_physical, EnumSuppressPosResBit_asconfigured, EnumVerdictOnInvalidValues_fail))
        break;
    }

    __res = DiagErrCodeTestStep(__res, "Can't retrieve last response for request! No check possible.") < 0;
    if(__res)
    {
	  __bVerdict = __eVerdictFail;
      break;
    }
    {
      __res = DiagInterpretAs(__resp, "Pos");
      if(__res != 0)
      {
        __bVerdict = __eVerdictFail;
        DiagErrCodeTestStep(__res, "Can't interpret response as diagnostic primitive 'Pos'.");
        break;
      }
      else
      {
        TestStepPass( "Received primitive can be interpreted as diagnostic primitive 'Pos'.");
      }
    }
  }
  while(0);


  if (__bVerdict == __eVerdictFail)
    TestReportWriteDiagObjectList();
}

void Ttvccmce9_Tet_Tc31()
{
  CreateTTEIFFunction("Ttvccmce9_Tc31", __eTcDef, __eLocal);  
  AddIFParameterTestCaseAttribute("TC_ID", "");
  AddIFParameterTestCaseAttribute("Test Case ID", "");
  CallInterfaceFunction("2.5.12-Enter_Plant_Mode", __cEmpty , __cEmpty );
}
testcase Ttvccmce9_Tc31()
{
  stack long __tableHandle;
  SetBreakOnFail(0);

  TestCommandBegin(__eDiagService, __cDiagService, "", "0");
  {
    if (DiagIsFunctionalGroup("CVADAS_0001_00000000_000"))
    {
      DiagResponse * __resp;
      DiagRequest CVADAS_0001_00000000_000.Extended_Diagnostic_Session_Start __req;
      __diagServicevccmce9_148(__req, __resp);
    }
    else
    {
      DiagResponse CVADAS_0001_00000000_000.* __resp;
      DiagRequest CVADAS_0001_00000000_000.Extended_Diagnostic_Session_Start __req;
      __diagServicevccmce9_148(__req, __resp);
    }
  }
  TestCommandEnd();


  TestCommandBegin(__eWait, __cWait, "", "1");
  {
    Wait("1", (500 * 1000000LL), 1000000, "");
  }
  TestCommandEnd();

  TestCommandBegin(__eDiagService, __cDiagService, "", "2");
  {
    if (DiagIsFunctionalGroup("CVADAS_0001_00000000_000"))
    {
      DiagResponse * __resp;
      DiagRequest CVADAS_0001_00000000_000._31015200_Plant_Mode_Routine_Start __req;
      __diagServicevccmce9_149(__req, __resp);
    }
    else
    {
      DiagResponse CVADAS_0001_00000000_000.* __resp;
      DiagRequest CVADAS_0001_00000000_000._31015200_Plant_Mode_Routine_Start __req;
      __diagServicevccmce9_149(__req, __resp);
    }
  }
  TestCommandEnd();


  TestCommandBegin(__eWait, __cWait, "", "3");
  {
    Wait("1", (500 * 1000000LL), 1000000, "");
  }
  TestCommandEnd();

  TestCommandBegin(__eFaultMemoryClear, __cFaultMemoryClear, "", "4");
  {
    long __res;
    long __dtc;
    
    DiagSetReportDetailLevel("CVADAS_0001_00000000_000", EnumServiceDetails_onfail);
    TestStep("Query fault memory", "Clearing fault memory of target Diagnostic ECU 'CVADAS_0001_00000000_000'");
  
    __bVerdict = __eVerdictPass;
    __dtc = 0x621200;
    snprintf(__cArray, 8192, "Diagnostic trouble code \'C221200\'");
    snprintf(__cArray2, 8192, "(%s)", __cArray);
  #if LINUX
    TestStep("", "Clearing DTC 0x%X%s", __dtc, __cArray2);
  #else 
    TestStep("", "Clearing DTC 0x%lX%s", __dtc, __cArray2);
  #endif
    __res = TestWaitForDiagTroubleCodesCleared("CVADAS_0001_00000000_000", __dtc, cDiagAppTimeoutDefault);
    if (__EvaluateWaitResWithVerdict("CVADAS_0001_00000000_000", __res, 1, "DTC cleared successfully"))
      TestReportWriteFaultMemoryDetails("CVADAS_0001_00000000_000", __bVerdict);  
  }
  TestCommandEnd();


}

  
void __diagServicevccmce9_148(DiagRequest * __req, DiagResponse * __resp )
{
  stack long __tableHandle;
  long __res, __paramLen, __bytePos;

   __bVerdict = __eVerdictPass;

  do {
    TestReportResetDiagObjectList();
    DiagSetReportDetailLevel("CVADAS_0001_00000000_000", EnumServiceDetails_onfail);
    // Request aspect
    {
      {
        __res = DiagSetParameterErrorHandled(__req, "DiagSessionType", 03);
        if(__res < 0)
        {
          __bVerdict = __eVerdictFail;
          DiagErrCodeTestStep(__res, "Cannot set diagnostic parameter 'DiagSessionType'");
          break;
        }
      }

      if (0 >= DiagSendReqAndWaitForResp("CVADAS_0001_00000000_000", __req, __resp, __res, -1, -1, -1, -1, -1, EnumResult_pos, EnumServiceDetails_onfail, EnumSendingMode_physical, EnumSuppressPosResBit_asconfigured, EnumVerdictOnInvalidValues_fail))
        break;
    }

    __res = DiagErrCodeTestStep(__res, "Can't retrieve last response for request! No check possible.") < 0;
    if(__res)
    {
	  __bVerdict = __eVerdictFail;
      break;
    }
    {
      __res = DiagInterpretAs(__resp, "DSC_PR");
      if(__res != 0)
      {
        __bVerdict = __eVerdictFail;
        DiagErrCodeTestStep(__res, "Can't interpret response as diagnostic primitive 'DSC_PR'.");
        break;
      }
      else
      {
        TestStepPass( "Received primitive can be interpreted as diagnostic primitive 'DSC_PR'.");
      }
    }
  }
  while(0);


  // Response, check & read aspect
  {
    __res = 1;
    __tableHandle = ReportTableHead5Columns(__cCheckCaption, __cTSym, __cTOp, __cRefVal, __cActual, __cRes);
    {
      double __nDiagValue;
      DiagGetParameterErrorHandled(__resp, "DiagSessionType", __nDiagValue);
      __csr = CheckSignalMatch(__nDiagValue, 03, "==") == 1;
      snprintf(__cArray, 8192, "%s", "Diagnostic parameter \'DiagSessionType\'");
      snprintf(__cArray2, 8192, "%s", __cArray);
      snprintf(__cArray3, 8192, "%s", "");
      ReportTableRow(__tableHandle, 0, __cArray2, "==", 03, __cArray3, __oneOfFlag, __bSetInCheckAlignment);
      ReportCell(__tableHandle, __nDiagValue);
      ReportCellResult(__tableHandle, __csr, __ePassFail);
    
      __res = __res && __csr;
    
    }
    ReportTableEndVerdict(__tableHandle, __cEvaluateResponse, __res);
	__bVerdict = __bVerdict && __res;
  }
  if (__bVerdict == __eVerdictFail)
    TestReportWriteDiagObjectList();
}
  
void __diagServicevccmce9_149(DiagRequest * __req, DiagResponse * __resp )
{
  stack long __tableHandle;
  long __res, __paramLen, __bytePos;

   __bVerdict = __eVerdictPass;

  do {
    TestReportResetDiagObjectList();
    DiagSetReportDetailLevel("CVADAS_0001_00000000_000", EnumServiceDetails_onfail);
    // Request aspect
    {
      {
        __res = DiagSetParameterErrorHandled(__req, "PlantModeState", "EnterInPlantMode");
        if(__res < 0)
        {
          __bVerdict = __eVerdictFail;
          DiagErrCodeTestStep(__res, "Cannot set diagnostic parameter 'PlantModeState'");
          break;
        }
      }

      if (0 >= DiagSendReqAndWaitForResp("CVADAS_0001_00000000_000", __req, __resp, __res, -1, -1, -1, -1, -1, EnumResult_pos, EnumServiceDetails_onfail, EnumSendingMode_physical, EnumSuppressPosResBit_asconfigured, EnumVerdictOnInvalidValues_fail))
        break;
    }

    __res = DiagErrCodeTestStep(__res, "Can't retrieve last response for request! No check possible.") < 0;
    if(__res)
    {
	  __bVerdict = __eVerdictFail;
      break;
    }
    {
      __res = DiagInterpretAs(__resp, "RC_STR_PR");
      if(__res != 0)
      {
        __bVerdict = __eVerdictFail;
        DiagErrCodeTestStep(__res, "Can't interpret response as diagnostic primitive 'RC_STR_PR'.");
        break;
      }
      else
      {
        TestStepPass( "Received primitive can be interpreted as diagnostic primitive 'RC_STR_PR'.");
      }
    }
  }
  while(0);


  // Response, check & read aspect
  {
    __res = 1;
    __tableHandle = ReportTableHead5Columns(__cCheckCaption, __cTSym, __cTOp, __cRefVal, __cActual, __cRes);
    {
      double __nDiagValue;
      DiagGetParameterErrorHandled(__resp, "RoutineControlType", __nDiagValue);
      __csr = CheckSignalMatch(__nDiagValue, 1, "==") == 1;
      snprintf(__cArray, 8192, "%s", "Diagnostic parameter \'RoutineControlType\'");
      snprintf(__cArray2, 8192, "%s", __cArray);
      snprintf(__cArray3, 8192, "%s", "");
      ReportTableRow(__tableHandle, 0, __cArray2, "==", 1, __cArray3, __oneOfFlag, __bSetInCheckAlignment);
      ReportCell(__tableHandle, __nDiagValue);
      ReportCellResult(__tableHandle, __csr, __ePassFail);
    
      __res = __res && __csr;
    
    }
    ReportTableEndVerdict(__tableHandle, __cEvaluateResponse, __res);
	__bVerdict = __bVerdict && __res;
  }
  if (__bVerdict == __eVerdictFail)
    TestReportWriteDiagObjectList();
}

void Ttvccmce9_Tet_Tc32()
{
  CreateTTEIFFunction("Ttvccmce9_Tc32", __eTcDef, __eLocal);  
  AddIFParameterTestCaseAttribute("TC_ID", "");
  AddIFParameterTestCaseAttribute("Test Case ID", "");
  CallInterfaceFunction("2.5.13-Exit_Plant_Mode", __cEmpty , __cEmpty );
}
testcase Ttvccmce9_Tc32()
{
  stack long __tableHandle;
  SetBreakOnFail(0);

  TestCommandBegin(__eWait, __cWait, "", "0");
  {
    Wait("1", (500 * 1000000LL), 1000000, "");
  }
  TestCommandEnd();

  TestCommandBegin(__eDiagService, __cDiagService, "", "1");
  {
    if (DiagIsFunctionalGroup("CVADAS_0001_00000000_000"))
    {
      DiagResponse * __resp;
      DiagRequest CVADAS_0001_00000000_000.Extended_Diagnostic_Session_Start __req;
      __diagServicevccmce9_150(__req, __resp);
    }
    else
    {
      DiagResponse CVADAS_0001_00000000_000.* __resp;
      DiagRequest CVADAS_0001_00000000_000.Extended_Diagnostic_Session_Start __req;
      __diagServicevccmce9_150(__req, __resp);
    }
  }
  TestCommandEnd();


  TestCommandBegin(__eWait, __cWait, "", "2");
  {
    Wait("1", (500 * 1000000LL), 1000000, "");
  }
  TestCommandEnd();

  TestCommandBegin(__eDiagService, __cDiagService, "", "3");
  {
    if (DiagIsFunctionalGroup("CVADAS_0001_00000000_000"))
    {
      DiagResponse * __resp;
      DiagRequest CVADAS_0001_00000000_000._31015200_Plant_Mode_Routine_Start __req;
      __diagServicevccmce9_151(__req, __resp);
    }
    else
    {
      DiagResponse CVADAS_0001_00000000_000.* __resp;
      DiagRequest CVADAS_0001_00000000_000._31015200_Plant_Mode_Routine_Start __req;
      __diagServicevccmce9_151(__req, __resp);
    }
  }
  TestCommandEnd();


  TestCommandBegin(__eWait, __cWait, "", "4");
  {
    Wait("1", (500 * 1000000LL), 1000000, "");
  }
  TestCommandEnd();

  TestCommandBegin(__eFaultMemoryClear, __cFaultMemoryClear, "", "5");
  {
    long __res;
    long __dtc;
    
    DiagSetReportDetailLevel("CVADAS_0001_00000000_000", EnumServiceDetails_onfail);
    TestStep("Query fault memory", "Clearing fault memory of target Diagnostic ECU 'CVADAS_0001_00000000_000'");
  
    __bVerdict = __eVerdictPass;
    __dtc = 0x621200;
    snprintf(__cArray, 8192, "Diagnostic trouble code \'C221200\'");
    snprintf(__cArray2, 8192, "(%s)", __cArray);
  #if LINUX
    TestStep("", "Clearing DTC 0x%X%s", __dtc, __cArray2);
  #else 
    TestStep("", "Clearing DTC 0x%lX%s", __dtc, __cArray2);
  #endif
    __res = TestWaitForDiagTroubleCodesCleared("CVADAS_0001_00000000_000", __dtc, cDiagAppTimeoutDefault);
    if (__EvaluateWaitResWithVerdict("CVADAS_0001_00000000_000", __res, 1, "DTC cleared successfully"))
      TestReportWriteFaultMemoryDetails("CVADAS_0001_00000000_000", __bVerdict);  
  }
  TestCommandEnd();


}

  
void __diagServicevccmce9_150(DiagRequest * __req, DiagResponse * __resp )
{
  stack long __tableHandle;
  long __res, __paramLen, __bytePos;

   __bVerdict = __eVerdictPass;

  do {
    TestReportResetDiagObjectList();
    DiagSetReportDetailLevel("CVADAS_0001_00000000_000", EnumServiceDetails_onfail);
    // Request aspect
    {
      {
        __res = DiagSetParameterErrorHandled(__req, "DiagSessionType", 03);
        if(__res < 0)
        {
          __bVerdict = __eVerdictFail;
          DiagErrCodeTestStep(__res, "Cannot set diagnostic parameter 'DiagSessionType'");
          break;
        }
      }

      if (0 >= DiagSendReqAndWaitForResp("CVADAS_0001_00000000_000", __req, __resp, __res, -1, -1, -1, -1, -1, EnumResult_pos, EnumServiceDetails_onfail, EnumSendingMode_physical, EnumSuppressPosResBit_asconfigured, EnumVerdictOnInvalidValues_fail))
        break;
    }

    __res = DiagErrCodeTestStep(__res, "Can't retrieve last response for request! No check possible.") < 0;
    if(__res)
    {
	  __bVerdict = __eVerdictFail;
      break;
    }
    {
      __res = DiagInterpretAs(__resp, "DSC_PR");
      if(__res != 0)
      {
        __bVerdict = __eVerdictFail;
        DiagErrCodeTestStep(__res, "Can't interpret response as diagnostic primitive 'DSC_PR'.");
        break;
      }
      else
      {
        TestStepPass( "Received primitive can be interpreted as diagnostic primitive 'DSC_PR'.");
      }
    }
  }
  while(0);


  // Response, check & read aspect
  {
    __res = 1;
    __tableHandle = ReportTableHead5Columns(__cCheckCaption, __cTSym, __cTOp, __cRefVal, __cActual, __cRes);
    {
      double __nDiagValue;
      DiagGetParameterErrorHandled(__resp, "DiagSessionType", __nDiagValue);
      __csr = CheckSignalMatch(__nDiagValue, 03, "==") == 1;
      snprintf(__cArray, 8192, "%s", "Diagnostic parameter \'DiagSessionType\'");
      snprintf(__cArray2, 8192, "%s", __cArray);
      snprintf(__cArray3, 8192, "%s", "");
      ReportTableRow(__tableHandle, 0, __cArray2, "==", 03, __cArray3, __oneOfFlag, __bSetInCheckAlignment);
      ReportCell(__tableHandle, __nDiagValue);
      ReportCellResult(__tableHandle, __csr, __ePassFail);
    
      __res = __res && __csr;
    
    }
    ReportTableEndVerdict(__tableHandle, __cEvaluateResponse, __res);
	__bVerdict = __bVerdict && __res;
  }
  if (__bVerdict == __eVerdictFail)
    TestReportWriteDiagObjectList();
}
  
void __diagServicevccmce9_151(DiagRequest * __req, DiagResponse * __resp )
{
  stack long __tableHandle;
  long __res, __paramLen, __bytePos;

   __bVerdict = __eVerdictPass;

  do {
    TestReportResetDiagObjectList();
    DiagSetReportDetailLevel("CVADAS_0001_00000000_000", EnumServiceDetails_onfail);
    // Request aspect
    {
      {
        __res = DiagSetParameterErrorHandled(__req, "PlantModeState", "ExitFromPlantMode");
        if(__res < 0)
        {
          __bVerdict = __eVerdictFail;
          DiagErrCodeTestStep(__res, "Cannot set diagnostic parameter 'PlantModeState'");
          break;
        }
      }

      if (0 >= DiagSendReqAndWaitForResp("CVADAS_0001_00000000_000", __req, __resp, __res, -1, -1, -1, -1, -1, EnumResult_pos, EnumServiceDetails_onfail, EnumSendingMode_physical, EnumSuppressPosResBit_asconfigured, EnumVerdictOnInvalidValues_fail))
        break;
    }

    __res = DiagErrCodeTestStep(__res, "Can't retrieve last response for request! No check possible.") < 0;
    if(__res)
    {
	  __bVerdict = __eVerdictFail;
      break;
    }
    {
      __res = DiagInterpretAs(__resp, "RC_STR_PR");
      if(__res != 0)
      {
        __bVerdict = __eVerdictFail;
        DiagErrCodeTestStep(__res, "Can't interpret response as diagnostic primitive 'RC_STR_PR'.");
        break;
      }
      else
      {
        TestStepPass( "Received primitive can be interpreted as diagnostic primitive 'RC_STR_PR'.");
      }
    }
  }
  while(0);


  // Response, check & read aspect
  {
    __res = 1;
    __tableHandle = ReportTableHead5Columns(__cCheckCaption, __cTSym, __cTOp, __cRefVal, __cActual, __cRes);
    {
      double __nDiagValue;
      DiagGetParameterErrorHandled(__resp, "RoutineControlType", __nDiagValue);
      __csr = CheckSignalMatch(__nDiagValue, 1, "==") == 1;
      snprintf(__cArray, 8192, "%s", "Diagnostic parameter \'RoutineControlType\'");
      snprintf(__cArray2, 8192, "%s", __cArray);
      snprintf(__cArray3, 8192, "%s", "");
      ReportTableRow(__tableHandle, 0, __cArray2, "==", 1, __cArray3, __oneOfFlag, __bSetInCheckAlignment);
      ReportCell(__tableHandle, __nDiagValue);
      ReportCellResult(__tableHandle, __csr, __ePassFail);
    
      __res = __res && __csr;
    
    }
    ReportTableEndVerdict(__tableHandle, __cEvaluateResponse, __res);
	__bVerdict = __bVerdict && __res;
  }
  if (__bVerdict == __eVerdictFail)
    TestReportWriteDiagObjectList();
}

void Ttvccmce9_Tet_Tc33()
{
  CreateTTEIFFunction("Ttvccmce9_Tc33", __eTcDef, __eLocal);  
  AddIFParameterTestCaseAttribute("TC_ID", "");
  AddIFParameterTestCaseAttribute("Test Case ID", "");
  CallInterfaceFunction("2.6.12_Sleep_Power_Off", __cEmpty , __cEmpty );
}
testcase Ttvccmce9_Tc33()
{
  stack long __tableHandle;
  SetBreakOnFail(0);

  CreateTTEIFFunction("Ttvccmce9_Tet_Tc33_Completion", __eFct, __eLocal);
  
  AddIFAsCleanUpFunction();

  TestCommandBegin(__eDiagService, __cDiagService, "", "0");
  {
    if (DiagIsFunctionalGroup("CVADAS_0001_00000000_000"))
    {
      DiagResponse * __resp;
      DiagRequest CVADAS_0001_00000000_000.Extended_Diagnostic_Session_Start __req;
      __diagServicevccmce9_154(__req, __resp);
    }
    else
    {
      DiagResponse CVADAS_0001_00000000_000.* __resp;
      DiagRequest CVADAS_0001_00000000_000.Extended_Diagnostic_Session_Start __req;
      __diagServicevccmce9_154(__req, __resp);
    }
  }
  TestCommandEnd();


  TestCommandBegin(__eSet, __cSet, "", "1");
  {
    __tableHandle = ReportTableHead3Columns(__cSetCaption , __cTSym, __cTOp, __cAssigned); 
    {
      $`FDCAN2::dbNode::`BCM::`BCM_FD_10::`CmdIgnSts.phys = 0;
      snprintf(__cArray, 8192, "%s", "CmdIgnSts");
      snprintf(__cArray2, 8192, "%s '%s'", __cCANSignal, __cArray);
      snprintf(__cArray3, 8192, "%s", "");
      
      ReportSetLValueOrSignalNotOnline(getSignalTime(`FDCAN2::dbNode::`BCM::`BCM_FD_10::`CmdIgnSts), __cArray2, __cArray4, 8192);
      ReportTableRow(__tableHandle, 0, __cArray4, __cAOp, 0, __cArray3, __oneOfFlag, __bSetInCheckAlignment);
      
  
    }
    {
      $`FDCAN2::dbNode::`BCM::`TRANSM_FD_4::`ShiftLeverPosition.phys = 1;
      snprintf(__cArray, 8192, "%s", "ShiftLeverPosition");
      snprintf(__cArray2, 8192, "%s '%s'", __cCANSignal, __cArray);
      snprintf(__cArray3, 8192, "%s", "P");
      
      ReportSetLValueOrSignalNotOnline(getSignalTime(`FDCAN2::dbNode::`BCM::`TRANSM_FD_4::`ShiftLeverPosition), __cArray2, __cArray4, 8192);
      ReportTableRow(__tableHandle, 0, __cArray4, __cAOp, 1, __cArray3, __oneOfFlag, __bSetInCheckAlignment);
      
  
    }
    {
      @sysvarInt::`IL::`Klemme15 = 0;
      snprintf(__cArray, 8192, "%s", "Klemme15");
      snprintf(__cArray2, 8192, "%s '%s'", __cSysVar, __cArray);
      snprintf(__cArray3, 8192, "%s", "");
      
      ReportTableRow(__tableHandle, 0, __cArray2, __cAOp, 0, __cArray3, __oneOfFlag, __bSetInCheckAlignment);
      
  
    }
    {
      @sysvarInt::`IL::`Klemme30 = 0;
      snprintf(__cArray, 8192, "%s", "Klemme30");
      snprintf(__cArray2, 8192, "%s '%s'", __cSysVar, __cArray);
      snprintf(__cArray3, 8192, "%s", "");
      
      ReportTableRow(__tableHandle, 0, __cArray2, __cAOp, 0, __cArray3, __oneOfFlag, __bSetInCheckAlignment);
      
  
    }
    ReportTableEndTestStep(__tableHandle, "1");
  }
  TestCommandEnd();


  TestCommandBegin(__eWait, __cWait, "", "2");
  {
    Wait("1", (30000 * 1000000LL), 1000000, "");
  }
  TestCommandEnd();

  TestCommandBegin(__eCAPLInline, __cCAPLInline, "", "3");
  {
    __civccmce9CaplInline3();
  }
  TestCommandEnd();


}

  
void __diagServicevccmce9_152(DiagRequest * __req, DiagResponse * __resp )
{
  stack long __tableHandle;
  long __res, __paramLen, __bytePos;

   __bVerdict = __eVerdictPass;

  do {
    TestReportResetDiagObjectList();
    DiagSetReportDetailLevel("CVADAS_0001_00000000_000", EnumServiceDetails_onfail);
    // Request aspect
    {

      if (0 >= DiagSendReqAndWaitForResp("CVADAS_0001_00000000_000", __req, __resp, __res, -1, -1, -1, -1, -1, EnumResult_pos, EnumServiceDetails_onfail, EnumSendingMode_physical, EnumSuppressPosResBit_asconfigured, EnumVerdictOnInvalidValues_fail))
        break;
    }

    __res = DiagErrCodeTestStep(__res, "Can't retrieve last response for request! No check possible.") < 0;
    if(__res)
    {
	  __bVerdict = __eVerdictFail;
      break;
    }
    {
      __res = DiagInterpretAs(__resp, "DSC_PR");
      if(__res != 0)
      {
        __bVerdict = __eVerdictFail;
        DiagErrCodeTestStep(__res, "Can't interpret response as diagnostic primitive 'DSC_PR'.");
        break;
      }
      else
      {
        TestStepPass( "Received primitive can be interpreted as diagnostic primitive 'DSC_PR'.");
      }
    }
  }
  while(0);


  if (__bVerdict == __eVerdictFail)
    TestReportWriteDiagObjectList();
}
  
void __diagServicevccmce9_153(DiagRequest * __req, DiagResponse * __resp )
{
  stack long __tableHandle;
  long __res, __paramLen, __bytePos;

   __bVerdict = __eVerdictPass;

  do {
    TestReportResetDiagObjectList();
    DiagSetReportDetailLevel("CVADAS_0001_00000000_000", EnumServiceDetails_onfail);
    // Request aspect
    {
      {
        __res = DiagSetParameterErrorHandled(__req, "PlantModeState", "ExitFromPlantMode");
        if(__res < 0)
        {
          __bVerdict = __eVerdictFail;
          DiagErrCodeTestStep(__res, "Cannot set diagnostic parameter 'PlantModeState'");
          break;
        }
      }

      if (0 >= DiagSendReqAndWaitForResp("CVADAS_0001_00000000_000", __req, __resp, __res, -1, -1, -1, -1, -1, EnumResult_pos, EnumServiceDetails_onfail, EnumSendingMode_physical, EnumSuppressPosResBit_asconfigured, EnumVerdictOnInvalidValues_fail))
        break;
    }

    __res = DiagErrCodeTestStep(__res, "Can't retrieve last response for request! No check possible.") < 0;
    if(__res)
    {
	  __bVerdict = __eVerdictFail;
      break;
    }
    {
      __res = DiagInterpretAs(__resp, "RC_STR_PR");
      if(__res != 0)
      {
        __bVerdict = __eVerdictFail;
        DiagErrCodeTestStep(__res, "Can't interpret response as diagnostic primitive 'RC_STR_PR'.");
        break;
      }
      else
      {
        TestStepPass( "Received primitive can be interpreted as diagnostic primitive 'RC_STR_PR'.");
      }
    }
  }
  while(0);


  if (__bVerdict == __eVerdictFail)
    TestReportWriteDiagObjectList();
}
  
void __diagServicevccmce9_154(DiagRequest * __req, DiagResponse * __resp )
{
  stack long __tableHandle;
  long __res, __paramLen, __bytePos;

   __bVerdict = __eVerdictPass;

  do {
    TestReportResetDiagObjectList();
    DiagSetReportDetailLevel("CVADAS_0001_00000000_000", EnumServiceDetails_onfail);
    // Request aspect
    {
      {
        __res = DiagSetParameterErrorHandled(__req, "DiagSessionType", 03);
        if(__res < 0)
        {
          __bVerdict = __eVerdictFail;
          DiagErrCodeTestStep(__res, "Cannot set diagnostic parameter 'DiagSessionType'");
          break;
        }
      }

      if (0 >= DiagSendReqAndWaitForResp("CVADAS_0001_00000000_000", __req, __resp, __res, -1, -1, -1, -1, -1, EnumResult_pos, EnumServiceDetails_onfail, EnumSendingMode_physical, EnumSuppressPosResBit_asconfigured, EnumVerdictOnInvalidValues_fail))
        break;
    }

    __res = DiagErrCodeTestStep(__res, "Can't retrieve last response for request! No check possible.") < 0;
    if(__res)
    {
	  __bVerdict = __eVerdictFail;
      break;
    }
    {
      __res = DiagInterpretAs(__resp, "DSC_PR");
      if(__res != 0)
      {
        __bVerdict = __eVerdictFail;
        DiagErrCodeTestStep(__res, "Can't interpret response as diagnostic primitive 'DSC_PR'.");
        break;
      }
      else
      {
        TestStepPass( "Received primitive can be interpreted as diagnostic primitive 'DSC_PR'.");
      }
    }
  }
  while(0);


  // Response, check & read aspect
  {
    __res = 1;
    __tableHandle = ReportTableHead5Columns(__cCheckCaption, __cTSym, __cTOp, __cRefVal, __cActual, __cRes);
    {
      double __nDiagValue;
      DiagGetParameterErrorHandled(__resp, "DiagSessionType", __nDiagValue);
      __csr = CheckSignalMatch(__nDiagValue, 03, "==") == 1;
      snprintf(__cArray, 8192, "%s", "Diagnostic parameter \'DiagSessionType\'");
      snprintf(__cArray2, 8192, "%s", __cArray);
      snprintf(__cArray3, 8192, "%s", "");
      ReportTableRow(__tableHandle, 0, __cArray2, "==", 03, __cArray3, __oneOfFlag, __bSetInCheckAlignment);
      ReportCell(__tableHandle, __nDiagValue);
      ReportCellResult(__tableHandle, __csr, __ePassFail);
    
      __res = __res && __csr;
    
    }
    ReportTableEndVerdict(__tableHandle, __cEvaluateResponse, __res);
	__bVerdict = __bVerdict && __res;
  }
  if (__bVerdict == __eVerdictFail)
    TestReportWriteDiagObjectList();
}
void __civccmce9CaplInline3()
{
  stack long __tableHandle;
  {
    testReportAddWindowCapture("cvadas","cvadas","Sleep_Mode","//images//");

  }
}
void Ttvccmce9_Tet_Tc33_Completion()
{
  stack long __tableHandle;
  TestCompletionBegin();
  {
    TestCommandBegin(__eDiagService, __cDiagService, "", "4");
    {
      if (DiagIsFunctionalGroup("CVADAS_0001_00000000_000"))
      {
        DiagResponse * __resp;
        DiagRequest CVADAS_0001_00000000_000.Extended_Diagnostic_Session_Start __req;
        __diagServicevccmce9_152(__req, __resp);
      }
      else
      {
        DiagResponse CVADAS_0001_00000000_000.* __resp;
        DiagRequest CVADAS_0001_00000000_000.Extended_Diagnostic_Session_Start __req;
        __diagServicevccmce9_152(__req, __resp);
      }
    }
    TestCommandEnd();


    TestCommandBegin(__eDiagService, __cDiagService, "", "5");
    {
      if (DiagIsFunctionalGroup("CVADAS_0001_00000000_000"))
      {
        DiagResponse * __resp;
        DiagRequest CVADAS_0001_00000000_000._31015200_Plant_Mode_Routine_Start __req;
        __diagServicevccmce9_153(__req, __resp);
      }
      else
      {
        DiagResponse CVADAS_0001_00000000_000.* __resp;
        DiagRequest CVADAS_0001_00000000_000._31015200_Plant_Mode_Routine_Start __req;
        __diagServicevccmce9_153(__req, __resp);
      }
    }
    TestCommandEnd();


  }
  TestCompletionEnd();
}

void Ttvccmce9_Tet_Tc34()
{
  CreateTTEIFFunction("Ttvccmce9_Tc34", __eTcDef, __eLocal);  
  AddIFParameterTestCaseAttribute("TC_ID", "");
  AddIFParameterTestCaseAttribute("Test Case ID", "");
  CallInterfaceFunction("TC_ID_20205165_Defaults_Session", __cEmpty , __cEmpty );
}
testcase Ttvccmce9_Tc34()
{
  stack long __tableHandle;
  SetBreakOnFail(0);

  CreateTTEIFFunction("Ttvccmce9_Tet_Tc34_Completion", __eFct, __eLocal);
  
  AddIFAsCleanUpFunction();

  TestPreparationBegin();
  {
    {
      CreateTTEIFFunction("Ttvccmce9_General_Precondition", __eFct, __eLocal);
      CallInterfaceFunction(__cEmpty, __cEmpty, "b588ddda-8fe4-4271-93b3-dd1beefd9138");
    }


  }
  TestPreparationEnd();

  TestCommandBegin(__eDiagService, __cDiagService, "", "2");
  {
    if (DiagIsFunctionalGroup("CVADAS_0001_00000000_000"))
    {
      DiagResponse * __resp;
      DiagRequest CVADAS_0001_00000000_000.Default_Session_Start __req;
      __diagServicevccmce9_155(__req, __resp);
    }
    else
    {
      DiagResponse CVADAS_0001_00000000_000.* __resp;
      DiagRequest CVADAS_0001_00000000_000.Default_Session_Start __req;
      __diagServicevccmce9_155(__req, __resp);
    }
  }
  TestCommandEnd();


  {
    CreateTTEIFFunction("Ttvccmce9_F186_DID_with_PhysicalAdd_DefaultSession", __eFct, __eLocal);
    CallInterfaceFunction(__cEmpty, __cEmpty, "94cfa590-eac0-4499-adc5-5b1a2141e3ff");
  }


  {
    CreateTTEIFFunction("Ttvccmce9_F110_DID_with_Physical_Address", __eFct, __eLocal);
    CallInterfaceFunction(__cEmpty, __cEmpty, "7efed2f9-b2d7-4e6d-9041-19ed96d650f4");
  }



}

  
void __diagServicevccmce9_155(DiagRequest * __req, DiagResponse * __resp )
{
  stack long __tableHandle;
  long __res, __paramLen, __bytePos;

   __bVerdict = __eVerdictPass;

  do {
    TestReportResetDiagObjectList();
    DiagSetReportDetailLevel("CVADAS_0001_00000000_000", EnumServiceDetails_onfail);
    // Request aspect
    {

      if (0 >= DiagSendReqAndWaitForResp("CVADAS_0001_00000000_000", __req, __resp, __res, -1, -1, -1, -1, -1, EnumResult_pos, EnumServiceDetails_onfail, EnumSendingMode_physical, EnumSuppressPosResBit_asconfigured, EnumVerdictOnInvalidValues_fail))
        break;
    }

    __res = DiagErrCodeTestStep(__res, "Can't retrieve last response for request! No check possible.") < 0;
    if(__res)
    {
	  __bVerdict = __eVerdictFail;
      break;
    }
    {
      __res = DiagInterpretAs(__resp, "DSC_PR");
      if(__res != 0)
      {
        __bVerdict = __eVerdictFail;
        DiagErrCodeTestStep(__res, "Can't interpret response as diagnostic primitive 'DSC_PR'.");
        break;
      }
      else
      {
        TestStepPass( "Received primitive can be interpreted as diagnostic primitive 'DSC_PR'.");
      }
    }
  }
  while(0);


  // Response, check & read aspect
  {
    __res = 1;
    __tableHandle = ReportTableHead5Columns(__cCheckCaption, __cTSym, __cTOp, __cRefVal, __cActual, __cRes);
    {
      __bDiagValueArrayCtr = DiagGetParameterErrorHandled(__resp, "DiagSessionType", __bDiagValueArray, elcount(__bDiagValueArray), __cDiagValueArray, elcount(__cDiagValueArray));
      {
        byte __bArray2[1] = { 0x01 };
        __bArrayCtr = __CopyBytes(__bDiagValueArray, __bDiagValueArrayCtr, __bArray);
        __bArrayCtr2 = elCount(__bArray2);
        __csr = CompareBytes(__bArray, __bArrayCtr, __bArray2, __bArrayCtr2) == 0;
        snprintf(__cArray, 8192, "%s", "Diagnostic parameter \'DiagSessionType\'");
        snprintf(__cArray2, 8192, "%s", __cArray);
        snprintf(__cArray3, 8192, "%s", "");
        ReportTableRow(__tableHandle, 0, __cArray2, "Bytes", __bArray2, __bArrayCtr2, __cArray3, __oneOfFlag, __bSetInCheckAlignment);
        ReportCell(__tableHandle, __bArray, __bArrayCtr);
        ReportCellResult(__tableHandle, __csr, __ePassFail);
      }
    
      __res = __res && __csr;
    
    }
    ReportTableEndVerdict(__tableHandle, __cEvaluateResponse, __res);
	__bVerdict = __bVerdict && __res;
  }
  if (__bVerdict == __eVerdictFail)
    TestReportWriteDiagObjectList();
}
void Ttvccmce9_Tet_Tc34_Completion()
{
  stack long __tableHandle;
  TestCompletionBegin();
  {
    {
      CreateTTEIFFunction("Ttvccmce9_General_Postconditions", __eFct, __eLocal);
      CallInterfaceFunction(__cEmpty, __cEmpty, "3d1998f6-ed4f-4d8f-9c0f-63439c24b6a7");
    }


  }
  TestCompletionEnd();
}

void Ttvccmce9_Tet_Tc35()
{
  CreateTTEIFFunction("Ttvccmce9_Tc35", __eTcDef, __eLocal);  
  AddIFParameterTestCaseAttribute("TC_ID", "");
  AddIFParameterTestCaseAttribute("Test Case ID", "");
  CallInterfaceFunction("TC_ID_20205129_Standard_Physical_Address", __cEmpty , __cEmpty );
}
testcase Ttvccmce9_Tc35()
{
  stack long __tableHandle;
  SetBreakOnFail(0);

  CreateTTEIFFunction("Ttvccmce9_Tet_Tc35_Completion", __eFct, __eLocal);
  
  AddIFAsCleanUpFunction();

  TestPreparationBegin();
  {
    {
      CreateTTEIFFunction("Ttvccmce9_General_Precondition", __eFct, __eLocal);
      CallInterfaceFunction(__cEmpty, __cEmpty, "b588ddda-8fe4-4271-93b3-dd1beefd9138");
    }


  }
  TestPreparationEnd();

  {
    CreateTTEIFFunction("Ttvccmce9_Default_Session_Standard_Physical_Address", __eFct, __eLocal);
    CallInterfaceFunction(__cEmpty, __cEmpty, "a876afd8-79e2-4bc6-b86f-76bf44cfb774");
  }


  {
    CreateTTEIFFunction("Ttvccmce9_F186_DID_with_Standard_Physical_Address_Default_Session", __eFct, __eLocal);
    CallInterfaceFunction(__cEmpty, __cEmpty, "a35d2af3-f713-4f2b-9c1d-1a28d63eb692");
  }


  {
    CreateTTEIFFunction("Ttvccmce9_F110_DID_with_Standard_Physical_Address", __eFct, __eLocal);
    CallInterfaceFunction(__cEmpty, __cEmpty, "32cba445-859d-4679-8e7d-8bdd39c82090");
  }



}

void Ttvccmce9_Tet_Tc35_Completion()
{
  stack long __tableHandle;
  TestCompletionBegin();
  {
    {
      CreateTTEIFFunction("Ttvccmce9_General_Postconditions", __eFct, __eLocal);
      CallInterfaceFunction(__cEmpty, __cEmpty, "3d1998f6-ed4f-4d8f-9c0f-63439c24b6a7");
    }


  }
  TestCompletionEnd();
}

void Ttvccmce9_Tet_Tc36()
{
  CreateTTEIFFunction("Ttvccmce9_Tc36", __eTcDef, __eLocal);  
  AddIFParameterTestCaseAttribute("TC_ID", "");
  AddIFParameterTestCaseAttribute("Test Case ID", "");
  CallInterfaceFunction("TC_ID_20205138_Extended_Session", __cEmpty , __cEmpty );
}
testcase Ttvccmce9_Tc36()
{
  stack long __tableHandle;
  SetBreakOnFail(0);

  CreateTTEIFFunction("Ttvccmce9_Tet_Tc36_Completion", __eFct, __eLocal);
  
  AddIFAsCleanUpFunction();

  TestPreparationBegin();
  {
    {
      CreateTTEIFFunction("Ttvccmce9_General_Precondition", __eFct, __eLocal);
      CallInterfaceFunction(__cEmpty, __cEmpty, "b588ddda-8fe4-4271-93b3-dd1beefd9138");
    }


  }
  TestPreparationEnd();

  TestCommandBegin(__eDiagService, __cDiagService, "", "2");
  {
    if (DiagIsFunctionalGroup("CVADAS_0001_00000000_000"))
    {
      DiagResponse * __resp;
      DiagRequest CVADAS_0001_00000000_000.Default_Session_Start __req;
      __diagServicevccmce9_156(__req, __resp);
    }
    else
    {
      DiagResponse CVADAS_0001_00000000_000.* __resp;
      DiagRequest CVADAS_0001_00000000_000.Default_Session_Start __req;
      __diagServicevccmce9_156(__req, __resp);
    }
  }
  TestCommandEnd();


  TestCommandBegin(__eDiagService, __cDiagService, "", "3");
  {
    if (DiagIsFunctionalGroup("CVADAS_0001_00000000_000"))
    {
      DiagResponse * __resp;
      DiagRequest CVADAS_0001_00000000_000.Extended_Diagnostic_Session_Start __req;
      __diagServicevccmce9_157(__req, __resp);
    }
    else
    {
      DiagResponse CVADAS_0001_00000000_000.* __resp;
      DiagRequest CVADAS_0001_00000000_000.Extended_Diagnostic_Session_Start __req;
      __diagServicevccmce9_157(__req, __resp);
    }
  }
  TestCommandEnd();


  {
    CreateTTEIFFunction("Ttvccmce9_F186_DID_with_PhysicalAdd_ExtendedSession", __eFct, __eLocal);
    CallInterfaceFunction(__cEmpty, __cEmpty, "ef9ee47d-f468-4fc1-8d48-13fa51881535");
  }


  {
    CreateTTEIFFunction("Ttvccmce9_F110_DID_with_Physical_Address", __eFct, __eLocal);
    CallInterfaceFunction(__cEmpty, __cEmpty, "7efed2f9-b2d7-4e6d-9041-19ed96d650f4");
  }



}

  
void __diagServicevccmce9_156(DiagRequest * __req, DiagResponse * __resp )
{
  stack long __tableHandle;
  long __res, __paramLen, __bytePos;

   __bVerdict = __eVerdictPass;

  do {
    TestReportResetDiagObjectList();
    DiagSetReportDetailLevel("CVADAS_0001_00000000_000", EnumServiceDetails_onfail);
    // Request aspect
    {

      if (0 >= DiagSendReqAndWaitForResp("CVADAS_0001_00000000_000", __req, __resp, __res, -1, -1, -1, -1, -1, EnumResult_pos, EnumServiceDetails_onfail, EnumSendingMode_physical, EnumSuppressPosResBit_asconfigured, EnumVerdictOnInvalidValues_fail))
        break;
    }

    __res = DiagErrCodeTestStep(__res, "Can't retrieve last response for request! No check possible.") < 0;
    if(__res)
    {
	  __bVerdict = __eVerdictFail;
      break;
    }
    {
      __res = DiagInterpretAs(__resp, "DSC_PR");
      if(__res != 0)
      {
        __bVerdict = __eVerdictFail;
        DiagErrCodeTestStep(__res, "Can't interpret response as diagnostic primitive 'DSC_PR'.");
        break;
      }
      else
      {
        TestStepPass( "Received primitive can be interpreted as diagnostic primitive 'DSC_PR'.");
      }
    }
  }
  while(0);


  // Response, check & read aspect
  {
    __res = 1;
    __tableHandle = ReportTableHead5Columns(__cCheckCaption, __cTSym, __cTOp, __cRefVal, __cActual, __cRes);
    {
      __bDiagValueArrayCtr = DiagGetParameterErrorHandled(__resp, "DiagSessionType", __bDiagValueArray, elcount(__bDiagValueArray), __cDiagValueArray, elcount(__cDiagValueArray));
      {
        byte __bArray2[1] = { 0x01 };
        __bArrayCtr = __CopyBytes(__bDiagValueArray, __bDiagValueArrayCtr, __bArray);
        __bArrayCtr2 = elCount(__bArray2);
        __csr = CompareBytes(__bArray, __bArrayCtr, __bArray2, __bArrayCtr2) == 0;
        snprintf(__cArray, 8192, "%s", "Diagnostic parameter \'DiagSessionType\'");
        snprintf(__cArray2, 8192, "%s", __cArray);
        snprintf(__cArray3, 8192, "%s", "");
        ReportTableRow(__tableHandle, 0, __cArray2, "Bytes", __bArray2, __bArrayCtr2, __cArray3, __oneOfFlag, __bSetInCheckAlignment);
        ReportCell(__tableHandle, __bArray, __bArrayCtr);
        ReportCellResult(__tableHandle, __csr, __ePassFail);
      }
    
      __res = __res && __csr;
    
    }
    ReportTableEndVerdict(__tableHandle, __cEvaluateResponse, __res);
	__bVerdict = __bVerdict && __res;
  }
  if (__bVerdict == __eVerdictFail)
    TestReportWriteDiagObjectList();
}
  
void __diagServicevccmce9_157(DiagRequest * __req, DiagResponse * __resp )
{
  stack long __tableHandle;
  long __res, __paramLen, __bytePos;

   __bVerdict = __eVerdictPass;

  do {
    TestReportResetDiagObjectList();
    DiagSetReportDetailLevel("CVADAS_0001_00000000_000", EnumServiceDetails_onfail);
    // Request aspect
    {

      if (0 >= DiagSendReqAndWaitForResp("CVADAS_0001_00000000_000", __req, __resp, __res, -1, -1, -1, -1, -1, EnumResult_pos, EnumServiceDetails_onfail, EnumSendingMode_physical, EnumSuppressPosResBit_asconfigured, EnumVerdictOnInvalidValues_fail))
        break;
    }

    __res = DiagErrCodeTestStep(__res, "Can't retrieve last response for request! No check possible.") < 0;
    if(__res)
    {
	  __bVerdict = __eVerdictFail;
      break;
    }
    {
      __res = DiagInterpretAs(__resp, "DSC_PR");
      if(__res != 0)
      {
        __bVerdict = __eVerdictFail;
        DiagErrCodeTestStep(__res, "Can't interpret response as diagnostic primitive 'DSC_PR'.");
        break;
      }
      else
      {
        TestStepPass( "Received primitive can be interpreted as diagnostic primitive 'DSC_PR'.");
      }
    }
  }
  while(0);


  // Response, check & read aspect
  {
    __res = 1;
    __tableHandle = ReportTableHead5Columns(__cCheckCaption, __cTSym, __cTOp, __cRefVal, __cActual, __cRes);
    {
      __bDiagValueArrayCtr = DiagGetParameterErrorHandled(__resp, "DiagSessionType", __bDiagValueArray, elcount(__bDiagValueArray), __cDiagValueArray, elcount(__cDiagValueArray));
      {
        byte __bArray2[1] = { 0x03 };
        __bArrayCtr = __CopyBytes(__bDiagValueArray, __bDiagValueArrayCtr, __bArray);
        __bArrayCtr2 = elCount(__bArray2);
        __csr = CompareBytes(__bArray, __bArrayCtr, __bArray2, __bArrayCtr2) == 0;
        snprintf(__cArray, 8192, "%s", "Diagnostic parameter \'DiagSessionType\'");
        snprintf(__cArray2, 8192, "%s", __cArray);
        snprintf(__cArray3, 8192, "%s", "");
        ReportTableRow(__tableHandle, 0, __cArray2, "Bytes", __bArray2, __bArrayCtr2, __cArray3, __oneOfFlag, __bSetInCheckAlignment);
        ReportCell(__tableHandle, __bArray, __bArrayCtr);
        ReportCellResult(__tableHandle, __csr, __ePassFail);
      }
    
      __res = __res && __csr;
    
    }
    ReportTableEndVerdict(__tableHandle, __cEvaluateResponse, __res);
	__bVerdict = __bVerdict && __res;
  }
  if (__bVerdict == __eVerdictFail)
    TestReportWriteDiagObjectList();
}
void Ttvccmce9_Tet_Tc36_Completion()
{
  stack long __tableHandle;
  TestCompletionBegin();
  {
    {
      CreateTTEIFFunction("Ttvccmce9_General_Postconditions", __eFct, __eLocal);
      CallInterfaceFunction(__cEmpty, __cEmpty, "3d1998f6-ed4f-4d8f-9c0f-63439c24b6a7");
    }


  }
  TestCompletionEnd();
}

void Ttvccmce9_Tet_Tc37()
{
  CreateTTEIFFunction("Ttvccmce9_Tc37", __eTcDef, __eLocal);  
  AddIFParameterTestCaseAttribute("TC_ID", "");
  AddIFParameterTestCaseAttribute("Test Case ID", "");
  CallInterfaceFunction("TC_ID_20205147_Standard_Physical_Address", __cEmpty , __cEmpty );
}
testcase Ttvccmce9_Tc37()
{
  stack long __tableHandle;
  SetBreakOnFail(0);

  CreateTTEIFFunction("Ttvccmce9_Tet_Tc37_Completion", __eFct, __eLocal);
  
  AddIFAsCleanUpFunction();

  TestPreparationBegin();
  {
    {
      CreateTTEIFFunction("Ttvccmce9_General_Precondition", __eFct, __eLocal);
      CallInterfaceFunction(__cEmpty, __cEmpty, "b588ddda-8fe4-4271-93b3-dd1beefd9138");
    }


  }
  TestPreparationEnd();

  {
    CreateTTEIFFunction("Ttvccmce9_Default_Session_Standard_Physical_Address", __eFct, __eLocal);
    CallInterfaceFunction(__cEmpty, __cEmpty, "a876afd8-79e2-4bc6-b86f-76bf44cfb774");
  }


  {
    CreateTTEIFFunction("Ttvccmce9_Extended_Session_Standard_Physical_Address", __eFct, __eLocal);
    CallInterfaceFunction(__cEmpty, __cEmpty, "aab9c8d5-4152-43a6-9531-8599a5c4c508");
  }


  {
    CreateTTEIFFunction("Ttvccmce9_F186_DID_with_Standard_Physical_Address_Extended_Session", __eFct, __eLocal);
    CallInterfaceFunction(__cEmpty, __cEmpty, "c8044f49-226c-49c1-9a34-3c367524be30");
  }


  {
    CreateTTEIFFunction("Ttvccmce9_F110_DID_with_Standard_Physical_Address", __eFct, __eLocal);
    CallInterfaceFunction(__cEmpty, __cEmpty, "32cba445-859d-4679-8e7d-8bdd39c82090");
  }



}

void Ttvccmce9_Tet_Tc37_Completion()
{
  stack long __tableHandle;
  TestCompletionBegin();
  {
    {
      CreateTTEIFFunction("Ttvccmce9_General_Postconditions", __eFct, __eLocal);
      CallInterfaceFunction(__cEmpty, __cEmpty, "3d1998f6-ed4f-4d8f-9c0f-63439c24b6a7");
    }


  }
  TestCompletionEnd();
}

void Ttvccmce9_Tet_Tc38()
{
  CreateTTEIFFunction("Ttvccmce9_Tc38", __eTcDef, __eLocal);  
  AddIFParameterTestCaseAttribute("TC_ID", "");
  AddIFParameterTestCaseAttribute("Test Case ID", "");
  CallInterfaceFunction("TC_ID_20205102_Standard_Physical_Address", __cEmpty , __cEmpty );
}
testcase Ttvccmce9_Tc38()
{
  stack long __tableHandle;
  SetBreakOnFail(0);

  CreateTTEIFFunction("Ttvccmce9_Tet_Tc38_Completion", __eFct, __eLocal);
  
  AddIFAsCleanUpFunction();

  TestPreparationBegin();
  {
    {
      CreateTTEIFFunction("Ttvccmce9_General_Precondition", __eFct, __eLocal);
      CallInterfaceFunction(__cEmpty, __cEmpty, "b588ddda-8fe4-4271-93b3-dd1beefd9138");
    }


  }
  TestPreparationEnd();

  {
    CreateTTEIFFunction("Ttvccmce9_Default_Session_Standard_Physical_Address", __eFct, __eLocal);
    CallInterfaceFunction(__cEmpty, __cEmpty, "a876afd8-79e2-4bc6-b86f-76bf44cfb774");
  }


  {
    CreateTTEIFFunction("Ttvccmce9_Extended_Session_Standard_Physical_Address", __eFct, __eLocal);
    CallInterfaceFunction(__cEmpty, __cEmpty, "aab9c8d5-4152-43a6-9531-8599a5c4c508");
  }


  {
    CreateTTEIFFunction("Ttvccmce9_Programming_Session_Standard_Physical_Address", __eFct, __eLocal);
    CallInterfaceFunction(__cEmpty, __cEmpty, "a8462e0e-f701-4463-99a2-405de827e117");
  }


  TestCommandBegin(__eWait, __cWait, "", "6");
  {
    Wait("1", (2000 * 1000000LL), 1000000, "");
  }
  TestCommandEnd();

  {
    CreateTTEIFFunction("Ttvccmce9_F110_DID_with_Standard_Physical_Address", __eFct, __eLocal);
    CallInterfaceFunction(__cEmpty, __cEmpty, "32cba445-859d-4679-8e7d-8bdd39c82090");
  }



}

void Ttvccmce9_Tet_Tc38_Completion()
{
  stack long __tableHandle;
  TestCompletionBegin();
  {
    {
      CreateTTEIFFunction("Ttvccmce9_General_Postconditions", __eFct, __eLocal);
      CallInterfaceFunction(__cEmpty, __cEmpty, "3d1998f6-ed4f-4d8f-9c0f-63439c24b6a7");
    }


  }
  TestCompletionEnd();
}

void Ttvccmce9_Tet_Tc39()
{
  CreateTTEIFFunction("Ttvccmce9_Tc39", __eTcDef, __eLocal);  
  AddIFParameterTestCaseAttribute("TC_ID", "");
  AddIFParameterTestCaseAttribute("Test Case ID", "");
  CallInterfaceFunction("TC_ID_20205280_Defaults_Session", __cEmpty , __cEmpty );
}
testcase Ttvccmce9_Tc39()
{
  stack long __tableHandle;
  SetBreakOnFail(0);

  CreateTTEIFFunction("Ttvccmce9_Tet_Tc39_Completion", __eFct, __eLocal);
  
  AddIFAsCleanUpFunction();

  TestPreparationBegin();
  {
    {
      CreateTTEIFFunction("Ttvccmce9_General_Precondition", __eFct, __eLocal);
      CallInterfaceFunction(__cEmpty, __cEmpty, "b588ddda-8fe4-4271-93b3-dd1beefd9138");
    }


  }
  TestPreparationEnd();

  TestCommandBegin(__eDiagService, __cDiagService, "", "2");
  {
    if (DiagIsFunctionalGroup("CVADAS_0001_00000000_000"))
    {
      DiagResponse * __resp;
      DiagRequest CVADAS_0001_00000000_000.Default_Session_Start __req;
      __diagServicevccmce9_158(__req, __resp);
    }
    else
    {
      DiagResponse CVADAS_0001_00000000_000.* __resp;
      DiagRequest CVADAS_0001_00000000_000.Default_Session_Start __req;
      __diagServicevccmce9_158(__req, __resp);
    }
  }
  TestCommandEnd();


  {
    CreateTTEIFFunction("Ttvccmce9_F186_DID_with_PhysicalAdd_DefaultSession", __eFct, __eLocal);
    CallInterfaceFunction(__cEmpty, __cEmpty, "94cfa590-eac0-4499-adc5-5b1a2141e3ff");
  }


  {
    CreateTTEIFFunction("Ttvccmce9_F10D_DID_with_Physical_Address", __eFct, __eLocal);
    CallInterfaceFunction(__cEmpty, __cEmpty, "213e855d-729b-4b1c-9780-76c928384f6d");
  }



}

  
void __diagServicevccmce9_158(DiagRequest * __req, DiagResponse * __resp )
{
  stack long __tableHandle;
  long __res, __paramLen, __bytePos;

   __bVerdict = __eVerdictPass;

  do {
    TestReportResetDiagObjectList();
    DiagSetReportDetailLevel("CVADAS_0001_00000000_000", EnumServiceDetails_onfail);
    // Request aspect
    {

      if (0 >= DiagSendReqAndWaitForResp("CVADAS_0001_00000000_000", __req, __resp, __res, -1, -1, -1, -1, -1, EnumResult_pos, EnumServiceDetails_onfail, EnumSendingMode_physical, EnumSuppressPosResBit_asconfigured, EnumVerdictOnInvalidValues_fail))
        break;
    }

    __res = DiagErrCodeTestStep(__res, "Can't retrieve last response for request! No check possible.") < 0;
    if(__res)
    {
	  __bVerdict = __eVerdictFail;
      break;
    }
    {
      __res = DiagInterpretAs(__resp, "DSC_PR");
      if(__res != 0)
      {
        __bVerdict = __eVerdictFail;
        DiagErrCodeTestStep(__res, "Can't interpret response as diagnostic primitive 'DSC_PR'.");
        break;
      }
      else
      {
        TestStepPass( "Received primitive can be interpreted as diagnostic primitive 'DSC_PR'.");
      }
    }
  }
  while(0);


  // Response, check & read aspect
  {
    __res = 1;
    __tableHandle = ReportTableHead5Columns(__cCheckCaption, __cTSym, __cTOp, __cRefVal, __cActual, __cRes);
    {
      __bDiagValueArrayCtr = DiagGetParameterErrorHandled(__resp, "DiagSessionType", __bDiagValueArray, elcount(__bDiagValueArray), __cDiagValueArray, elcount(__cDiagValueArray));
      {
        byte __bArray2[1] = { 0x01 };
        __bArrayCtr = __CopyBytes(__bDiagValueArray, __bDiagValueArrayCtr, __bArray);
        __bArrayCtr2 = elCount(__bArray2);
        __csr = CompareBytes(__bArray, __bArrayCtr, __bArray2, __bArrayCtr2) == 0;
        snprintf(__cArray, 8192, "%s", "Diagnostic parameter \'DiagSessionType\'");
        snprintf(__cArray2, 8192, "%s", __cArray);
        snprintf(__cArray3, 8192, "%s", "");
        ReportTableRow(__tableHandle, 0, __cArray2, "Bytes", __bArray2, __bArrayCtr2, __cArray3, __oneOfFlag, __bSetInCheckAlignment);
        ReportCell(__tableHandle, __bArray, __bArrayCtr);
        ReportCellResult(__tableHandle, __csr, __ePassFail);
      }
    
      __res = __res && __csr;
    
    }
    ReportTableEndVerdict(__tableHandle, __cEvaluateResponse, __res);
	__bVerdict = __bVerdict && __res;
  }
  if (__bVerdict == __eVerdictFail)
    TestReportWriteDiagObjectList();
}
void Ttvccmce9_Tet_Tc39_Completion()
{
  stack long __tableHandle;
  TestCompletionBegin();
  {
    {
      CreateTTEIFFunction("Ttvccmce9_General_Postconditions", __eFct, __eLocal);
      CallInterfaceFunction(__cEmpty, __cEmpty, "3d1998f6-ed4f-4d8f-9c0f-63439c24b6a7");
    }


  }
  TestCompletionEnd();
}

void Ttvccmce9_Tet_Tc40()
{
  CreateTTEIFFunction("Ttvccmce9_Tc40", __eTcDef, __eLocal);  
  AddIFParameterTestCaseAttribute("TC_ID", "");
  AddIFParameterTestCaseAttribute("Test Case ID", "");
  CallInterfaceFunction("TC_ID_20205246_Standard_Physical_Address", __cEmpty , __cEmpty );
}
testcase Ttvccmce9_Tc40()
{
  stack long __tableHandle;
  SetBreakOnFail(0);

  CreateTTEIFFunction("Ttvccmce9_Tet_Tc40_Completion", __eFct, __eLocal);
  
  AddIFAsCleanUpFunction();

  TestPreparationBegin();
  {
    {
      CreateTTEIFFunction("Ttvccmce9_General_Precondition", __eFct, __eLocal);
      CallInterfaceFunction(__cEmpty, __cEmpty, "b588ddda-8fe4-4271-93b3-dd1beefd9138");
    }


  }
  TestPreparationEnd();

  {
    CreateTTEIFFunction("Ttvccmce9_Default_Session_Standard_Physical_Address", __eFct, __eLocal);
    CallInterfaceFunction(__cEmpty, __cEmpty, "a876afd8-79e2-4bc6-b86f-76bf44cfb774");
  }


  {
    CreateTTEIFFunction("Ttvccmce9_F186_DID_with_Standard_Physical_Address_Default_Session", __eFct, __eLocal);
    CallInterfaceFunction(__cEmpty, __cEmpty, "a35d2af3-f713-4f2b-9c1d-1a28d63eb692");
  }


  {
    CreateTTEIFFunction("Ttvccmce9_F10D_DID_with_Standard_Physical_Address", __eFct, __eLocal);
    CallInterfaceFunction(__cEmpty, __cEmpty, "c3fd3e79-2e23-4951-9da4-51c21391b6b4");
  }



}

void Ttvccmce9_Tet_Tc40_Completion()
{
  stack long __tableHandle;
  TestCompletionBegin();
  {
    {
      CreateTTEIFFunction("Ttvccmce9_General_Postconditions", __eFct, __eLocal);
      CallInterfaceFunction(__cEmpty, __cEmpty, "3d1998f6-ed4f-4d8f-9c0f-63439c24b6a7");
    }


  }
  TestCompletionEnd();
}

void Ttvccmce9_Tet_Tc41()
{
  CreateTTEIFFunction("Ttvccmce9_Tc41", __eTcDef, __eLocal);  
  AddIFParameterTestCaseAttribute("TC_ID", "");
  AddIFParameterTestCaseAttribute("Test Case ID", "");
  CallInterfaceFunction("TC_ID_20205217_Extended_Session", __cEmpty , __cEmpty );
}
testcase Ttvccmce9_Tc41()
{
  stack long __tableHandle;
  SetBreakOnFail(0);

  CreateTTEIFFunction("Ttvccmce9_Tet_Tc41_Completion", __eFct, __eLocal);
  
  AddIFAsCleanUpFunction();

  TestPreparationBegin();
  {
    {
      CreateTTEIFFunction("Ttvccmce9_General_Precondition", __eFct, __eLocal);
      CallInterfaceFunction(__cEmpty, __cEmpty, "b588ddda-8fe4-4271-93b3-dd1beefd9138");
    }


  }
  TestPreparationEnd();

  TestCommandBegin(__eDiagService, __cDiagService, "", "2");
  {
    if (DiagIsFunctionalGroup("CVADAS_0001_00000000_000"))
    {
      DiagResponse * __resp;
      DiagRequest CVADAS_0001_00000000_000.Default_Session_Start __req;
      __diagServicevccmce9_159(__req, __resp);
    }
    else
    {
      DiagResponse CVADAS_0001_00000000_000.* __resp;
      DiagRequest CVADAS_0001_00000000_000.Default_Session_Start __req;
      __diagServicevccmce9_159(__req, __resp);
    }
  }
  TestCommandEnd();


  TestCommandBegin(__eDiagService, __cDiagService, "", "3");
  {
    if (DiagIsFunctionalGroup("CVADAS_0001_00000000_000"))
    {
      DiagResponse * __resp;
      DiagRequest CVADAS_0001_00000000_000.Extended_Diagnostic_Session_Start __req;
      __diagServicevccmce9_160(__req, __resp);
    }
    else
    {
      DiagResponse CVADAS_0001_00000000_000.* __resp;
      DiagRequest CVADAS_0001_00000000_000.Extended_Diagnostic_Session_Start __req;
      __diagServicevccmce9_160(__req, __resp);
    }
  }
  TestCommandEnd();


  {
    CreateTTEIFFunction("Ttvccmce9_F186_DID_with_PhysicalAdd_ExtendedSession", __eFct, __eLocal);
    CallInterfaceFunction(__cEmpty, __cEmpty, "ef9ee47d-f468-4fc1-8d48-13fa51881535");
  }


  {
    CreateTTEIFFunction("Ttvccmce9_F10D_DID_with_Physical_Address", __eFct, __eLocal);
    CallInterfaceFunction(__cEmpty, __cEmpty, "213e855d-729b-4b1c-9780-76c928384f6d");
  }



}

  
void __diagServicevccmce9_159(DiagRequest * __req, DiagResponse * __resp )
{
  stack long __tableHandle;
  long __res, __paramLen, __bytePos;

   __bVerdict = __eVerdictPass;

  do {
    TestReportResetDiagObjectList();
    DiagSetReportDetailLevel("CVADAS_0001_00000000_000", EnumServiceDetails_onfail);
    // Request aspect
    {

      if (0 >= DiagSendReqAndWaitForResp("CVADAS_0001_00000000_000", __req, __resp, __res, -1, -1, -1, -1, -1, EnumResult_pos, EnumServiceDetails_onfail, EnumSendingMode_physical, EnumSuppressPosResBit_asconfigured, EnumVerdictOnInvalidValues_fail))
        break;
    }

    __res = DiagErrCodeTestStep(__res, "Can't retrieve last response for request! No check possible.") < 0;
    if(__res)
    {
	  __bVerdict = __eVerdictFail;
      break;
    }
    {
      __res = DiagInterpretAs(__resp, "DSC_PR");
      if(__res != 0)
      {
        __bVerdict = __eVerdictFail;
        DiagErrCodeTestStep(__res, "Can't interpret response as diagnostic primitive 'DSC_PR'.");
        break;
      }
      else
      {
        TestStepPass( "Received primitive can be interpreted as diagnostic primitive 'DSC_PR'.");
      }
    }
  }
  while(0);


  // Response, check & read aspect
  {
    __res = 1;
    __tableHandle = ReportTableHead5Columns(__cCheckCaption, __cTSym, __cTOp, __cRefVal, __cActual, __cRes);
    {
      __bDiagValueArrayCtr = DiagGetParameterErrorHandled(__resp, "DiagSessionType", __bDiagValueArray, elcount(__bDiagValueArray), __cDiagValueArray, elcount(__cDiagValueArray));
      {
        byte __bArray2[1] = { 0x01 };
        __bArrayCtr = __CopyBytes(__bDiagValueArray, __bDiagValueArrayCtr, __bArray);
        __bArrayCtr2 = elCount(__bArray2);
        __csr = CompareBytes(__bArray, __bArrayCtr, __bArray2, __bArrayCtr2) == 0;
        snprintf(__cArray, 8192, "%s", "Diagnostic parameter \'DiagSessionType\'");
        snprintf(__cArray2, 8192, "%s", __cArray);
        snprintf(__cArray3, 8192, "%s", "");
        ReportTableRow(__tableHandle, 0, __cArray2, "Bytes", __bArray2, __bArrayCtr2, __cArray3, __oneOfFlag, __bSetInCheckAlignment);
        ReportCell(__tableHandle, __bArray, __bArrayCtr);
        ReportCellResult(__tableHandle, __csr, __ePassFail);
      }
    
      __res = __res && __csr;
    
    }
    ReportTableEndVerdict(__tableHandle, __cEvaluateResponse, __res);
	__bVerdict = __bVerdict && __res;
  }
  if (__bVerdict == __eVerdictFail)
    TestReportWriteDiagObjectList();
}
  
void __diagServicevccmce9_160(DiagRequest * __req, DiagResponse * __resp )
{
  stack long __tableHandle;
  long __res, __paramLen, __bytePos;

   __bVerdict = __eVerdictPass;

  do {
    TestReportResetDiagObjectList();
    DiagSetReportDetailLevel("CVADAS_0001_00000000_000", EnumServiceDetails_onfail);
    // Request aspect
    {

      if (0 >= DiagSendReqAndWaitForResp("CVADAS_0001_00000000_000", __req, __resp, __res, -1, -1, -1, -1, -1, EnumResult_pos, EnumServiceDetails_onfail, EnumSendingMode_physical, EnumSuppressPosResBit_asconfigured, EnumVerdictOnInvalidValues_fail))
        break;
    }

    __res = DiagErrCodeTestStep(__res, "Can't retrieve last response for request! No check possible.") < 0;
    if(__res)
    {
	  __bVerdict = __eVerdictFail;
      break;
    }
    {
      __res = DiagInterpretAs(__resp, "DSC_PR");
      if(__res != 0)
      {
        __bVerdict = __eVerdictFail;
        DiagErrCodeTestStep(__res, "Can't interpret response as diagnostic primitive 'DSC_PR'.");
        break;
      }
      else
      {
        TestStepPass( "Received primitive can be interpreted as diagnostic primitive 'DSC_PR'.");
      }
    }
  }
  while(0);


  // Response, check & read aspect
  {
    __res = 1;
    __tableHandle = ReportTableHead5Columns(__cCheckCaption, __cTSym, __cTOp, __cRefVal, __cActual, __cRes);
    {
      __bDiagValueArrayCtr = DiagGetParameterErrorHandled(__resp, "DiagSessionType", __bDiagValueArray, elcount(__bDiagValueArray), __cDiagValueArray, elcount(__cDiagValueArray));
      {
        byte __bArray2[1] = { 0x03 };
        __bArrayCtr = __CopyBytes(__bDiagValueArray, __bDiagValueArrayCtr, __bArray);
        __bArrayCtr2 = elCount(__bArray2);
        __csr = CompareBytes(__bArray, __bArrayCtr, __bArray2, __bArrayCtr2) == 0;
        snprintf(__cArray, 8192, "%s", "Diagnostic parameter \'DiagSessionType\'");
        snprintf(__cArray2, 8192, "%s", __cArray);
        snprintf(__cArray3, 8192, "%s", "");
        ReportTableRow(__tableHandle, 0, __cArray2, "Bytes", __bArray2, __bArrayCtr2, __cArray3, __oneOfFlag, __bSetInCheckAlignment);
        ReportCell(__tableHandle, __bArray, __bArrayCtr);
        ReportCellResult(__tableHandle, __csr, __ePassFail);
      }
    
      __res = __res && __csr;
    
    }
    ReportTableEndVerdict(__tableHandle, __cEvaluateResponse, __res);
	__bVerdict = __bVerdict && __res;
  }
  if (__bVerdict == __eVerdictFail)
    TestReportWriteDiagObjectList();
}
void Ttvccmce9_Tet_Tc41_Completion()
{
  stack long __tableHandle;
  TestCompletionBegin();
  {
    {
      CreateTTEIFFunction("Ttvccmce9_General_Postconditions", __eFct, __eLocal);
      CallInterfaceFunction(__cEmpty, __cEmpty, "3d1998f6-ed4f-4d8f-9c0f-63439c24b6a7");
    }


  }
  TestCompletionEnd();
}

void Ttvccmce9_Tet_Tc42()
{
  CreateTTEIFFunction("Ttvccmce9_Tc42", __eTcDef, __eLocal);  
  AddIFParameterTestCaseAttribute("TC_ID", "");
  AddIFParameterTestCaseAttribute("Test Case ID", "");
  CallInterfaceFunction("TC_ID_20205220_Standard_Physical_Address", __cEmpty , __cEmpty );
}
testcase Ttvccmce9_Tc42()
{
  stack long __tableHandle;
  SetBreakOnFail(0);

  CreateTTEIFFunction("Ttvccmce9_Tet_Tc42_Completion", __eFct, __eLocal);
  
  AddIFAsCleanUpFunction();

  TestPreparationBegin();
  {
    {
      CreateTTEIFFunction("Ttvccmce9_General_Precondition", __eFct, __eLocal);
      CallInterfaceFunction(__cEmpty, __cEmpty, "b588ddda-8fe4-4271-93b3-dd1beefd9138");
    }


  }
  TestPreparationEnd();

  {
    CreateTTEIFFunction("Ttvccmce9_Default_Session_Standard_Physical_Address", __eFct, __eLocal);
    CallInterfaceFunction(__cEmpty, __cEmpty, "a876afd8-79e2-4bc6-b86f-76bf44cfb774");
  }


  {
    CreateTTEIFFunction("Ttvccmce9_Extended_Session_Standard_Physical_Address", __eFct, __eLocal);
    CallInterfaceFunction(__cEmpty, __cEmpty, "aab9c8d5-4152-43a6-9531-8599a5c4c508");
  }


  {
    CreateTTEIFFunction("Ttvccmce9_F186_DID_with_Standard_Physical_Address_Extended_Session", __eFct, __eLocal);
    CallInterfaceFunction(__cEmpty, __cEmpty, "c8044f49-226c-49c1-9a34-3c367524be30");
  }


  {
    CreateTTEIFFunction("Ttvccmce9_F10D_DID_with_Standard_Physical_Address", __eFct, __eLocal);
    CallInterfaceFunction(__cEmpty, __cEmpty, "c3fd3e79-2e23-4951-9da4-51c21391b6b4");
  }



}

void Ttvccmce9_Tet_Tc42_Completion()
{
  stack long __tableHandle;
  TestCompletionBegin();
  {
    {
      CreateTTEIFFunction("Ttvccmce9_General_Postconditions", __eFct, __eLocal);
      CallInterfaceFunction(__cEmpty, __cEmpty, "3d1998f6-ed4f-4d8f-9c0f-63439c24b6a7");
    }


  }
  TestCompletionEnd();
}

void Ttvccmce9_Tet_Tc43()
{
  CreateTTEIFFunction("Ttvccmce9_Tc43", __eTcDef, __eLocal);  
  AddIFParameterTestCaseAttribute("TC_ID", "");
  AddIFParameterTestCaseAttribute("Test Case ID", "");
  CallInterfaceFunction("TC_ID_20205164_Defaults_Session_Physical_and_Standard_Addressing", __cEmpty , __cEmpty );
}
testcase Ttvccmce9_Tc43()
{
  stack long __tableHandle;
  SetBreakOnFail(0);

  CreateTTEIFFunction("Ttvccmce9_Tet_Tc43_Completion", __eFct, __eLocal);
  
  AddIFAsCleanUpFunction();

  TestPreparationBegin();
  {
    {
      CreateTTEIFFunction("Ttvccmce9_General_Precondition", __eFct, __eLocal);
      CallInterfaceFunction(__cEmpty, __cEmpty, "b588ddda-8fe4-4271-93b3-dd1beefd9138");
    }


  }
  TestPreparationEnd();

  TestCommandBegin(__eDiagService, __cDiagService, "", "2");
  {
    if (DiagIsFunctionalGroup("CVADAS_0001_00000000_000"))
    {
      DiagResponse * __resp;
      DiagRequest CVADAS_0001_00000000_000.Default_Session_Start __req;
      __diagServicevccmce9_161(__req, __resp);
    }
    else
    {
      DiagResponse CVADAS_0001_00000000_000.* __resp;
      DiagRequest CVADAS_0001_00000000_000.Default_Session_Start __req;
      __diagServicevccmce9_161(__req, __resp);
    }
  }
  TestCommandEnd();


  {
    CreateTTEIFFunction("Ttvccmce9_F186_DID_with_PhysicalAdd_DefaultSession", __eFct, __eLocal);
    CallInterfaceFunction(__cEmpty, __cEmpty, "94cfa590-eac0-4499-adc5-5b1a2141e3ff");
  }


  TestCommandBegin(__eWait, __cWait, "", "5");
  {
    Wait("1", (2000 * 1000000LL), 1000000, "");
  }
  TestCommandEnd();

  {
    CreateTTEIFFunction("Ttvccmce9_F122_DID_with_Physical_Address", __eFct, __eLocal);
    CallInterfaceFunction(__cEmpty, __cEmpty, "07c8543d-92fc-4e6a-9e5e-cdfb76dec484");
  }



}

  
void __diagServicevccmce9_161(DiagRequest * __req, DiagResponse * __resp )
{
  stack long __tableHandle;
  long __res, __paramLen, __bytePos;

   __bVerdict = __eVerdictPass;

  do {
    TestReportResetDiagObjectList();
    DiagSetReportDetailLevel("CVADAS_0001_00000000_000", EnumServiceDetails_onfail);
    // Request aspect
    {

      if (0 >= DiagSendReqAndWaitForResp("CVADAS_0001_00000000_000", __req, __resp, __res, -1, -1, -1, -1, -1, EnumResult_pos, EnumServiceDetails_onfail, EnumSendingMode_physical, EnumSuppressPosResBit_asconfigured, EnumVerdictOnInvalidValues_fail))
        break;
    }

    __res = DiagErrCodeTestStep(__res, "Can't retrieve last response for request! No check possible.") < 0;
    if(__res)
    {
	  __bVerdict = __eVerdictFail;
      break;
    }
    {
      __res = DiagInterpretAs(__resp, "DSC_PR");
      if(__res != 0)
      {
        __bVerdict = __eVerdictFail;
        DiagErrCodeTestStep(__res, "Can't interpret response as diagnostic primitive 'DSC_PR'.");
        break;
      }
      else
      {
        TestStepPass( "Received primitive can be interpreted as diagnostic primitive 'DSC_PR'.");
      }
    }
  }
  while(0);


  // Response, check & read aspect
  {
    __res = 1;
    __tableHandle = ReportTableHead5Columns(__cCheckCaption, __cTSym, __cTOp, __cRefVal, __cActual, __cRes);
    {
      __bDiagValueArrayCtr = DiagGetParameterErrorHandled(__resp, "DiagSessionType", __bDiagValueArray, elcount(__bDiagValueArray), __cDiagValueArray, elcount(__cDiagValueArray));
      {
        byte __bArray2[1] = { 0x01 };
        __bArrayCtr = __CopyBytes(__bDiagValueArray, __bDiagValueArrayCtr, __bArray);
        __bArrayCtr2 = elCount(__bArray2);
        __csr = CompareBytes(__bArray, __bArrayCtr, __bArray2, __bArrayCtr2) == 0;
        snprintf(__cArray, 8192, "%s", "Diagnostic parameter \'DiagSessionType\'");
        snprintf(__cArray2, 8192, "%s", __cArray);
        snprintf(__cArray3, 8192, "%s", "");
        ReportTableRow(__tableHandle, 0, __cArray2, "Bytes", __bArray2, __bArrayCtr2, __cArray3, __oneOfFlag, __bSetInCheckAlignment);
        ReportCell(__tableHandle, __bArray, __bArrayCtr);
        ReportCellResult(__tableHandle, __csr, __ePassFail);
      }
    
      __res = __res && __csr;
    
    }
    ReportTableEndVerdict(__tableHandle, __cEvaluateResponse, __res);
	__bVerdict = __bVerdict && __res;
  }
  if (__bVerdict == __eVerdictFail)
    TestReportWriteDiagObjectList();
}
void Ttvccmce9_Tet_Tc43_Completion()
{
  stack long __tableHandle;
  TestCompletionBegin();
  {
    {
      CreateTTEIFFunction("Ttvccmce9_General_Postconditions", __eFct, __eLocal);
      CallInterfaceFunction(__cEmpty, __cEmpty, "3d1998f6-ed4f-4d8f-9c0f-63439c24b6a7");
    }


  }
  TestCompletionEnd();
}

void Ttvccmce9_Tet_Tc44()
{
  CreateTTEIFFunction("Ttvccmce9_Tc44", __eTcDef, __eLocal);  
  AddIFParameterTestCaseAttribute("TC_ID", "");
  AddIFParameterTestCaseAttribute("Test Case ID", "");
  CallInterfaceFunction("TC_ID_20205173_Extended_Session_Physical_and_Standard_Addressing", __cEmpty , __cEmpty );
}
testcase Ttvccmce9_Tc44()
{
  stack long __tableHandle;
  SetBreakOnFail(0);

  CreateTTEIFFunction("Ttvccmce9_Tet_Tc44_Completion", __eFct, __eLocal);
  
  AddIFAsCleanUpFunction();

  TestPreparationBegin();
  {
    {
      CreateTTEIFFunction("Ttvccmce9_General_Precondition", __eFct, __eLocal);
      CallInterfaceFunction(__cEmpty, __cEmpty, "b588ddda-8fe4-4271-93b3-dd1beefd9138");
    }


  }
  TestPreparationEnd();

  TestCommandBegin(__eDiagService, __cDiagService, "", "2");
  {
    if (DiagIsFunctionalGroup("CVADAS_0001_00000000_000"))
    {
      DiagResponse * __resp;
      DiagRequest CVADAS_0001_00000000_000.Default_Session_Start __req;
      __diagServicevccmce9_162(__req, __resp);
    }
    else
    {
      DiagResponse CVADAS_0001_00000000_000.* __resp;
      DiagRequest CVADAS_0001_00000000_000.Default_Session_Start __req;
      __diagServicevccmce9_162(__req, __resp);
    }
  }
  TestCommandEnd();


  TestCommandBegin(__eDiagService, __cDiagService, "", "3");
  {
    if (DiagIsFunctionalGroup("CVADAS_0001_00000000_000"))
    {
      DiagResponse * __resp;
      DiagRequest CVADAS_0001_00000000_000.Extended_Diagnostic_Session_Start __req;
      __diagServicevccmce9_163(__req, __resp);
    }
    else
    {
      DiagResponse CVADAS_0001_00000000_000.* __resp;
      DiagRequest CVADAS_0001_00000000_000.Extended_Diagnostic_Session_Start __req;
      __diagServicevccmce9_163(__req, __resp);
    }
  }
  TestCommandEnd();


  {
    CreateTTEIFFunction("Ttvccmce9_F186_DID_with_PhysicalAdd_ExtendedSession", __eFct, __eLocal);
    CallInterfaceFunction(__cEmpty, __cEmpty, "ef9ee47d-f468-4fc1-8d48-13fa51881535");
  }


  {
    CreateTTEIFFunction("Ttvccmce9_F122_DID_with_Physical_Address", __eFct, __eLocal);
    CallInterfaceFunction(__cEmpty, __cEmpty, "07c8543d-92fc-4e6a-9e5e-cdfb76dec484");
  }



}

  
void __diagServicevccmce9_162(DiagRequest * __req, DiagResponse * __resp )
{
  stack long __tableHandle;
  long __res, __paramLen, __bytePos;

   __bVerdict = __eVerdictPass;

  do {
    TestReportResetDiagObjectList();
    DiagSetReportDetailLevel("CVADAS_0001_00000000_000", EnumServiceDetails_onfail);
    // Request aspect
    {

      if (0 >= DiagSendReqAndWaitForResp("CVADAS_0001_00000000_000", __req, __resp, __res, -1, -1, -1, -1, -1, EnumResult_pos, EnumServiceDetails_onfail, EnumSendingMode_physical, EnumSuppressPosResBit_asconfigured, EnumVerdictOnInvalidValues_fail))
        break;
    }

    __res = DiagErrCodeTestStep(__res, "Can't retrieve last response for request! No check possible.") < 0;
    if(__res)
    {
	  __bVerdict = __eVerdictFail;
      break;
    }
    {
      __res = DiagInterpretAs(__resp, "DSC_PR");
      if(__res != 0)
      {
        __bVerdict = __eVerdictFail;
        DiagErrCodeTestStep(__res, "Can't interpret response as diagnostic primitive 'DSC_PR'.");
        break;
      }
      else
      {
        TestStepPass( "Received primitive can be interpreted as diagnostic primitive 'DSC_PR'.");
      }
    }
  }
  while(0);


  // Response, check & read aspect
  {
    __res = 1;
    __tableHandle = ReportTableHead5Columns(__cCheckCaption, __cTSym, __cTOp, __cRefVal, __cActual, __cRes);
    {
      __bDiagValueArrayCtr = DiagGetParameterErrorHandled(__resp, "DiagSessionType", __bDiagValueArray, elcount(__bDiagValueArray), __cDiagValueArray, elcount(__cDiagValueArray));
      {
        byte __bArray2[1] = { 0x01 };
        __bArrayCtr = __CopyBytes(__bDiagValueArray, __bDiagValueArrayCtr, __bArray);
        __bArrayCtr2 = elCount(__bArray2);
        __csr = CompareBytes(__bArray, __bArrayCtr, __bArray2, __bArrayCtr2) == 0;
        snprintf(__cArray, 8192, "%s", "Diagnostic parameter \'DiagSessionType\'");
        snprintf(__cArray2, 8192, "%s", __cArray);
        snprintf(__cArray3, 8192, "%s", "");
        ReportTableRow(__tableHandle, 0, __cArray2, "Bytes", __bArray2, __bArrayCtr2, __cArray3, __oneOfFlag, __bSetInCheckAlignment);
        ReportCell(__tableHandle, __bArray, __bArrayCtr);
        ReportCellResult(__tableHandle, __csr, __ePassFail);
      }
    
      __res = __res && __csr;
    
    }
    ReportTableEndVerdict(__tableHandle, __cEvaluateResponse, __res);
	__bVerdict = __bVerdict && __res;
  }
  if (__bVerdict == __eVerdictFail)
    TestReportWriteDiagObjectList();
}
  
void __diagServicevccmce9_163(DiagRequest * __req, DiagResponse * __resp )
{
  stack long __tableHandle;
  long __res, __paramLen, __bytePos;

   __bVerdict = __eVerdictPass;

  do {
    TestReportResetDiagObjectList();
    DiagSetReportDetailLevel("CVADAS_0001_00000000_000", EnumServiceDetails_onfail);
    // Request aspect
    {

      if (0 >= DiagSendReqAndWaitForResp("CVADAS_0001_00000000_000", __req, __resp, __res, -1, -1, -1, -1, -1, EnumResult_pos, EnumServiceDetails_onfail, EnumSendingMode_physical, EnumSuppressPosResBit_asconfigured, EnumVerdictOnInvalidValues_fail))
        break;
    }

    __res = DiagErrCodeTestStep(__res, "Can't retrieve last response for request! No check possible.") < 0;
    if(__res)
    {
	  __bVerdict = __eVerdictFail;
      break;
    }
    {
      __res = DiagInterpretAs(__resp, "DSC_PR");
      if(__res != 0)
      {
        __bVerdict = __eVerdictFail;
        DiagErrCodeTestStep(__res, "Can't interpret response as diagnostic primitive 'DSC_PR'.");
        break;
      }
      else
      {
        TestStepPass( "Received primitive can be interpreted as diagnostic primitive 'DSC_PR'.");
      }
    }
  }
  while(0);


  // Response, check & read aspect
  {
    __res = 1;
    __tableHandle = ReportTableHead5Columns(__cCheckCaption, __cTSym, __cTOp, __cRefVal, __cActual, __cRes);
    {
      __bDiagValueArrayCtr = DiagGetParameterErrorHandled(__resp, "DiagSessionType", __bDiagValueArray, elcount(__bDiagValueArray), __cDiagValueArray, elcount(__cDiagValueArray));
      {
        byte __bArray2[1] = { 0x03 };
        __bArrayCtr = __CopyBytes(__bDiagValueArray, __bDiagValueArrayCtr, __bArray);
        __bArrayCtr2 = elCount(__bArray2);
        __csr = CompareBytes(__bArray, __bArrayCtr, __bArray2, __bArrayCtr2) == 0;
        snprintf(__cArray, 8192, "%s", "Diagnostic parameter \'DiagSessionType\'");
        snprintf(__cArray2, 8192, "%s", __cArray);
        snprintf(__cArray3, 8192, "%s", "");
        ReportTableRow(__tableHandle, 0, __cArray2, "Bytes", __bArray2, __bArrayCtr2, __cArray3, __oneOfFlag, __bSetInCheckAlignment);
        ReportCell(__tableHandle, __bArray, __bArrayCtr);
        ReportCellResult(__tableHandle, __csr, __ePassFail);
      }
    
      __res = __res && __csr;
    
    }
    ReportTableEndVerdict(__tableHandle, __cEvaluateResponse, __res);
	__bVerdict = __bVerdict && __res;
  }
  if (__bVerdict == __eVerdictFail)
    TestReportWriteDiagObjectList();
}
void Ttvccmce9_Tet_Tc44_Completion()
{
  stack long __tableHandle;
  TestCompletionBegin();
  {
    {
      CreateTTEIFFunction("Ttvccmce9_General_Postconditions", __eFct, __eLocal);
      CallInterfaceFunction(__cEmpty, __cEmpty, "3d1998f6-ed4f-4d8f-9c0f-63439c24b6a7");
    }


  }
  TestCompletionEnd();
}

void Ttvccmce9_Tet_Tc45()
{
  CreateTTEIFFunction("Ttvccmce9_Tc45", __eTcDef, __eLocal);  
  AddIFParameterTestCaseAttribute("TC_ID", "");
  AddIFParameterTestCaseAttribute("Test Case ID", "");
  CallInterfaceFunction("TC_ID_20205104_Defaults_Session", __cEmpty , __cEmpty );
}
testcase Ttvccmce9_Tc45()
{
  stack long __tableHandle;
  SetBreakOnFail(0);

  CreateTTEIFFunction("Ttvccmce9_Tet_Tc45_Completion", __eFct, __eLocal);
  
  AddIFAsCleanUpFunction();

  TestPreparationBegin();
  {
    {
      CreateTTEIFFunction("Ttvccmce9_General_Precondition", __eFct, __eLocal);
      CallInterfaceFunction(__cEmpty, __cEmpty, "b588ddda-8fe4-4271-93b3-dd1beefd9138");
    }


  }
  TestPreparationEnd();

  TestCommandBegin(__eDiagService, __cDiagService, "", "2");
  {
    if (DiagIsFunctionalGroup("CVADAS_0001_00000000_000"))
    {
      DiagResponse * __resp;
      DiagRequest CVADAS_0001_00000000_000.Default_Session_Start __req;
      __diagServicevccmce9_164(__req, __resp);
    }
    else
    {
      DiagResponse CVADAS_0001_00000000_000.* __resp;
      DiagRequest CVADAS_0001_00000000_000.Default_Session_Start __req;
      __diagServicevccmce9_164(__req, __resp);
    }
  }
  TestCommandEnd();


  {
    CreateTTEIFFunction("Ttvccmce9_F186_DID_with_PhysicalAdd_DefaultSession", __eFct, __eLocal);
    CallInterfaceFunction(__cEmpty, __cEmpty, "94cfa590-eac0-4499-adc5-5b1a2141e3ff");
  }


  TestCommandBegin(__eWait, __cWait, "", "4");
  {
    Wait("1", (2000 * 1000000LL), 1000000, "");
  }
  TestCommandEnd();

  {
    CreateTTEIFFunction("Ttvccmce9_F181_DID_with_Physical_Address", __eFct, __eLocal);
    CallInterfaceFunction(__cEmpty, __cEmpty, "711cdfa6-eef7-4424-b044-15ae5a2c8a12");
  }



}

  
void __diagServicevccmce9_164(DiagRequest * __req, DiagResponse * __resp )
{
  stack long __tableHandle;
  long __res, __paramLen, __bytePos;

   __bVerdict = __eVerdictPass;

  do {
    TestReportResetDiagObjectList();
    DiagSetReportDetailLevel("CVADAS_0001_00000000_000", EnumServiceDetails_onfail);
    // Request aspect
    {

      if (0 >= DiagSendReqAndWaitForResp("CVADAS_0001_00000000_000", __req, __resp, __res, -1, -1, -1, -1, -1, EnumResult_pos, EnumServiceDetails_onfail, EnumSendingMode_physical, EnumSuppressPosResBit_asconfigured, EnumVerdictOnInvalidValues_fail))
        break;
    }

    __res = DiagErrCodeTestStep(__res, "Can't retrieve last response for request! No check possible.") < 0;
    if(__res)
    {
	  __bVerdict = __eVerdictFail;
      break;
    }
    {
      __res = DiagInterpretAs(__resp, "DSC_PR");
      if(__res != 0)
      {
        __bVerdict = __eVerdictFail;
        DiagErrCodeTestStep(__res, "Can't interpret response as diagnostic primitive 'DSC_PR'.");
        break;
      }
      else
      {
        TestStepPass( "Received primitive can be interpreted as diagnostic primitive 'DSC_PR'.");
      }
    }
  }
  while(0);


  // Response, check & read aspect
  {
    __res = 1;
    __tableHandle = ReportTableHead5Columns(__cCheckCaption, __cTSym, __cTOp, __cRefVal, __cActual, __cRes);
    {
      __bDiagValueArrayCtr = DiagGetParameterErrorHandled(__resp, "DiagSessionType", __bDiagValueArray, elcount(__bDiagValueArray), __cDiagValueArray, elcount(__cDiagValueArray));
      {
        byte __bArray2[1] = { 0x01 };
        __bArrayCtr = __CopyBytes(__bDiagValueArray, __bDiagValueArrayCtr, __bArray);
        __bArrayCtr2 = elCount(__bArray2);
        __csr = CompareBytes(__bArray, __bArrayCtr, __bArray2, __bArrayCtr2) == 0;
        snprintf(__cArray, 8192, "%s", "Diagnostic parameter \'DiagSessionType\'");
        snprintf(__cArray2, 8192, "%s", __cArray);
        snprintf(__cArray3, 8192, "%s", "");
        ReportTableRow(__tableHandle, 0, __cArray2, "Bytes", __bArray2, __bArrayCtr2, __cArray3, __oneOfFlag, __bSetInCheckAlignment);
        ReportCell(__tableHandle, __bArray, __bArrayCtr);
        ReportCellResult(__tableHandle, __csr, __ePassFail);
      }
    
      __res = __res && __csr;
    
    }
    ReportTableEndVerdict(__tableHandle, __cEvaluateResponse, __res);
	__bVerdict = __bVerdict && __res;
  }
  if (__bVerdict == __eVerdictFail)
    TestReportWriteDiagObjectList();
}
void Ttvccmce9_Tet_Tc45_Completion()
{
  stack long __tableHandle;
  TestCompletionBegin();
  {
    {
      CreateTTEIFFunction("Ttvccmce9_General_Postconditions", __eFct, __eLocal);
      CallInterfaceFunction(__cEmpty, __cEmpty, "3d1998f6-ed4f-4d8f-9c0f-63439c24b6a7");
    }


  }
  TestCompletionEnd();
}

void Ttvccmce9_Tet_Tc46()
{
  CreateTTEIFFunction("Ttvccmce9_Tc46", __eTcDef, __eLocal);  
  AddIFParameterTestCaseAttribute("TC_ID", "");
  AddIFParameterTestCaseAttribute("Test Case ID", "");
  CallInterfaceFunction("TC_ID_20205111_Extended_Session", __cEmpty , __cEmpty );
}
testcase Ttvccmce9_Tc46()
{
  stack long __tableHandle;
  SetBreakOnFail(0);

  CreateTTEIFFunction("Ttvccmce9_Tet_Tc46_Completion", __eFct, __eLocal);
  
  AddIFAsCleanUpFunction();

  TestPreparationBegin();
  {
    {
      CreateTTEIFFunction("Ttvccmce9_General_Precondition", __eFct, __eLocal);
      CallInterfaceFunction(__cEmpty, __cEmpty, "b588ddda-8fe4-4271-93b3-dd1beefd9138");
    }


  }
  TestPreparationEnd();

  TestCommandBegin(__eDiagService, __cDiagService, "", "2");
  {
    if (DiagIsFunctionalGroup("CVADAS_0001_00000000_000"))
    {
      DiagResponse * __resp;
      DiagRequest CVADAS_0001_00000000_000.Default_Session_Start __req;
      __diagServicevccmce9_165(__req, __resp);
    }
    else
    {
      DiagResponse CVADAS_0001_00000000_000.* __resp;
      DiagRequest CVADAS_0001_00000000_000.Default_Session_Start __req;
      __diagServicevccmce9_165(__req, __resp);
    }
  }
  TestCommandEnd();


  TestCommandBegin(__eDiagService, __cDiagService, "", "3");
  {
    if (DiagIsFunctionalGroup("CVADAS_0001_00000000_000"))
    {
      DiagResponse * __resp;
      DiagRequest CVADAS_0001_00000000_000.Extended_Diagnostic_Session_Start __req;
      __diagServicevccmce9_166(__req, __resp);
    }
    else
    {
      DiagResponse CVADAS_0001_00000000_000.* __resp;
      DiagRequest CVADAS_0001_00000000_000.Extended_Diagnostic_Session_Start __req;
      __diagServicevccmce9_166(__req, __resp);
    }
  }
  TestCommandEnd();


  {
    CreateTTEIFFunction("Ttvccmce9_F186_DID_with_PhysicalAdd_ExtendedSession", __eFct, __eLocal);
    CallInterfaceFunction(__cEmpty, __cEmpty, "ef9ee47d-f468-4fc1-8d48-13fa51881535");
  }


  TestCommandBegin(__eWait, __cWait, "", "5");
  {
    Wait("1", (2000 * 1000000LL), 1000000, "");
  }
  TestCommandEnd();

  {
    CreateTTEIFFunction("Ttvccmce9_F181_DID_with_Physical_Address", __eFct, __eLocal);
    CallInterfaceFunction(__cEmpty, __cEmpty, "711cdfa6-eef7-4424-b044-15ae5a2c8a12");
  }



}

  
void __diagServicevccmce9_165(DiagRequest * __req, DiagResponse * __resp )
{
  stack long __tableHandle;
  long __res, __paramLen, __bytePos;

   __bVerdict = __eVerdictPass;

  do {
    TestReportResetDiagObjectList();
    DiagSetReportDetailLevel("CVADAS_0001_00000000_000", EnumServiceDetails_onfail);
    // Request aspect
    {

      if (0 >= DiagSendReqAndWaitForResp("CVADAS_0001_00000000_000", __req, __resp, __res, -1, -1, -1, -1, -1, EnumResult_pos, EnumServiceDetails_onfail, EnumSendingMode_physical, EnumSuppressPosResBit_asconfigured, EnumVerdictOnInvalidValues_fail))
        break;
    }

    __res = DiagErrCodeTestStep(__res, "Can't retrieve last response for request! No check possible.") < 0;
    if(__res)
    {
	  __bVerdict = __eVerdictFail;
      break;
    }
    {
      __res = DiagInterpretAs(__resp, "DSC_PR");
      if(__res != 0)
      {
        __bVerdict = __eVerdictFail;
        DiagErrCodeTestStep(__res, "Can't interpret response as diagnostic primitive 'DSC_PR'.");
        break;
      }
      else
      {
        TestStepPass( "Received primitive can be interpreted as diagnostic primitive 'DSC_PR'.");
      }
    }
  }
  while(0);


  // Response, check & read aspect
  {
    __res = 1;
    __tableHandle = ReportTableHead5Columns(__cCheckCaption, __cTSym, __cTOp, __cRefVal, __cActual, __cRes);
    {
      __bDiagValueArrayCtr = DiagGetParameterErrorHandled(__resp, "DiagSessionType", __bDiagValueArray, elcount(__bDiagValueArray), __cDiagValueArray, elcount(__cDiagValueArray));
      {
        byte __bArray2[1] = { 0x01 };
        __bArrayCtr = __CopyBytes(__bDiagValueArray, __bDiagValueArrayCtr, __bArray);
        __bArrayCtr2 = elCount(__bArray2);
        __csr = CompareBytes(__bArray, __bArrayCtr, __bArray2, __bArrayCtr2) == 0;
        snprintf(__cArray, 8192, "%s", "Diagnostic parameter \'DiagSessionType\'");
        snprintf(__cArray2, 8192, "%s", __cArray);
        snprintf(__cArray3, 8192, "%s", "");
        ReportTableRow(__tableHandle, 0, __cArray2, "Bytes", __bArray2, __bArrayCtr2, __cArray3, __oneOfFlag, __bSetInCheckAlignment);
        ReportCell(__tableHandle, __bArray, __bArrayCtr);
        ReportCellResult(__tableHandle, __csr, __ePassFail);
      }
    
      __res = __res && __csr;
    
    }
    ReportTableEndVerdict(__tableHandle, __cEvaluateResponse, __res);
	__bVerdict = __bVerdict && __res;
  }
  if (__bVerdict == __eVerdictFail)
    TestReportWriteDiagObjectList();
}
  
void __diagServicevccmce9_166(DiagRequest * __req, DiagResponse * __resp )
{
  stack long __tableHandle;
  long __res, __paramLen, __bytePos;

   __bVerdict = __eVerdictPass;

  do {
    TestReportResetDiagObjectList();
    DiagSetReportDetailLevel("CVADAS_0001_00000000_000", EnumServiceDetails_onfail);
    // Request aspect
    {

      if (0 >= DiagSendReqAndWaitForResp("CVADAS_0001_00000000_000", __req, __resp, __res, -1, -1, -1, -1, -1, EnumResult_pos, EnumServiceDetails_onfail, EnumSendingMode_physical, EnumSuppressPosResBit_asconfigured, EnumVerdictOnInvalidValues_fail))
        break;
    }

    __res = DiagErrCodeTestStep(__res, "Can't retrieve last response for request! No check possible.") < 0;
    if(__res)
    {
	  __bVerdict = __eVerdictFail;
      break;
    }
    {
      __res = DiagInterpretAs(__resp, "DSC_PR");
      if(__res != 0)
      {
        __bVerdict = __eVerdictFail;
        DiagErrCodeTestStep(__res, "Can't interpret response as diagnostic primitive 'DSC_PR'.");
        break;
      }
      else
      {
        TestStepPass( "Received primitive can be interpreted as diagnostic primitive 'DSC_PR'.");
      }
    }
  }
  while(0);


  // Response, check & read aspect
  {
    __res = 1;
    __tableHandle = ReportTableHead5Columns(__cCheckCaption, __cTSym, __cTOp, __cRefVal, __cActual, __cRes);
    {
      __bDiagValueArrayCtr = DiagGetParameterErrorHandled(__resp, "DiagSessionType", __bDiagValueArray, elcount(__bDiagValueArray), __cDiagValueArray, elcount(__cDiagValueArray));
      {
        byte __bArray2[1] = { 0x03 };
        __bArrayCtr = __CopyBytes(__bDiagValueArray, __bDiagValueArrayCtr, __bArray);
        __bArrayCtr2 = elCount(__bArray2);
        __csr = CompareBytes(__bArray, __bArrayCtr, __bArray2, __bArrayCtr2) == 0;
        snprintf(__cArray, 8192, "%s", "Diagnostic parameter \'DiagSessionType\'");
        snprintf(__cArray2, 8192, "%s", __cArray);
        snprintf(__cArray3, 8192, "%s", "");
        ReportTableRow(__tableHandle, 0, __cArray2, "Bytes", __bArray2, __bArrayCtr2, __cArray3, __oneOfFlag, __bSetInCheckAlignment);
        ReportCell(__tableHandle, __bArray, __bArrayCtr);
        ReportCellResult(__tableHandle, __csr, __ePassFail);
      }
    
      __res = __res && __csr;
    
    }
    ReportTableEndVerdict(__tableHandle, __cEvaluateResponse, __res);
	__bVerdict = __bVerdict && __res;
  }
  if (__bVerdict == __eVerdictFail)
    TestReportWriteDiagObjectList();
}
void Ttvccmce9_Tet_Tc46_Completion()
{
  stack long __tableHandle;
  TestCompletionBegin();
  {
    {
      CreateTTEIFFunction("Ttvccmce9_General_Postconditions", __eFct, __eLocal);
      CallInterfaceFunction(__cEmpty, __cEmpty, "3d1998f6-ed4f-4d8f-9c0f-63439c24b6a7");
    }


  }
  TestCompletionEnd();
}

void Ttvccmce9_Tet_Tc47()
{
  CreateTTEIFFunction("Ttvccmce9_Tc47", __eTcDef, __eLocal);  
  AddIFParameterTestCaseAttribute("TC_ID", "");
  AddIFParameterTestCaseAttribute("Test Case ID", "");
  CallInterfaceFunction("TC_ID_20205127_Standard_Physical_Address", __cEmpty , __cEmpty );
}
testcase Ttvccmce9_Tc47()
{
  stack long __tableHandle;
  SetBreakOnFail(0);

  CreateTTEIFFunction("Ttvccmce9_Tet_Tc47_Completion", __eFct, __eLocal);
  
  AddIFAsCleanUpFunction();

  TestPreparationBegin();
  {
    {
      CreateTTEIFFunction("Ttvccmce9_General_Precondition", __eFct, __eLocal);
      CallInterfaceFunction(__cEmpty, __cEmpty, "b588ddda-8fe4-4271-93b3-dd1beefd9138");
    }


  }
  TestPreparationEnd();

  {
    CreateTTEIFFunction("Ttvccmce9_Default_Session_Standard_Physical_Address", __eFct, __eLocal);
    CallInterfaceFunction(__cEmpty, __cEmpty, "a876afd8-79e2-4bc6-b86f-76bf44cfb774");
  }


  {
    CreateTTEIFFunction("Ttvccmce9_F186_DID_with_Standard_Physical_Address_Default_Session", __eFct, __eLocal);
    CallInterfaceFunction(__cEmpty, __cEmpty, "a35d2af3-f713-4f2b-9c1d-1a28d63eb692");
  }


  {
    CreateTTEIFFunction("Ttvccmce9_F181_DID_with_Standard_Physical_Address", __eFct, __eLocal);
    CallInterfaceFunction(__cEmpty, __cEmpty, "34feca23-01e0-40f0-a2f1-71f97871218e");
  }



}

void Ttvccmce9_Tet_Tc47_Completion()
{
  stack long __tableHandle;
  TestCompletionBegin();
  {
    {
      CreateTTEIFFunction("Ttvccmce9_General_Postconditions", __eFct, __eLocal);
      CallInterfaceFunction(__cEmpty, __cEmpty, "3d1998f6-ed4f-4d8f-9c0f-63439c24b6a7");
    }


  }
  TestCompletionEnd();
}

void Ttvccmce9_Tet_Tc48()
{
  CreateTTEIFFunction("Ttvccmce9_Tc48", __eTcDef, __eLocal);  
  AddIFParameterTestCaseAttribute("TC_ID", "");
  AddIFParameterTestCaseAttribute("Test Case ID", "");
  CallInterfaceFunction("TC_ID_20205076_Standard_Physical_Address", __cEmpty , __cEmpty );
}
testcase Ttvccmce9_Tc48()
{
  stack long __tableHandle;
  SetBreakOnFail(0);

  CreateTTEIFFunction("Ttvccmce9_Tet_Tc48_Completion", __eFct, __eLocal);
  
  AddIFAsCleanUpFunction();

  TestPreparationBegin();
  {
    {
      CreateTTEIFFunction("Ttvccmce9_General_Precondition", __eFct, __eLocal);
      CallInterfaceFunction(__cEmpty, __cEmpty, "b588ddda-8fe4-4271-93b3-dd1beefd9138");
    }


  }
  TestPreparationEnd();

  {
    CreateTTEIFFunction("Ttvccmce9_Default_Session_Standard_Physical_Address", __eFct, __eLocal);
    CallInterfaceFunction(__cEmpty, __cEmpty, "a876afd8-79e2-4bc6-b86f-76bf44cfb774");
  }


  {
    CreateTTEIFFunction("Ttvccmce9_Extended_Session_Standard_Physical_Address", __eFct, __eLocal);
    CallInterfaceFunction(__cEmpty, __cEmpty, "aab9c8d5-4152-43a6-9531-8599a5c4c508");
  }


  {
    CreateTTEIFFunction("Ttvccmce9_F186_DID_with_Standard_Physical_Address_Extended_Session", __eFct, __eLocal);
    CallInterfaceFunction(__cEmpty, __cEmpty, "c8044f49-226c-49c1-9a34-3c367524be30");
  }


  {
    CreateTTEIFFunction("Ttvccmce9_F181_DID_with_Standard_Physical_Address", __eFct, __eLocal);
    CallInterfaceFunction(__cEmpty, __cEmpty, "34feca23-01e0-40f0-a2f1-71f97871218e");
  }



}

void Ttvccmce9_Tet_Tc48_Completion()
{
  stack long __tableHandle;
  TestCompletionBegin();
  {
    {
      CreateTTEIFFunction("Ttvccmce9_General_Postconditions", __eFct, __eLocal);
      CallInterfaceFunction(__cEmpty, __cEmpty, "3d1998f6-ed4f-4d8f-9c0f-63439c24b6a7");
    }


  }
  TestCompletionEnd();
}

void Ttvccmce9_Tet_Tc49()
{
  CreateTTEIFFunction("Ttvccmce9_Tc49", __eTcDef, __eLocal);  
  AddIFParameterTestCaseAttribute("TC_ID", "");
  AddIFParameterTestCaseAttribute("Test Case ID", "");
  CallInterfaceFunction("TC_ID_20205284_Defaults_Session", __cEmpty , __cEmpty );
}
testcase Ttvccmce9_Tc49()
{
  stack long __tableHandle;
  SetBreakOnFail(0);

  CreateTTEIFFunction("Ttvccmce9_Tet_Tc49_Completion", __eFct, __eLocal);
  
  AddIFAsCleanUpFunction();

  TestPreparationBegin();
  {
    {
      CreateTTEIFFunction("Ttvccmce9_General_Precondition", __eFct, __eLocal);
      CallInterfaceFunction(__cEmpty, __cEmpty, "b588ddda-8fe4-4271-93b3-dd1beefd9138");
    }


  }
  TestPreparationEnd();

  TestCommandBegin(__eDiagService, __cDiagService, "", "2");
  {
    if (DiagIsFunctionalGroup("CVADAS_0001_00000000_000"))
    {
      DiagResponse * __resp;
      DiagRequest CVADAS_0001_00000000_000.Default_Session_Start __req;
      __diagServicevccmce9_167(__req, __resp);
    }
    else
    {
      DiagResponse CVADAS_0001_00000000_000.* __resp;
      DiagRequest CVADAS_0001_00000000_000.Default_Session_Start __req;
      __diagServicevccmce9_167(__req, __resp);
    }
  }
  TestCommandEnd();


  {
    CreateTTEIFFunction("Ttvccmce9_F186_DID_with_PhysicalAdd_DefaultSession", __eFct, __eLocal);
    CallInterfaceFunction(__cEmpty, __cEmpty, "94cfa590-eac0-4499-adc5-5b1a2141e3ff");
  }


  {
    CreateTTEIFFunction("Ttvccmce9_F182_DID_with_Physical_Address", __eFct, __eLocal);
    CallInterfaceFunction(__cEmpty, __cEmpty, "7311c37f-5552-4af9-8a6b-1fac266ca7e7");
  }



}

  
void __diagServicevccmce9_167(DiagRequest * __req, DiagResponse * __resp )
{
  stack long __tableHandle;
  long __res, __paramLen, __bytePos;

   __bVerdict = __eVerdictPass;

  do {
    TestReportResetDiagObjectList();
    DiagSetReportDetailLevel("CVADAS_0001_00000000_000", EnumServiceDetails_onfail);
    // Request aspect
    {

      if (0 >= DiagSendReqAndWaitForResp("CVADAS_0001_00000000_000", __req, __resp, __res, -1, -1, -1, -1, -1, EnumResult_pos, EnumServiceDetails_onfail, EnumSendingMode_physical, EnumSuppressPosResBit_asconfigured, EnumVerdictOnInvalidValues_fail))
        break;
    }

    __res = DiagErrCodeTestStep(__res, "Can't retrieve last response for request! No check possible.") < 0;
    if(__res)
    {
	  __bVerdict = __eVerdictFail;
      break;
    }
    {
      __res = DiagInterpretAs(__resp, "DSC_PR");
      if(__res != 0)
      {
        __bVerdict = __eVerdictFail;
        DiagErrCodeTestStep(__res, "Can't interpret response as diagnostic primitive 'DSC_PR'.");
        break;
      }
      else
      {
        TestStepPass( "Received primitive can be interpreted as diagnostic primitive 'DSC_PR'.");
      }
    }
  }
  while(0);


  // Response, check & read aspect
  {
    __res = 1;
    __tableHandle = ReportTableHead5Columns(__cCheckCaption, __cTSym, __cTOp, __cRefVal, __cActual, __cRes);
    {
      __bDiagValueArrayCtr = DiagGetParameterErrorHandled(__resp, "DiagSessionType", __bDiagValueArray, elcount(__bDiagValueArray), __cDiagValueArray, elcount(__cDiagValueArray));
      {
        byte __bArray2[1] = { 0x01 };
        __bArrayCtr = __CopyBytes(__bDiagValueArray, __bDiagValueArrayCtr, __bArray);
        __bArrayCtr2 = elCount(__bArray2);
        __csr = CompareBytes(__bArray, __bArrayCtr, __bArray2, __bArrayCtr2) == 0;
        snprintf(__cArray, 8192, "%s", "Diagnostic parameter \'DiagSessionType\'");
        snprintf(__cArray2, 8192, "%s", __cArray);
        snprintf(__cArray3, 8192, "%s", "");
        ReportTableRow(__tableHandle, 0, __cArray2, "Bytes", __bArray2, __bArrayCtr2, __cArray3, __oneOfFlag, __bSetInCheckAlignment);
        ReportCell(__tableHandle, __bArray, __bArrayCtr);
        ReportCellResult(__tableHandle, __csr, __ePassFail);
      }
    
      __res = __res && __csr;
    
    }
    ReportTableEndVerdict(__tableHandle, __cEvaluateResponse, __res);
	__bVerdict = __bVerdict && __res;
  }
  if (__bVerdict == __eVerdictFail)
    TestReportWriteDiagObjectList();
}
void Ttvccmce9_Tet_Tc49_Completion()
{
  stack long __tableHandle;
  TestCompletionBegin();
  {
    {
      CreateTTEIFFunction("Ttvccmce9_General_Postconditions", __eFct, __eLocal);
      CallInterfaceFunction(__cEmpty, __cEmpty, "3d1998f6-ed4f-4d8f-9c0f-63439c24b6a7");
    }


  }
  TestCompletionEnd();
}

void Ttvccmce9_Tet_Tc50()
{
  CreateTTEIFFunction("Ttvccmce9_Tc50", __eTcDef, __eLocal);  
  AddIFParameterTestCaseAttribute("TC_ID", "");
  AddIFParameterTestCaseAttribute("Test Case ID", "");
  CallInterfaceFunction("TC_ID_20205286_Extended_Session", __cEmpty , __cEmpty );
}
testcase Ttvccmce9_Tc50()
{
  stack long __tableHandle;
  SetBreakOnFail(0);

  CreateTTEIFFunction("Ttvccmce9_Tet_Tc50_Completion", __eFct, __eLocal);
  
  AddIFAsCleanUpFunction();

  TestPreparationBegin();
  {
    {
      CreateTTEIFFunction("Ttvccmce9_General_Precondition", __eFct, __eLocal);
      CallInterfaceFunction(__cEmpty, __cEmpty, "b588ddda-8fe4-4271-93b3-dd1beefd9138");
    }


  }
  TestPreparationEnd();

  TestCommandBegin(__eDiagService, __cDiagService, "", "2");
  {
    if (DiagIsFunctionalGroup("CVADAS_0001_00000000_000"))
    {
      DiagResponse * __resp;
      DiagRequest CVADAS_0001_00000000_000.Default_Session_Start __req;
      __diagServicevccmce9_168(__req, __resp);
    }
    else
    {
      DiagResponse CVADAS_0001_00000000_000.* __resp;
      DiagRequest CVADAS_0001_00000000_000.Default_Session_Start __req;
      __diagServicevccmce9_168(__req, __resp);
    }
  }
  TestCommandEnd();


  TestCommandBegin(__eDiagService, __cDiagService, "", "3");
  {
    if (DiagIsFunctionalGroup("CVADAS_0001_00000000_000"))
    {
      DiagResponse * __resp;
      DiagRequest CVADAS_0001_00000000_000.Extended_Diagnostic_Session_Start __req;
      __diagServicevccmce9_169(__req, __resp);
    }
    else
    {
      DiagResponse CVADAS_0001_00000000_000.* __resp;
      DiagRequest CVADAS_0001_00000000_000.Extended_Diagnostic_Session_Start __req;
      __diagServicevccmce9_169(__req, __resp);
    }
  }
  TestCommandEnd();


  {
    CreateTTEIFFunction("Ttvccmce9_F186_DID_with_PhysicalAdd_ExtendedSession", __eFct, __eLocal);
    CallInterfaceFunction(__cEmpty, __cEmpty, "ef9ee47d-f468-4fc1-8d48-13fa51881535");
  }


  {
    CreateTTEIFFunction("Ttvccmce9_F182_DID_with_Physical_Address", __eFct, __eLocal);
    CallInterfaceFunction(__cEmpty, __cEmpty, "7311c37f-5552-4af9-8a6b-1fac266ca7e7");
  }



}

  
void __diagServicevccmce9_168(DiagRequest * __req, DiagResponse * __resp )
{
  stack long __tableHandle;
  long __res, __paramLen, __bytePos;

   __bVerdict = __eVerdictPass;

  do {
    TestReportResetDiagObjectList();
    DiagSetReportDetailLevel("CVADAS_0001_00000000_000", EnumServiceDetails_onfail);
    // Request aspect
    {

      if (0 >= DiagSendReqAndWaitForResp("CVADAS_0001_00000000_000", __req, __resp, __res, -1, -1, -1, -1, -1, EnumResult_pos, EnumServiceDetails_onfail, EnumSendingMode_physical, EnumSuppressPosResBit_asconfigured, EnumVerdictOnInvalidValues_fail))
        break;
    }

    __res = DiagErrCodeTestStep(__res, "Can't retrieve last response for request! No check possible.") < 0;
    if(__res)
    {
	  __bVerdict = __eVerdictFail;
      break;
    }
    {
      __res = DiagInterpretAs(__resp, "DSC_PR");
      if(__res != 0)
      {
        __bVerdict = __eVerdictFail;
        DiagErrCodeTestStep(__res, "Can't interpret response as diagnostic primitive 'DSC_PR'.");
        break;
      }
      else
      {
        TestStepPass( "Received primitive can be interpreted as diagnostic primitive 'DSC_PR'.");
      }
    }
  }
  while(0);


  // Response, check & read aspect
  {
    __res = 1;
    __tableHandle = ReportTableHead5Columns(__cCheckCaption, __cTSym, __cTOp, __cRefVal, __cActual, __cRes);
    {
      __bDiagValueArrayCtr = DiagGetParameterErrorHandled(__resp, "DiagSessionType", __bDiagValueArray, elcount(__bDiagValueArray), __cDiagValueArray, elcount(__cDiagValueArray));
      {
        byte __bArray2[1] = { 0x01 };
        __bArrayCtr = __CopyBytes(__bDiagValueArray, __bDiagValueArrayCtr, __bArray);
        __bArrayCtr2 = elCount(__bArray2);
        __csr = CompareBytes(__bArray, __bArrayCtr, __bArray2, __bArrayCtr2) == 0;
        snprintf(__cArray, 8192, "%s", "Diagnostic parameter \'DiagSessionType\'");
        snprintf(__cArray2, 8192, "%s", __cArray);
        snprintf(__cArray3, 8192, "%s", "");
        ReportTableRow(__tableHandle, 0, __cArray2, "Bytes", __bArray2, __bArrayCtr2, __cArray3, __oneOfFlag, __bSetInCheckAlignment);
        ReportCell(__tableHandle, __bArray, __bArrayCtr);
        ReportCellResult(__tableHandle, __csr, __ePassFail);
      }
    
      __res = __res && __csr;
    
    }
    ReportTableEndVerdict(__tableHandle, __cEvaluateResponse, __res);
	__bVerdict = __bVerdict && __res;
  }
  if (__bVerdict == __eVerdictFail)
    TestReportWriteDiagObjectList();
}
  
void __diagServicevccmce9_169(DiagRequest * __req, DiagResponse * __resp )
{
  stack long __tableHandle;
  long __res, __paramLen, __bytePos;

   __bVerdict = __eVerdictPass;

  do {
    TestReportResetDiagObjectList();
    DiagSetReportDetailLevel("CVADAS_0001_00000000_000", EnumServiceDetails_onfail);
    // Request aspect
    {

      if (0 >= DiagSendReqAndWaitForResp("CVADAS_0001_00000000_000", __req, __resp, __res, -1, -1, -1, -1, -1, EnumResult_pos, EnumServiceDetails_onfail, EnumSendingMode_physical, EnumSuppressPosResBit_asconfigured, EnumVerdictOnInvalidValues_fail))
        break;
    }

    __res = DiagErrCodeTestStep(__res, "Can't retrieve last response for request! No check possible.") < 0;
    if(__res)
    {
	  __bVerdict = __eVerdictFail;
      break;
    }
    {
      __res = DiagInterpretAs(__resp, "DSC_PR");
      if(__res != 0)
      {
        __bVerdict = __eVerdictFail;
        DiagErrCodeTestStep(__res, "Can't interpret response as diagnostic primitive 'DSC_PR'.");
        break;
      }
      else
      {
        TestStepPass( "Received primitive can be interpreted as diagnostic primitive 'DSC_PR'.");
      }
    }
  }
  while(0);


  // Response, check & read aspect
  {
    __res = 1;
    __tableHandle = ReportTableHead5Columns(__cCheckCaption, __cTSym, __cTOp, __cRefVal, __cActual, __cRes);
    {
      __bDiagValueArrayCtr = DiagGetParameterErrorHandled(__resp, "DiagSessionType", __bDiagValueArray, elcount(__bDiagValueArray), __cDiagValueArray, elcount(__cDiagValueArray));
      {
        byte __bArray2[1] = { 0x03 };
        __bArrayCtr = __CopyBytes(__bDiagValueArray, __bDiagValueArrayCtr, __bArray);
        __bArrayCtr2 = elCount(__bArray2);
        __csr = CompareBytes(__bArray, __bArrayCtr, __bArray2, __bArrayCtr2) == 0;
        snprintf(__cArray, 8192, "%s", "Diagnostic parameter \'DiagSessionType\'");
        snprintf(__cArray2, 8192, "%s", __cArray);
        snprintf(__cArray3, 8192, "%s", "");
        ReportTableRow(__tableHandle, 0, __cArray2, "Bytes", __bArray2, __bArrayCtr2, __cArray3, __oneOfFlag, __bSetInCheckAlignment);
        ReportCell(__tableHandle, __bArray, __bArrayCtr);
        ReportCellResult(__tableHandle, __csr, __ePassFail);
      }
    
      __res = __res && __csr;
    
    }
    ReportTableEndVerdict(__tableHandle, __cEvaluateResponse, __res);
	__bVerdict = __bVerdict && __res;
  }
  if (__bVerdict == __eVerdictFail)
    TestReportWriteDiagObjectList();
}
void Ttvccmce9_Tet_Tc50_Completion()
{
  stack long __tableHandle;
  TestCompletionBegin();
  {
    {
      CreateTTEIFFunction("Ttvccmce9_General_Postconditions", __eFct, __eLocal);
      CallInterfaceFunction(__cEmpty, __cEmpty, "3d1998f6-ed4f-4d8f-9c0f-63439c24b6a7");
    }


  }
  TestCompletionEnd();
}

void Ttvccmce9_Tet_Tc51()
{
  CreateTTEIFFunction("Ttvccmce9_Tc51", __eTcDef, __eLocal);  
  AddIFParameterTestCaseAttribute("TC_ID", "");
  AddIFParameterTestCaseAttribute("Test Case ID", "");
  CallInterfaceFunction("TC_ID_20205288_Standard_Physical_Address", __cEmpty , __cEmpty );
}
testcase Ttvccmce9_Tc51()
{
  stack long __tableHandle;
  SetBreakOnFail(0);

  CreateTTEIFFunction("Ttvccmce9_Tet_Tc51_Completion", __eFct, __eLocal);
  
  AddIFAsCleanUpFunction();

  TestPreparationBegin();
  {
    {
      CreateTTEIFFunction("Ttvccmce9_General_Precondition", __eFct, __eLocal);
      CallInterfaceFunction(__cEmpty, __cEmpty, "b588ddda-8fe4-4271-93b3-dd1beefd9138");
    }


  }
  TestPreparationEnd();

  {
    CreateTTEIFFunction("Ttvccmce9_Default_Session_Standard_Physical_Address", __eFct, __eLocal);
    CallInterfaceFunction(__cEmpty, __cEmpty, "a876afd8-79e2-4bc6-b86f-76bf44cfb774");
  }


  {
    CreateTTEIFFunction("Ttvccmce9_Extended_Session_Standard_Physical_Address", __eFct, __eLocal);
    CallInterfaceFunction(__cEmpty, __cEmpty, "aab9c8d5-4152-43a6-9531-8599a5c4c508");
  }


  {
    CreateTTEIFFunction("Ttvccmce9_F186_DID_with_Standard_Physical_Address_Extended_Session", __eFct, __eLocal);
    CallInterfaceFunction(__cEmpty, __cEmpty, "c8044f49-226c-49c1-9a34-3c367524be30");
  }


  {
    CreateTTEIFFunction("Ttvccmce9_F182_DID_with_Standard_Physical_Address", __eFct, __eLocal);
    CallInterfaceFunction(__cEmpty, __cEmpty, "e4f0fdca-506d-4bf0-a80b-10b31a7dde2c");
  }



}

void Ttvccmce9_Tet_Tc51_Completion()
{
  stack long __tableHandle;
  TestCompletionBegin();
  {
    {
      CreateTTEIFFunction("Ttvccmce9_General_Postconditions", __eFct, __eLocal);
      CallInterfaceFunction(__cEmpty, __cEmpty, "3d1998f6-ed4f-4d8f-9c0f-63439c24b6a7");
    }


  }
  TestCompletionEnd();
}

void Ttvccmce9_Tet_Tc52()
{
  CreateTTEIFFunction("Ttvccmce9_Tc52", __eTcDef, __eLocal);  
  AddIFParameterTestCaseAttribute("TC_ID", "");
  AddIFParameterTestCaseAttribute("Test Case ID", "");
  CallInterfaceFunction("TC_ID_20205268_Standard_Physical_Address", __cEmpty , __cEmpty );
}
testcase Ttvccmce9_Tc52()
{
  stack long __tableHandle;
  SetBreakOnFail(0);

  CreateTTEIFFunction("Ttvccmce9_Tet_Tc52_Completion", __eFct, __eLocal);
  
  AddIFAsCleanUpFunction();

  TestPreparationBegin();
  {
    {
      CreateTTEIFFunction("Ttvccmce9_General_Precondition", __eFct, __eLocal);
      CallInterfaceFunction(__cEmpty, __cEmpty, "b588ddda-8fe4-4271-93b3-dd1beefd9138");
    }


  }
  TestPreparationEnd();

  {
    CreateTTEIFFunction("Ttvccmce9_Default_Session_Standard_Physical_Address", __eFct, __eLocal);
    CallInterfaceFunction(__cEmpty, __cEmpty, "a876afd8-79e2-4bc6-b86f-76bf44cfb774");
  }


  {
    CreateTTEIFFunction("Ttvccmce9_F186_DID_with_Standard_Physical_Address_Default_Session", __eFct, __eLocal);
    CallInterfaceFunction(__cEmpty, __cEmpty, "a35d2af3-f713-4f2b-9c1d-1a28d63eb692");
  }


  {
    CreateTTEIFFunction("Ttvccmce9_F182_DID_with_Standard_Physical_Address", __eFct, __eLocal);
    CallInterfaceFunction(__cEmpty, __cEmpty, "e4f0fdca-506d-4bf0-a80b-10b31a7dde2c");
  }



}

void Ttvccmce9_Tet_Tc52_Completion()
{
  stack long __tableHandle;
  TestCompletionBegin();
  {
    {
      CreateTTEIFFunction("Ttvccmce9_General_Postconditions", __eFct, __eLocal);
      CallInterfaceFunction(__cEmpty, __cEmpty, "3d1998f6-ed4f-4d8f-9c0f-63439c24b6a7");
    }


  }
  TestCompletionEnd();
}

void Ttvccmce9_Tet_Tc53()
{
  CreateTTEIFFunction("Ttvccmce9_Tc53", __eTcDef, __eLocal);  
  AddIFParameterTestCaseAttribute("TC_ID", "");
  AddIFParameterTestCaseAttribute("Test Case ID", "");
  CallInterfaceFunction("TC_ID_20205222_Defaults_Session_Physical_and_Standard_Addressing", __cEmpty , __cEmpty );
}
testcase Ttvccmce9_Tc53()
{
  stack long __tableHandle;
  SetBreakOnFail(0);

  CreateTTEIFFunction("Ttvccmce9_Tet_Tc53_Completion", __eFct, __eLocal);
  
  AddIFAsCleanUpFunction();

  TestPreparationBegin();
  {
    {
      CreateTTEIFFunction("Ttvccmce9_General_Precondition", __eFct, __eLocal);
      CallInterfaceFunction(__cEmpty, __cEmpty, "b588ddda-8fe4-4271-93b3-dd1beefd9138");
    }


  }
  TestPreparationEnd();

  TestCommandBegin(__eDiagService, __cDiagService, "", "2");
  {
    if (DiagIsFunctionalGroup("CVADAS_0001_00000000_000"))
    {
      DiagResponse * __resp;
      DiagRequest CVADAS_0001_00000000_000.Default_Session_Start __req;
      __diagServicevccmce9_170(__req, __resp);
    }
    else
    {
      DiagResponse CVADAS_0001_00000000_000.* __resp;
      DiagRequest CVADAS_0001_00000000_000.Default_Session_Start __req;
      __diagServicevccmce9_170(__req, __resp);
    }
  }
  TestCommandEnd();


  {
    CreateTTEIFFunction("Ttvccmce9_F186_DID_with_PhysicalAdd_DefaultSession", __eFct, __eLocal);
    CallInterfaceFunction(__cEmpty, __cEmpty, "94cfa590-eac0-4499-adc5-5b1a2141e3ff");
  }



}

  
void __diagServicevccmce9_170(DiagRequest * __req, DiagResponse * __resp )
{
  stack long __tableHandle;
  long __res, __paramLen, __bytePos;

   __bVerdict = __eVerdictPass;

  do {
    TestReportResetDiagObjectList();
    DiagSetReportDetailLevel("CVADAS_0001_00000000_000", EnumServiceDetails_onfail);
    // Request aspect
    {

      if (0 >= DiagSendReqAndWaitForResp("CVADAS_0001_00000000_000", __req, __resp, __res, -1, -1, -1, -1, -1, EnumResult_pos, EnumServiceDetails_onfail, EnumSendingMode_physical, EnumSuppressPosResBit_asconfigured, EnumVerdictOnInvalidValues_fail))
        break;
    }

    __res = DiagErrCodeTestStep(__res, "Can't retrieve last response for request! No check possible.") < 0;
    if(__res)
    {
	  __bVerdict = __eVerdictFail;
      break;
    }
    {
      __res = DiagInterpretAs(__resp, "DSC_PR");
      if(__res != 0)
      {
        __bVerdict = __eVerdictFail;
        DiagErrCodeTestStep(__res, "Can't interpret response as diagnostic primitive 'DSC_PR'.");
        break;
      }
      else
      {
        TestStepPass( "Received primitive can be interpreted as diagnostic primitive 'DSC_PR'.");
      }
    }
  }
  while(0);


  // Response, check & read aspect
  {
    __res = 1;
    __tableHandle = ReportTableHead5Columns(__cCheckCaption, __cTSym, __cTOp, __cRefVal, __cActual, __cRes);
    {
      __bDiagValueArrayCtr = DiagGetParameterErrorHandled(__resp, "DiagSessionType", __bDiagValueArray, elcount(__bDiagValueArray), __cDiagValueArray, elcount(__cDiagValueArray));
      {
        byte __bArray2[1] = { 0x01 };
        __bArrayCtr = __CopyBytes(__bDiagValueArray, __bDiagValueArrayCtr, __bArray);
        __bArrayCtr2 = elCount(__bArray2);
        __csr = CompareBytes(__bArray, __bArrayCtr, __bArray2, __bArrayCtr2) == 0;
        snprintf(__cArray, 8192, "%s", "Diagnostic parameter \'DiagSessionType\'");
        snprintf(__cArray2, 8192, "%s", __cArray);
        snprintf(__cArray3, 8192, "%s", "");
        ReportTableRow(__tableHandle, 0, __cArray2, "Bytes", __bArray2, __bArrayCtr2, __cArray3, __oneOfFlag, __bSetInCheckAlignment);
        ReportCell(__tableHandle, __bArray, __bArrayCtr);
        ReportCellResult(__tableHandle, __csr, __ePassFail);
      }
    
      __res = __res && __csr;
    
    }
    ReportTableEndVerdict(__tableHandle, __cEvaluateResponse, __res);
	__bVerdict = __bVerdict && __res;
  }
  if (__bVerdict == __eVerdictFail)
    TestReportWriteDiagObjectList();
}
void Ttvccmce9_Tet_Tc53_Completion()
{
  stack long __tableHandle;
  TestCompletionBegin();
  {
    {
      CreateTTEIFFunction("Ttvccmce9_General_Postconditions", __eFct, __eLocal);
      CallInterfaceFunction(__cEmpty, __cEmpty, "3d1998f6-ed4f-4d8f-9c0f-63439c24b6a7");
    }


  }
  TestCompletionEnd();
}

void Ttvccmce9_Tet_Tc54()
{
  CreateTTEIFFunction("Ttvccmce9_Tc54", __eTcDef, __eLocal);  
  AddIFParameterTestCaseAttribute("TC_ID", "");
  AddIFParameterTestCaseAttribute("Test Case ID", "");
  CallInterfaceFunction("TC_ID_20205226_Extended_Session_Physical_and_Standard_Addressing", __cEmpty , __cEmpty );
}
testcase Ttvccmce9_Tc54()
{
  stack long __tableHandle;
  SetBreakOnFail(0);

  CreateTTEIFFunction("Ttvccmce9_Tet_Tc54_Completion", __eFct, __eLocal);
  
  AddIFAsCleanUpFunction();

  TestPreparationBegin();
  {
    {
      CreateTTEIFFunction("Ttvccmce9_General_Precondition", __eFct, __eLocal);
      CallInterfaceFunction(__cEmpty, __cEmpty, "b588ddda-8fe4-4271-93b3-dd1beefd9138");
    }


  }
  TestPreparationEnd();

  TestCommandBegin(__eDiagService, __cDiagService, "", "2");
  {
    if (DiagIsFunctionalGroup("CVADAS_0001_00000000_000"))
    {
      DiagResponse * __resp;
      DiagRequest CVADAS_0001_00000000_000.Default_Session_Start __req;
      __diagServicevccmce9_171(__req, __resp);
    }
    else
    {
      DiagResponse CVADAS_0001_00000000_000.* __resp;
      DiagRequest CVADAS_0001_00000000_000.Default_Session_Start __req;
      __diagServicevccmce9_171(__req, __resp);
    }
  }
  TestCommandEnd();


  TestCommandBegin(__eDiagService, __cDiagService, "", "3");
  {
    if (DiagIsFunctionalGroup("CVADAS_0001_00000000_000"))
    {
      DiagResponse * __resp;
      DiagRequest CVADAS_0001_00000000_000.Extended_Diagnostic_Session_Start __req;
      __diagServicevccmce9_172(__req, __resp);
    }
    else
    {
      DiagResponse CVADAS_0001_00000000_000.* __resp;
      DiagRequest CVADAS_0001_00000000_000.Extended_Diagnostic_Session_Start __req;
      __diagServicevccmce9_172(__req, __resp);
    }
  }
  TestCommandEnd();


  {
    CreateTTEIFFunction("Ttvccmce9_F186_DID_with_PhysicalAdd_ExtendedSession", __eFct, __eLocal);
    CallInterfaceFunction(__cEmpty, __cEmpty, "ef9ee47d-f468-4fc1-8d48-13fa51881535");
  }



}

  
void __diagServicevccmce9_171(DiagRequest * __req, DiagResponse * __resp )
{
  stack long __tableHandle;
  long __res, __paramLen, __bytePos;

   __bVerdict = __eVerdictPass;

  do {
    TestReportResetDiagObjectList();
    DiagSetReportDetailLevel("CVADAS_0001_00000000_000", EnumServiceDetails_onfail);
    // Request aspect
    {

      if (0 >= DiagSendReqAndWaitForResp("CVADAS_0001_00000000_000", __req, __resp, __res, -1, -1, -1, -1, -1, EnumResult_pos, EnumServiceDetails_onfail, EnumSendingMode_physical, EnumSuppressPosResBit_asconfigured, EnumVerdictOnInvalidValues_fail))
        break;
    }

    __res = DiagErrCodeTestStep(__res, "Can't retrieve last response for request! No check possible.") < 0;
    if(__res)
    {
	  __bVerdict = __eVerdictFail;
      break;
    }
    {
      __res = DiagInterpretAs(__resp, "DSC_PR");
      if(__res != 0)
      {
        __bVerdict = __eVerdictFail;
        DiagErrCodeTestStep(__res, "Can't interpret response as diagnostic primitive 'DSC_PR'.");
        break;
      }
      else
      {
        TestStepPass( "Received primitive can be interpreted as diagnostic primitive 'DSC_PR'.");
      }
    }
  }
  while(0);


  // Response, check & read aspect
  {
    __res = 1;
    __tableHandle = ReportTableHead5Columns(__cCheckCaption, __cTSym, __cTOp, __cRefVal, __cActual, __cRes);
    {
      __bDiagValueArrayCtr = DiagGetParameterErrorHandled(__resp, "DiagSessionType", __bDiagValueArray, elcount(__bDiagValueArray), __cDiagValueArray, elcount(__cDiagValueArray));
      {
        byte __bArray2[1] = { 0x01 };
        __bArrayCtr = __CopyBytes(__bDiagValueArray, __bDiagValueArrayCtr, __bArray);
        __bArrayCtr2 = elCount(__bArray2);
        __csr = CompareBytes(__bArray, __bArrayCtr, __bArray2, __bArrayCtr2) == 0;
        snprintf(__cArray, 8192, "%s", "Diagnostic parameter \'DiagSessionType\'");
        snprintf(__cArray2, 8192, "%s", __cArray);
        snprintf(__cArray3, 8192, "%s", "");
        ReportTableRow(__tableHandle, 0, __cArray2, "Bytes", __bArray2, __bArrayCtr2, __cArray3, __oneOfFlag, __bSetInCheckAlignment);
        ReportCell(__tableHandle, __bArray, __bArrayCtr);
        ReportCellResult(__tableHandle, __csr, __ePassFail);
      }
    
      __res = __res && __csr;
    
    }
    ReportTableEndVerdict(__tableHandle, __cEvaluateResponse, __res);
	__bVerdict = __bVerdict && __res;
  }
  if (__bVerdict == __eVerdictFail)
    TestReportWriteDiagObjectList();
}
  
void __diagServicevccmce9_172(DiagRequest * __req, DiagResponse * __resp )
{
  stack long __tableHandle;
  long __res, __paramLen, __bytePos;

   __bVerdict = __eVerdictPass;

  do {
    TestReportResetDiagObjectList();
    DiagSetReportDetailLevel("CVADAS_0001_00000000_000", EnumServiceDetails_onfail);
    // Request aspect
    {

      if (0 >= DiagSendReqAndWaitForResp("CVADAS_0001_00000000_000", __req, __resp, __res, -1, -1, -1, -1, -1, EnumResult_pos, EnumServiceDetails_onfail, EnumSendingMode_physical, EnumSuppressPosResBit_asconfigured, EnumVerdictOnInvalidValues_fail))
        break;
    }

    __res = DiagErrCodeTestStep(__res, "Can't retrieve last response for request! No check possible.") < 0;
    if(__res)
    {
	  __bVerdict = __eVerdictFail;
      break;
    }
    {
      __res = DiagInterpretAs(__resp, "DSC_PR");
      if(__res != 0)
      {
        __bVerdict = __eVerdictFail;
        DiagErrCodeTestStep(__res, "Can't interpret response as diagnostic primitive 'DSC_PR'.");
        break;
      }
      else
      {
        TestStepPass( "Received primitive can be interpreted as diagnostic primitive 'DSC_PR'.");
      }
    }
  }
  while(0);


  // Response, check & read aspect
  {
    __res = 1;
    __tableHandle = ReportTableHead5Columns(__cCheckCaption, __cTSym, __cTOp, __cRefVal, __cActual, __cRes);
    {
      __bDiagValueArrayCtr = DiagGetParameterErrorHandled(__resp, "DiagSessionType", __bDiagValueArray, elcount(__bDiagValueArray), __cDiagValueArray, elcount(__cDiagValueArray));
      {
        byte __bArray2[1] = { 0x03 };
        __bArrayCtr = __CopyBytes(__bDiagValueArray, __bDiagValueArrayCtr, __bArray);
        __bArrayCtr2 = elCount(__bArray2);
        __csr = CompareBytes(__bArray, __bArrayCtr, __bArray2, __bArrayCtr2) == 0;
        snprintf(__cArray, 8192, "%s", "Diagnostic parameter \'DiagSessionType\'");
        snprintf(__cArray2, 8192, "%s", __cArray);
        snprintf(__cArray3, 8192, "%s", "");
        ReportTableRow(__tableHandle, 0, __cArray2, "Bytes", __bArray2, __bArrayCtr2, __cArray3, __oneOfFlag, __bSetInCheckAlignment);
        ReportCell(__tableHandle, __bArray, __bArrayCtr);
        ReportCellResult(__tableHandle, __csr, __ePassFail);
      }
    
      __res = __res && __csr;
    
    }
    ReportTableEndVerdict(__tableHandle, __cEvaluateResponse, __res);
	__bVerdict = __bVerdict && __res;
  }
  if (__bVerdict == __eVerdictFail)
    TestReportWriteDiagObjectList();
}
void Ttvccmce9_Tet_Tc54_Completion()
{
  stack long __tableHandle;
  TestCompletionBegin();
  {
    {
      CreateTTEIFFunction("Ttvccmce9_General_Postconditions", __eFct, __eLocal);
      CallInterfaceFunction(__cEmpty, __cEmpty, "3d1998f6-ed4f-4d8f-9c0f-63439c24b6a7");
    }


  }
  TestCompletionEnd();
}

void Ttvccmce9_Tet_Tc55()
{
  CreateTTEIFFunction("Ttvccmce9_Tc55", __eTcDef, __eLocal);  
  AddIFParameterTestCaseAttribute("TC_ID", "");
  AddIFParameterTestCaseAttribute("Test Case ID", "");
  CallInterfaceFunction("TC_ID_20205318_Defaults_Session", __cEmpty , __cEmpty );
}
testcase Ttvccmce9_Tc55()
{
  stack long __tableHandle;
  SetBreakOnFail(0);

  CreateTTEIFFunction("Ttvccmce9_Tet_Tc55_Completion", __eFct, __eLocal);
  
  AddIFAsCleanUpFunction();

  TestPreparationBegin();
  {
    {
      CreateTTEIFFunction("Ttvccmce9_General_Precondition", __eFct, __eLocal);
      CallInterfaceFunction(__cEmpty, __cEmpty, "b588ddda-8fe4-4271-93b3-dd1beefd9138");
    }


  }
  TestPreparationEnd();

  TestCommandBegin(__eDiagService, __cDiagService, "", "2");
  {
    if (DiagIsFunctionalGroup("CVADAS_0001_00000000_000"))
    {
      DiagResponse * __resp;
      DiagRequest CVADAS_0001_00000000_000.Default_Session_Start __req;
      __diagServicevccmce9_173(__req, __resp);
    }
    else
    {
      DiagResponse CVADAS_0001_00000000_000.* __resp;
      DiagRequest CVADAS_0001_00000000_000.Default_Session_Start __req;
      __diagServicevccmce9_173(__req, __resp);
    }
  }
  TestCommandEnd();


  {
    CreateTTEIFFunction("Ttvccmce9_F186_DID_with_PhysicalAdd_DefaultSession", __eFct, __eLocal);
    CallInterfaceFunction(__cEmpty, __cEmpty, "94cfa590-eac0-4499-adc5-5b1a2141e3ff");
  }


  TestCommandBegin(__eWait, __cWait, "", "4");
  {
    Wait("1", (2000 * 1000000LL), 1000000, "");
  }
  TestCommandEnd();

  {
    CreateTTEIFFunction("Ttvccmce9_F154_DID_with_Physical_Address", __eFct, __eLocal);
    CallInterfaceFunction(__cEmpty, __cEmpty, "d57b9ac5-afaf-4abd-9bb6-186be9379a09");
  }



}

  
void __diagServicevccmce9_173(DiagRequest * __req, DiagResponse * __resp )
{
  stack long __tableHandle;
  long __res, __paramLen, __bytePos;

   __bVerdict = __eVerdictPass;

  do {
    TestReportResetDiagObjectList();
    DiagSetReportDetailLevel("CVADAS_0001_00000000_000", EnumServiceDetails_onfail);
    // Request aspect
    {

      if (0 >= DiagSendReqAndWaitForResp("CVADAS_0001_00000000_000", __req, __resp, __res, -1, -1, -1, -1, -1, EnumResult_pos, EnumServiceDetails_onfail, EnumSendingMode_physical, EnumSuppressPosResBit_asconfigured, EnumVerdictOnInvalidValues_fail))
        break;
    }

    __res = DiagErrCodeTestStep(__res, "Can't retrieve last response for request! No check possible.") < 0;
    if(__res)
    {
	  __bVerdict = __eVerdictFail;
      break;
    }
    {
      __res = DiagInterpretAs(__resp, "DSC_PR");
      if(__res != 0)
      {
        __bVerdict = __eVerdictFail;
        DiagErrCodeTestStep(__res, "Can't interpret response as diagnostic primitive 'DSC_PR'.");
        break;
      }
      else
      {
        TestStepPass( "Received primitive can be interpreted as diagnostic primitive 'DSC_PR'.");
      }
    }
  }
  while(0);


  // Response, check & read aspect
  {
    __res = 1;
    __tableHandle = ReportTableHead5Columns(__cCheckCaption, __cTSym, __cTOp, __cRefVal, __cActual, __cRes);
    {
      __bDiagValueArrayCtr = DiagGetParameterErrorHandled(__resp, "DiagSessionType", __bDiagValueArray, elcount(__bDiagValueArray), __cDiagValueArray, elcount(__cDiagValueArray));
      {
        byte __bArray2[1] = { 0x01 };
        __bArrayCtr = __CopyBytes(__bDiagValueArray, __bDiagValueArrayCtr, __bArray);
        __bArrayCtr2 = elCount(__bArray2);
        __csr = CompareBytes(__bArray, __bArrayCtr, __bArray2, __bArrayCtr2) == 0;
        snprintf(__cArray, 8192, "%s", "Diagnostic parameter \'DiagSessionType\'");
        snprintf(__cArray2, 8192, "%s", __cArray);
        snprintf(__cArray3, 8192, "%s", "");
        ReportTableRow(__tableHandle, 0, __cArray2, "Bytes", __bArray2, __bArrayCtr2, __cArray3, __oneOfFlag, __bSetInCheckAlignment);
        ReportCell(__tableHandle, __bArray, __bArrayCtr);
        ReportCellResult(__tableHandle, __csr, __ePassFail);
      }
    
      __res = __res && __csr;
    
    }
    ReportTableEndVerdict(__tableHandle, __cEvaluateResponse, __res);
	__bVerdict = __bVerdict && __res;
  }
  if (__bVerdict == __eVerdictFail)
    TestReportWriteDiagObjectList();
}
void Ttvccmce9_Tet_Tc55_Completion()
{
  stack long __tableHandle;
  TestCompletionBegin();
  {
    {
      CreateTTEIFFunction("Ttvccmce9_General_Postconditions", __eFct, __eLocal);
      CallInterfaceFunction(__cEmpty, __cEmpty, "3d1998f6-ed4f-4d8f-9c0f-63439c24b6a7");
    }


  }
  TestCompletionEnd();
}

void Ttvccmce9_Tet_Tc56()
{
  CreateTTEIFFunction("Ttvccmce9_Tc56", __eTcDef, __eLocal);  
  AddIFParameterTestCaseAttribute("TC_ID", "");
  AddIFParameterTestCaseAttribute("Test Case ID", "");
  CallInterfaceFunction("TC_ID_20205290_Standard_Physical_Address", __cEmpty , __cEmpty );
}
testcase Ttvccmce9_Tc56()
{
  stack long __tableHandle;
  SetBreakOnFail(0);

  CreateTTEIFFunction("Ttvccmce9_Tet_Tc56_Completion", __eFct, __eLocal);
  
  AddIFAsCleanUpFunction();

  TestPreparationBegin();
  {
    {
      CreateTTEIFFunction("Ttvccmce9_General_Precondition", __eFct, __eLocal);
      CallInterfaceFunction(__cEmpty, __cEmpty, "b588ddda-8fe4-4271-93b3-dd1beefd9138");
    }


  }
  TestPreparationEnd();

  {
    CreateTTEIFFunction("Ttvccmce9_Default_Session_Standard_Physical_Address", __eFct, __eLocal);
    CallInterfaceFunction(__cEmpty, __cEmpty, "a876afd8-79e2-4bc6-b86f-76bf44cfb774");
  }


  {
    CreateTTEIFFunction("Ttvccmce9_F186_DID_with_Standard_Physical_Address_Default_Session", __eFct, __eLocal);
    CallInterfaceFunction(__cEmpty, __cEmpty, "a35d2af3-f713-4f2b-9c1d-1a28d63eb692");
  }


  {
    CreateTTEIFFunction("Ttvccmce9_F154_DID_with_Standard_Physical_Address", __eFct, __eLocal);
    CallInterfaceFunction(__cEmpty, __cEmpty, "256f99a2-142f-4b47-ab53-e41c696926d8");
  }



}

void Ttvccmce9_Tet_Tc56_Completion()
{
  stack long __tableHandle;
  TestCompletionBegin();
  {
    {
      CreateTTEIFFunction("Ttvccmce9_General_Postconditions", __eFct, __eLocal);
      CallInterfaceFunction(__cEmpty, __cEmpty, "3d1998f6-ed4f-4d8f-9c0f-63439c24b6a7");
    }


  }
  TestCompletionEnd();
}

void Ttvccmce9_Tet_Tc57()
{
  CreateTTEIFFunction("Ttvccmce9_Tc57", __eTcDef, __eLocal);  
  AddIFParameterTestCaseAttribute("TC_ID", "");
  AddIFParameterTestCaseAttribute("Test Case ID", "");
  CallInterfaceFunction("TC_ID_20205281_Extended_Session", __cEmpty , __cEmpty );
}
testcase Ttvccmce9_Tc57()
{
  stack long __tableHandle;
  SetBreakOnFail(0);

  CreateTTEIFFunction("Ttvccmce9_Tet_Tc57_Completion", __eFct, __eLocal);
  
  AddIFAsCleanUpFunction();

  TestPreparationBegin();
  {
    {
      CreateTTEIFFunction("Ttvccmce9_General_Precondition", __eFct, __eLocal);
      CallInterfaceFunction(__cEmpty, __cEmpty, "b588ddda-8fe4-4271-93b3-dd1beefd9138");
    }


  }
  TestPreparationEnd();

  TestCommandBegin(__eDiagService, __cDiagService, "", "2");
  {
    if (DiagIsFunctionalGroup("CVADAS_0001_00000000_000"))
    {
      DiagResponse * __resp;
      DiagRequest CVADAS_0001_00000000_000.Default_Session_Start __req;
      __diagServicevccmce9_174(__req, __resp);
    }
    else
    {
      DiagResponse CVADAS_0001_00000000_000.* __resp;
      DiagRequest CVADAS_0001_00000000_000.Default_Session_Start __req;
      __diagServicevccmce9_174(__req, __resp);
    }
  }
  TestCommandEnd();


  TestCommandBegin(__eDiagService, __cDiagService, "", "3");
  {
    if (DiagIsFunctionalGroup("CVADAS_0001_00000000_000"))
    {
      DiagResponse * __resp;
      DiagRequest CVADAS_0001_00000000_000.Extended_Diagnostic_Session_Start __req;
      __diagServicevccmce9_175(__req, __resp);
    }
    else
    {
      DiagResponse CVADAS_0001_00000000_000.* __resp;
      DiagRequest CVADAS_0001_00000000_000.Extended_Diagnostic_Session_Start __req;
      __diagServicevccmce9_175(__req, __resp);
    }
  }
  TestCommandEnd();


  {
    CreateTTEIFFunction("Ttvccmce9_F186_DID_with_PhysicalAdd_ExtendedSession", __eFct, __eLocal);
    CallInterfaceFunction(__cEmpty, __cEmpty, "ef9ee47d-f468-4fc1-8d48-13fa51881535");
  }


  TestCommandBegin(__eWait, __cWait, "", "6");
  {
    Wait("1", (2000 * 1000000LL), 1000000, "");
  }
  TestCommandEnd();

  {
    CreateTTEIFFunction("Ttvccmce9_F154_DID_with_Physical_Address", __eFct, __eLocal);
    CallInterfaceFunction(__cEmpty, __cEmpty, "d57b9ac5-afaf-4abd-9bb6-186be9379a09");
  }



}

  
void __diagServicevccmce9_174(DiagRequest * __req, DiagResponse * __resp )
{
  stack long __tableHandle;
  long __res, __paramLen, __bytePos;

   __bVerdict = __eVerdictPass;

  do {
    TestReportResetDiagObjectList();
    DiagSetReportDetailLevel("CVADAS_0001_00000000_000", EnumServiceDetails_onfail);
    // Request aspect
    {

      if (0 >= DiagSendReqAndWaitForResp("CVADAS_0001_00000000_000", __req, __resp, __res, -1, -1, -1, -1, -1, EnumResult_pos, EnumServiceDetails_onfail, EnumSendingMode_physical, EnumSuppressPosResBit_asconfigured, EnumVerdictOnInvalidValues_fail))
        break;
    }

    __res = DiagErrCodeTestStep(__res, "Can't retrieve last response for request! No check possible.") < 0;
    if(__res)
    {
	  __bVerdict = __eVerdictFail;
      break;
    }
    {
      __res = DiagInterpretAs(__resp, "DSC_PR");
      if(__res != 0)
      {
        __bVerdict = __eVerdictFail;
        DiagErrCodeTestStep(__res, "Can't interpret response as diagnostic primitive 'DSC_PR'.");
        break;
      }
      else
      {
        TestStepPass( "Received primitive can be interpreted as diagnostic primitive 'DSC_PR'.");
      }
    }
  }
  while(0);


  // Response, check & read aspect
  {
    __res = 1;
    __tableHandle = ReportTableHead5Columns(__cCheckCaption, __cTSym, __cTOp, __cRefVal, __cActual, __cRes);
    {
      __bDiagValueArrayCtr = DiagGetParameterErrorHandled(__resp, "DiagSessionType", __bDiagValueArray, elcount(__bDiagValueArray), __cDiagValueArray, elcount(__cDiagValueArray));
      {
        byte __bArray2[1] = { 0x01 };
        __bArrayCtr = __CopyBytes(__bDiagValueArray, __bDiagValueArrayCtr, __bArray);
        __bArrayCtr2 = elCount(__bArray2);
        __csr = CompareBytes(__bArray, __bArrayCtr, __bArray2, __bArrayCtr2) == 0;
        snprintf(__cArray, 8192, "%s", "Diagnostic parameter \'DiagSessionType\'");
        snprintf(__cArray2, 8192, "%s", __cArray);
        snprintf(__cArray3, 8192, "%s", "");
        ReportTableRow(__tableHandle, 0, __cArray2, "Bytes", __bArray2, __bArrayCtr2, __cArray3, __oneOfFlag, __bSetInCheckAlignment);
        ReportCell(__tableHandle, __bArray, __bArrayCtr);
        ReportCellResult(__tableHandle, __csr, __ePassFail);
      }
    
      __res = __res && __csr;
    
    }
    ReportTableEndVerdict(__tableHandle, __cEvaluateResponse, __res);
	__bVerdict = __bVerdict && __res;
  }
  if (__bVerdict == __eVerdictFail)
    TestReportWriteDiagObjectList();
}
  
void __diagServicevccmce9_175(DiagRequest * __req, DiagResponse * __resp )
{
  stack long __tableHandle;
  long __res, __paramLen, __bytePos;

   __bVerdict = __eVerdictPass;

  do {
    TestReportResetDiagObjectList();
    DiagSetReportDetailLevel("CVADAS_0001_00000000_000", EnumServiceDetails_onfail);
    // Request aspect
    {

      if (0 >= DiagSendReqAndWaitForResp("CVADAS_0001_00000000_000", __req, __resp, __res, -1, -1, -1, -1, -1, EnumResult_pos, EnumServiceDetails_onfail, EnumSendingMode_physical, EnumSuppressPosResBit_asconfigured, EnumVerdictOnInvalidValues_fail))
        break;
    }

    __res = DiagErrCodeTestStep(__res, "Can't retrieve last response for request! No check possible.") < 0;
    if(__res)
    {
	  __bVerdict = __eVerdictFail;
      break;
    }
    {
      __res = DiagInterpretAs(__resp, "DSC_PR");
      if(__res != 0)
      {
        __bVerdict = __eVerdictFail;
        DiagErrCodeTestStep(__res, "Can't interpret response as diagnostic primitive 'DSC_PR'.");
        break;
      }
      else
      {
        TestStepPass( "Received primitive can be interpreted as diagnostic primitive 'DSC_PR'.");
      }
    }
  }
  while(0);


  // Response, check & read aspect
  {
    __res = 1;
    __tableHandle = ReportTableHead5Columns(__cCheckCaption, __cTSym, __cTOp, __cRefVal, __cActual, __cRes);
    {
      __bDiagValueArrayCtr = DiagGetParameterErrorHandled(__resp, "DiagSessionType", __bDiagValueArray, elcount(__bDiagValueArray), __cDiagValueArray, elcount(__cDiagValueArray));
      {
        byte __bArray2[1] = { 0x03 };
        __bArrayCtr = __CopyBytes(__bDiagValueArray, __bDiagValueArrayCtr, __bArray);
        __bArrayCtr2 = elCount(__bArray2);
        __csr = CompareBytes(__bArray, __bArrayCtr, __bArray2, __bArrayCtr2) == 0;
        snprintf(__cArray, 8192, "%s", "Diagnostic parameter \'DiagSessionType\'");
        snprintf(__cArray2, 8192, "%s", __cArray);
        snprintf(__cArray3, 8192, "%s", "");
        ReportTableRow(__tableHandle, 0, __cArray2, "Bytes", __bArray2, __bArrayCtr2, __cArray3, __oneOfFlag, __bSetInCheckAlignment);
        ReportCell(__tableHandle, __bArray, __bArrayCtr);
        ReportCellResult(__tableHandle, __csr, __ePassFail);
      }
    
      __res = __res && __csr;
    
    }
    ReportTableEndVerdict(__tableHandle, __cEvaluateResponse, __res);
	__bVerdict = __bVerdict && __res;
  }
  if (__bVerdict == __eVerdictFail)
    TestReportWriteDiagObjectList();
}
void Ttvccmce9_Tet_Tc57_Completion()
{
  stack long __tableHandle;
  TestCompletionBegin();
  {
    {
      CreateTTEIFFunction("Ttvccmce9_General_Postconditions", __eFct, __eLocal);
      CallInterfaceFunction(__cEmpty, __cEmpty, "3d1998f6-ed4f-4d8f-9c0f-63439c24b6a7");
    }


  }
  TestCompletionEnd();
}

void Ttvccmce9_Tet_Tc58()
{
  CreateTTEIFFunction("Ttvccmce9_Tc58", __eTcDef, __eLocal);  
  AddIFParameterTestCaseAttribute("TC_ID", "");
  AddIFParameterTestCaseAttribute("Test Case ID", "");
  CallInterfaceFunction("TC_ID_20205247_Standard_Physical_Address", __cEmpty , __cEmpty );
}
testcase Ttvccmce9_Tc58()
{
  stack long __tableHandle;
  SetBreakOnFail(0);

  CreateTTEIFFunction("Ttvccmce9_Tet_Tc58_Completion", __eFct, __eLocal);
  
  AddIFAsCleanUpFunction();

  TestPreparationBegin();
  {
    {
      CreateTTEIFFunction("Ttvccmce9_General_Precondition", __eFct, __eLocal);
      CallInterfaceFunction(__cEmpty, __cEmpty, "b588ddda-8fe4-4271-93b3-dd1beefd9138");
    }


  }
  TestPreparationEnd();

  {
    CreateTTEIFFunction("Ttvccmce9_Default_Session_Standard_Physical_Address", __eFct, __eLocal);
    CallInterfaceFunction(__cEmpty, __cEmpty, "a876afd8-79e2-4bc6-b86f-76bf44cfb774");
  }


  {
    CreateTTEIFFunction("Ttvccmce9_Extended_Session_Standard_Physical_Address", __eFct, __eLocal);
    CallInterfaceFunction(__cEmpty, __cEmpty, "aab9c8d5-4152-43a6-9531-8599a5c4c508");
  }


  {
    CreateTTEIFFunction("Ttvccmce9_F186_DID_with_Standard_Physical_Address_Extended_Session", __eFct, __eLocal);
    CallInterfaceFunction(__cEmpty, __cEmpty, "c8044f49-226c-49c1-9a34-3c367524be30");
  }


  {
    CreateTTEIFFunction("Ttvccmce9_F154_DID_with_Standard_Physical_Address", __eFct, __eLocal);
    CallInterfaceFunction(__cEmpty, __cEmpty, "256f99a2-142f-4b47-ab53-e41c696926d8");
  }



}

void Ttvccmce9_Tet_Tc58_Completion()
{
  stack long __tableHandle;
  TestCompletionBegin();
  {
    {
      CreateTTEIFFunction("Ttvccmce9_General_Postconditions", __eFct, __eLocal);
      CallInterfaceFunction(__cEmpty, __cEmpty, "3d1998f6-ed4f-4d8f-9c0f-63439c24b6a7");
    }


  }
  TestCompletionEnd();
}

void Ttvccmce9_Tet_Tc59()
{
  CreateTTEIFFunction("Ttvccmce9_Tc59", __eTcDef, __eLocal);  
  AddIFParameterTestCaseAttribute("TC_ID", "");
  AddIFParameterTestCaseAttribute("Test Case ID", "");
  CallInterfaceFunction("TC_ID_20205248_Defaults_Session_Physical_and_Standard_Addressing", __cEmpty , __cEmpty );
}
testcase Ttvccmce9_Tc59()
{
  stack long __tableHandle;
  SetBreakOnFail(0);

  CreateTTEIFFunction("Ttvccmce9_Tet_Tc59_Completion", __eFct, __eLocal);
  
  AddIFAsCleanUpFunction();

  TestPreparationBegin();
  {
    {
      CreateTTEIFFunction("Ttvccmce9_General_Precondition", __eFct, __eLocal);
      CallInterfaceFunction(__cEmpty, __cEmpty, "b588ddda-8fe4-4271-93b3-dd1beefd9138");
    }


  }
  TestPreparationEnd();

  TestCommandBegin(__eDiagService, __cDiagService, "", "2");
  {
    if (DiagIsFunctionalGroup("CVADAS_0001_00000000_000"))
    {
      DiagResponse * __resp;
      DiagRequest CVADAS_0001_00000000_000.Default_Session_Start __req;
      __diagServicevccmce9_176(__req, __resp);
    }
    else
    {
      DiagResponse CVADAS_0001_00000000_000.* __resp;
      DiagRequest CVADAS_0001_00000000_000.Default_Session_Start __req;
      __diagServicevccmce9_176(__req, __resp);
    }
  }
  TestCommandEnd();


  {
    CreateTTEIFFunction("Ttvccmce9_F186_DID_with_PhysicalAdd_DefaultSession", __eFct, __eLocal);
    CallInterfaceFunction(__cEmpty, __cEmpty, "94cfa590-eac0-4499-adc5-5b1a2141e3ff");
  }


  TestCommandBegin(__eWait, __cWait, "", "5");
  {
    Wait("1", (2000 * 1000000LL), 1000000, "");
  }
  TestCommandEnd();

  {
    CreateTTEIFFunction("Ttvccmce9_F155_DID_with_Physical_Address", __eFct, __eLocal);
    CallInterfaceFunction(__cEmpty, __cEmpty, "176f226c-2251-4c67-aae6-1fc10c49128a");
  }



}

  
void __diagServicevccmce9_176(DiagRequest * __req, DiagResponse * __resp )
{
  stack long __tableHandle;
  long __res, __paramLen, __bytePos;

   __bVerdict = __eVerdictPass;

  do {
    TestReportResetDiagObjectList();
    DiagSetReportDetailLevel("CVADAS_0001_00000000_000", EnumServiceDetails_onfail);
    // Request aspect
    {

      if (0 >= DiagSendReqAndWaitForResp("CVADAS_0001_00000000_000", __req, __resp, __res, -1, -1, -1, -1, -1, EnumResult_pos, EnumServiceDetails_onfail, EnumSendingMode_physical, EnumSuppressPosResBit_asconfigured, EnumVerdictOnInvalidValues_fail))
        break;
    }

    __res = DiagErrCodeTestStep(__res, "Can't retrieve last response for request! No check possible.") < 0;
    if(__res)
    {
	  __bVerdict = __eVerdictFail;
      break;
    }
    {
      __res = DiagInterpretAs(__resp, "DSC_PR");
      if(__res != 0)
      {
        __bVerdict = __eVerdictFail;
        DiagErrCodeTestStep(__res, "Can't interpret response as diagnostic primitive 'DSC_PR'.");
        break;
      }
      else
      {
        TestStepPass( "Received primitive can be interpreted as diagnostic primitive 'DSC_PR'.");
      }
    }
  }
  while(0);


  // Response, check & read aspect
  {
    __res = 1;
    __tableHandle = ReportTableHead5Columns(__cCheckCaption, __cTSym, __cTOp, __cRefVal, __cActual, __cRes);
    {
      __bDiagValueArrayCtr = DiagGetParameterErrorHandled(__resp, "DiagSessionType", __bDiagValueArray, elcount(__bDiagValueArray), __cDiagValueArray, elcount(__cDiagValueArray));
      {
        byte __bArray2[1] = { 0x01 };
        __bArrayCtr = __CopyBytes(__bDiagValueArray, __bDiagValueArrayCtr, __bArray);
        __bArrayCtr2 = elCount(__bArray2);
        __csr = CompareBytes(__bArray, __bArrayCtr, __bArray2, __bArrayCtr2) == 0;
        snprintf(__cArray, 8192, "%s", "Diagnostic parameter \'DiagSessionType\'");
        snprintf(__cArray2, 8192, "%s", __cArray);
        snprintf(__cArray3, 8192, "%s", "");
        ReportTableRow(__tableHandle, 0, __cArray2, "Bytes", __bArray2, __bArrayCtr2, __cArray3, __oneOfFlag, __bSetInCheckAlignment);
        ReportCell(__tableHandle, __bArray, __bArrayCtr);
        ReportCellResult(__tableHandle, __csr, __ePassFail);
      }
    
      __res = __res && __csr;
    
    }
    ReportTableEndVerdict(__tableHandle, __cEvaluateResponse, __res);
	__bVerdict = __bVerdict && __res;
  }
  if (__bVerdict == __eVerdictFail)
    TestReportWriteDiagObjectList();
}
void Ttvccmce9_Tet_Tc59_Completion()
{
  stack long __tableHandle;
  TestCompletionBegin();
  {
    {
      CreateTTEIFFunction("Ttvccmce9_General_Postconditions", __eFct, __eLocal);
      CallInterfaceFunction(__cEmpty, __cEmpty, "3d1998f6-ed4f-4d8f-9c0f-63439c24b6a7");
    }


  }
  TestCompletionEnd();
}

void Ttvccmce9_Tet_Tc60()
{
  CreateTTEIFFunction("Ttvccmce9_Tc60", __eTcDef, __eLocal);  
  AddIFParameterTestCaseAttribute("TC_ID", "");
  AddIFParameterTestCaseAttribute("Test Case ID", "");
  CallInterfaceFunction("TC_ID_20205257_Extended_Session_Physical_and_Standard_Addressing", __cEmpty , __cEmpty );
}
testcase Ttvccmce9_Tc60()
{
  stack long __tableHandle;
  SetBreakOnFail(0);

  CreateTTEIFFunction("Ttvccmce9_Tet_Tc60_Completion", __eFct, __eLocal);
  
  AddIFAsCleanUpFunction();

  TestPreparationBegin();
  {
    {
      CreateTTEIFFunction("Ttvccmce9_General_Precondition", __eFct, __eLocal);
      CallInterfaceFunction(__cEmpty, __cEmpty, "b588ddda-8fe4-4271-93b3-dd1beefd9138");
    }


  }
  TestPreparationEnd();

  TestCommandBegin(__eDiagService, __cDiagService, "", "2");
  {
    if (DiagIsFunctionalGroup("CVADAS_0001_00000000_000"))
    {
      DiagResponse * __resp;
      DiagRequest CVADAS_0001_00000000_000.Default_Session_Start __req;
      __diagServicevccmce9_177(__req, __resp);
    }
    else
    {
      DiagResponse CVADAS_0001_00000000_000.* __resp;
      DiagRequest CVADAS_0001_00000000_000.Default_Session_Start __req;
      __diagServicevccmce9_177(__req, __resp);
    }
  }
  TestCommandEnd();


  TestCommandBegin(__eDiagService, __cDiagService, "", "3");
  {
    if (DiagIsFunctionalGroup("CVADAS_0001_00000000_000"))
    {
      DiagResponse * __resp;
      DiagRequest CVADAS_0001_00000000_000.Extended_Diagnostic_Session_Start __req;
      __diagServicevccmce9_178(__req, __resp);
    }
    else
    {
      DiagResponse CVADAS_0001_00000000_000.* __resp;
      DiagRequest CVADAS_0001_00000000_000.Extended_Diagnostic_Session_Start __req;
      __diagServicevccmce9_178(__req, __resp);
    }
  }
  TestCommandEnd();


  {
    CreateTTEIFFunction("Ttvccmce9_F186_DID_with_PhysicalAdd_ExtendedSession", __eFct, __eLocal);
    CallInterfaceFunction(__cEmpty, __cEmpty, "ef9ee47d-f468-4fc1-8d48-13fa51881535");
  }


  TestCommandBegin(__eWait, __cWait, "", "6");
  {
    Wait("1", (2000 * 1000000LL), 1000000, "");
  }
  TestCommandEnd();

  {
    CreateTTEIFFunction("Ttvccmce9_F155_DID_with_Physical_Address", __eFct, __eLocal);
    CallInterfaceFunction(__cEmpty, __cEmpty, "176f226c-2251-4c67-aae6-1fc10c49128a");
  }



}

  
void __diagServicevccmce9_177(DiagRequest * __req, DiagResponse * __resp )
{
  stack long __tableHandle;
  long __res, __paramLen, __bytePos;

   __bVerdict = __eVerdictPass;

  do {
    TestReportResetDiagObjectList();
    DiagSetReportDetailLevel("CVADAS_0001_00000000_000", EnumServiceDetails_onfail);
    // Request aspect
    {

      if (0 >= DiagSendReqAndWaitForResp("CVADAS_0001_00000000_000", __req, __resp, __res, -1, -1, -1, -1, -1, EnumResult_pos, EnumServiceDetails_onfail, EnumSendingMode_physical, EnumSuppressPosResBit_asconfigured, EnumVerdictOnInvalidValues_fail))
        break;
    }

    __res = DiagErrCodeTestStep(__res, "Can't retrieve last response for request! No check possible.") < 0;
    if(__res)
    {
	  __bVerdict = __eVerdictFail;
      break;
    }
    {
      __res = DiagInterpretAs(__resp, "DSC_PR");
      if(__res != 0)
      {
        __bVerdict = __eVerdictFail;
        DiagErrCodeTestStep(__res, "Can't interpret response as diagnostic primitive 'DSC_PR'.");
        break;
      }
      else
      {
        TestStepPass( "Received primitive can be interpreted as diagnostic primitive 'DSC_PR'.");
      }
    }
  }
  while(0);


  // Response, check & read aspect
  {
    __res = 1;
    __tableHandle = ReportTableHead5Columns(__cCheckCaption, __cTSym, __cTOp, __cRefVal, __cActual, __cRes);
    {
      __bDiagValueArrayCtr = DiagGetParameterErrorHandled(__resp, "DiagSessionType", __bDiagValueArray, elcount(__bDiagValueArray), __cDiagValueArray, elcount(__cDiagValueArray));
      {
        byte __bArray2[1] = { 0x01 };
        __bArrayCtr = __CopyBytes(__bDiagValueArray, __bDiagValueArrayCtr, __bArray);
        __bArrayCtr2 = elCount(__bArray2);
        __csr = CompareBytes(__bArray, __bArrayCtr, __bArray2, __bArrayCtr2) == 0;
        snprintf(__cArray, 8192, "%s", "Diagnostic parameter \'DiagSessionType\'");
        snprintf(__cArray2, 8192, "%s", __cArray);
        snprintf(__cArray3, 8192, "%s", "");
        ReportTableRow(__tableHandle, 0, __cArray2, "Bytes", __bArray2, __bArrayCtr2, __cArray3, __oneOfFlag, __bSetInCheckAlignment);
        ReportCell(__tableHandle, __bArray, __bArrayCtr);
        ReportCellResult(__tableHandle, __csr, __ePassFail);
      }
    
      __res = __res && __csr;
    
    }
    ReportTableEndVerdict(__tableHandle, __cEvaluateResponse, __res);
	__bVerdict = __bVerdict && __res;
  }
  if (__bVerdict == __eVerdictFail)
    TestReportWriteDiagObjectList();
}
  
void __diagServicevccmce9_178(DiagRequest * __req, DiagResponse * __resp )
{
  stack long __tableHandle;
  long __res, __paramLen, __bytePos;

   __bVerdict = __eVerdictPass;

  do {
    TestReportResetDiagObjectList();
    DiagSetReportDetailLevel("CVADAS_0001_00000000_000", EnumServiceDetails_onfail);
    // Request aspect
    {

      if (0 >= DiagSendReqAndWaitForResp("CVADAS_0001_00000000_000", __req, __resp, __res, -1, -1, -1, -1, -1, EnumResult_pos, EnumServiceDetails_onfail, EnumSendingMode_physical, EnumSuppressPosResBit_asconfigured, EnumVerdictOnInvalidValues_fail))
        break;
    }

    __res = DiagErrCodeTestStep(__res, "Can't retrieve last response for request! No check possible.") < 0;
    if(__res)
    {
	  __bVerdict = __eVerdictFail;
      break;
    }
    {
      __res = DiagInterpretAs(__resp, "DSC_PR");
      if(__res != 0)
      {
        __bVerdict = __eVerdictFail;
        DiagErrCodeTestStep(__res, "Can't interpret response as diagnostic primitive 'DSC_PR'.");
        break;
      }
      else
      {
        TestStepPass( "Received primitive can be interpreted as diagnostic primitive 'DSC_PR'.");
      }
    }
  }
  while(0);


  // Response, check & read aspect
  {
    __res = 1;
    __tableHandle = ReportTableHead5Columns(__cCheckCaption, __cTSym, __cTOp, __cRefVal, __cActual, __cRes);
    {
      __bDiagValueArrayCtr = DiagGetParameterErrorHandled(__resp, "DiagSessionType", __bDiagValueArray, elcount(__bDiagValueArray), __cDiagValueArray, elcount(__cDiagValueArray));
      {
        byte __bArray2[1] = { 0x03 };
        __bArrayCtr = __CopyBytes(__bDiagValueArray, __bDiagValueArrayCtr, __bArray);
        __bArrayCtr2 = elCount(__bArray2);
        __csr = CompareBytes(__bArray, __bArrayCtr, __bArray2, __bArrayCtr2) == 0;
        snprintf(__cArray, 8192, "%s", "Diagnostic parameter \'DiagSessionType\'");
        snprintf(__cArray2, 8192, "%s", __cArray);
        snprintf(__cArray3, 8192, "%s", "");
        ReportTableRow(__tableHandle, 0, __cArray2, "Bytes", __bArray2, __bArrayCtr2, __cArray3, __oneOfFlag, __bSetInCheckAlignment);
        ReportCell(__tableHandle, __bArray, __bArrayCtr);
        ReportCellResult(__tableHandle, __csr, __ePassFail);
      }
    
      __res = __res && __csr;
    
    }
    ReportTableEndVerdict(__tableHandle, __cEvaluateResponse, __res);
	__bVerdict = __bVerdict && __res;
  }
  if (__bVerdict == __eVerdictFail)
    TestReportWriteDiagObjectList();
}
void Ttvccmce9_Tet_Tc60_Completion()
{
  stack long __tableHandle;
  TestCompletionBegin();
  {
    {
      CreateTTEIFFunction("Ttvccmce9_General_Postconditions", __eFct, __eLocal);
      CallInterfaceFunction(__cEmpty, __cEmpty, "3d1998f6-ed4f-4d8f-9c0f-63439c24b6a7");
    }


  }
  TestCompletionEnd();
}

void Ttvccmce9_Tet_Tc61()
{
  CreateTTEIFFunction("Ttvccmce9_Tc61", __eTcDef, __eLocal);  
  AddIFParameterTestCaseAttribute("TC_ID", "");
  AddIFParameterTestCaseAttribute("Test Case ID", "");
  CallInterfaceFunction("TC_ID_20205191_Defaults_Session_Physical_and_Standard_Addressing", __cEmpty , __cEmpty );
}
testcase Ttvccmce9_Tc61()
{
  stack long __tableHandle;
  SetBreakOnFail(0);

  CreateTTEIFFunction("Ttvccmce9_Tet_Tc61_Completion", __eFct, __eLocal);
  
  AddIFAsCleanUpFunction();

  TestPreparationBegin();
  {
    {
      CreateTTEIFFunction("Ttvccmce9_General_Precondition", __eFct, __eLocal);
      CallInterfaceFunction(__cEmpty, __cEmpty, "b588ddda-8fe4-4271-93b3-dd1beefd9138");
    }


  }
  TestPreparationEnd();

  TestCommandBegin(__eDiagService, __cDiagService, "", "2");
  {
    if (DiagIsFunctionalGroup("CVADAS_0001_00000000_000"))
    {
      DiagResponse * __resp;
      DiagRequest CVADAS_0001_00000000_000.Default_Session_Start __req;
      __diagServicevccmce9_179(__req, __resp);
    }
    else
    {
      DiagResponse CVADAS_0001_00000000_000.* __resp;
      DiagRequest CVADAS_0001_00000000_000.Default_Session_Start __req;
      __diagServicevccmce9_179(__req, __resp);
    }
  }
  TestCommandEnd();


  {
    CreateTTEIFFunction("Ttvccmce9_F186_DID_with_PhysicalAdd_DefaultSession", __eFct, __eLocal);
    CallInterfaceFunction(__cEmpty, __cEmpty, "94cfa590-eac0-4499-adc5-5b1a2141e3ff");
  }


  TestCommandBegin(__eWait, __cWait, "", "5");
  {
    Wait("1", (2000 * 1000000LL), 1000000, "");
  }
  TestCommandEnd();

  {
    CreateTTEIFFunction("Ttvccmce9_F180_DID_with_Physical_Address", __eFct, __eLocal);
    CallInterfaceFunction(__cEmpty, __cEmpty, "de7ccffc-e582-4dc4-b99c-186965dd0afa");
  }



}

  
void __diagServicevccmce9_179(DiagRequest * __req, DiagResponse * __resp )
{
  stack long __tableHandle;
  long __res, __paramLen, __bytePos;

   __bVerdict = __eVerdictPass;

  do {
    TestReportResetDiagObjectList();
    DiagSetReportDetailLevel("CVADAS_0001_00000000_000", EnumServiceDetails_onfail);
    // Request aspect
    {

      if (0 >= DiagSendReqAndWaitForResp("CVADAS_0001_00000000_000", __req, __resp, __res, -1, -1, -1, -1, -1, EnumResult_pos, EnumServiceDetails_onfail, EnumSendingMode_physical, EnumSuppressPosResBit_asconfigured, EnumVerdictOnInvalidValues_fail))
        break;
    }

    __res = DiagErrCodeTestStep(__res, "Can't retrieve last response for request! No check possible.") < 0;
    if(__res)
    {
	  __bVerdict = __eVerdictFail;
      break;
    }
    {
      __res = DiagInterpretAs(__resp, "DSC_PR");
      if(__res != 0)
      {
        __bVerdict = __eVerdictFail;
        DiagErrCodeTestStep(__res, "Can't interpret response as diagnostic primitive 'DSC_PR'.");
        break;
      }
      else
      {
        TestStepPass( "Received primitive can be interpreted as diagnostic primitive 'DSC_PR'.");
      }
    }
  }
  while(0);


  // Response, check & read aspect
  {
    __res = 1;
    __tableHandle = ReportTableHead5Columns(__cCheckCaption, __cTSym, __cTOp, __cRefVal, __cActual, __cRes);
    {
      __bDiagValueArrayCtr = DiagGetParameterErrorHandled(__resp, "DiagSessionType", __bDiagValueArray, elcount(__bDiagValueArray), __cDiagValueArray, elcount(__cDiagValueArray));
      {
        byte __bArray2[1] = { 0x01 };
        __bArrayCtr = __CopyBytes(__bDiagValueArray, __bDiagValueArrayCtr, __bArray);
        __bArrayCtr2 = elCount(__bArray2);
        __csr = CompareBytes(__bArray, __bArrayCtr, __bArray2, __bArrayCtr2) == 0;
        snprintf(__cArray, 8192, "%s", "Diagnostic parameter \'DiagSessionType\'");
        snprintf(__cArray2, 8192, "%s", __cArray);
        snprintf(__cArray3, 8192, "%s", "");
        ReportTableRow(__tableHandle, 0, __cArray2, "Bytes", __bArray2, __bArrayCtr2, __cArray3, __oneOfFlag, __bSetInCheckAlignment);
        ReportCell(__tableHandle, __bArray, __bArrayCtr);
        ReportCellResult(__tableHandle, __csr, __ePassFail);
      }
    
      __res = __res && __csr;
    
    }
    ReportTableEndVerdict(__tableHandle, __cEvaluateResponse, __res);
	__bVerdict = __bVerdict && __res;
  }
  if (__bVerdict == __eVerdictFail)
    TestReportWriteDiagObjectList();
}
void Ttvccmce9_Tet_Tc61_Completion()
{
  stack long __tableHandle;
  TestCompletionBegin();
  {
    {
      CreateTTEIFFunction("Ttvccmce9_General_Postconditions", __eFct, __eLocal);
      CallInterfaceFunction(__cEmpty, __cEmpty, "3d1998f6-ed4f-4d8f-9c0f-63439c24b6a7");
    }


  }
  TestCompletionEnd();
}

void Ttvccmce9_Tet_Tc62()
{
  CreateTTEIFFunction("Ttvccmce9_Tc62", __eTcDef, __eLocal);  
  AddIFParameterTestCaseAttribute("TC_ID", "");
  AddIFParameterTestCaseAttribute("Test Case ID", "");
  CallInterfaceFunction("TC_ID_20205193_Extended_Session_Physical_and_Standard_Addressing", __cEmpty , __cEmpty );
}
testcase Ttvccmce9_Tc62()
{
  stack long __tableHandle;
  SetBreakOnFail(0);

  CreateTTEIFFunction("Ttvccmce9_Tet_Tc62_Completion", __eFct, __eLocal);
  
  AddIFAsCleanUpFunction();

  TestPreparationBegin();
  {
    {
      CreateTTEIFFunction("Ttvccmce9_General_Precondition", __eFct, __eLocal);
      CallInterfaceFunction(__cEmpty, __cEmpty, "b588ddda-8fe4-4271-93b3-dd1beefd9138");
    }


  }
  TestPreparationEnd();

  TestCommandBegin(__eDiagService, __cDiagService, "", "2");
  {
    if (DiagIsFunctionalGroup("CVADAS_0001_00000000_000"))
    {
      DiagResponse * __resp;
      DiagRequest CVADAS_0001_00000000_000.Default_Session_Start __req;
      __diagServicevccmce9_180(__req, __resp);
    }
    else
    {
      DiagResponse CVADAS_0001_00000000_000.* __resp;
      DiagRequest CVADAS_0001_00000000_000.Default_Session_Start __req;
      __diagServicevccmce9_180(__req, __resp);
    }
  }
  TestCommandEnd();


  TestCommandBegin(__eDiagService, __cDiagService, "", "3");
  {
    if (DiagIsFunctionalGroup("CVADAS_0001_00000000_000"))
    {
      DiagResponse * __resp;
      DiagRequest CVADAS_0001_00000000_000.Extended_Diagnostic_Session_Start __req;
      __diagServicevccmce9_181(__req, __resp);
    }
    else
    {
      DiagResponse CVADAS_0001_00000000_000.* __resp;
      DiagRequest CVADAS_0001_00000000_000.Extended_Diagnostic_Session_Start __req;
      __diagServicevccmce9_181(__req, __resp);
    }
  }
  TestCommandEnd();


  {
    CreateTTEIFFunction("Ttvccmce9_F186_DID_with_PhysicalAdd_ExtendedSession", __eFct, __eLocal);
    CallInterfaceFunction(__cEmpty, __cEmpty, "ef9ee47d-f468-4fc1-8d48-13fa51881535");
  }


  TestCommandBegin(__eWait, __cWait, "", "6");
  {
    Wait("1", (2000 * 1000000LL), 1000000, "");
  }
  TestCommandEnd();

  {
    CreateTTEIFFunction("Ttvccmce9_F180_DID_with_Physical_Address", __eFct, __eLocal);
    CallInterfaceFunction(__cEmpty, __cEmpty, "de7ccffc-e582-4dc4-b99c-186965dd0afa");
  }



}

  
void __diagServicevccmce9_180(DiagRequest * __req, DiagResponse * __resp )
{
  stack long __tableHandle;
  long __res, __paramLen, __bytePos;

   __bVerdict = __eVerdictPass;

  do {
    TestReportResetDiagObjectList();
    DiagSetReportDetailLevel("CVADAS_0001_00000000_000", EnumServiceDetails_onfail);
    // Request aspect
    {

      if (0 >= DiagSendReqAndWaitForResp("CVADAS_0001_00000000_000", __req, __resp, __res, -1, -1, -1, -1, -1, EnumResult_pos, EnumServiceDetails_onfail, EnumSendingMode_physical, EnumSuppressPosResBit_asconfigured, EnumVerdictOnInvalidValues_fail))
        break;
    }

    __res = DiagErrCodeTestStep(__res, "Can't retrieve last response for request! No check possible.") < 0;
    if(__res)
    {
	  __bVerdict = __eVerdictFail;
      break;
    }
    {
      __res = DiagInterpretAs(__resp, "DSC_PR");
      if(__res != 0)
      {
        __bVerdict = __eVerdictFail;
        DiagErrCodeTestStep(__res, "Can't interpret response as diagnostic primitive 'DSC_PR'.");
        break;
      }
      else
      {
        TestStepPass( "Received primitive can be interpreted as diagnostic primitive 'DSC_PR'.");
      }
    }
  }
  while(0);


  // Response, check & read aspect
  {
    __res = 1;
    __tableHandle = ReportTableHead5Columns(__cCheckCaption, __cTSym, __cTOp, __cRefVal, __cActual, __cRes);
    {
      __bDiagValueArrayCtr = DiagGetParameterErrorHandled(__resp, "DiagSessionType", __bDiagValueArray, elcount(__bDiagValueArray), __cDiagValueArray, elcount(__cDiagValueArray));
      {
        byte __bArray2[1] = { 0x01 };
        __bArrayCtr = __CopyBytes(__bDiagValueArray, __bDiagValueArrayCtr, __bArray);
        __bArrayCtr2 = elCount(__bArray2);
        __csr = CompareBytes(__bArray, __bArrayCtr, __bArray2, __bArrayCtr2) == 0;
        snprintf(__cArray, 8192, "%s", "Diagnostic parameter \'DiagSessionType\'");
        snprintf(__cArray2, 8192, "%s", __cArray);
        snprintf(__cArray3, 8192, "%s", "");
        ReportTableRow(__tableHandle, 0, __cArray2, "Bytes", __bArray2, __bArrayCtr2, __cArray3, __oneOfFlag, __bSetInCheckAlignment);
        ReportCell(__tableHandle, __bArray, __bArrayCtr);
        ReportCellResult(__tableHandle, __csr, __ePassFail);
      }
    
      __res = __res && __csr;
    
    }
    ReportTableEndVerdict(__tableHandle, __cEvaluateResponse, __res);
	__bVerdict = __bVerdict && __res;
  }
  if (__bVerdict == __eVerdictFail)
    TestReportWriteDiagObjectList();
}
  
void __diagServicevccmce9_181(DiagRequest * __req, DiagResponse * __resp )
{
  stack long __tableHandle;
  long __res, __paramLen, __bytePos;

   __bVerdict = __eVerdictPass;

  do {
    TestReportResetDiagObjectList();
    DiagSetReportDetailLevel("CVADAS_0001_00000000_000", EnumServiceDetails_onfail);
    // Request aspect
    {

      if (0 >= DiagSendReqAndWaitForResp("CVADAS_0001_00000000_000", __req, __resp, __res, -1, -1, -1, -1, -1, EnumResult_pos, EnumServiceDetails_onfail, EnumSendingMode_physical, EnumSuppressPosResBit_asconfigured, EnumVerdictOnInvalidValues_fail))
        break;
    }

    __res = DiagErrCodeTestStep(__res, "Can't retrieve last response for request! No check possible.") < 0;
    if(__res)
    {
	  __bVerdict = __eVerdictFail;
      break;
    }
    {
      __res = DiagInterpretAs(__resp, "DSC_PR");
      if(__res != 0)
      {
        __bVerdict = __eVerdictFail;
        DiagErrCodeTestStep(__res, "Can't interpret response as diagnostic primitive 'DSC_PR'.");
        break;
      }
      else
      {
        TestStepPass( "Received primitive can be interpreted as diagnostic primitive 'DSC_PR'.");
      }
    }
  }
  while(0);


  // Response, check & read aspect
  {
    __res = 1;
    __tableHandle = ReportTableHead5Columns(__cCheckCaption, __cTSym, __cTOp, __cRefVal, __cActual, __cRes);
    {
      __bDiagValueArrayCtr = DiagGetParameterErrorHandled(__resp, "DiagSessionType", __bDiagValueArray, elcount(__bDiagValueArray), __cDiagValueArray, elcount(__cDiagValueArray));
      {
        byte __bArray2[1] = { 0x03 };
        __bArrayCtr = __CopyBytes(__bDiagValueArray, __bDiagValueArrayCtr, __bArray);
        __bArrayCtr2 = elCount(__bArray2);
        __csr = CompareBytes(__bArray, __bArrayCtr, __bArray2, __bArrayCtr2) == 0;
        snprintf(__cArray, 8192, "%s", "Diagnostic parameter \'DiagSessionType\'");
        snprintf(__cArray2, 8192, "%s", __cArray);
        snprintf(__cArray3, 8192, "%s", "");
        ReportTableRow(__tableHandle, 0, __cArray2, "Bytes", __bArray2, __bArrayCtr2, __cArray3, __oneOfFlag, __bSetInCheckAlignment);
        ReportCell(__tableHandle, __bArray, __bArrayCtr);
        ReportCellResult(__tableHandle, __csr, __ePassFail);
      }
    
      __res = __res && __csr;
    
    }
    ReportTableEndVerdict(__tableHandle, __cEvaluateResponse, __res);
	__bVerdict = __bVerdict && __res;
  }
  if (__bVerdict == __eVerdictFail)
    TestReportWriteDiagObjectList();
}
void Ttvccmce9_Tet_Tc62_Completion()
{
  stack long __tableHandle;
  TestCompletionBegin();
  {
    {
      CreateTTEIFFunction("Ttvccmce9_General_Postconditions", __eFct, __eLocal);
      CallInterfaceFunction(__cEmpty, __cEmpty, "3d1998f6-ed4f-4d8f-9c0f-63439c24b6a7");
    }


  }
  TestCompletionEnd();
}

void Ttvccmce9_Tet_Tc63()
{
  CreateTTEIFFunction("Ttvccmce9_Tc63", __eTcDef, __eLocal);  
  AddIFParameterTestCaseAttribute("TC_ID", "");
  AddIFParameterTestCaseAttribute("Test Case ID", "");
  CallInterfaceFunction("TC_ID_20205179_Defaults_Session_Physical_and_Standard_Addressing", __cEmpty , __cEmpty );
}
testcase Ttvccmce9_Tc63()
{
  stack long __tableHandle;
  SetBreakOnFail(0);

  CreateTTEIFFunction("Ttvccmce9_Tet_Tc63_Completion", __eFct, __eLocal);
  
  AddIFAsCleanUpFunction();

  TestPreparationBegin();
  {
    {
      CreateTTEIFFunction("Ttvccmce9_General_Precondition", __eFct, __eLocal);
      CallInterfaceFunction(__cEmpty, __cEmpty, "b588ddda-8fe4-4271-93b3-dd1beefd9138");
    }


  }
  TestPreparationEnd();

  TestCommandBegin(__eDiagService, __cDiagService, "", "2");
  {
    if (DiagIsFunctionalGroup("CVADAS_0001_00000000_000"))
    {
      DiagResponse * __resp;
      DiagRequest CVADAS_0001_00000000_000.Default_Session_Start __req;
      __diagServicevccmce9_182(__req, __resp);
    }
    else
    {
      DiagResponse CVADAS_0001_00000000_000.* __resp;
      DiagRequest CVADAS_0001_00000000_000.Default_Session_Start __req;
      __diagServicevccmce9_182(__req, __resp);
    }
  }
  TestCommandEnd();


  {
    CreateTTEIFFunction("Ttvccmce9_F186_DID_with_PhysicalAdd_DefaultSession", __eFct, __eLocal);
    CallInterfaceFunction(__cEmpty, __cEmpty, "94cfa590-eac0-4499-adc5-5b1a2141e3ff");
  }


  {
    CreateTTEIFFunction("Ttvccmce9_F132_DID_with_Physical_Address", __eFct, __eLocal);
    CallInterfaceFunction(__cEmpty, __cEmpty, "3ca5b1a6-7a28-48d5-a4cd-63cd2672621d");
  }



}

  
void __diagServicevccmce9_182(DiagRequest * __req, DiagResponse * __resp )
{
  stack long __tableHandle;
  long __res, __paramLen, __bytePos;

   __bVerdict = __eVerdictPass;

  do {
    TestReportResetDiagObjectList();
    DiagSetReportDetailLevel("CVADAS_0001_00000000_000", EnumServiceDetails_onfail);
    // Request aspect
    {

      if (0 >= DiagSendReqAndWaitForResp("CVADAS_0001_00000000_000", __req, __resp, __res, -1, -1, -1, -1, -1, EnumResult_pos, EnumServiceDetails_onfail, EnumSendingMode_physical, EnumSuppressPosResBit_asconfigured, EnumVerdictOnInvalidValues_fail))
        break;
    }

    __res = DiagErrCodeTestStep(__res, "Can't retrieve last response for request! No check possible.") < 0;
    if(__res)
    {
	  __bVerdict = __eVerdictFail;
      break;
    }
    {
      __res = DiagInterpretAs(__resp, "DSC_PR");
      if(__res != 0)
      {
        __bVerdict = __eVerdictFail;
        DiagErrCodeTestStep(__res, "Can't interpret response as diagnostic primitive 'DSC_PR'.");
        break;
      }
      else
      {
        TestStepPass( "Received primitive can be interpreted as diagnostic primitive 'DSC_PR'.");
      }
    }
  }
  while(0);


  // Response, check & read aspect
  {
    __res = 1;
    __tableHandle = ReportTableHead5Columns(__cCheckCaption, __cTSym, __cTOp, __cRefVal, __cActual, __cRes);
    {
      __bDiagValueArrayCtr = DiagGetParameterErrorHandled(__resp, "DiagSessionType", __bDiagValueArray, elcount(__bDiagValueArray), __cDiagValueArray, elcount(__cDiagValueArray));
      {
        byte __bArray2[1] = { 0x01 };
        __bArrayCtr = __CopyBytes(__bDiagValueArray, __bDiagValueArrayCtr, __bArray);
        __bArrayCtr2 = elCount(__bArray2);
        __csr = CompareBytes(__bArray, __bArrayCtr, __bArray2, __bArrayCtr2) == 0;
        snprintf(__cArray, 8192, "%s", "Diagnostic parameter \'DiagSessionType\'");
        snprintf(__cArray2, 8192, "%s", __cArray);
        snprintf(__cArray3, 8192, "%s", "");
        ReportTableRow(__tableHandle, 0, __cArray2, "Bytes", __bArray2, __bArrayCtr2, __cArray3, __oneOfFlag, __bSetInCheckAlignment);
        ReportCell(__tableHandle, __bArray, __bArrayCtr);
        ReportCellResult(__tableHandle, __csr, __ePassFail);
      }
    
      __res = __res && __csr;
    
    }
    ReportTableEndVerdict(__tableHandle, __cEvaluateResponse, __res);
	__bVerdict = __bVerdict && __res;
  }
  if (__bVerdict == __eVerdictFail)
    TestReportWriteDiagObjectList();
}
void Ttvccmce9_Tet_Tc63_Completion()
{
  stack long __tableHandle;
  TestCompletionBegin();
  {
    {
      CreateTTEIFFunction("Ttvccmce9_General_Postconditions", __eFct, __eLocal);
      CallInterfaceFunction(__cEmpty, __cEmpty, "3d1998f6-ed4f-4d8f-9c0f-63439c24b6a7");
    }


  }
  TestCompletionEnd();
}

void Ttvccmce9_Tet_Tc64()
{
  CreateTTEIFFunction("Ttvccmce9_Tc64", __eTcDef, __eLocal);  
  AddIFParameterTestCaseAttribute("TC_ID", "");
  AddIFParameterTestCaseAttribute("Test Case ID", "");
  CallInterfaceFunction("TC_ID_20205181_Extended_Session_Physical_and_Standard_Addressing", __cEmpty , __cEmpty );
}
testcase Ttvccmce9_Tc64()
{
  stack long __tableHandle;
  SetBreakOnFail(0);

  CreateTTEIFFunction("Ttvccmce9_Tet_Tc64_Completion", __eFct, __eLocal);
  
  AddIFAsCleanUpFunction();

  TestPreparationBegin();
  {
    {
      CreateTTEIFFunction("Ttvccmce9_General_Precondition", __eFct, __eLocal);
      CallInterfaceFunction(__cEmpty, __cEmpty, "b588ddda-8fe4-4271-93b3-dd1beefd9138");
    }


  }
  TestPreparationEnd();

  TestCommandBegin(__eDiagService, __cDiagService, "", "2");
  {
    if (DiagIsFunctionalGroup("CVADAS_0001_00000000_000"))
    {
      DiagResponse * __resp;
      DiagRequest CVADAS_0001_00000000_000.Default_Session_Start __req;
      __diagServicevccmce9_183(__req, __resp);
    }
    else
    {
      DiagResponse CVADAS_0001_00000000_000.* __resp;
      DiagRequest CVADAS_0001_00000000_000.Default_Session_Start __req;
      __diagServicevccmce9_183(__req, __resp);
    }
  }
  TestCommandEnd();


  TestCommandBegin(__eDiagService, __cDiagService, "", "3");
  {
    if (DiagIsFunctionalGroup("CVADAS_0001_00000000_000"))
    {
      DiagResponse * __resp;
      DiagRequest CVADAS_0001_00000000_000.Extended_Diagnostic_Session_Start __req;
      __diagServicevccmce9_184(__req, __resp);
    }
    else
    {
      DiagResponse CVADAS_0001_00000000_000.* __resp;
      DiagRequest CVADAS_0001_00000000_000.Extended_Diagnostic_Session_Start __req;
      __diagServicevccmce9_184(__req, __resp);
    }
  }
  TestCommandEnd();


  {
    CreateTTEIFFunction("Ttvccmce9_F186_DID_with_PhysicalAdd_ExtendedSession", __eFct, __eLocal);
    CallInterfaceFunction(__cEmpty, __cEmpty, "ef9ee47d-f468-4fc1-8d48-13fa51881535");
  }


  {
    CreateTTEIFFunction("Ttvccmce9_F132_DID_with_Physical_Address", __eFct, __eLocal);
    CallInterfaceFunction(__cEmpty, __cEmpty, "3ca5b1a6-7a28-48d5-a4cd-63cd2672621d");
  }



}

  
void __diagServicevccmce9_183(DiagRequest * __req, DiagResponse * __resp )
{
  stack long __tableHandle;
  long __res, __paramLen, __bytePos;

   __bVerdict = __eVerdictPass;

  do {
    TestReportResetDiagObjectList();
    DiagSetReportDetailLevel("CVADAS_0001_00000000_000", EnumServiceDetails_onfail);
    // Request aspect
    {

      if (0 >= DiagSendReqAndWaitForResp("CVADAS_0001_00000000_000", __req, __resp, __res, -1, -1, -1, -1, -1, EnumResult_pos, EnumServiceDetails_onfail, EnumSendingMode_physical, EnumSuppressPosResBit_asconfigured, EnumVerdictOnInvalidValues_fail))
        break;
    }

    __res = DiagErrCodeTestStep(__res, "Can't retrieve last response for request! No check possible.") < 0;
    if(__res)
    {
	  __bVerdict = __eVerdictFail;
      break;
    }
    {
      __res = DiagInterpretAs(__resp, "DSC_PR");
      if(__res != 0)
      {
        __bVerdict = __eVerdictFail;
        DiagErrCodeTestStep(__res, "Can't interpret response as diagnostic primitive 'DSC_PR'.");
        break;
      }
      else
      {
        TestStepPass( "Received primitive can be interpreted as diagnostic primitive 'DSC_PR'.");
      }
    }
  }
  while(0);


  // Response, check & read aspect
  {
    __res = 1;
    __tableHandle = ReportTableHead5Columns(__cCheckCaption, __cTSym, __cTOp, __cRefVal, __cActual, __cRes);
    {
      __bDiagValueArrayCtr = DiagGetParameterErrorHandled(__resp, "DiagSessionType", __bDiagValueArray, elcount(__bDiagValueArray), __cDiagValueArray, elcount(__cDiagValueArray));
      {
        byte __bArray2[1] = { 0x01 };
        __bArrayCtr = __CopyBytes(__bDiagValueArray, __bDiagValueArrayCtr, __bArray);
        __bArrayCtr2 = elCount(__bArray2);
        __csr = CompareBytes(__bArray, __bArrayCtr, __bArray2, __bArrayCtr2) == 0;
        snprintf(__cArray, 8192, "%s", "Diagnostic parameter \'DiagSessionType\'");
        snprintf(__cArray2, 8192, "%s", __cArray);
        snprintf(__cArray3, 8192, "%s", "");
        ReportTableRow(__tableHandle, 0, __cArray2, "Bytes", __bArray2, __bArrayCtr2, __cArray3, __oneOfFlag, __bSetInCheckAlignment);
        ReportCell(__tableHandle, __bArray, __bArrayCtr);
        ReportCellResult(__tableHandle, __csr, __ePassFail);
      }
    
      __res = __res && __csr;
    
    }
    ReportTableEndVerdict(__tableHandle, __cEvaluateResponse, __res);
	__bVerdict = __bVerdict && __res;
  }
  if (__bVerdict == __eVerdictFail)
    TestReportWriteDiagObjectList();
}
  
void __diagServicevccmce9_184(DiagRequest * __req, DiagResponse * __resp )
{
  stack long __tableHandle;
  long __res, __paramLen, __bytePos;

   __bVerdict = __eVerdictPass;

  do {
    TestReportResetDiagObjectList();
    DiagSetReportDetailLevel("CVADAS_0001_00000000_000", EnumServiceDetails_onfail);
    // Request aspect
    {

      if (0 >= DiagSendReqAndWaitForResp("CVADAS_0001_00000000_000", __req, __resp, __res, -1, -1, -1, -1, -1, EnumResult_pos, EnumServiceDetails_onfail, EnumSendingMode_physical, EnumSuppressPosResBit_asconfigured, EnumVerdictOnInvalidValues_fail))
        break;
    }

    __res = DiagErrCodeTestStep(__res, "Can't retrieve last response for request! No check possible.") < 0;
    if(__res)
    {
	  __bVerdict = __eVerdictFail;
      break;
    }
    {
      __res = DiagInterpretAs(__resp, "DSC_PR");
      if(__res != 0)
      {
        __bVerdict = __eVerdictFail;
        DiagErrCodeTestStep(__res, "Can't interpret response as diagnostic primitive 'DSC_PR'.");
        break;
      }
      else
      {
        TestStepPass( "Received primitive can be interpreted as diagnostic primitive 'DSC_PR'.");
      }
    }
  }
  while(0);


  // Response, check & read aspect
  {
    __res = 1;
    __tableHandle = ReportTableHead5Columns(__cCheckCaption, __cTSym, __cTOp, __cRefVal, __cActual, __cRes);
    {
      __bDiagValueArrayCtr = DiagGetParameterErrorHandled(__resp, "DiagSessionType", __bDiagValueArray, elcount(__bDiagValueArray), __cDiagValueArray, elcount(__cDiagValueArray));
      {
        byte __bArray2[1] = { 0x03 };
        __bArrayCtr = __CopyBytes(__bDiagValueArray, __bDiagValueArrayCtr, __bArray);
        __bArrayCtr2 = elCount(__bArray2);
        __csr = CompareBytes(__bArray, __bArrayCtr, __bArray2, __bArrayCtr2) == 0;
        snprintf(__cArray, 8192, "%s", "Diagnostic parameter \'DiagSessionType\'");
        snprintf(__cArray2, 8192, "%s", __cArray);
        snprintf(__cArray3, 8192, "%s", "");
        ReportTableRow(__tableHandle, 0, __cArray2, "Bytes", __bArray2, __bArrayCtr2, __cArray3, __oneOfFlag, __bSetInCheckAlignment);
        ReportCell(__tableHandle, __bArray, __bArrayCtr);
        ReportCellResult(__tableHandle, __csr, __ePassFail);
      }
    
      __res = __res && __csr;
    
    }
    ReportTableEndVerdict(__tableHandle, __cEvaluateResponse, __res);
	__bVerdict = __bVerdict && __res;
  }
  if (__bVerdict == __eVerdictFail)
    TestReportWriteDiagObjectList();
}
void Ttvccmce9_Tet_Tc64_Completion()
{
  stack long __tableHandle;
  TestCompletionBegin();
  {
    {
      CreateTTEIFFunction("Ttvccmce9_General_Postconditions", __eFct, __eLocal);
      CallInterfaceFunction(__cEmpty, __cEmpty, "3d1998f6-ed4f-4d8f-9c0f-63439c24b6a7");
    }


  }
  TestCompletionEnd();
}

void Ttvccmce9_Tet_Tc65()
{
  CreateTTEIFFunction("Ttvccmce9_Tc65", __eTcDef, __eLocal);  
  AddIFParameterTestCaseAttribute("TC_ID", "");
  AddIFParameterTestCaseAttribute("Test Case ID", "");
  CallInterfaceFunction("TC_ID_20205379_Defaults_Session_Physical_and_Standard_Addressing", __cEmpty , __cEmpty );
}
testcase Ttvccmce9_Tc65()
{
  stack long __tableHandle;
  SetBreakOnFail(0);

  CreateTTEIFFunction("Ttvccmce9_Tet_Tc65_Completion", __eFct, __eLocal);
  
  AddIFAsCleanUpFunction();

  TestPreparationBegin();
  {
    {
      CreateTTEIFFunction("Ttvccmce9_General_Precondition", __eFct, __eLocal);
      CallInterfaceFunction(__cEmpty, __cEmpty, "b588ddda-8fe4-4271-93b3-dd1beefd9138");
    }


  }
  TestPreparationEnd();

  TestCommandBegin(__eDiagService, __cDiagService, "", "2");
  {
    if (DiagIsFunctionalGroup("CVADAS_0001_00000000_000"))
    {
      DiagResponse * __resp;
      DiagRequest CVADAS_0001_00000000_000.Default_Session_Start __req;
      __diagServicevccmce9_185(__req, __resp);
    }
    else
    {
      DiagResponse CVADAS_0001_00000000_000.* __resp;
      DiagRequest CVADAS_0001_00000000_000.Default_Session_Start __req;
      __diagServicevccmce9_185(__req, __resp);
    }
  }
  TestCommandEnd();


  {
    CreateTTEIFFunction("Ttvccmce9_F186_DID_with_PhysicalAdd_DefaultSession", __eFct, __eLocal);
    CallInterfaceFunction(__cEmpty, __cEmpty, "94cfa590-eac0-4499-adc5-5b1a2141e3ff");
  }


  {
    CreateTTEIFFunction("Ttvccmce9_F187_DID_with_Physical_Address", __eFct, __eLocal);
    CallInterfaceFunction(__cEmpty, __cEmpty, "c9ea355b-dc58-4a71-817d-7ada42d6094a");
  }



}

  
void __diagServicevccmce9_185(DiagRequest * __req, DiagResponse * __resp )
{
  stack long __tableHandle;
  long __res, __paramLen, __bytePos;

   __bVerdict = __eVerdictPass;

  do {
    TestReportResetDiagObjectList();
    DiagSetReportDetailLevel("CVADAS_0001_00000000_000", EnumServiceDetails_onfail);
    // Request aspect
    {

      if (0 >= DiagSendReqAndWaitForResp("CVADAS_0001_00000000_000", __req, __resp, __res, -1, -1, -1, -1, -1, EnumResult_pos, EnumServiceDetails_onfail, EnumSendingMode_physical, EnumSuppressPosResBit_asconfigured, EnumVerdictOnInvalidValues_fail))
        break;
    }

    __res = DiagErrCodeTestStep(__res, "Can't retrieve last response for request! No check possible.") < 0;
    if(__res)
    {
	  __bVerdict = __eVerdictFail;
      break;
    }
    {
      __res = DiagInterpretAs(__resp, "DSC_PR");
      if(__res != 0)
      {
        __bVerdict = __eVerdictFail;
        DiagErrCodeTestStep(__res, "Can't interpret response as diagnostic primitive 'DSC_PR'.");
        break;
      }
      else
      {
        TestStepPass( "Received primitive can be interpreted as diagnostic primitive 'DSC_PR'.");
      }
    }
  }
  while(0);


  // Response, check & read aspect
  {
    __res = 1;
    __tableHandle = ReportTableHead5Columns(__cCheckCaption, __cTSym, __cTOp, __cRefVal, __cActual, __cRes);
    {
      __bDiagValueArrayCtr = DiagGetParameterErrorHandled(__resp, "DiagSessionType", __bDiagValueArray, elcount(__bDiagValueArray), __cDiagValueArray, elcount(__cDiagValueArray));
      {
        byte __bArray2[1] = { 0x01 };
        __bArrayCtr = __CopyBytes(__bDiagValueArray, __bDiagValueArrayCtr, __bArray);
        __bArrayCtr2 = elCount(__bArray2);
        __csr = CompareBytes(__bArray, __bArrayCtr, __bArray2, __bArrayCtr2) == 0;
        snprintf(__cArray, 8192, "%s", "Diagnostic parameter \'DiagSessionType\'");
        snprintf(__cArray2, 8192, "%s", __cArray);
        snprintf(__cArray3, 8192, "%s", "");
        ReportTableRow(__tableHandle, 0, __cArray2, "Bytes", __bArray2, __bArrayCtr2, __cArray3, __oneOfFlag, __bSetInCheckAlignment);
        ReportCell(__tableHandle, __bArray, __bArrayCtr);
        ReportCellResult(__tableHandle, __csr, __ePassFail);
      }
    
      __res = __res && __csr;
    
    }
    ReportTableEndVerdict(__tableHandle, __cEvaluateResponse, __res);
	__bVerdict = __bVerdict && __res;
  }
  if (__bVerdict == __eVerdictFail)
    TestReportWriteDiagObjectList();
}
void Ttvccmce9_Tet_Tc65_Completion()
{
  stack long __tableHandle;
  TestCompletionBegin();
  {
    {
      CreateTTEIFFunction("Ttvccmce9_General_Postconditions", __eFct, __eLocal);
      CallInterfaceFunction(__cEmpty, __cEmpty, "3d1998f6-ed4f-4d8f-9c0f-63439c24b6a7");
    }


  }
  TestCompletionEnd();
}

void Ttvccmce9_Tet_Tc66()
{
  CreateTTEIFFunction("Ttvccmce9_Tc66", __eTcDef, __eLocal);  
  AddIFParameterTestCaseAttribute("TC_ID", "");
  AddIFParameterTestCaseAttribute("Test Case ID", "");
  CallInterfaceFunction("TC_ID_20205357_Extended_Session_Physical_and_Standard_Addressing", __cEmpty , __cEmpty );
}
testcase Ttvccmce9_Tc66()
{
  stack long __tableHandle;
  SetBreakOnFail(0);

  CreateTTEIFFunction("Ttvccmce9_Tet_Tc66_Completion", __eFct, __eLocal);
  
  AddIFAsCleanUpFunction();

  TestPreparationBegin();
  {
    {
      CreateTTEIFFunction("Ttvccmce9_General_Precondition", __eFct, __eLocal);
      CallInterfaceFunction(__cEmpty, __cEmpty, "b588ddda-8fe4-4271-93b3-dd1beefd9138");
    }


  }
  TestPreparationEnd();

  TestCommandBegin(__eDiagService, __cDiagService, "", "2");
  {
    if (DiagIsFunctionalGroup("CVADAS_0001_00000000_000"))
    {
      DiagResponse * __resp;
      DiagRequest CVADAS_0001_00000000_000.Default_Session_Start __req;
      __diagServicevccmce9_186(__req, __resp);
    }
    else
    {
      DiagResponse CVADAS_0001_00000000_000.* __resp;
      DiagRequest CVADAS_0001_00000000_000.Default_Session_Start __req;
      __diagServicevccmce9_186(__req, __resp);
    }
  }
  TestCommandEnd();


  TestCommandBegin(__eDiagService, __cDiagService, "", "3");
  {
    if (DiagIsFunctionalGroup("CVADAS_0001_00000000_000"))
    {
      DiagResponse * __resp;
      DiagRequest CVADAS_0001_00000000_000.Extended_Diagnostic_Session_Start __req;
      __diagServicevccmce9_187(__req, __resp);
    }
    else
    {
      DiagResponse CVADAS_0001_00000000_000.* __resp;
      DiagRequest CVADAS_0001_00000000_000.Extended_Diagnostic_Session_Start __req;
      __diagServicevccmce9_187(__req, __resp);
    }
  }
  TestCommandEnd();


  {
    CreateTTEIFFunction("Ttvccmce9_F186_DID_with_PhysicalAdd_ExtendedSession", __eFct, __eLocal);
    CallInterfaceFunction(__cEmpty, __cEmpty, "ef9ee47d-f468-4fc1-8d48-13fa51881535");
  }


  {
    CreateTTEIFFunction("Ttvccmce9_F187_DID_with_Physical_Address", __eFct, __eLocal);
    CallInterfaceFunction(__cEmpty, __cEmpty, "c9ea355b-dc58-4a71-817d-7ada42d6094a");
  }



}

  
void __diagServicevccmce9_186(DiagRequest * __req, DiagResponse * __resp )
{
  stack long __tableHandle;
  long __res, __paramLen, __bytePos;

   __bVerdict = __eVerdictPass;

  do {
    TestReportResetDiagObjectList();
    DiagSetReportDetailLevel("CVADAS_0001_00000000_000", EnumServiceDetails_onfail);
    // Request aspect
    {

      if (0 >= DiagSendReqAndWaitForResp("CVADAS_0001_00000000_000", __req, __resp, __res, -1, -1, -1, -1, -1, EnumResult_pos, EnumServiceDetails_onfail, EnumSendingMode_physical, EnumSuppressPosResBit_asconfigured, EnumVerdictOnInvalidValues_fail))
        break;
    }

    __res = DiagErrCodeTestStep(__res, "Can't retrieve last response for request! No check possible.") < 0;
    if(__res)
    {
	  __bVerdict = __eVerdictFail;
      break;
    }
    {
      __res = DiagInterpretAs(__resp, "DSC_PR");
      if(__res != 0)
      {
        __bVerdict = __eVerdictFail;
        DiagErrCodeTestStep(__res, "Can't interpret response as diagnostic primitive 'DSC_PR'.");
        break;
      }
      else
      {
        TestStepPass( "Received primitive can be interpreted as diagnostic primitive 'DSC_PR'.");
      }
    }
  }
  while(0);


  // Response, check & read aspect
  {
    __res = 1;
    __tableHandle = ReportTableHead5Columns(__cCheckCaption, __cTSym, __cTOp, __cRefVal, __cActual, __cRes);
    {
      __bDiagValueArrayCtr = DiagGetParameterErrorHandled(__resp, "DiagSessionType", __bDiagValueArray, elcount(__bDiagValueArray), __cDiagValueArray, elcount(__cDiagValueArray));
      {
        byte __bArray2[1] = { 0x01 };
        __bArrayCtr = __CopyBytes(__bDiagValueArray, __bDiagValueArrayCtr, __bArray);
        __bArrayCtr2 = elCount(__bArray2);
        __csr = CompareBytes(__bArray, __bArrayCtr, __bArray2, __bArrayCtr2) == 0;
        snprintf(__cArray, 8192, "%s", "Diagnostic parameter \'DiagSessionType\'");
        snprintf(__cArray2, 8192, "%s", __cArray);
        snprintf(__cArray3, 8192, "%s", "");
        ReportTableRow(__tableHandle, 0, __cArray2, "Bytes", __bArray2, __bArrayCtr2, __cArray3, __oneOfFlag, __bSetInCheckAlignment);
        ReportCell(__tableHandle, __bArray, __bArrayCtr);
        ReportCellResult(__tableHandle, __csr, __ePassFail);
      }
    
      __res = __res && __csr;
    
    }
    ReportTableEndVerdict(__tableHandle, __cEvaluateResponse, __res);
	__bVerdict = __bVerdict && __res;
  }
  if (__bVerdict == __eVerdictFail)
    TestReportWriteDiagObjectList();
}
  
void __diagServicevccmce9_187(DiagRequest * __req, DiagResponse * __resp )
{
  stack long __tableHandle;
  long __res, __paramLen, __bytePos;

   __bVerdict = __eVerdictPass;

  do {
    TestReportResetDiagObjectList();
    DiagSetReportDetailLevel("CVADAS_0001_00000000_000", EnumServiceDetails_onfail);
    // Request aspect
    {

      if (0 >= DiagSendReqAndWaitForResp("CVADAS_0001_00000000_000", __req, __resp, __res, -1, -1, -1, -1, -1, EnumResult_pos, EnumServiceDetails_onfail, EnumSendingMode_physical, EnumSuppressPosResBit_asconfigured, EnumVerdictOnInvalidValues_fail))
        break;
    }

    __res = DiagErrCodeTestStep(__res, "Can't retrieve last response for request! No check possible.") < 0;
    if(__res)
    {
	  __bVerdict = __eVerdictFail;
      break;
    }
    {
      __res = DiagInterpretAs(__resp, "DSC_PR");
      if(__res != 0)
      {
        __bVerdict = __eVerdictFail;
        DiagErrCodeTestStep(__res, "Can't interpret response as diagnostic primitive 'DSC_PR'.");
        break;
      }
      else
      {
        TestStepPass( "Received primitive can be interpreted as diagnostic primitive 'DSC_PR'.");
      }
    }
  }
  while(0);


  // Response, check & read aspect
  {
    __res = 1;
    __tableHandle = ReportTableHead5Columns(__cCheckCaption, __cTSym, __cTOp, __cRefVal, __cActual, __cRes);
    {
      __bDiagValueArrayCtr = DiagGetParameterErrorHandled(__resp, "DiagSessionType", __bDiagValueArray, elcount(__bDiagValueArray), __cDiagValueArray, elcount(__cDiagValueArray));
      {
        byte __bArray2[1] = { 0x03 };
        __bArrayCtr = __CopyBytes(__bDiagValueArray, __bDiagValueArrayCtr, __bArray);
        __bArrayCtr2 = elCount(__bArray2);
        __csr = CompareBytes(__bArray, __bArrayCtr, __bArray2, __bArrayCtr2) == 0;
        snprintf(__cArray, 8192, "%s", "Diagnostic parameter \'DiagSessionType\'");
        snprintf(__cArray2, 8192, "%s", __cArray);
        snprintf(__cArray3, 8192, "%s", "");
        ReportTableRow(__tableHandle, 0, __cArray2, "Bytes", __bArray2, __bArrayCtr2, __cArray3, __oneOfFlag, __bSetInCheckAlignment);
        ReportCell(__tableHandle, __bArray, __bArrayCtr);
        ReportCellResult(__tableHandle, __csr, __ePassFail);
      }
    
      __res = __res && __csr;
    
    }
    ReportTableEndVerdict(__tableHandle, __cEvaluateResponse, __res);
	__bVerdict = __bVerdict && __res;
  }
  if (__bVerdict == __eVerdictFail)
    TestReportWriteDiagObjectList();
}
void Ttvccmce9_Tet_Tc66_Completion()
{
  stack long __tableHandle;
  TestCompletionBegin();
  {
    {
      CreateTTEIFFunction("Ttvccmce9_General_Postconditions", __eFct, __eLocal);
      CallInterfaceFunction(__cEmpty, __cEmpty, "3d1998f6-ed4f-4d8f-9c0f-63439c24b6a7");
    }


  }
  TestCompletionEnd();
}

void Ttvccmce9_Tet_Tc67()
{
  CreateTTEIFFunction("Ttvccmce9_Tc67", __eTcDef, __eLocal);  
  AddIFParameterTestCaseAttribute("TC_ID", "");
  AddIFParameterTestCaseAttribute("Test Case ID", "");
  CallInterfaceFunction("TC_ID_20205242_Defaults_Session_Physical_and_Standard_Addressing", __cEmpty , __cEmpty );
}
testcase Ttvccmce9_Tc67()
{
  stack long __tableHandle;
  SetBreakOnFail(0);

  CreateTTEIFFunction("Ttvccmce9_Tet_Tc67_Completion", __eFct, __eLocal);
  
  AddIFAsCleanUpFunction();

  TestPreparationBegin();
  {
    {
      CreateTTEIFFunction("Ttvccmce9_General_Precondition", __eFct, __eLocal);
      CallInterfaceFunction(__cEmpty, __cEmpty, "b588ddda-8fe4-4271-93b3-dd1beefd9138");
    }


  }
  TestPreparationEnd();

  TestCommandBegin(__eDiagService, __cDiagService, "", "2");
  {
    if (DiagIsFunctionalGroup("CVADAS_0001_00000000_000"))
    {
      DiagResponse * __resp;
      DiagRequest CVADAS_0001_00000000_000.Default_Session_Start __req;
      __diagServicevccmce9_188(__req, __resp);
    }
    else
    {
      DiagResponse CVADAS_0001_00000000_000.* __resp;
      DiagRequest CVADAS_0001_00000000_000.Default_Session_Start __req;
      __diagServicevccmce9_188(__req, __resp);
    }
  }
  TestCommandEnd();


  {
    CreateTTEIFFunction("Ttvccmce9_F186_DID_with_PhysicalAdd_DefaultSession", __eFct, __eLocal);
    CallInterfaceFunction(__cEmpty, __cEmpty, "94cfa590-eac0-4499-adc5-5b1a2141e3ff");
  }


  TestCommandBegin(__eWait, __cWait, "", "4");
  {
    Wait("1", (2000 * 1000000LL), 1000000, "");
  }
  TestCommandEnd();

  {
    CreateTTEIFFunction("Ttvccmce9_F112_DID_with_Physical_Addressing", __eFct, __eLocal);
    CallInterfaceFunction(__cEmpty, __cEmpty, "2e47bb24-367d-46d5-90aa-9394ddf7fb1c");
  }



}

  
void __diagServicevccmce9_188(DiagRequest * __req, DiagResponse * __resp )
{
  stack long __tableHandle;
  long __res, __paramLen, __bytePos;

   __bVerdict = __eVerdictPass;

  do {
    TestReportResetDiagObjectList();
    DiagSetReportDetailLevel("CVADAS_0001_00000000_000", EnumServiceDetails_onfail);
    // Request aspect
    {

      if (0 >= DiagSendReqAndWaitForResp("CVADAS_0001_00000000_000", __req, __resp, __res, -1, -1, -1, -1, -1, EnumResult_pos, EnumServiceDetails_onfail, EnumSendingMode_physical, EnumSuppressPosResBit_asconfigured, EnumVerdictOnInvalidValues_fail))
        break;
    }

    __res = DiagErrCodeTestStep(__res, "Can't retrieve last response for request! No check possible.") < 0;
    if(__res)
    {
	  __bVerdict = __eVerdictFail;
      break;
    }
    {
      __res = DiagInterpretAs(__resp, "DSC_PR");
      if(__res != 0)
      {
        __bVerdict = __eVerdictFail;
        DiagErrCodeTestStep(__res, "Can't interpret response as diagnostic primitive 'DSC_PR'.");
        break;
      }
      else
      {
        TestStepPass( "Received primitive can be interpreted as diagnostic primitive 'DSC_PR'.");
      }
    }
  }
  while(0);


  // Response, check & read aspect
  {
    __res = 1;
    __tableHandle = ReportTableHead5Columns(__cCheckCaption, __cTSym, __cTOp, __cRefVal, __cActual, __cRes);
    {
      __bDiagValueArrayCtr = DiagGetParameterErrorHandled(__resp, "DiagSessionType", __bDiagValueArray, elcount(__bDiagValueArray), __cDiagValueArray, elcount(__cDiagValueArray));
      {
        byte __bArray2[1] = { 0x01 };
        __bArrayCtr = __CopyBytes(__bDiagValueArray, __bDiagValueArrayCtr, __bArray);
        __bArrayCtr2 = elCount(__bArray2);
        __csr = CompareBytes(__bArray, __bArrayCtr, __bArray2, __bArrayCtr2) == 0;
        snprintf(__cArray, 8192, "%s", "Diagnostic parameter \'DiagSessionType\'");
        snprintf(__cArray2, 8192, "%s", __cArray);
        snprintf(__cArray3, 8192, "%s", "");
        ReportTableRow(__tableHandle, 0, __cArray2, "Bytes", __bArray2, __bArrayCtr2, __cArray3, __oneOfFlag, __bSetInCheckAlignment);
        ReportCell(__tableHandle, __bArray, __bArrayCtr);
        ReportCellResult(__tableHandle, __csr, __ePassFail);
      }
    
      __res = __res && __csr;
    
    }
    ReportTableEndVerdict(__tableHandle, __cEvaluateResponse, __res);
	__bVerdict = __bVerdict && __res;
  }
  if (__bVerdict == __eVerdictFail)
    TestReportWriteDiagObjectList();
}
void Ttvccmce9_Tet_Tc67_Completion()
{
  stack long __tableHandle;
  TestCompletionBegin();
  {
    {
      CreateTTEIFFunction("Ttvccmce9_General_Postconditions", __eFct, __eLocal);
      CallInterfaceFunction(__cEmpty, __cEmpty, "3d1998f6-ed4f-4d8f-9c0f-63439c24b6a7");
    }


  }
  TestCompletionEnd();
}

void Ttvccmce9_Tet_Tc68()
{
  CreateTTEIFFunction("Ttvccmce9_Tc68", __eTcDef, __eLocal);  
  AddIFParameterTestCaseAttribute("TC_ID", "");
  AddIFParameterTestCaseAttribute("Test Case ID", "");
  CallInterfaceFunction("TC_ID_20205241_Extended_Session_Physical_and_Standard_Addressing", __cEmpty , __cEmpty );
}
testcase Ttvccmce9_Tc68()
{
  stack long __tableHandle;
  SetBreakOnFail(0);

  CreateTTEIFFunction("Ttvccmce9_Tet_Tc68_Completion", __eFct, __eLocal);
  
  AddIFAsCleanUpFunction();

  TestPreparationBegin();
  {
    {
      CreateTTEIFFunction("Ttvccmce9_General_Precondition", __eFct, __eLocal);
      CallInterfaceFunction(__cEmpty, __cEmpty, "b588ddda-8fe4-4271-93b3-dd1beefd9138");
    }


  }
  TestPreparationEnd();

  TestCommandBegin(__eDiagService, __cDiagService, "", "2");
  {
    if (DiagIsFunctionalGroup("CVADAS_0001_00000000_000"))
    {
      DiagResponse * __resp;
      DiagRequest CVADAS_0001_00000000_000.Default_Session_Start __req;
      __diagServicevccmce9_189(__req, __resp);
    }
    else
    {
      DiagResponse CVADAS_0001_00000000_000.* __resp;
      DiagRequest CVADAS_0001_00000000_000.Default_Session_Start __req;
      __diagServicevccmce9_189(__req, __resp);
    }
  }
  TestCommandEnd();


  TestCommandBegin(__eDiagService, __cDiagService, "", "3");
  {
    if (DiagIsFunctionalGroup("CVADAS_0001_00000000_000"))
    {
      DiagResponse * __resp;
      DiagRequest CVADAS_0001_00000000_000.Extended_Diagnostic_Session_Start __req;
      __diagServicevccmce9_190(__req, __resp);
    }
    else
    {
      DiagResponse CVADAS_0001_00000000_000.* __resp;
      DiagRequest CVADAS_0001_00000000_000.Extended_Diagnostic_Session_Start __req;
      __diagServicevccmce9_190(__req, __resp);
    }
  }
  TestCommandEnd();


  {
    CreateTTEIFFunction("Ttvccmce9_F186_DID_with_PhysicalAdd_ExtendedSession", __eFct, __eLocal);
    CallInterfaceFunction(__cEmpty, __cEmpty, "ef9ee47d-f468-4fc1-8d48-13fa51881535");
  }


  {
    CreateTTEIFFunction("Ttvccmce9_F112_DID_with_Physical_Addressing", __eFct, __eLocal);
    CallInterfaceFunction(__cEmpty, __cEmpty, "2e47bb24-367d-46d5-90aa-9394ddf7fb1c");
  }



}

  
void __diagServicevccmce9_189(DiagRequest * __req, DiagResponse * __resp )
{
  stack long __tableHandle;
  long __res, __paramLen, __bytePos;

   __bVerdict = __eVerdictPass;

  do {
    TestReportResetDiagObjectList();
    DiagSetReportDetailLevel("CVADAS_0001_00000000_000", EnumServiceDetails_onfail);
    // Request aspect
    {

      if (0 >= DiagSendReqAndWaitForResp("CVADAS_0001_00000000_000", __req, __resp, __res, -1, -1, -1, -1, -1, EnumResult_pos, EnumServiceDetails_onfail, EnumSendingMode_physical, EnumSuppressPosResBit_asconfigured, EnumVerdictOnInvalidValues_fail))
        break;
    }

    __res = DiagErrCodeTestStep(__res, "Can't retrieve last response for request! No check possible.") < 0;
    if(__res)
    {
	  __bVerdict = __eVerdictFail;
      break;
    }
    {
      __res = DiagInterpretAs(__resp, "DSC_PR");
      if(__res != 0)
      {
        __bVerdict = __eVerdictFail;
        DiagErrCodeTestStep(__res, "Can't interpret response as diagnostic primitive 'DSC_PR'.");
        break;
      }
      else
      {
        TestStepPass( "Received primitive can be interpreted as diagnostic primitive 'DSC_PR'.");
      }
    }
  }
  while(0);


  // Response, check & read aspect
  {
    __res = 1;
    __tableHandle = ReportTableHead5Columns(__cCheckCaption, __cTSym, __cTOp, __cRefVal, __cActual, __cRes);
    {
      __bDiagValueArrayCtr = DiagGetParameterErrorHandled(__resp, "DiagSessionType", __bDiagValueArray, elcount(__bDiagValueArray), __cDiagValueArray, elcount(__cDiagValueArray));
      {
        byte __bArray2[1] = { 0x01 };
        __bArrayCtr = __CopyBytes(__bDiagValueArray, __bDiagValueArrayCtr, __bArray);
        __bArrayCtr2 = elCount(__bArray2);
        __csr = CompareBytes(__bArray, __bArrayCtr, __bArray2, __bArrayCtr2) == 0;
        snprintf(__cArray, 8192, "%s", "Diagnostic parameter \'DiagSessionType\'");
        snprintf(__cArray2, 8192, "%s", __cArray);
        snprintf(__cArray3, 8192, "%s", "");
        ReportTableRow(__tableHandle, 0, __cArray2, "Bytes", __bArray2, __bArrayCtr2, __cArray3, __oneOfFlag, __bSetInCheckAlignment);
        ReportCell(__tableHandle, __bArray, __bArrayCtr);
        ReportCellResult(__tableHandle, __csr, __ePassFail);
      }
    
      __res = __res && __csr;
    
    }
    ReportTableEndVerdict(__tableHandle, __cEvaluateResponse, __res);
	__bVerdict = __bVerdict && __res;
  }
  if (__bVerdict == __eVerdictFail)
    TestReportWriteDiagObjectList();
}
  
void __diagServicevccmce9_190(DiagRequest * __req, DiagResponse * __resp )
{
  stack long __tableHandle;
  long __res, __paramLen, __bytePos;

   __bVerdict = __eVerdictPass;

  do {
    TestReportResetDiagObjectList();
    DiagSetReportDetailLevel("CVADAS_0001_00000000_000", EnumServiceDetails_onfail);
    // Request aspect
    {

      if (0 >= DiagSendReqAndWaitForResp("CVADAS_0001_00000000_000", __req, __resp, __res, -1, -1, -1, -1, -1, EnumResult_pos, EnumServiceDetails_onfail, EnumSendingMode_physical, EnumSuppressPosResBit_asconfigured, EnumVerdictOnInvalidValues_fail))
        break;
    }

    __res = DiagErrCodeTestStep(__res, "Can't retrieve last response for request! No check possible.") < 0;
    if(__res)
    {
	  __bVerdict = __eVerdictFail;
      break;
    }
    {
      __res = DiagInterpretAs(__resp, "DSC_PR");
      if(__res != 0)
      {
        __bVerdict = __eVerdictFail;
        DiagErrCodeTestStep(__res, "Can't interpret response as diagnostic primitive 'DSC_PR'.");
        break;
      }
      else
      {
        TestStepPass( "Received primitive can be interpreted as diagnostic primitive 'DSC_PR'.");
      }
    }
  }
  while(0);


  // Response, check & read aspect
  {
    __res = 1;
    __tableHandle = ReportTableHead5Columns(__cCheckCaption, __cTSym, __cTOp, __cRefVal, __cActual, __cRes);
    {
      __bDiagValueArrayCtr = DiagGetParameterErrorHandled(__resp, "DiagSessionType", __bDiagValueArray, elcount(__bDiagValueArray), __cDiagValueArray, elcount(__cDiagValueArray));
      {
        byte __bArray2[1] = { 0x03 };
        __bArrayCtr = __CopyBytes(__bDiagValueArray, __bDiagValueArrayCtr, __bArray);
        __bArrayCtr2 = elCount(__bArray2);
        __csr = CompareBytes(__bArray, __bArrayCtr, __bArray2, __bArrayCtr2) == 0;
        snprintf(__cArray, 8192, "%s", "Diagnostic parameter \'DiagSessionType\'");
        snprintf(__cArray2, 8192, "%s", __cArray);
        snprintf(__cArray3, 8192, "%s", "");
        ReportTableRow(__tableHandle, 0, __cArray2, "Bytes", __bArray2, __bArrayCtr2, __cArray3, __oneOfFlag, __bSetInCheckAlignment);
        ReportCell(__tableHandle, __bArray, __bArrayCtr);
        ReportCellResult(__tableHandle, __csr, __ePassFail);
      }
    
      __res = __res && __csr;
    
    }
    ReportTableEndVerdict(__tableHandle, __cEvaluateResponse, __res);
	__bVerdict = __bVerdict && __res;
  }
  if (__bVerdict == __eVerdictFail)
    TestReportWriteDiagObjectList();
}
void Ttvccmce9_Tet_Tc68_Completion()
{
  stack long __tableHandle;
  TestCompletionBegin();
  {
    {
      CreateTTEIFFunction("Ttvccmce9_General_Postconditions", __eFct, __eLocal);
      CallInterfaceFunction(__cEmpty, __cEmpty, "3d1998f6-ed4f-4d8f-9c0f-63439c24b6a7");
    }


  }
  TestCompletionEnd();
}

void Ttvccmce9_Tet_Tc69()
{
  CreateTTEIFFunction("Ttvccmce9_Tc69", __eTcDef, __eLocal);  
  AddIFParameterTestCaseAttribute("TC_ID", "");
  AddIFParameterTestCaseAttribute("Test Case ID", "");
  CallInterfaceFunction("TC_ID_20205159_Defaults_Session_Physical_and_Standard_Addressing", __cEmpty , __cEmpty );
}
testcase Ttvccmce9_Tc69()
{
  stack long __tableHandle;
  SetBreakOnFail(0);

  CreateTTEIFFunction("Ttvccmce9_Tet_Tc69_Completion", __eFct, __eLocal);
  
  AddIFAsCleanUpFunction();

  TestPreparationBegin();
  {
    {
      CreateTTEIFFunction("Ttvccmce9_General_Precondition", __eFct, __eLocal);
      CallInterfaceFunction(__cEmpty, __cEmpty, "b588ddda-8fe4-4271-93b3-dd1beefd9138");
    }


  }
  TestPreparationEnd();

  TestCommandBegin(__eDiagService, __cDiagService, "", "2");
  {
    if (DiagIsFunctionalGroup("CVADAS_0001_00000000_000"))
    {
      DiagResponse * __resp;
      DiagRequest CVADAS_0001_00000000_000.Default_Session_Start __req;
      __diagServicevccmce9_191(__req, __resp);
    }
    else
    {
      DiagResponse CVADAS_0001_00000000_000.* __resp;
      DiagRequest CVADAS_0001_00000000_000.Default_Session_Start __req;
      __diagServicevccmce9_191(__req, __resp);
    }
  }
  TestCommandEnd();


  {
    CreateTTEIFFunction("Ttvccmce9_F186_DID_with_PhysicalAdd_DefaultSession", __eFct, __eLocal);
    CallInterfaceFunction(__cEmpty, __cEmpty, "94cfa590-eac0-4499-adc5-5b1a2141e3ff");
  }


  {
    CreateTTEIFFunction("Ttvccmce9_F1A2_DID_with_Physical_Address", __eFct, __eLocal);
    CallInterfaceFunction(__cEmpty, __cEmpty, "58396d49-0d69-4f64-9544-c8942ae29e26");
  }



}

  
void __diagServicevccmce9_191(DiagRequest * __req, DiagResponse * __resp )
{
  stack long __tableHandle;
  long __res, __paramLen, __bytePos;

   __bVerdict = __eVerdictPass;

  do {
    TestReportResetDiagObjectList();
    DiagSetReportDetailLevel("CVADAS_0001_00000000_000", EnumServiceDetails_onfail);
    // Request aspect
    {

      if (0 >= DiagSendReqAndWaitForResp("CVADAS_0001_00000000_000", __req, __resp, __res, -1, -1, -1, -1, -1, EnumResult_pos, EnumServiceDetails_onfail, EnumSendingMode_physical, EnumSuppressPosResBit_asconfigured, EnumVerdictOnInvalidValues_fail))
        break;
    }

    __res = DiagErrCodeTestStep(__res, "Can't retrieve last response for request! No check possible.") < 0;
    if(__res)
    {
	  __bVerdict = __eVerdictFail;
      break;
    }
    {
      __res = DiagInterpretAs(__resp, "DSC_PR");
      if(__res != 0)
      {
        __bVerdict = __eVerdictFail;
        DiagErrCodeTestStep(__res, "Can't interpret response as diagnostic primitive 'DSC_PR'.");
        break;
      }
      else
      {
        TestStepPass( "Received primitive can be interpreted as diagnostic primitive 'DSC_PR'.");
      }
    }
  }
  while(0);


  // Response, check & read aspect
  {
    __res = 1;
    __tableHandle = ReportTableHead5Columns(__cCheckCaption, __cTSym, __cTOp, __cRefVal, __cActual, __cRes);
    {
      __bDiagValueArrayCtr = DiagGetParameterErrorHandled(__resp, "DiagSessionType", __bDiagValueArray, elcount(__bDiagValueArray), __cDiagValueArray, elcount(__cDiagValueArray));
      {
        byte __bArray2[1] = { 0x01 };
        __bArrayCtr = __CopyBytes(__bDiagValueArray, __bDiagValueArrayCtr, __bArray);
        __bArrayCtr2 = elCount(__bArray2);
        __csr = CompareBytes(__bArray, __bArrayCtr, __bArray2, __bArrayCtr2) == 0;
        snprintf(__cArray, 8192, "%s", "Diagnostic parameter \'DiagSessionType\'");
        snprintf(__cArray2, 8192, "%s", __cArray);
        snprintf(__cArray3, 8192, "%s", "");
        ReportTableRow(__tableHandle, 0, __cArray2, "Bytes", __bArray2, __bArrayCtr2, __cArray3, __oneOfFlag, __bSetInCheckAlignment);
        ReportCell(__tableHandle, __bArray, __bArrayCtr);
        ReportCellResult(__tableHandle, __csr, __ePassFail);
      }
    
      __res = __res && __csr;
    
    }
    ReportTableEndVerdict(__tableHandle, __cEvaluateResponse, __res);
	__bVerdict = __bVerdict && __res;
  }
  if (__bVerdict == __eVerdictFail)
    TestReportWriteDiagObjectList();
}
void Ttvccmce9_Tet_Tc69_Completion()
{
  stack long __tableHandle;
  TestCompletionBegin();
  {
    {
      CreateTTEIFFunction("Ttvccmce9_General_Postconditions", __eFct, __eLocal);
      CallInterfaceFunction(__cEmpty, __cEmpty, "3d1998f6-ed4f-4d8f-9c0f-63439c24b6a7");
    }


  }
  TestCompletionEnd();
}

void Ttvccmce9_Tet_Tc70()
{
  CreateTTEIFFunction("Ttvccmce9_Tc70", __eTcDef, __eLocal);  
  AddIFParameterTestCaseAttribute("TC_ID", "");
  AddIFParameterTestCaseAttribute("Test Case ID", "");
  CallInterfaceFunction("TC_ID_20205175_Extended_Session_Physical_and_Standard_Addressing", __cEmpty , __cEmpty );
}
testcase Ttvccmce9_Tc70()
{
  stack long __tableHandle;
  SetBreakOnFail(0);

  CreateTTEIFFunction("Ttvccmce9_Tet_Tc70_Completion", __eFct, __eLocal);
  
  AddIFAsCleanUpFunction();

  TestPreparationBegin();
  {
    {
      CreateTTEIFFunction("Ttvccmce9_General_Precondition", __eFct, __eLocal);
      CallInterfaceFunction(__cEmpty, __cEmpty, "b588ddda-8fe4-4271-93b3-dd1beefd9138");
    }


  }
  TestPreparationEnd();

  TestCommandBegin(__eDiagService, __cDiagService, "", "2");
  {
    if (DiagIsFunctionalGroup("CVADAS_0001_00000000_000"))
    {
      DiagResponse * __resp;
      DiagRequest CVADAS_0001_00000000_000.Default_Session_Start __req;
      __diagServicevccmce9_192(__req, __resp);
    }
    else
    {
      DiagResponse CVADAS_0001_00000000_000.* __resp;
      DiagRequest CVADAS_0001_00000000_000.Default_Session_Start __req;
      __diagServicevccmce9_192(__req, __resp);
    }
  }
  TestCommandEnd();


  TestCommandBegin(__eDiagService, __cDiagService, "", "3");
  {
    if (DiagIsFunctionalGroup("CVADAS_0001_00000000_000"))
    {
      DiagResponse * __resp;
      DiagRequest CVADAS_0001_00000000_000.Extended_Diagnostic_Session_Start __req;
      __diagServicevccmce9_193(__req, __resp);
    }
    else
    {
      DiagResponse CVADAS_0001_00000000_000.* __resp;
      DiagRequest CVADAS_0001_00000000_000.Extended_Diagnostic_Session_Start __req;
      __diagServicevccmce9_193(__req, __resp);
    }
  }
  TestCommandEnd();


  {
    CreateTTEIFFunction("Ttvccmce9_F186_DID_with_PhysicalAdd_ExtendedSession", __eFct, __eLocal);
    CallInterfaceFunction(__cEmpty, __cEmpty, "ef9ee47d-f468-4fc1-8d48-13fa51881535");
  }


  {
    CreateTTEIFFunction("Ttvccmce9_F1A2_DID_with_Physical_Address", __eFct, __eLocal);
    CallInterfaceFunction(__cEmpty, __cEmpty, "58396d49-0d69-4f64-9544-c8942ae29e26");
  }



}

  
void __diagServicevccmce9_192(DiagRequest * __req, DiagResponse * __resp )
{
  stack long __tableHandle;
  long __res, __paramLen, __bytePos;

   __bVerdict = __eVerdictPass;

  do {
    TestReportResetDiagObjectList();
    DiagSetReportDetailLevel("CVADAS_0001_00000000_000", EnumServiceDetails_onfail);
    // Request aspect
    {

      if (0 >= DiagSendReqAndWaitForResp("CVADAS_0001_00000000_000", __req, __resp, __res, -1, -1, -1, -1, -1, EnumResult_pos, EnumServiceDetails_onfail, EnumSendingMode_physical, EnumSuppressPosResBit_asconfigured, EnumVerdictOnInvalidValues_fail))
        break;
    }

    __res = DiagErrCodeTestStep(__res, "Can't retrieve last response for request! No check possible.") < 0;
    if(__res)
    {
	  __bVerdict = __eVerdictFail;
      break;
    }
    {
      __res = DiagInterpretAs(__resp, "DSC_PR");
      if(__res != 0)
      {
        __bVerdict = __eVerdictFail;
        DiagErrCodeTestStep(__res, "Can't interpret response as diagnostic primitive 'DSC_PR'.");
        break;
      }
      else
      {
        TestStepPass( "Received primitive can be interpreted as diagnostic primitive 'DSC_PR'.");
      }
    }
  }
  while(0);


  // Response, check & read aspect
  {
    __res = 1;
    __tableHandle = ReportTableHead5Columns(__cCheckCaption, __cTSym, __cTOp, __cRefVal, __cActual, __cRes);
    {
      __bDiagValueArrayCtr = DiagGetParameterErrorHandled(__resp, "DiagSessionType", __bDiagValueArray, elcount(__bDiagValueArray), __cDiagValueArray, elcount(__cDiagValueArray));
      {
        byte __bArray2[1] = { 0x01 };
        __bArrayCtr = __CopyBytes(__bDiagValueArray, __bDiagValueArrayCtr, __bArray);
        __bArrayCtr2 = elCount(__bArray2);
        __csr = CompareBytes(__bArray, __bArrayCtr, __bArray2, __bArrayCtr2) == 0;
        snprintf(__cArray, 8192, "%s", "Diagnostic parameter \'DiagSessionType\'");
        snprintf(__cArray2, 8192, "%s", __cArray);
        snprintf(__cArray3, 8192, "%s", "");
        ReportTableRow(__tableHandle, 0, __cArray2, "Bytes", __bArray2, __bArrayCtr2, __cArray3, __oneOfFlag, __bSetInCheckAlignment);
        ReportCell(__tableHandle, __bArray, __bArrayCtr);
        ReportCellResult(__tableHandle, __csr, __ePassFail);
      }
    
      __res = __res && __csr;
    
    }
    ReportTableEndVerdict(__tableHandle, __cEvaluateResponse, __res);
	__bVerdict = __bVerdict && __res;
  }
  if (__bVerdict == __eVerdictFail)
    TestReportWriteDiagObjectList();
}
  
void __diagServicevccmce9_193(DiagRequest * __req, DiagResponse * __resp )
{
  stack long __tableHandle;
  long __res, __paramLen, __bytePos;

   __bVerdict = __eVerdictPass;

  do {
    TestReportResetDiagObjectList();
    DiagSetReportDetailLevel("CVADAS_0001_00000000_000", EnumServiceDetails_onfail);
    // Request aspect
    {

      if (0 >= DiagSendReqAndWaitForResp("CVADAS_0001_00000000_000", __req, __resp, __res, -1, -1, -1, -1, -1, EnumResult_pos, EnumServiceDetails_onfail, EnumSendingMode_physical, EnumSuppressPosResBit_asconfigured, EnumVerdictOnInvalidValues_fail))
        break;
    }

    __res = DiagErrCodeTestStep(__res, "Can't retrieve last response for request! No check possible.") < 0;
    if(__res)
    {
	  __bVerdict = __eVerdictFail;
      break;
    }
    {
      __res = DiagInterpretAs(__resp, "DSC_PR");
      if(__res != 0)
      {
        __bVerdict = __eVerdictFail;
        DiagErrCodeTestStep(__res, "Can't interpret response as diagnostic primitive 'DSC_PR'.");
        break;
      }
      else
      {
        TestStepPass( "Received primitive can be interpreted as diagnostic primitive 'DSC_PR'.");
      }
    }
  }
  while(0);


  // Response, check & read aspect
  {
    __res = 1;
    __tableHandle = ReportTableHead5Columns(__cCheckCaption, __cTSym, __cTOp, __cRefVal, __cActual, __cRes);
    {
      __bDiagValueArrayCtr = DiagGetParameterErrorHandled(__resp, "DiagSessionType", __bDiagValueArray, elcount(__bDiagValueArray), __cDiagValueArray, elcount(__cDiagValueArray));
      {
        byte __bArray2[1] = { 0x03 };
        __bArrayCtr = __CopyBytes(__bDiagValueArray, __bDiagValueArrayCtr, __bArray);
        __bArrayCtr2 = elCount(__bArray2);
        __csr = CompareBytes(__bArray, __bArrayCtr, __bArray2, __bArrayCtr2) == 0;
        snprintf(__cArray, 8192, "%s", "Diagnostic parameter \'DiagSessionType\'");
        snprintf(__cArray2, 8192, "%s", __cArray);
        snprintf(__cArray3, 8192, "%s", "");
        ReportTableRow(__tableHandle, 0, __cArray2, "Bytes", __bArray2, __bArrayCtr2, __cArray3, __oneOfFlag, __bSetInCheckAlignment);
        ReportCell(__tableHandle, __bArray, __bArrayCtr);
        ReportCellResult(__tableHandle, __csr, __ePassFail);
      }
    
      __res = __res && __csr;
    
    }
    ReportTableEndVerdict(__tableHandle, __cEvaluateResponse, __res);
	__bVerdict = __bVerdict && __res;
  }
  if (__bVerdict == __eVerdictFail)
    TestReportWriteDiagObjectList();
}
void Ttvccmce9_Tet_Tc70_Completion()
{
  stack long __tableHandle;
  TestCompletionBegin();
  {
    {
      CreateTTEIFFunction("Ttvccmce9_General_Postconditions", __eFct, __eLocal);
      CallInterfaceFunction(__cEmpty, __cEmpty, "3d1998f6-ed4f-4d8f-9c0f-63439c24b6a7");
    }


  }
  TestCompletionEnd();
}

void Ttvccmce9_Tet_Tc71()
{
  CreateTTEIFFunction("Ttvccmce9_Tc71", __eTcDef, __eLocal);  
  AddIFParameterTestCaseAttribute("TC_ID", "");
  AddIFParameterTestCaseAttribute("Test Case ID", "");
  CallInterfaceFunction("TC_ID_20205327_Defaults_Session", __cEmpty , __cEmpty );
}
testcase Ttvccmce9_Tc71()
{
  stack long __tableHandle;
  SetBreakOnFail(0);

  CreateTTEIFFunction("Ttvccmce9_Tet_Tc71_Completion", __eFct, __eLocal);
  
  AddIFAsCleanUpFunction();

  TestPreparationBegin();
  {
    {
      CreateTTEIFFunction("Ttvccmce9_General_Precondition", __eFct, __eLocal);
      CallInterfaceFunction(__cEmpty, __cEmpty, "b588ddda-8fe4-4271-93b3-dd1beefd9138");
    }


  }
  TestPreparationEnd();

  TestCommandBegin(__eDiagService, __cDiagService, "", "2");
  {
    if (DiagIsFunctionalGroup("CVADAS_0001_00000000_000"))
    {
      DiagResponse * __resp;
      DiagRequest CVADAS_0001_00000000_000.Default_Session_Start __req;
      __diagServicevccmce9_194(__req, __resp);
    }
    else
    {
      DiagResponse CVADAS_0001_00000000_000.* __resp;
      DiagRequest CVADAS_0001_00000000_000.Default_Session_Start __req;
      __diagServicevccmce9_194(__req, __resp);
    }
  }
  TestCommandEnd();


  {
    CreateTTEIFFunction("Ttvccmce9_F186_DID_with_PhysicalAdd_DefaultSession", __eFct, __eLocal);
    CallInterfaceFunction(__cEmpty, __cEmpty, "94cfa590-eac0-4499-adc5-5b1a2141e3ff");
  }


  {
    CreateTTEIFFunction("Ttvccmce9_FD1D_DID_with_Physical_Address", __eFct, __eLocal);
    CallInterfaceFunction(__cEmpty, __cEmpty, "35bfcd04-c1f8-4587-896c-4cba7f7eebd0");
  }



}

  
void __diagServicevccmce9_194(DiagRequest * __req, DiagResponse * __resp )
{
  stack long __tableHandle;
  long __res, __paramLen, __bytePos;

   __bVerdict = __eVerdictPass;

  do {
    TestReportResetDiagObjectList();
    DiagSetReportDetailLevel("CVADAS_0001_00000000_000", EnumServiceDetails_onfail);
    // Request aspect
    {

      if (0 >= DiagSendReqAndWaitForResp("CVADAS_0001_00000000_000", __req, __resp, __res, -1, -1, -1, -1, -1, EnumResult_pos, EnumServiceDetails_onfail, EnumSendingMode_physical, EnumSuppressPosResBit_asconfigured, EnumVerdictOnInvalidValues_fail))
        break;
    }

    __res = DiagErrCodeTestStep(__res, "Can't retrieve last response for request! No check possible.") < 0;
    if(__res)
    {
	  __bVerdict = __eVerdictFail;
      break;
    }
    {
      __res = DiagInterpretAs(__resp, "DSC_PR");
      if(__res != 0)
      {
        __bVerdict = __eVerdictFail;
        DiagErrCodeTestStep(__res, "Can't interpret response as diagnostic primitive 'DSC_PR'.");
        break;
      }
      else
      {
        TestStepPass( "Received primitive can be interpreted as diagnostic primitive 'DSC_PR'.");
      }
    }
  }
  while(0);


  // Response, check & read aspect
  {
    __res = 1;
    __tableHandle = ReportTableHead5Columns(__cCheckCaption, __cTSym, __cTOp, __cRefVal, __cActual, __cRes);
    {
      __bDiagValueArrayCtr = DiagGetParameterErrorHandled(__resp, "DiagSessionType", __bDiagValueArray, elcount(__bDiagValueArray), __cDiagValueArray, elcount(__cDiagValueArray));
      {
        byte __bArray2[1] = { 0x01 };
        __bArrayCtr = __CopyBytes(__bDiagValueArray, __bDiagValueArrayCtr, __bArray);
        __bArrayCtr2 = elCount(__bArray2);
        __csr = CompareBytes(__bArray, __bArrayCtr, __bArray2, __bArrayCtr2) == 0;
        snprintf(__cArray, 8192, "%s", "Diagnostic parameter \'DiagSessionType\'");
        snprintf(__cArray2, 8192, "%s", __cArray);
        snprintf(__cArray3, 8192, "%s", "");
        ReportTableRow(__tableHandle, 0, __cArray2, "Bytes", __bArray2, __bArrayCtr2, __cArray3, __oneOfFlag, __bSetInCheckAlignment);
        ReportCell(__tableHandle, __bArray, __bArrayCtr);
        ReportCellResult(__tableHandle, __csr, __ePassFail);
      }
    
      __res = __res && __csr;
    
    }
    ReportTableEndVerdict(__tableHandle, __cEvaluateResponse, __res);
	__bVerdict = __bVerdict && __res;
  }
  if (__bVerdict == __eVerdictFail)
    TestReportWriteDiagObjectList();
}
void Ttvccmce9_Tet_Tc71_Completion()
{
  stack long __tableHandle;
  TestCompletionBegin();
  {
    {
      CreateTTEIFFunction("Ttvccmce9_General_Postconditions", __eFct, __eLocal);
      CallInterfaceFunction(__cEmpty, __cEmpty, "3d1998f6-ed4f-4d8f-9c0f-63439c24b6a7");
    }


  }
  TestCompletionEnd();
}

void Ttvccmce9_Tet_Tc72()
{
  CreateTTEIFFunction("Ttvccmce9_Tc72", __eTcDef, __eLocal);  
  AddIFParameterTestCaseAttribute("TC_ID", "");
  AddIFParameterTestCaseAttribute("Test Case ID", "");
  CallInterfaceFunction("TC_ID_20205326_Extended_Session", __cEmpty , __cEmpty );
}
testcase Ttvccmce9_Tc72()
{
  stack long __tableHandle;
  SetBreakOnFail(0);

  CreateTTEIFFunction("Ttvccmce9_Tet_Tc72_Completion", __eFct, __eLocal);
  
  AddIFAsCleanUpFunction();

  TestPreparationBegin();
  {
    {
      CreateTTEIFFunction("Ttvccmce9_General_Precondition", __eFct, __eLocal);
      CallInterfaceFunction(__cEmpty, __cEmpty, "b588ddda-8fe4-4271-93b3-dd1beefd9138");
    }


  }
  TestPreparationEnd();

  TestCommandBegin(__eDiagService, __cDiagService, "", "2");
  {
    if (DiagIsFunctionalGroup("CVADAS_0001_00000000_000"))
    {
      DiagResponse * __resp;
      DiagRequest CVADAS_0001_00000000_000.Default_Session_Start __req;
      __diagServicevccmce9_195(__req, __resp);
    }
    else
    {
      DiagResponse CVADAS_0001_00000000_000.* __resp;
      DiagRequest CVADAS_0001_00000000_000.Default_Session_Start __req;
      __diagServicevccmce9_195(__req, __resp);
    }
  }
  TestCommandEnd();


  TestCommandBegin(__eDiagService, __cDiagService, "", "3");
  {
    if (DiagIsFunctionalGroup("CVADAS_0001_00000000_000"))
    {
      DiagResponse * __resp;
      DiagRequest CVADAS_0001_00000000_000.Extended_Diagnostic_Session_Start __req;
      __diagServicevccmce9_196(__req, __resp);
    }
    else
    {
      DiagResponse CVADAS_0001_00000000_000.* __resp;
      DiagRequest CVADAS_0001_00000000_000.Extended_Diagnostic_Session_Start __req;
      __diagServicevccmce9_196(__req, __resp);
    }
  }
  TestCommandEnd();


  {
    CreateTTEIFFunction("Ttvccmce9_F186_DID_with_PhysicalAdd_ExtendedSession", __eFct, __eLocal);
    CallInterfaceFunction(__cEmpty, __cEmpty, "ef9ee47d-f468-4fc1-8d48-13fa51881535");
  }


  {
    CreateTTEIFFunction("Ttvccmce9_FD1D_DID_with_Physical_Address", __eFct, __eLocal);
    CallInterfaceFunction(__cEmpty, __cEmpty, "35bfcd04-c1f8-4587-896c-4cba7f7eebd0");
  }



}

  
void __diagServicevccmce9_195(DiagRequest * __req, DiagResponse * __resp )
{
  stack long __tableHandle;
  long __res, __paramLen, __bytePos;

   __bVerdict = __eVerdictPass;

  do {
    TestReportResetDiagObjectList();
    DiagSetReportDetailLevel("CVADAS_0001_00000000_000", EnumServiceDetails_onfail);
    // Request aspect
    {

      if (0 >= DiagSendReqAndWaitForResp("CVADAS_0001_00000000_000", __req, __resp, __res, -1, -1, -1, -1, -1, EnumResult_pos, EnumServiceDetails_onfail, EnumSendingMode_physical, EnumSuppressPosResBit_asconfigured, EnumVerdictOnInvalidValues_fail))
        break;
    }

    __res = DiagErrCodeTestStep(__res, "Can't retrieve last response for request! No check possible.") < 0;
    if(__res)
    {
	  __bVerdict = __eVerdictFail;
      break;
    }
    {
      __res = DiagInterpretAs(__resp, "DSC_PR");
      if(__res != 0)
      {
        __bVerdict = __eVerdictFail;
        DiagErrCodeTestStep(__res, "Can't interpret response as diagnostic primitive 'DSC_PR'.");
        break;
      }
      else
      {
        TestStepPass( "Received primitive can be interpreted as diagnostic primitive 'DSC_PR'.");
      }
    }
  }
  while(0);


  // Response, check & read aspect
  {
    __res = 1;
    __tableHandle = ReportTableHead5Columns(__cCheckCaption, __cTSym, __cTOp, __cRefVal, __cActual, __cRes);
    {
      __bDiagValueArrayCtr = DiagGetParameterErrorHandled(__resp, "DiagSessionType", __bDiagValueArray, elcount(__bDiagValueArray), __cDiagValueArray, elcount(__cDiagValueArray));
      {
        byte __bArray2[1] = { 0x01 };
        __bArrayCtr = __CopyBytes(__bDiagValueArray, __bDiagValueArrayCtr, __bArray);
        __bArrayCtr2 = elCount(__bArray2);
        __csr = CompareBytes(__bArray, __bArrayCtr, __bArray2, __bArrayCtr2) == 0;
        snprintf(__cArray, 8192, "%s", "Diagnostic parameter \'DiagSessionType\'");
        snprintf(__cArray2, 8192, "%s", __cArray);
        snprintf(__cArray3, 8192, "%s", "");
        ReportTableRow(__tableHandle, 0, __cArray2, "Bytes", __bArray2, __bArrayCtr2, __cArray3, __oneOfFlag, __bSetInCheckAlignment);
        ReportCell(__tableHandle, __bArray, __bArrayCtr);
        ReportCellResult(__tableHandle, __csr, __ePassFail);
      }
    
      __res = __res && __csr;
    
    }
    ReportTableEndVerdict(__tableHandle, __cEvaluateResponse, __res);
	__bVerdict = __bVerdict && __res;
  }
  if (__bVerdict == __eVerdictFail)
    TestReportWriteDiagObjectList();
}
  
void __diagServicevccmce9_196(DiagRequest * __req, DiagResponse * __resp )
{
  stack long __tableHandle;
  long __res, __paramLen, __bytePos;

   __bVerdict = __eVerdictPass;

  do {
    TestReportResetDiagObjectList();
    DiagSetReportDetailLevel("CVADAS_0001_00000000_000", EnumServiceDetails_onfail);
    // Request aspect
    {

      if (0 >= DiagSendReqAndWaitForResp("CVADAS_0001_00000000_000", __req, __resp, __res, -1, -1, -1, -1, -1, EnumResult_pos, EnumServiceDetails_onfail, EnumSendingMode_physical, EnumSuppressPosResBit_asconfigured, EnumVerdictOnInvalidValues_fail))
        break;
    }

    __res = DiagErrCodeTestStep(__res, "Can't retrieve last response for request! No check possible.") < 0;
    if(__res)
    {
	  __bVerdict = __eVerdictFail;
      break;
    }
    {
      __res = DiagInterpretAs(__resp, "DSC_PR");
      if(__res != 0)
      {
        __bVerdict = __eVerdictFail;
        DiagErrCodeTestStep(__res, "Can't interpret response as diagnostic primitive 'DSC_PR'.");
        break;
      }
      else
      {
        TestStepPass( "Received primitive can be interpreted as diagnostic primitive 'DSC_PR'.");
      }
    }
  }
  while(0);


  // Response, check & read aspect
  {
    __res = 1;
    __tableHandle = ReportTableHead5Columns(__cCheckCaption, __cTSym, __cTOp, __cRefVal, __cActual, __cRes);
    {
      __bDiagValueArrayCtr = DiagGetParameterErrorHandled(__resp, "DiagSessionType", __bDiagValueArray, elcount(__bDiagValueArray), __cDiagValueArray, elcount(__cDiagValueArray));
      {
        byte __bArray2[1] = { 0x03 };
        __bArrayCtr = __CopyBytes(__bDiagValueArray, __bDiagValueArrayCtr, __bArray);
        __bArrayCtr2 = elCount(__bArray2);
        __csr = CompareBytes(__bArray, __bArrayCtr, __bArray2, __bArrayCtr2) == 0;
        snprintf(__cArray, 8192, "%s", "Diagnostic parameter \'DiagSessionType\'");
        snprintf(__cArray2, 8192, "%s", __cArray);
        snprintf(__cArray3, 8192, "%s", "");
        ReportTableRow(__tableHandle, 0, __cArray2, "Bytes", __bArray2, __bArrayCtr2, __cArray3, __oneOfFlag, __bSetInCheckAlignment);
        ReportCell(__tableHandle, __bArray, __bArrayCtr);
        ReportCellResult(__tableHandle, __csr, __ePassFail);
      }
    
      __res = __res && __csr;
    
    }
    ReportTableEndVerdict(__tableHandle, __cEvaluateResponse, __res);
	__bVerdict = __bVerdict && __res;
  }
  if (__bVerdict == __eVerdictFail)
    TestReportWriteDiagObjectList();
}
void Ttvccmce9_Tet_Tc72_Completion()
{
  stack long __tableHandle;
  TestCompletionBegin();
  {
    {
      CreateTTEIFFunction("Ttvccmce9_General_Postconditions", __eFct, __eLocal);
      CallInterfaceFunction(__cEmpty, __cEmpty, "3d1998f6-ed4f-4d8f-9c0f-63439c24b6a7");
    }


  }
  TestCompletionEnd();
}

void Ttvccmce9_Tet_Tc73()
{
  CreateTTEIFFunction("Ttvccmce9_Tc73", __eTcDef, __eLocal);  
  AddIFParameterTestCaseAttribute("TC_ID", "");
  AddIFParameterTestCaseAttribute("Test Case ID", "");
  CallInterfaceFunction("TC_ID_20205334_Standard_Physical_Address", __cEmpty , __cEmpty );
}
testcase Ttvccmce9_Tc73()
{
  stack long __tableHandle;
  SetBreakOnFail(0);

  CreateTTEIFFunction("Ttvccmce9_Tet_Tc73_Completion", __eFct, __eLocal);
  
  AddIFAsCleanUpFunction();

  TestPreparationBegin();
  {
    {
      CreateTTEIFFunction("Ttvccmce9_General_Precondition", __eFct, __eLocal);
      CallInterfaceFunction(__cEmpty, __cEmpty, "b588ddda-8fe4-4271-93b3-dd1beefd9138");
    }


  }
  TestPreparationEnd();

  {
    CreateTTEIFFunction("Ttvccmce9_Default_Session_Standard_Physical_Address", __eFct, __eLocal);
    CallInterfaceFunction(__cEmpty, __cEmpty, "a876afd8-79e2-4bc6-b86f-76bf44cfb774");
  }


  {
    CreateTTEIFFunction("Ttvccmce9_Extended_Session_Standard_Physical_Address", __eFct, __eLocal);
    CallInterfaceFunction(__cEmpty, __cEmpty, "aab9c8d5-4152-43a6-9531-8599a5c4c508");
  }


  {
    CreateTTEIFFunction("Ttvccmce9_F186_DID_with_Standard_Physical_Address_Extended_Session", __eFct, __eLocal);
    CallInterfaceFunction(__cEmpty, __cEmpty, "c8044f49-226c-49c1-9a34-3c367524be30");
  }


  {
    CreateTTEIFFunction("Ttvccmce9_FD1D_DID_with_Standard_Physical_Address", __eFct, __eLocal);
    CallInterfaceFunction(__cEmpty, __cEmpty, "b62ce508-c8a9-4a9f-9c19-91f3503c47da");
  }



}

void Ttvccmce9_Tet_Tc73_Completion()
{
  stack long __tableHandle;
  TestCompletionBegin();
  {
    {
      CreateTTEIFFunction("Ttvccmce9_General_Postconditions", __eFct, __eLocal);
      CallInterfaceFunction(__cEmpty, __cEmpty, "3d1998f6-ed4f-4d8f-9c0f-63439c24b6a7");
    }


  }
  TestCompletionEnd();
}

void Ttvccmce9_Tet_Tc74()
{
  CreateTTEIFFunction("Ttvccmce9_Tc74", __eTcDef, __eLocal);  
  AddIFParameterTestCaseAttribute("TC_ID", "");
  AddIFParameterTestCaseAttribute("Test Case ID", "");
  CallInterfaceFunction("TC_ID_20205358_Defaults_Session_Physical_and_Standard_Physical_Address", __cEmpty , __cEmpty );
}
testcase Ttvccmce9_Tc74()
{
  stack long __tableHandle;
  SetBreakOnFail(0);

  CreateTTEIFFunction("Ttvccmce9_Tet_Tc74_Completion", __eFct, __eLocal);
  
  AddIFAsCleanUpFunction();

  TestPreparationBegin();
  {
    {
      CreateTTEIFFunction("Ttvccmce9_General_Precondition", __eFct, __eLocal);
      CallInterfaceFunction(__cEmpty, __cEmpty, "b588ddda-8fe4-4271-93b3-dd1beefd9138");
    }


  }
  TestPreparationEnd();

  TestCommandBegin(__eWait, __cWait, "", "2");
  {
    Wait("1", (40 * 1000000000LL), 1000000000, "");
  }
  TestCommandEnd();

  TestCommandBegin(__eDiagService, __cDiagService, "", "3");
  {
    if (DiagIsFunctionalGroup("CVADAS_0001_00000000_000"))
    {
      DiagResponse * __resp;
      DiagRequest CVADAS_0001_00000000_000.Default_Session_Start __req;
      __diagServicevccmce9_197(__req, __resp);
    }
    else
    {
      DiagResponse CVADAS_0001_00000000_000.* __resp;
      DiagRequest CVADAS_0001_00000000_000.Default_Session_Start __req;
      __diagServicevccmce9_197(__req, __resp);
    }
  }
  TestCommandEnd();


  TestCommandBegin(__eWait, __cWait, "", "4");
  {
    Wait("1", (1000 * 1000000LL), 1000000, "");
  }
  TestCommandEnd();

  {
    CreateTTEIFFunction("Ttvccmce9_F186_DID_with_PhysicalAdd_DefaultSession", __eFct, __eLocal);
    CallInterfaceFunction(__cEmpty, __cEmpty, "94cfa590-eac0-4499-adc5-5b1a2141e3ff");
  }


  TestCommandBegin(__eWait, __cWait, "", "6");
  {
    Wait("1", (1000 * 1000000LL), 1000000, "");
  }
  TestCommandEnd();

  {
    CreateTTEIFFunction("Ttvccmce9_FD13_DID_with_Physical_Address", __eFct, __eLocal);
    CallInterfaceFunction(__cEmpty, __cEmpty, "6b6d6123-24dd-4f57-ae94-2481269e5bf1");
  }


  TestCommandBegin(__eWait, __cWait, "", "8");
  {
    Wait("1", (5 * 1000000000LL), 1000000000, "");
  }
  TestCommandEnd();


}

  
void __diagServicevccmce9_197(DiagRequest * __req, DiagResponse * __resp )
{
  stack long __tableHandle;
  long __res, __paramLen, __bytePos;

   __bVerdict = __eVerdictPass;

  do {
    TestReportResetDiagObjectList();
    DiagSetReportDetailLevel("CVADAS_0001_00000000_000", EnumServiceDetails_onfail);
    // Request aspect
    {

      if (0 >= DiagSendReqAndWaitForResp("CVADAS_0001_00000000_000", __req, __resp, __res, -1, -1, -1, -1, -1, EnumResult_pos, EnumServiceDetails_onfail, EnumSendingMode_physical, EnumSuppressPosResBit_asconfigured, EnumVerdictOnInvalidValues_fail))
        break;
    }

    __res = DiagErrCodeTestStep(__res, "Can't retrieve last response for request! No check possible.") < 0;
    if(__res)
    {
	  __bVerdict = __eVerdictFail;
      break;
    }
    {
      __res = DiagInterpretAs(__resp, "DSC_PR");
      if(__res != 0)
      {
        __bVerdict = __eVerdictFail;
        DiagErrCodeTestStep(__res, "Can't interpret response as diagnostic primitive 'DSC_PR'.");
        break;
      }
      else
      {
        TestStepPass( "Received primitive can be interpreted as diagnostic primitive 'DSC_PR'.");
      }
    }
  }
  while(0);


  // Response, check & read aspect
  {
    __res = 1;
    __tableHandle = ReportTableHead5Columns(__cCheckCaption, __cTSym, __cTOp, __cRefVal, __cActual, __cRes);
    {
      __bDiagValueArrayCtr = DiagGetParameterErrorHandled(__resp, "DiagSessionType", __bDiagValueArray, elcount(__bDiagValueArray), __cDiagValueArray, elcount(__cDiagValueArray));
      {
        byte __bArray2[1] = { 0x01 };
        __bArrayCtr = __CopyBytes(__bDiagValueArray, __bDiagValueArrayCtr, __bArray);
        __bArrayCtr2 = elCount(__bArray2);
        __csr = CompareBytes(__bArray, __bArrayCtr, __bArray2, __bArrayCtr2) == 0;
        snprintf(__cArray, 8192, "%s", "Diagnostic parameter \'DiagSessionType\'");
        snprintf(__cArray2, 8192, "%s", __cArray);
        snprintf(__cArray3, 8192, "%s", "");
        ReportTableRow(__tableHandle, 0, __cArray2, "Bytes", __bArray2, __bArrayCtr2, __cArray3, __oneOfFlag, __bSetInCheckAlignment);
        ReportCell(__tableHandle, __bArray, __bArrayCtr);
        ReportCellResult(__tableHandle, __csr, __ePassFail);
      }
    
      __res = __res && __csr;
    
    }
    ReportTableEndVerdict(__tableHandle, __cEvaluateResponse, __res);
	__bVerdict = __bVerdict && __res;
  }
  if (__bVerdict == __eVerdictFail)
    TestReportWriteDiagObjectList();
}
void Ttvccmce9_Tet_Tc74_Completion()
{
  stack long __tableHandle;
  TestCompletionBegin();
  {
    {
      CreateTTEIFFunction("Ttvccmce9_General_Postconditions", __eFct, __eLocal);
      CallInterfaceFunction(__cEmpty, __cEmpty, "3d1998f6-ed4f-4d8f-9c0f-63439c24b6a7");
    }


  }
  TestCompletionEnd();
}

void Ttvccmce9_Tet_Tc75()
{
  CreateTTEIFFunction("Ttvccmce9_Tc75", __eTcDef, __eLocal);  
  AddIFParameterTestCaseAttribute("TC_ID", "");
  AddIFParameterTestCaseAttribute("Test Case ID", "");
  CallInterfaceFunction("TC_ID_20205356_Extended_Session", __cEmpty , __cEmpty );
}
testcase Ttvccmce9_Tc75()
{
  stack long __tableHandle;
  SetBreakOnFail(0);

  CreateTTEIFFunction("Ttvccmce9_Tet_Tc75_Completion", __eFct, __eLocal);
  
  AddIFAsCleanUpFunction();

  TestPreparationBegin();
  {
    {
      CreateTTEIFFunction("Ttvccmce9_General_Precondition", __eFct, __eLocal);
      CallInterfaceFunction(__cEmpty, __cEmpty, "b588ddda-8fe4-4271-93b3-dd1beefd9138");
    }


  }
  TestPreparationEnd();

  TestCommandBegin(__eWait, __cWait, "", "2");
  {
    Wait("1", (40 * 1000000000LL), 1000000000, "");
  }
  TestCommandEnd();

  TestCommandBegin(__eDiagService, __cDiagService, "", "3");
  {
    if (DiagIsFunctionalGroup("CVADAS_0001_00000000_000"))
    {
      DiagResponse * __resp;
      DiagRequest CVADAS_0001_00000000_000.Default_Session_Start __req;
      __diagServicevccmce9_198(__req, __resp);
    }
    else
    {
      DiagResponse CVADAS_0001_00000000_000.* __resp;
      DiagRequest CVADAS_0001_00000000_000.Default_Session_Start __req;
      __diagServicevccmce9_198(__req, __resp);
    }
  }
  TestCommandEnd();


  TestCommandBegin(__eWait, __cWait, "", "4");
  {
    Wait("1", (1000 * 1000000LL), 1000000, "");
  }
  TestCommandEnd();

  TestCommandBegin(__eDiagService, __cDiagService, "", "5");
  {
    if (DiagIsFunctionalGroup("CVADAS_0001_00000000_000"))
    {
      DiagResponse * __resp;
      DiagRequest CVADAS_0001_00000000_000.Extended_Diagnostic_Session_Start __req;
      __diagServicevccmce9_199(__req, __resp);
    }
    else
    {
      DiagResponse CVADAS_0001_00000000_000.* __resp;
      DiagRequest CVADAS_0001_00000000_000.Extended_Diagnostic_Session_Start __req;
      __diagServicevccmce9_199(__req, __resp);
    }
  }
  TestCommandEnd();


  TestCommandBegin(__eWait, __cWait, "", "6");
  {
    Wait("1", (1000 * 1000000LL), 1000000, "");
  }
  TestCommandEnd();

  {
    CreateCaplIFFunction("startTesterPresent", __eTestFct);
    CallInterfaceFunction("startTesterPresent ()", __cEmpty, "7");
  }


  TestCommandBegin(__eWait, __cWait, "", "8");
  {
    Wait("1", (1000 * 1000000LL), 1000000, "");
  }
  TestCommandEnd();

  {
    CreateTTEIFFunction("Ttvccmce9_F186_DID_with_PhysicalAdd_ExtendedSession", __eFct, __eLocal);
    CallInterfaceFunction(__cEmpty, __cEmpty, "ef9ee47d-f468-4fc1-8d48-13fa51881535");
  }


  TestCommandBegin(__eWait, __cWait, "", "10");
  {
    Wait("1", (1000 * 1000000LL), 1000000, "");
  }
  TestCommandEnd();

  {
    CreateTTEIFFunction("Ttvccmce9_FD13_DID_with_Physical_Address", __eFct, __eLocal);
    CallInterfaceFunction(__cEmpty, __cEmpty, "6b6d6123-24dd-4f57-ae94-2481269e5bf1");
  }


  TestCommandBegin(__eWait, __cWait, "", "13");
  {
    Wait("1", (5 * 1000000000LL), 1000000000, "");
  }
  TestCommandEnd();


}

  
void __diagServicevccmce9_198(DiagRequest * __req, DiagResponse * __resp )
{
  stack long __tableHandle;
  long __res, __paramLen, __bytePos;

   __bVerdict = __eVerdictPass;

  do {
    TestReportResetDiagObjectList();
    DiagSetReportDetailLevel("CVADAS_0001_00000000_000", EnumServiceDetails_onfail);
    // Request aspect
    {

      if (0 >= DiagSendReqAndWaitForResp("CVADAS_0001_00000000_000", __req, __resp, __res, -1, -1, -1, -1, -1, EnumResult_pos, EnumServiceDetails_onfail, EnumSendingMode_physical, EnumSuppressPosResBit_asconfigured, EnumVerdictOnInvalidValues_fail))
        break;
    }

    __res = DiagErrCodeTestStep(__res, "Can't retrieve last response for request! No check possible.") < 0;
    if(__res)
    {
	  __bVerdict = __eVerdictFail;
      break;
    }
    {
      __res = DiagInterpretAs(__resp, "DSC_PR");
      if(__res != 0)
      {
        __bVerdict = __eVerdictFail;
        DiagErrCodeTestStep(__res, "Can't interpret response as diagnostic primitive 'DSC_PR'.");
        break;
      }
      else
      {
        TestStepPass( "Received primitive can be interpreted as diagnostic primitive 'DSC_PR'.");
      }
    }
  }
  while(0);


  // Response, check & read aspect
  {
    __res = 1;
    __tableHandle = ReportTableHead5Columns(__cCheckCaption, __cTSym, __cTOp, __cRefVal, __cActual, __cRes);
    {
      __bDiagValueArrayCtr = DiagGetParameterErrorHandled(__resp, "DiagSessionType", __bDiagValueArray, elcount(__bDiagValueArray), __cDiagValueArray, elcount(__cDiagValueArray));
      {
        byte __bArray2[1] = { 0x01 };
        __bArrayCtr = __CopyBytes(__bDiagValueArray, __bDiagValueArrayCtr, __bArray);
        __bArrayCtr2 = elCount(__bArray2);
        __csr = CompareBytes(__bArray, __bArrayCtr, __bArray2, __bArrayCtr2) == 0;
        snprintf(__cArray, 8192, "%s", "Diagnostic parameter \'DiagSessionType\'");
        snprintf(__cArray2, 8192, "%s", __cArray);
        snprintf(__cArray3, 8192, "%s", "");
        ReportTableRow(__tableHandle, 0, __cArray2, "Bytes", __bArray2, __bArrayCtr2, __cArray3, __oneOfFlag, __bSetInCheckAlignment);
        ReportCell(__tableHandle, __bArray, __bArrayCtr);
        ReportCellResult(__tableHandle, __csr, __ePassFail);
      }
    
      __res = __res && __csr;
    
    }
    ReportTableEndVerdict(__tableHandle, __cEvaluateResponse, __res);
	__bVerdict = __bVerdict && __res;
  }
  if (__bVerdict == __eVerdictFail)
    TestReportWriteDiagObjectList();
}
  
void __diagServicevccmce9_199(DiagRequest * __req, DiagResponse * __resp )
{
  stack long __tableHandle;
  long __res, __paramLen, __bytePos;

   __bVerdict = __eVerdictPass;

  do {
    TestReportResetDiagObjectList();
    DiagSetReportDetailLevel("CVADAS_0001_00000000_000", EnumServiceDetails_onfail);
    // Request aspect
    {

      if (0 >= DiagSendReqAndWaitForResp("CVADAS_0001_00000000_000", __req, __resp, __res, -1, -1, -1, -1, -1, EnumResult_pos, EnumServiceDetails_onfail, EnumSendingMode_physical, EnumSuppressPosResBit_asconfigured, EnumVerdictOnInvalidValues_fail))
        break;
    }

    __res = DiagErrCodeTestStep(__res, "Can't retrieve last response for request! No check possible.") < 0;
    if(__res)
    {
	  __bVerdict = __eVerdictFail;
      break;
    }
    {
      __res = DiagInterpretAs(__resp, "DSC_PR");
      if(__res != 0)
      {
        __bVerdict = __eVerdictFail;
        DiagErrCodeTestStep(__res, "Can't interpret response as diagnostic primitive 'DSC_PR'.");
        break;
      }
      else
      {
        TestStepPass( "Received primitive can be interpreted as diagnostic primitive 'DSC_PR'.");
      }
    }
  }
  while(0);


  // Response, check & read aspect
  {
    __res = 1;
    __tableHandle = ReportTableHead5Columns(__cCheckCaption, __cTSym, __cTOp, __cRefVal, __cActual, __cRes);
    {
      __bDiagValueArrayCtr = DiagGetParameterErrorHandled(__resp, "DiagSessionType", __bDiagValueArray, elcount(__bDiagValueArray), __cDiagValueArray, elcount(__cDiagValueArray));
      {
        byte __bArray2[1] = { 0x03 };
        __bArrayCtr = __CopyBytes(__bDiagValueArray, __bDiagValueArrayCtr, __bArray);
        __bArrayCtr2 = elCount(__bArray2);
        __csr = CompareBytes(__bArray, __bArrayCtr, __bArray2, __bArrayCtr2) == 0;
        snprintf(__cArray, 8192, "%s", "Diagnostic parameter \'DiagSessionType\'");
        snprintf(__cArray2, 8192, "%s", __cArray);
        snprintf(__cArray3, 8192, "%s", "");
        ReportTableRow(__tableHandle, 0, __cArray2, "Bytes", __bArray2, __bArrayCtr2, __cArray3, __oneOfFlag, __bSetInCheckAlignment);
        ReportCell(__tableHandle, __bArray, __bArrayCtr);
        ReportCellResult(__tableHandle, __csr, __ePassFail);
      }
    
      __res = __res && __csr;
    
    }
    ReportTableEndVerdict(__tableHandle, __cEvaluateResponse, __res);
	__bVerdict = __bVerdict && __res;
  }
  if (__bVerdict == __eVerdictFail)
    TestReportWriteDiagObjectList();
}
void Ttvccmce9_Tet_Tc75_Completion()
{
  stack long __tableHandle;
  TestCompletionBegin();
  {
    {
      CreateTTEIFFunction("Ttvccmce9_General_Postconditions", __eFct, __eLocal);
      CallInterfaceFunction(__cEmpty, __cEmpty, "3d1998f6-ed4f-4d8f-9c0f-63439c24b6a7");
    }


  }
  TestCompletionEnd();
}

void Ttvccmce9_Tet_Tc76()
{
  CreateTTEIFFunction("Ttvccmce9_Tc76", __eTcDef, __eLocal);  
  AddIFParameterTestCaseAttribute("TC_ID", "");
  AddIFParameterTestCaseAttribute("Test Case ID", "");
  CallInterfaceFunction("TC_ID_20205052_Defaults_Session_Physical_and_Standard_Addressing", __cEmpty , __cEmpty );
}
testcase Ttvccmce9_Tc76()
{
  stack long __tableHandle;
  SetBreakOnFail(0);

  CreateTTEIFFunction("Ttvccmce9_Tet_Tc76_Completion", __eFct, __eLocal);
  
  AddIFAsCleanUpFunction();

  TestPreparationBegin();
  {
    {
      CreateTTEIFFunction("Ttvccmce9_General_Precondition", __eFct, __eLocal);
      CallInterfaceFunction(__cEmpty, __cEmpty, "b588ddda-8fe4-4271-93b3-dd1beefd9138");
    }


  }
  TestPreparationEnd();

  TestCommandBegin(__eDiagService, __cDiagService, "", "2");
  {
    if (DiagIsFunctionalGroup("CVADAS_0001_00000000_000"))
    {
      DiagResponse * __resp;
      DiagRequest CVADAS_0001_00000000_000.Default_Session_Start __req;
      __diagServicevccmce9_200(__req, __resp);
    }
    else
    {
      DiagResponse CVADAS_0001_00000000_000.* __resp;
      DiagRequest CVADAS_0001_00000000_000.Default_Session_Start __req;
      __diagServicevccmce9_200(__req, __resp);
    }
  }
  TestCommandEnd();


  {
    CreateTTEIFFunction("Ttvccmce9_F186_DID_with_PhysicalAdd_DefaultSession", __eFct, __eLocal);
    CallInterfaceFunction(__cEmpty, __cEmpty, "94cfa590-eac0-4499-adc5-5b1a2141e3ff");
  }


  {
    CreateTTEIFFunction("Ttvccmce9_FD38_DID_with_Physical_Address", __eFct, __eLocal);
    CallInterfaceFunction(__cEmpty, __cEmpty, "fc1d6a79-52fe-44dc-8bb0-18ebe44a3516");
  }



}

  
void __diagServicevccmce9_200(DiagRequest * __req, DiagResponse * __resp )
{
  stack long __tableHandle;
  long __res, __paramLen, __bytePos;

   __bVerdict = __eVerdictPass;

  do {
    TestReportResetDiagObjectList();
    DiagSetReportDetailLevel("CVADAS_0001_00000000_000", EnumServiceDetails_onfail);
    // Request aspect
    {

      if (0 >= DiagSendReqAndWaitForResp("CVADAS_0001_00000000_000", __req, __resp, __res, -1, -1, -1, -1, -1, EnumResult_pos, EnumServiceDetails_onfail, EnumSendingMode_physical, EnumSuppressPosResBit_asconfigured, EnumVerdictOnInvalidValues_fail))
        break;
    }

    __res = DiagErrCodeTestStep(__res, "Can't retrieve last response for request! No check possible.") < 0;
    if(__res)
    {
	  __bVerdict = __eVerdictFail;
      break;
    }
    {
      __res = DiagInterpretAs(__resp, "DSC_PR");
      if(__res != 0)
      {
        __bVerdict = __eVerdictFail;
        DiagErrCodeTestStep(__res, "Can't interpret response as diagnostic primitive 'DSC_PR'.");
        break;
      }
      else
      {
        TestStepPass( "Received primitive can be interpreted as diagnostic primitive 'DSC_PR'.");
      }
    }
  }
  while(0);


  // Response, check & read aspect
  {
    __res = 1;
    __tableHandle = ReportTableHead5Columns(__cCheckCaption, __cTSym, __cTOp, __cRefVal, __cActual, __cRes);
    {
      __bDiagValueArrayCtr = DiagGetParameterErrorHandled(__resp, "DiagSessionType", __bDiagValueArray, elcount(__bDiagValueArray), __cDiagValueArray, elcount(__cDiagValueArray));
      {
        byte __bArray2[1] = { 0x01 };
        __bArrayCtr = __CopyBytes(__bDiagValueArray, __bDiagValueArrayCtr, __bArray);
        __bArrayCtr2 = elCount(__bArray2);
        __csr = CompareBytes(__bArray, __bArrayCtr, __bArray2, __bArrayCtr2) == 0;
        snprintf(__cArray, 8192, "%s", "Diagnostic parameter \'DiagSessionType\'");
        snprintf(__cArray2, 8192, "%s", __cArray);
        snprintf(__cArray3, 8192, "%s", "");
        ReportTableRow(__tableHandle, 0, __cArray2, "Bytes", __bArray2, __bArrayCtr2, __cArray3, __oneOfFlag, __bSetInCheckAlignment);
        ReportCell(__tableHandle, __bArray, __bArrayCtr);
        ReportCellResult(__tableHandle, __csr, __ePassFail);
      }
    
      __res = __res && __csr;
    
    }
    ReportTableEndVerdict(__tableHandle, __cEvaluateResponse, __res);
	__bVerdict = __bVerdict && __res;
  }
  if (__bVerdict == __eVerdictFail)
    TestReportWriteDiagObjectList();
}
void Ttvccmce9_Tet_Tc76_Completion()
{
  stack long __tableHandle;
  TestCompletionBegin();
  {
    {
      CreateTTEIFFunction("Ttvccmce9_General_Postconditions", __eFct, __eLocal);
      CallInterfaceFunction(__cEmpty, __cEmpty, "3d1998f6-ed4f-4d8f-9c0f-63439c24b6a7");
    }


  }
  TestCompletionEnd();
}

void Ttvccmce9_Tet_Tc77()
{
  CreateTTEIFFunction("Ttvccmce9_Tc77", __eTcDef, __eLocal);  
  AddIFParameterTestCaseAttribute("TC_ID", "");
  AddIFParameterTestCaseAttribute("Test Case ID", "");
  CallInterfaceFunction("TC_ID_20205051_Extended_Session", __cEmpty , __cEmpty );
}
testcase Ttvccmce9_Tc77()
{
  stack long __tableHandle;
  SetBreakOnFail(0);

  CreateTTEIFFunction("Ttvccmce9_Tet_Tc77_Completion", __eFct, __eLocal);
  
  AddIFAsCleanUpFunction();

  TestPreparationBegin();
  {
    {
      CreateTTEIFFunction("Ttvccmce9_General_Precondition", __eFct, __eLocal);
      CallInterfaceFunction(__cEmpty, __cEmpty, "b588ddda-8fe4-4271-93b3-dd1beefd9138");
    }


  }
  TestPreparationEnd();

  TestCommandBegin(__eDiagService, __cDiagService, "", "2");
  {
    if (DiagIsFunctionalGroup("CVADAS_0001_00000000_000"))
    {
      DiagResponse * __resp;
      DiagRequest CVADAS_0001_00000000_000.Default_Session_Start __req;
      __diagServicevccmce9_201(__req, __resp);
    }
    else
    {
      DiagResponse CVADAS_0001_00000000_000.* __resp;
      DiagRequest CVADAS_0001_00000000_000.Default_Session_Start __req;
      __diagServicevccmce9_201(__req, __resp);
    }
  }
  TestCommandEnd();


  TestCommandBegin(__eDiagService, __cDiagService, "", "3");
  {
    if (DiagIsFunctionalGroup("CVADAS_0001_00000000_000"))
    {
      DiagResponse * __resp;
      DiagRequest CVADAS_0001_00000000_000.Extended_Diagnostic_Session_Start __req;
      __diagServicevccmce9_202(__req, __resp);
    }
    else
    {
      DiagResponse CVADAS_0001_00000000_000.* __resp;
      DiagRequest CVADAS_0001_00000000_000.Extended_Diagnostic_Session_Start __req;
      __diagServicevccmce9_202(__req, __resp);
    }
  }
  TestCommandEnd();


  {
    CreateTTEIFFunction("Ttvccmce9_F186_DID_with_PhysicalAdd_ExtendedSession", __eFct, __eLocal);
    CallInterfaceFunction(__cEmpty, __cEmpty, "ef9ee47d-f468-4fc1-8d48-13fa51881535");
  }


  {
    CreateTTEIFFunction("Ttvccmce9_FD38_DID_with_Physical_Address", __eFct, __eLocal);
    CallInterfaceFunction(__cEmpty, __cEmpty, "fc1d6a79-52fe-44dc-8bb0-18ebe44a3516");
  }



}

  
void __diagServicevccmce9_201(DiagRequest * __req, DiagResponse * __resp )
{
  stack long __tableHandle;
  long __res, __paramLen, __bytePos;

   __bVerdict = __eVerdictPass;

  do {
    TestReportResetDiagObjectList();
    DiagSetReportDetailLevel("CVADAS_0001_00000000_000", EnumServiceDetails_onfail);
    // Request aspect
    {

      if (0 >= DiagSendReqAndWaitForResp("CVADAS_0001_00000000_000", __req, __resp, __res, -1, -1, -1, -1, -1, EnumResult_pos, EnumServiceDetails_onfail, EnumSendingMode_physical, EnumSuppressPosResBit_asconfigured, EnumVerdictOnInvalidValues_fail))
        break;
    }

    __res = DiagErrCodeTestStep(__res, "Can't retrieve last response for request! No check possible.") < 0;
    if(__res)
    {
	  __bVerdict = __eVerdictFail;
      break;
    }
    {
      __res = DiagInterpretAs(__resp, "DSC_PR");
      if(__res != 0)
      {
        __bVerdict = __eVerdictFail;
        DiagErrCodeTestStep(__res, "Can't interpret response as diagnostic primitive 'DSC_PR'.");
        break;
      }
      else
      {
        TestStepPass( "Received primitive can be interpreted as diagnostic primitive 'DSC_PR'.");
      }
    }
  }
  while(0);


  // Response, check & read aspect
  {
    __res = 1;
    __tableHandle = ReportTableHead5Columns(__cCheckCaption, __cTSym, __cTOp, __cRefVal, __cActual, __cRes);
    {
      __bDiagValueArrayCtr = DiagGetParameterErrorHandled(__resp, "DiagSessionType", __bDiagValueArray, elcount(__bDiagValueArray), __cDiagValueArray, elcount(__cDiagValueArray));
      {
        byte __bArray2[1] = { 0x01 };
        __bArrayCtr = __CopyBytes(__bDiagValueArray, __bDiagValueArrayCtr, __bArray);
        __bArrayCtr2 = elCount(__bArray2);
        __csr = CompareBytes(__bArray, __bArrayCtr, __bArray2, __bArrayCtr2) == 0;
        snprintf(__cArray, 8192, "%s", "Diagnostic parameter \'DiagSessionType\'");
        snprintf(__cArray2, 8192, "%s", __cArray);
        snprintf(__cArray3, 8192, "%s", "");
        ReportTableRow(__tableHandle, 0, __cArray2, "Bytes", __bArray2, __bArrayCtr2, __cArray3, __oneOfFlag, __bSetInCheckAlignment);
        ReportCell(__tableHandle, __bArray, __bArrayCtr);
        ReportCellResult(__tableHandle, __csr, __ePassFail);
      }
    
      __res = __res && __csr;
    
    }
    ReportTableEndVerdict(__tableHandle, __cEvaluateResponse, __res);
	__bVerdict = __bVerdict && __res;
  }
  if (__bVerdict == __eVerdictFail)
    TestReportWriteDiagObjectList();
}
  
void __diagServicevccmce9_202(DiagRequest * __req, DiagResponse * __resp )
{
  stack long __tableHandle;
  long __res, __paramLen, __bytePos;

   __bVerdict = __eVerdictPass;

  do {
    TestReportResetDiagObjectList();
    DiagSetReportDetailLevel("CVADAS_0001_00000000_000", EnumServiceDetails_onfail);
    // Request aspect
    {

      if (0 >= DiagSendReqAndWaitForResp("CVADAS_0001_00000000_000", __req, __resp, __res, -1, -1, -1, -1, -1, EnumResult_pos, EnumServiceDetails_onfail, EnumSendingMode_physical, EnumSuppressPosResBit_asconfigured, EnumVerdictOnInvalidValues_fail))
        break;
    }

    __res = DiagErrCodeTestStep(__res, "Can't retrieve last response for request! No check possible.") < 0;
    if(__res)
    {
	  __bVerdict = __eVerdictFail;
      break;
    }
    {
      __res = DiagInterpretAs(__resp, "DSC_PR");
      if(__res != 0)
      {
        __bVerdict = __eVerdictFail;
        DiagErrCodeTestStep(__res, "Can't interpret response as diagnostic primitive 'DSC_PR'.");
        break;
      }
      else
      {
        TestStepPass( "Received primitive can be interpreted as diagnostic primitive 'DSC_PR'.");
      }
    }
  }
  while(0);


  // Response, check & read aspect
  {
    __res = 1;
    __tableHandle = ReportTableHead5Columns(__cCheckCaption, __cTSym, __cTOp, __cRefVal, __cActual, __cRes);
    {
      __bDiagValueArrayCtr = DiagGetParameterErrorHandled(__resp, "DiagSessionType", __bDiagValueArray, elcount(__bDiagValueArray), __cDiagValueArray, elcount(__cDiagValueArray));
      {
        byte __bArray2[1] = { 0x03 };
        __bArrayCtr = __CopyBytes(__bDiagValueArray, __bDiagValueArrayCtr, __bArray);
        __bArrayCtr2 = elCount(__bArray2);
        __csr = CompareBytes(__bArray, __bArrayCtr, __bArray2, __bArrayCtr2) == 0;
        snprintf(__cArray, 8192, "%s", "Diagnostic parameter \'DiagSessionType\'");
        snprintf(__cArray2, 8192, "%s", __cArray);
        snprintf(__cArray3, 8192, "%s", "");
        ReportTableRow(__tableHandle, 0, __cArray2, "Bytes", __bArray2, __bArrayCtr2, __cArray3, __oneOfFlag, __bSetInCheckAlignment);
        ReportCell(__tableHandle, __bArray, __bArrayCtr);
        ReportCellResult(__tableHandle, __csr, __ePassFail);
      }
    
      __res = __res && __csr;
    
    }
    ReportTableEndVerdict(__tableHandle, __cEvaluateResponse, __res);
	__bVerdict = __bVerdict && __res;
  }
  if (__bVerdict == __eVerdictFail)
    TestReportWriteDiagObjectList();
}
void Ttvccmce9_Tet_Tc77_Completion()
{
  stack long __tableHandle;
  TestCompletionBegin();
  {
    {
      CreateTTEIFFunction("Ttvccmce9_General_Postconditions", __eFct, __eLocal);
      CallInterfaceFunction(__cEmpty, __cEmpty, "3d1998f6-ed4f-4d8f-9c0f-63439c24b6a7");
    }


  }
  TestCompletionEnd();
}

void Ttvccmce9_Tet_Tc78()
{
  CreateTTEIFFunction("Ttvccmce9_Tc78", __eTcDef, __eLocal);  
  AddIFParameterTestCaseAttribute("TC_ID", "");
  AddIFParameterTestCaseAttribute("Test Case ID", "");
  CallInterfaceFunction("TC_ID_18404905_Defaults_Session_Physical_and_Standard_Addressing", __cEmpty , __cEmpty );
}
testcase Ttvccmce9_Tc78()
{
  stack long __tableHandle;
  SetBreakOnFail(0);

  CreateTTEIFFunction("Ttvccmce9_Tet_Tc78_Completion", __eFct, __eLocal);
  
  AddIFAsCleanUpFunction();

  TestPreparationBegin();
  {
    {
      CreateTTEIFFunction("Ttvccmce9_General_Precondition", __eFct, __eLocal);
      CallInterfaceFunction(__cEmpty, __cEmpty, "b588ddda-8fe4-4271-93b3-dd1beefd9138");
    }


  }
  TestPreparationEnd();

  TestCommandBegin(__eDiagService, __cDiagService, "", "2");
  {
    if (DiagIsFunctionalGroup("CVADAS_0001_00000000_000"))
    {
      DiagResponse * __resp;
      DiagRequest CVADAS_0001_00000000_000.Default_Session_Start __req;
      __diagServicevccmce9_203(__req, __resp);
    }
    else
    {
      DiagResponse CVADAS_0001_00000000_000.* __resp;
      DiagRequest CVADAS_0001_00000000_000.Default_Session_Start __req;
      __diagServicevccmce9_203(__req, __resp);
    }
  }
  TestCommandEnd();


  {
    CreateTTEIFFunction("Ttvccmce9_F186_DID_with_PhysicalAdd_DefaultSession", __eFct, __eLocal);
    CallInterfaceFunction(__cEmpty, __cEmpty, "94cfa590-eac0-4499-adc5-5b1a2141e3ff");
  }


  {
    CreateTTEIFFunction("Ttvccmce9_F18C_DID_with_Physical_Addressing", __eFct, __eLocal);
    CallInterfaceFunction(__cEmpty, __cEmpty, "ff7b107a-5d3d-4243-aeea-4001e0fad1be");
  }



}

  
void __diagServicevccmce9_203(DiagRequest * __req, DiagResponse * __resp )
{
  stack long __tableHandle;
  long __res, __paramLen, __bytePos;

   __bVerdict = __eVerdictPass;

  do {
    TestReportResetDiagObjectList();
    DiagSetReportDetailLevel("CVADAS_0001_00000000_000", EnumServiceDetails_onfail);
    // Request aspect
    {

      if (0 >= DiagSendReqAndWaitForResp("CVADAS_0001_00000000_000", __req, __resp, __res, -1, -1, -1, -1, -1, EnumResult_pos, EnumServiceDetails_onfail, EnumSendingMode_physical, EnumSuppressPosResBit_asconfigured, EnumVerdictOnInvalidValues_fail))
        break;
    }

    __res = DiagErrCodeTestStep(__res, "Can't retrieve last response for request! No check possible.") < 0;
    if(__res)
    {
	  __bVerdict = __eVerdictFail;
      break;
    }
    {
      __res = DiagInterpretAs(__resp, "DSC_PR");
      if(__res != 0)
      {
        __bVerdict = __eVerdictFail;
        DiagErrCodeTestStep(__res, "Can't interpret response as diagnostic primitive 'DSC_PR'.");
        break;
      }
      else
      {
        TestStepPass( "Received primitive can be interpreted as diagnostic primitive 'DSC_PR'.");
      }
    }
  }
  while(0);


  // Response, check & read aspect
  {
    __res = 1;
    __tableHandle = ReportTableHead5Columns(__cCheckCaption, __cTSym, __cTOp, __cRefVal, __cActual, __cRes);
    {
      __bDiagValueArrayCtr = DiagGetParameterErrorHandled(__resp, "DiagSessionType", __bDiagValueArray, elcount(__bDiagValueArray), __cDiagValueArray, elcount(__cDiagValueArray));
      {
        byte __bArray2[1] = { 0x01 };
        __bArrayCtr = __CopyBytes(__bDiagValueArray, __bDiagValueArrayCtr, __bArray);
        __bArrayCtr2 = elCount(__bArray2);
        __csr = CompareBytes(__bArray, __bArrayCtr, __bArray2, __bArrayCtr2) == 0;
        snprintf(__cArray, 8192, "%s", "Diagnostic parameter \'DiagSessionType\'");
        snprintf(__cArray2, 8192, "%s", __cArray);
        snprintf(__cArray3, 8192, "%s", "");
        ReportTableRow(__tableHandle, 0, __cArray2, "Bytes", __bArray2, __bArrayCtr2, __cArray3, __oneOfFlag, __bSetInCheckAlignment);
        ReportCell(__tableHandle, __bArray, __bArrayCtr);
        ReportCellResult(__tableHandle, __csr, __ePassFail);
      }
    
      __res = __res && __csr;
    
    }
    ReportTableEndVerdict(__tableHandle, __cEvaluateResponse, __res);
	__bVerdict = __bVerdict && __res;
  }
  if (__bVerdict == __eVerdictFail)
    TestReportWriteDiagObjectList();
}
void Ttvccmce9_Tet_Tc78_Completion()
{
  stack long __tableHandle;
  TestCompletionBegin();
  {
    {
      CreateTTEIFFunction("Ttvccmce9_General_Postconditions", __eFct, __eLocal);
      CallInterfaceFunction(__cEmpty, __cEmpty, "3d1998f6-ed4f-4d8f-9c0f-63439c24b6a7");
    }


  }
  TestCompletionEnd();
}

void Ttvccmce9_Tet_Tc79()
{
  CreateTTEIFFunction("Ttvccmce9_Tc79", __eTcDef, __eLocal);  
  AddIFParameterTestCaseAttribute("TC_ID", "");
  AddIFParameterTestCaseAttribute("Test Case ID", "");
  CallInterfaceFunction("TC_ID_18404907_Extended_Session", __cEmpty , __cEmpty );
}
testcase Ttvccmce9_Tc79()
{
  stack long __tableHandle;
  SetBreakOnFail(0);

  CreateTTEIFFunction("Ttvccmce9_Tet_Tc79_Completion", __eFct, __eLocal);
  
  AddIFAsCleanUpFunction();

  TestPreparationBegin();
  {
    {
      CreateTTEIFFunction("Ttvccmce9_General_Precondition", __eFct, __eLocal);
      CallInterfaceFunction(__cEmpty, __cEmpty, "b588ddda-8fe4-4271-93b3-dd1beefd9138");
    }


  }
  TestPreparationEnd();

  TestCommandBegin(__eDiagService, __cDiagService, "", "2");
  {
    if (DiagIsFunctionalGroup("CVADAS_0001_00000000_000"))
    {
      DiagResponse * __resp;
      DiagRequest CVADAS_0001_00000000_000.Default_Session_Start __req;
      __diagServicevccmce9_204(__req, __resp);
    }
    else
    {
      DiagResponse CVADAS_0001_00000000_000.* __resp;
      DiagRequest CVADAS_0001_00000000_000.Default_Session_Start __req;
      __diagServicevccmce9_204(__req, __resp);
    }
  }
  TestCommandEnd();


  TestCommandBegin(__eDiagService, __cDiagService, "", "3");
  {
    if (DiagIsFunctionalGroup("CVADAS_0001_00000000_000"))
    {
      DiagResponse * __resp;
      DiagRequest CVADAS_0001_00000000_000.Extended_Diagnostic_Session_Start __req;
      __diagServicevccmce9_205(__req, __resp);
    }
    else
    {
      DiagResponse CVADAS_0001_00000000_000.* __resp;
      DiagRequest CVADAS_0001_00000000_000.Extended_Diagnostic_Session_Start __req;
      __diagServicevccmce9_205(__req, __resp);
    }
  }
  TestCommandEnd();


  {
    CreateTTEIFFunction("Ttvccmce9_F186_DID_with_PhysicalAdd_ExtendedSession", __eFct, __eLocal);
    CallInterfaceFunction(__cEmpty, __cEmpty, "ef9ee47d-f468-4fc1-8d48-13fa51881535");
  }


  {
    CreateTTEIFFunction("Ttvccmce9_F18C_DID_with_Physical_Addressing", __eFct, __eLocal);
    CallInterfaceFunction(__cEmpty, __cEmpty, "ff7b107a-5d3d-4243-aeea-4001e0fad1be");
  }



}

  
void __diagServicevccmce9_204(DiagRequest * __req, DiagResponse * __resp )
{
  stack long __tableHandle;
  long __res, __paramLen, __bytePos;

   __bVerdict = __eVerdictPass;

  do {
    TestReportResetDiagObjectList();
    DiagSetReportDetailLevel("CVADAS_0001_00000000_000", EnumServiceDetails_onfail);
    // Request aspect
    {

      if (0 >= DiagSendReqAndWaitForResp("CVADAS_0001_00000000_000", __req, __resp, __res, -1, -1, -1, -1, -1, EnumResult_pos, EnumServiceDetails_onfail, EnumSendingMode_physical, EnumSuppressPosResBit_asconfigured, EnumVerdictOnInvalidValues_fail))
        break;
    }

    __res = DiagErrCodeTestStep(__res, "Can't retrieve last response for request! No check possible.") < 0;
    if(__res)
    {
	  __bVerdict = __eVerdictFail;
      break;
    }
    {
      __res = DiagInterpretAs(__resp, "DSC_PR");
      if(__res != 0)
      {
        __bVerdict = __eVerdictFail;
        DiagErrCodeTestStep(__res, "Can't interpret response as diagnostic primitive 'DSC_PR'.");
        break;
      }
      else
      {
        TestStepPass( "Received primitive can be interpreted as diagnostic primitive 'DSC_PR'.");
      }
    }
  }
  while(0);


  // Response, check & read aspect
  {
    __res = 1;
    __tableHandle = ReportTableHead5Columns(__cCheckCaption, __cTSym, __cTOp, __cRefVal, __cActual, __cRes);
    {
      __bDiagValueArrayCtr = DiagGetParameterErrorHandled(__resp, "DiagSessionType", __bDiagValueArray, elcount(__bDiagValueArray), __cDiagValueArray, elcount(__cDiagValueArray));
      {
        byte __bArray2[1] = { 0x01 };
        __bArrayCtr = __CopyBytes(__bDiagValueArray, __bDiagValueArrayCtr, __bArray);
        __bArrayCtr2 = elCount(__bArray2);
        __csr = CompareBytes(__bArray, __bArrayCtr, __bArray2, __bArrayCtr2) == 0;
        snprintf(__cArray, 8192, "%s", "Diagnostic parameter \'DiagSessionType\'");
        snprintf(__cArray2, 8192, "%s", __cArray);
        snprintf(__cArray3, 8192, "%s", "");
        ReportTableRow(__tableHandle, 0, __cArray2, "Bytes", __bArray2, __bArrayCtr2, __cArray3, __oneOfFlag, __bSetInCheckAlignment);
        ReportCell(__tableHandle, __bArray, __bArrayCtr);
        ReportCellResult(__tableHandle, __csr, __ePassFail);
      }
    
      __res = __res && __csr;
    
    }
    ReportTableEndVerdict(__tableHandle, __cEvaluateResponse, __res);
	__bVerdict = __bVerdict && __res;
  }
  if (__bVerdict == __eVerdictFail)
    TestReportWriteDiagObjectList();
}
  
void __diagServicevccmce9_205(DiagRequest * __req, DiagResponse * __resp )
{
  stack long __tableHandle;
  long __res, __paramLen, __bytePos;

   __bVerdict = __eVerdictPass;

  do {
    TestReportResetDiagObjectList();
    DiagSetReportDetailLevel("CVADAS_0001_00000000_000", EnumServiceDetails_onfail);
    // Request aspect
    {

      if (0 >= DiagSendReqAndWaitForResp("CVADAS_0001_00000000_000", __req, __resp, __res, -1, -1, -1, -1, -1, EnumResult_pos, EnumServiceDetails_onfail, EnumSendingMode_physical, EnumSuppressPosResBit_asconfigured, EnumVerdictOnInvalidValues_fail))
        break;
    }

    __res = DiagErrCodeTestStep(__res, "Can't retrieve last response for request! No check possible.") < 0;
    if(__res)
    {
	  __bVerdict = __eVerdictFail;
      break;
    }
    {
      __res = DiagInterpretAs(__resp, "DSC_PR");
      if(__res != 0)
      {
        __bVerdict = __eVerdictFail;
        DiagErrCodeTestStep(__res, "Can't interpret response as diagnostic primitive 'DSC_PR'.");
        break;
      }
      else
      {
        TestStepPass( "Received primitive can be interpreted as diagnostic primitive 'DSC_PR'.");
      }
    }
  }
  while(0);


  // Response, check & read aspect
  {
    __res = 1;
    __tableHandle = ReportTableHead5Columns(__cCheckCaption, __cTSym, __cTOp, __cRefVal, __cActual, __cRes);
    {
      __bDiagValueArrayCtr = DiagGetParameterErrorHandled(__resp, "DiagSessionType", __bDiagValueArray, elcount(__bDiagValueArray), __cDiagValueArray, elcount(__cDiagValueArray));
      {
        byte __bArray2[1] = { 0x03 };
        __bArrayCtr = __CopyBytes(__bDiagValueArray, __bDiagValueArrayCtr, __bArray);
        __bArrayCtr2 = elCount(__bArray2);
        __csr = CompareBytes(__bArray, __bArrayCtr, __bArray2, __bArrayCtr2) == 0;
        snprintf(__cArray, 8192, "%s", "Diagnostic parameter \'DiagSessionType\'");
        snprintf(__cArray2, 8192, "%s", __cArray);
        snprintf(__cArray3, 8192, "%s", "");
        ReportTableRow(__tableHandle, 0, __cArray2, "Bytes", __bArray2, __bArrayCtr2, __cArray3, __oneOfFlag, __bSetInCheckAlignment);
        ReportCell(__tableHandle, __bArray, __bArrayCtr);
        ReportCellResult(__tableHandle, __csr, __ePassFail);
      }
    
      __res = __res && __csr;
    
    }
    ReportTableEndVerdict(__tableHandle, __cEvaluateResponse, __res);
	__bVerdict = __bVerdict && __res;
  }
  if (__bVerdict == __eVerdictFail)
    TestReportWriteDiagObjectList();
}
void Ttvccmce9_Tet_Tc79_Completion()
{
  stack long __tableHandle;
  TestCompletionBegin();
  {
    {
      CreateTTEIFFunction("Ttvccmce9_General_Postconditions", __eFct, __eLocal);
      CallInterfaceFunction(__cEmpty, __cEmpty, "3d1998f6-ed4f-4d8f-9c0f-63439c24b6a7");
    }


  }
  TestCompletionEnd();
}

void Ttvccmce9_Tet_Tc80()
{
  CreateTTEIFFunction("Ttvccmce9_Tc80", __eTcDef, __eLocal);  
  AddIFParameterTestCaseAttribute("TC_ID", "");
  AddIFParameterTestCaseAttribute("Test Case ID", "");
  CallInterfaceFunction("TC_ID_18404918_Defaults_Session_Physical_and_Standard_Addressing", __cEmpty , __cEmpty );
}
testcase Ttvccmce9_Tc80()
{
  stack long __tableHandle;
  SetBreakOnFail(0);

  CreateTTEIFFunction("Ttvccmce9_Tet_Tc80_Completion", __eFct, __eLocal);
  
  AddIFAsCleanUpFunction();

  TestPreparationBegin();
  {
    {
      CreateTTEIFFunction("Ttvccmce9_General_Precondition", __eFct, __eLocal);
      CallInterfaceFunction(__cEmpty, __cEmpty, "b588ddda-8fe4-4271-93b3-dd1beefd9138");
    }


  }
  TestPreparationEnd();

  TestCommandBegin(__eDiagService, __cDiagService, "", "2");
  {
    if (DiagIsFunctionalGroup("CVADAS_0001_00000000_000"))
    {
      DiagResponse * __resp;
      DiagRequest CVADAS_0001_00000000_000.Default_Session_Start __req;
      __diagServicevccmce9_206(__req, __resp);
    }
    else
    {
      DiagResponse CVADAS_0001_00000000_000.* __resp;
      DiagRequest CVADAS_0001_00000000_000.Default_Session_Start __req;
      __diagServicevccmce9_206(__req, __resp);
    }
  }
  TestCommandEnd();


  {
    CreateTTEIFFunction("Ttvccmce9_F186_DID_with_PhysicalAdd_DefaultSession", __eFct, __eLocal);
    CallInterfaceFunction(__cEmpty, __cEmpty, "94cfa590-eac0-4499-adc5-5b1a2141e3ff");
  }


  {
    CreateTTEIFFunction("Ttvccmce9_F192_DID_with_Physical_Addressing", __eFct, __eLocal);
    CallInterfaceFunction(__cEmpty, __cEmpty, "2296c3b0-5ed3-45e4-8c1a-444f60cb06ab");
  }



}

  
void __diagServicevccmce9_206(DiagRequest * __req, DiagResponse * __resp )
{
  stack long __tableHandle;
  long __res, __paramLen, __bytePos;

   __bVerdict = __eVerdictPass;

  do {
    TestReportResetDiagObjectList();
    DiagSetReportDetailLevel("CVADAS_0001_00000000_000", EnumServiceDetails_onfail);
    // Request aspect
    {

      if (0 >= DiagSendReqAndWaitForResp("CVADAS_0001_00000000_000", __req, __resp, __res, -1, -1, -1, -1, -1, EnumResult_pos, EnumServiceDetails_onfail, EnumSendingMode_physical, EnumSuppressPosResBit_asconfigured, EnumVerdictOnInvalidValues_fail))
        break;
    }

    __res = DiagErrCodeTestStep(__res, "Can't retrieve last response for request! No check possible.") < 0;
    if(__res)
    {
	  __bVerdict = __eVerdictFail;
      break;
    }
    {
      __res = DiagInterpretAs(__resp, "DSC_PR");
      if(__res != 0)
      {
        __bVerdict = __eVerdictFail;
        DiagErrCodeTestStep(__res, "Can't interpret response as diagnostic primitive 'DSC_PR'.");
        break;
      }
      else
      {
        TestStepPass( "Received primitive can be interpreted as diagnostic primitive 'DSC_PR'.");
      }
    }
  }
  while(0);


  // Response, check & read aspect
  {
    __res = 1;
    __tableHandle = ReportTableHead5Columns(__cCheckCaption, __cTSym, __cTOp, __cRefVal, __cActual, __cRes);
    {
      __bDiagValueArrayCtr = DiagGetParameterErrorHandled(__resp, "DiagSessionType", __bDiagValueArray, elcount(__bDiagValueArray), __cDiagValueArray, elcount(__cDiagValueArray));
      {
        byte __bArray2[1] = { 0x01 };
        __bArrayCtr = __CopyBytes(__bDiagValueArray, __bDiagValueArrayCtr, __bArray);
        __bArrayCtr2 = elCount(__bArray2);
        __csr = CompareBytes(__bArray, __bArrayCtr, __bArray2, __bArrayCtr2) == 0;
        snprintf(__cArray, 8192, "%s", "Diagnostic parameter \'DiagSessionType\'");
        snprintf(__cArray2, 8192, "%s", __cArray);
        snprintf(__cArray3, 8192, "%s", "");
        ReportTableRow(__tableHandle, 0, __cArray2, "Bytes", __bArray2, __bArrayCtr2, __cArray3, __oneOfFlag, __bSetInCheckAlignment);
        ReportCell(__tableHandle, __bArray, __bArrayCtr);
        ReportCellResult(__tableHandle, __csr, __ePassFail);
      }
    
      __res = __res && __csr;
    
    }
    ReportTableEndVerdict(__tableHandle, __cEvaluateResponse, __res);
	__bVerdict = __bVerdict && __res;
  }
  if (__bVerdict == __eVerdictFail)
    TestReportWriteDiagObjectList();
}
void Ttvccmce9_Tet_Tc80_Completion()
{
  stack long __tableHandle;
  TestCompletionBegin();
  {
    {
      CreateTTEIFFunction("Ttvccmce9_General_Postconditions", __eFct, __eLocal);
      CallInterfaceFunction(__cEmpty, __cEmpty, "3d1998f6-ed4f-4d8f-9c0f-63439c24b6a7");
    }


  }
  TestCompletionEnd();
}

void Ttvccmce9_Tet_Tc81()
{
  CreateTTEIFFunction("Ttvccmce9_Tc81", __eTcDef, __eLocal);  
  AddIFParameterTestCaseAttribute("TC_ID", "");
  AddIFParameterTestCaseAttribute("Test Case ID", "");
  CallInterfaceFunction("TC_ID_18404920_Extended_Session", __cEmpty , __cEmpty );
}
testcase Ttvccmce9_Tc81()
{
  stack long __tableHandle;
  SetBreakOnFail(0);

  CreateTTEIFFunction("Ttvccmce9_Tet_Tc81_Completion", __eFct, __eLocal);
  
  AddIFAsCleanUpFunction();

  TestPreparationBegin();
  {
    {
      CreateTTEIFFunction("Ttvccmce9_General_Precondition", __eFct, __eLocal);
      CallInterfaceFunction(__cEmpty, __cEmpty, "b588ddda-8fe4-4271-93b3-dd1beefd9138");
    }


  }
  TestPreparationEnd();

  TestCommandBegin(__eDiagService, __cDiagService, "", "2");
  {
    if (DiagIsFunctionalGroup("CVADAS_0001_00000000_000"))
    {
      DiagResponse * __resp;
      DiagRequest CVADAS_0001_00000000_000.Default_Session_Start __req;
      __diagServicevccmce9_207(__req, __resp);
    }
    else
    {
      DiagResponse CVADAS_0001_00000000_000.* __resp;
      DiagRequest CVADAS_0001_00000000_000.Default_Session_Start __req;
      __diagServicevccmce9_207(__req, __resp);
    }
  }
  TestCommandEnd();


  TestCommandBegin(__eDiagService, __cDiagService, "", "3");
  {
    if (DiagIsFunctionalGroup("CVADAS_0001_00000000_000"))
    {
      DiagResponse * __resp;
      DiagRequest CVADAS_0001_00000000_000.Extended_Diagnostic_Session_Start __req;
      __diagServicevccmce9_208(__req, __resp);
    }
    else
    {
      DiagResponse CVADAS_0001_00000000_000.* __resp;
      DiagRequest CVADAS_0001_00000000_000.Extended_Diagnostic_Session_Start __req;
      __diagServicevccmce9_208(__req, __resp);
    }
  }
  TestCommandEnd();


  {
    CreateTTEIFFunction("Ttvccmce9_F186_DID_with_PhysicalAdd_ExtendedSession", __eFct, __eLocal);
    CallInterfaceFunction(__cEmpty, __cEmpty, "ef9ee47d-f468-4fc1-8d48-13fa51881535");
  }


  {
    CreateTTEIFFunction("Ttvccmce9_F192_DID_with_Physical_Addressing", __eFct, __eLocal);
    CallInterfaceFunction(__cEmpty, __cEmpty, "2296c3b0-5ed3-45e4-8c1a-444f60cb06ab");
  }



}

  
void __diagServicevccmce9_207(DiagRequest * __req, DiagResponse * __resp )
{
  stack long __tableHandle;
  long __res, __paramLen, __bytePos;

   __bVerdict = __eVerdictPass;

  do {
    TestReportResetDiagObjectList();
    DiagSetReportDetailLevel("CVADAS_0001_00000000_000", EnumServiceDetails_onfail);
    // Request aspect
    {

      if (0 >= DiagSendReqAndWaitForResp("CVADAS_0001_00000000_000", __req, __resp, __res, -1, -1, -1, -1, -1, EnumResult_pos, EnumServiceDetails_onfail, EnumSendingMode_physical, EnumSuppressPosResBit_asconfigured, EnumVerdictOnInvalidValues_fail))
        break;
    }

    __res = DiagErrCodeTestStep(__res, "Can't retrieve last response for request! No check possible.") < 0;
    if(__res)
    {
	  __bVerdict = __eVerdictFail;
      break;
    }
    {
      __res = DiagInterpretAs(__resp, "DSC_PR");
      if(__res != 0)
      {
        __bVerdict = __eVerdictFail;
        DiagErrCodeTestStep(__res, "Can't interpret response as diagnostic primitive 'DSC_PR'.");
        break;
      }
      else
      {
        TestStepPass( "Received primitive can be interpreted as diagnostic primitive 'DSC_PR'.");
      }
    }
  }
  while(0);


  // Response, check & read aspect
  {
    __res = 1;
    __tableHandle = ReportTableHead5Columns(__cCheckCaption, __cTSym, __cTOp, __cRefVal, __cActual, __cRes);
    {
      __bDiagValueArrayCtr = DiagGetParameterErrorHandled(__resp, "DiagSessionType", __bDiagValueArray, elcount(__bDiagValueArray), __cDiagValueArray, elcount(__cDiagValueArray));
      {
        byte __bArray2[1] = { 0x01 };
        __bArrayCtr = __CopyBytes(__bDiagValueArray, __bDiagValueArrayCtr, __bArray);
        __bArrayCtr2 = elCount(__bArray2);
        __csr = CompareBytes(__bArray, __bArrayCtr, __bArray2, __bArrayCtr2) == 0;
        snprintf(__cArray, 8192, "%s", "Diagnostic parameter \'DiagSessionType\'");
        snprintf(__cArray2, 8192, "%s", __cArray);
        snprintf(__cArray3, 8192, "%s", "");
        ReportTableRow(__tableHandle, 0, __cArray2, "Bytes", __bArray2, __bArrayCtr2, __cArray3, __oneOfFlag, __bSetInCheckAlignment);
        ReportCell(__tableHandle, __bArray, __bArrayCtr);
        ReportCellResult(__tableHandle, __csr, __ePassFail);
      }
    
      __res = __res && __csr;
    
    }
    ReportTableEndVerdict(__tableHandle, __cEvaluateResponse, __res);
	__bVerdict = __bVerdict && __res;
  }
  if (__bVerdict == __eVerdictFail)
    TestReportWriteDiagObjectList();
}
  
void __diagServicevccmce9_208(DiagRequest * __req, DiagResponse * __resp )
{
  stack long __tableHandle;
  long __res, __paramLen, __bytePos;

   __bVerdict = __eVerdictPass;

  do {
    TestReportResetDiagObjectList();
    DiagSetReportDetailLevel("CVADAS_0001_00000000_000", EnumServiceDetails_onfail);
    // Request aspect
    {

      if (0 >= DiagSendReqAndWaitForResp("CVADAS_0001_00000000_000", __req, __resp, __res, -1, -1, -1, -1, -1, EnumResult_pos, EnumServiceDetails_onfail, EnumSendingMode_physical, EnumSuppressPosResBit_asconfigured, EnumVerdictOnInvalidValues_fail))
        break;
    }

    __res = DiagErrCodeTestStep(__res, "Can't retrieve last response for request! No check possible.") < 0;
    if(__res)
    {
	  __bVerdict = __eVerdictFail;
      break;
    }
    {
      __res = DiagInterpretAs(__resp, "DSC_PR");
      if(__res != 0)
      {
        __bVerdict = __eVerdictFail;
        DiagErrCodeTestStep(__res, "Can't interpret response as diagnostic primitive 'DSC_PR'.");
        break;
      }
      else
      {
        TestStepPass( "Received primitive can be interpreted as diagnostic primitive 'DSC_PR'.");
      }
    }
  }
  while(0);


  // Response, check & read aspect
  {
    __res = 1;
    __tableHandle = ReportTableHead5Columns(__cCheckCaption, __cTSym, __cTOp, __cRefVal, __cActual, __cRes);
    {
      __bDiagValueArrayCtr = DiagGetParameterErrorHandled(__resp, "DiagSessionType", __bDiagValueArray, elcount(__bDiagValueArray), __cDiagValueArray, elcount(__cDiagValueArray));
      {
        byte __bArray2[1] = { 0x03 };
        __bArrayCtr = __CopyBytes(__bDiagValueArray, __bDiagValueArrayCtr, __bArray);
        __bArrayCtr2 = elCount(__bArray2);
        __csr = CompareBytes(__bArray, __bArrayCtr, __bArray2, __bArrayCtr2) == 0;
        snprintf(__cArray, 8192, "%s", "Diagnostic parameter \'DiagSessionType\'");
        snprintf(__cArray2, 8192, "%s", __cArray);
        snprintf(__cArray3, 8192, "%s", "");
        ReportTableRow(__tableHandle, 0, __cArray2, "Bytes", __bArray2, __bArrayCtr2, __cArray3, __oneOfFlag, __bSetInCheckAlignment);
        ReportCell(__tableHandle, __bArray, __bArrayCtr);
        ReportCellResult(__tableHandle, __csr, __ePassFail);
      }
    
      __res = __res && __csr;
    
    }
    ReportTableEndVerdict(__tableHandle, __cEvaluateResponse, __res);
	__bVerdict = __bVerdict && __res;
  }
  if (__bVerdict == __eVerdictFail)
    TestReportWriteDiagObjectList();
}
void Ttvccmce9_Tet_Tc81_Completion()
{
  stack long __tableHandle;
  TestCompletionBegin();
  {
    {
      CreateTTEIFFunction("Ttvccmce9_General_Postconditions", __eFct, __eLocal);
      CallInterfaceFunction(__cEmpty, __cEmpty, "3d1998f6-ed4f-4d8f-9c0f-63439c24b6a7");
    }


  }
  TestCompletionEnd();
}

void Ttvccmce9_Tet_Tc82()
{
  CreateTTEIFFunction("Ttvccmce9_Tc82", __eTcDef, __eLocal);  
  AddIFParameterTestCaseAttribute("TC_ID", "");
  AddIFParameterTestCaseAttribute("Test Case ID", "");
  CallInterfaceFunction("TC_ID_18404934_Defaults_Session_Physical_and_Standard_Addressing", __cEmpty , __cEmpty );
}
testcase Ttvccmce9_Tc82()
{
  stack long __tableHandle;
  SetBreakOnFail(0);

  CreateTTEIFFunction("Ttvccmce9_Tet_Tc82_Completion", __eFct, __eLocal);
  
  AddIFAsCleanUpFunction();

  TestPreparationBegin();
  {
    {
      CreateTTEIFFunction("Ttvccmce9_General_Precondition", __eFct, __eLocal);
      CallInterfaceFunction(__cEmpty, __cEmpty, "b588ddda-8fe4-4271-93b3-dd1beefd9138");
    }


  }
  TestPreparationEnd();

  TestCommandBegin(__eDiagService, __cDiagService, "", "2");
  {
    if (DiagIsFunctionalGroup("CVADAS_0001_00000000_000"))
    {
      DiagResponse * __resp;
      DiagRequest CVADAS_0001_00000000_000.Default_Session_Start __req;
      __diagServicevccmce9_209(__req, __resp);
    }
    else
    {
      DiagResponse CVADAS_0001_00000000_000.* __resp;
      DiagRequest CVADAS_0001_00000000_000.Default_Session_Start __req;
      __diagServicevccmce9_209(__req, __resp);
    }
  }
  TestCommandEnd();


  {
    CreateTTEIFFunction("Ttvccmce9_F186_DID_with_PhysicalAdd_DefaultSession", __eFct, __eLocal);
    CallInterfaceFunction(__cEmpty, __cEmpty, "94cfa590-eac0-4499-adc5-5b1a2141e3ff");
  }


  {
    CreateTTEIFFunction("Ttvccmce9_F193_DID_with_Physical_Addressing", __eFct, __eLocal);
    CallInterfaceFunction(__cEmpty, __cEmpty, "c43e273c-d0ae-43c0-ba28-e1e260398ac5");
  }



}

  
void __diagServicevccmce9_209(DiagRequest * __req, DiagResponse * __resp )
{
  stack long __tableHandle;
  long __res, __paramLen, __bytePos;

   __bVerdict = __eVerdictPass;

  do {
    TestReportResetDiagObjectList();
    DiagSetReportDetailLevel("CVADAS_0001_00000000_000", EnumServiceDetails_onfail);
    // Request aspect
    {

      if (0 >= DiagSendReqAndWaitForResp("CVADAS_0001_00000000_000", __req, __resp, __res, -1, -1, -1, -1, -1, EnumResult_pos, EnumServiceDetails_onfail, EnumSendingMode_physical, EnumSuppressPosResBit_asconfigured, EnumVerdictOnInvalidValues_fail))
        break;
    }

    __res = DiagErrCodeTestStep(__res, "Can't retrieve last response for request! No check possible.") < 0;
    if(__res)
    {
	  __bVerdict = __eVerdictFail;
      break;
    }
    {
      __res = DiagInterpretAs(__resp, "DSC_PR");
      if(__res != 0)
      {
        __bVerdict = __eVerdictFail;
        DiagErrCodeTestStep(__res, "Can't interpret response as diagnostic primitive 'DSC_PR'.");
        break;
      }
      else
      {
        TestStepPass( "Received primitive can be interpreted as diagnostic primitive 'DSC_PR'.");
      }
    }
  }
  while(0);


  // Response, check & read aspect
  {
    __res = 1;
    __tableHandle = ReportTableHead5Columns(__cCheckCaption, __cTSym, __cTOp, __cRefVal, __cActual, __cRes);
    {
      __bDiagValueArrayCtr = DiagGetParameterErrorHandled(__resp, "DiagSessionType", __bDiagValueArray, elcount(__bDiagValueArray), __cDiagValueArray, elcount(__cDiagValueArray));
      {
        byte __bArray2[1] = { 0x01 };
        __bArrayCtr = __CopyBytes(__bDiagValueArray, __bDiagValueArrayCtr, __bArray);
        __bArrayCtr2 = elCount(__bArray2);
        __csr = CompareBytes(__bArray, __bArrayCtr, __bArray2, __bArrayCtr2) == 0;
        snprintf(__cArray, 8192, "%s", "Diagnostic parameter \'DiagSessionType\'");
        snprintf(__cArray2, 8192, "%s", __cArray);
        snprintf(__cArray3, 8192, "%s", "");
        ReportTableRow(__tableHandle, 0, __cArray2, "Bytes", __bArray2, __bArrayCtr2, __cArray3, __oneOfFlag, __bSetInCheckAlignment);
        ReportCell(__tableHandle, __bArray, __bArrayCtr);
        ReportCellResult(__tableHandle, __csr, __ePassFail);
      }
    
      __res = __res && __csr;
    
    }
    ReportTableEndVerdict(__tableHandle, __cEvaluateResponse, __res);
	__bVerdict = __bVerdict && __res;
  }
  if (__bVerdict == __eVerdictFail)
    TestReportWriteDiagObjectList();
}
void Ttvccmce9_Tet_Tc82_Completion()
{
  stack long __tableHandle;
  TestCompletionBegin();
  {
    {
      CreateTTEIFFunction("Ttvccmce9_General_Postconditions", __eFct, __eLocal);
      CallInterfaceFunction(__cEmpty, __cEmpty, "3d1998f6-ed4f-4d8f-9c0f-63439c24b6a7");
    }


  }
  TestCompletionEnd();
}

void Ttvccmce9_Tet_Tc83()
{
  CreateTTEIFFunction("Ttvccmce9_Tc83", __eTcDef, __eLocal);  
  AddIFParameterTestCaseAttribute("TC_ID", "");
  AddIFParameterTestCaseAttribute("Test Case ID", "");
  CallInterfaceFunction("TC_ID_18404936_Extended_Session", __cEmpty , __cEmpty );
}
testcase Ttvccmce9_Tc83()
{
  stack long __tableHandle;
  SetBreakOnFail(0);

  CreateTTEIFFunction("Ttvccmce9_Tet_Tc83_Completion", __eFct, __eLocal);
  
  AddIFAsCleanUpFunction();

  TestPreparationBegin();
  {
    {
      CreateTTEIFFunction("Ttvccmce9_General_Precondition", __eFct, __eLocal);
      CallInterfaceFunction(__cEmpty, __cEmpty, "b588ddda-8fe4-4271-93b3-dd1beefd9138");
    }


  }
  TestPreparationEnd();

  TestCommandBegin(__eDiagService, __cDiagService, "", "2");
  {
    if (DiagIsFunctionalGroup("CVADAS_0001_00000000_000"))
    {
      DiagResponse * __resp;
      DiagRequest CVADAS_0001_00000000_000.Default_Session_Start __req;
      __diagServicevccmce9_210(__req, __resp);
    }
    else
    {
      DiagResponse CVADAS_0001_00000000_000.* __resp;
      DiagRequest CVADAS_0001_00000000_000.Default_Session_Start __req;
      __diagServicevccmce9_210(__req, __resp);
    }
  }
  TestCommandEnd();


  TestCommandBegin(__eDiagService, __cDiagService, "", "3");
  {
    if (DiagIsFunctionalGroup("CVADAS_0001_00000000_000"))
    {
      DiagResponse * __resp;
      DiagRequest CVADAS_0001_00000000_000.Extended_Diagnostic_Session_Start __req;
      __diagServicevccmce9_211(__req, __resp);
    }
    else
    {
      DiagResponse CVADAS_0001_00000000_000.* __resp;
      DiagRequest CVADAS_0001_00000000_000.Extended_Diagnostic_Session_Start __req;
      __diagServicevccmce9_211(__req, __resp);
    }
  }
  TestCommandEnd();


  {
    CreateTTEIFFunction("Ttvccmce9_F186_DID_with_PhysicalAdd_ExtendedSession", __eFct, __eLocal);
    CallInterfaceFunction(__cEmpty, __cEmpty, "ef9ee47d-f468-4fc1-8d48-13fa51881535");
  }


  {
    CreateTTEIFFunction("Ttvccmce9_F193_DID_with_Physical_Addressing", __eFct, __eLocal);
    CallInterfaceFunction(__cEmpty, __cEmpty, "c43e273c-d0ae-43c0-ba28-e1e260398ac5");
  }



}

  
void __diagServicevccmce9_210(DiagRequest * __req, DiagResponse * __resp )
{
  stack long __tableHandle;
  long __res, __paramLen, __bytePos;

   __bVerdict = __eVerdictPass;

  do {
    TestReportResetDiagObjectList();
    DiagSetReportDetailLevel("CVADAS_0001_00000000_000", EnumServiceDetails_onfail);
    // Request aspect
    {

      if (0 >= DiagSendReqAndWaitForResp("CVADAS_0001_00000000_000", __req, __resp, __res, -1, -1, -1, -1, -1, EnumResult_pos, EnumServiceDetails_onfail, EnumSendingMode_physical, EnumSuppressPosResBit_asconfigured, EnumVerdictOnInvalidValues_fail))
        break;
    }

    __res = DiagErrCodeTestStep(__res, "Can't retrieve last response for request! No check possible.") < 0;
    if(__res)
    {
	  __bVerdict = __eVerdictFail;
      break;
    }
    {
      __res = DiagInterpretAs(__resp, "DSC_PR");
      if(__res != 0)
      {
        __bVerdict = __eVerdictFail;
        DiagErrCodeTestStep(__res, "Can't interpret response as diagnostic primitive 'DSC_PR'.");
        break;
      }
      else
      {
        TestStepPass( "Received primitive can be interpreted as diagnostic primitive 'DSC_PR'.");
      }
    }
  }
  while(0);


  // Response, check & read aspect
  {
    __res = 1;
    __tableHandle = ReportTableHead5Columns(__cCheckCaption, __cTSym, __cTOp, __cRefVal, __cActual, __cRes);
    {
      __bDiagValueArrayCtr = DiagGetParameterErrorHandled(__resp, "DiagSessionType", __bDiagValueArray, elcount(__bDiagValueArray), __cDiagValueArray, elcount(__cDiagValueArray));
      {
        byte __bArray2[1] = { 0x01 };
        __bArrayCtr = __CopyBytes(__bDiagValueArray, __bDiagValueArrayCtr, __bArray);
        __bArrayCtr2 = elCount(__bArray2);
        __csr = CompareBytes(__bArray, __bArrayCtr, __bArray2, __bArrayCtr2) == 0;
        snprintf(__cArray, 8192, "%s", "Diagnostic parameter \'DiagSessionType\'");
        snprintf(__cArray2, 8192, "%s", __cArray);
        snprintf(__cArray3, 8192, "%s", "");
        ReportTableRow(__tableHandle, 0, __cArray2, "Bytes", __bArray2, __bArrayCtr2, __cArray3, __oneOfFlag, __bSetInCheckAlignment);
        ReportCell(__tableHandle, __bArray, __bArrayCtr);
        ReportCellResult(__tableHandle, __csr, __ePassFail);
      }
    
      __res = __res && __csr;
    
    }
    ReportTableEndVerdict(__tableHandle, __cEvaluateResponse, __res);
	__bVerdict = __bVerdict && __res;
  }
  if (__bVerdict == __eVerdictFail)
    TestReportWriteDiagObjectList();
}
  
void __diagServicevccmce9_211(DiagRequest * __req, DiagResponse * __resp )
{
  stack long __tableHandle;
  long __res, __paramLen, __bytePos;

   __bVerdict = __eVerdictPass;

  do {
    TestReportResetDiagObjectList();
    DiagSetReportDetailLevel("CVADAS_0001_00000000_000", EnumServiceDetails_onfail);
    // Request aspect
    {

      if (0 >= DiagSendReqAndWaitForResp("CVADAS_0001_00000000_000", __req, __resp, __res, -1, -1, -1, -1, -1, EnumResult_pos, EnumServiceDetails_onfail, EnumSendingMode_physical, EnumSuppressPosResBit_asconfigured, EnumVerdictOnInvalidValues_fail))
        break;
    }

    __res = DiagErrCodeTestStep(__res, "Can't retrieve last response for request! No check possible.") < 0;
    if(__res)
    {
	  __bVerdict = __eVerdictFail;
      break;
    }
    {
      __res = DiagInterpretAs(__resp, "DSC_PR");
      if(__res != 0)
      {
        __bVerdict = __eVerdictFail;
        DiagErrCodeTestStep(__res, "Can't interpret response as diagnostic primitive 'DSC_PR'.");
        break;
      }
      else
      {
        TestStepPass( "Received primitive can be interpreted as diagnostic primitive 'DSC_PR'.");
      }
    }
  }
  while(0);


  // Response, check & read aspect
  {
    __res = 1;
    __tableHandle = ReportTableHead5Columns(__cCheckCaption, __cTSym, __cTOp, __cRefVal, __cActual, __cRes);
    {
      __bDiagValueArrayCtr = DiagGetParameterErrorHandled(__resp, "DiagSessionType", __bDiagValueArray, elcount(__bDiagValueArray), __cDiagValueArray, elcount(__cDiagValueArray));
      {
        byte __bArray2[1] = { 0x03 };
        __bArrayCtr = __CopyBytes(__bDiagValueArray, __bDiagValueArrayCtr, __bArray);
        __bArrayCtr2 = elCount(__bArray2);
        __csr = CompareBytes(__bArray, __bArrayCtr, __bArray2, __bArrayCtr2) == 0;
        snprintf(__cArray, 8192, "%s", "Diagnostic parameter \'DiagSessionType\'");
        snprintf(__cArray2, 8192, "%s", __cArray);
        snprintf(__cArray3, 8192, "%s", "");
        ReportTableRow(__tableHandle, 0, __cArray2, "Bytes", __bArray2, __bArrayCtr2, __cArray3, __oneOfFlag, __bSetInCheckAlignment);
        ReportCell(__tableHandle, __bArray, __bArrayCtr);
        ReportCellResult(__tableHandle, __csr, __ePassFail);
      }
    
      __res = __res && __csr;
    
    }
    ReportTableEndVerdict(__tableHandle, __cEvaluateResponse, __res);
	__bVerdict = __bVerdict && __res;
  }
  if (__bVerdict == __eVerdictFail)
    TestReportWriteDiagObjectList();
}
void Ttvccmce9_Tet_Tc83_Completion()
{
  stack long __tableHandle;
  TestCompletionBegin();
  {
    {
      CreateTTEIFFunction("Ttvccmce9_General_Postconditions", __eFct, __eLocal);
      CallInterfaceFunction(__cEmpty, __cEmpty, "3d1998f6-ed4f-4d8f-9c0f-63439c24b6a7");
    }


  }
  TestCompletionEnd();
}

void Ttvccmce9_Tet_Tc84()
{
  CreateTTEIFFunction("Ttvccmce9_Tc84", __eTcDef, __eLocal);  
  AddIFParameterTestCaseAttribute("TC_ID", "");
  AddIFParameterTestCaseAttribute("Test Case ID", "");
  CallInterfaceFunction("TC_ID_18404946_Defaults_Session_Physical_and_Standard_Addressing", __cEmpty , __cEmpty );
}
testcase Ttvccmce9_Tc84()
{
  stack long __tableHandle;
  SetBreakOnFail(0);

  CreateTTEIFFunction("Ttvccmce9_Tet_Tc84_Completion", __eFct, __eLocal);
  
  AddIFAsCleanUpFunction();

  TestPreparationBegin();
  {
    {
      CreateTTEIFFunction("Ttvccmce9_General_Precondition", __eFct, __eLocal);
      CallInterfaceFunction(__cEmpty, __cEmpty, "b588ddda-8fe4-4271-93b3-dd1beefd9138");
    }


  }
  TestPreparationEnd();

  TestCommandBegin(__eDiagService, __cDiagService, "", "2");
  {
    if (DiagIsFunctionalGroup("CVADAS_0001_00000000_000"))
    {
      DiagResponse * __resp;
      DiagRequest CVADAS_0001_00000000_000.Default_Session_Start __req;
      __diagServicevccmce9_212(__req, __resp);
    }
    else
    {
      DiagResponse CVADAS_0001_00000000_000.* __resp;
      DiagRequest CVADAS_0001_00000000_000.Default_Session_Start __req;
      __diagServicevccmce9_212(__req, __resp);
    }
  }
  TestCommandEnd();


  {
    CreateTTEIFFunction("Ttvccmce9_F186_DID_with_PhysicalAdd_DefaultSession", __eFct, __eLocal);
    CallInterfaceFunction(__cEmpty, __cEmpty, "94cfa590-eac0-4499-adc5-5b1a2141e3ff");
  }


  {
    CreateTTEIFFunction("Ttvccmce9_FD15_DID_with_Physical_Address", __eFct, __eLocal);
    CallInterfaceFunction(__cEmpty, __cEmpty, "82c3e1f2-a8db-4fc3-b7c5-ceb211a86e7f");
  }



}

  
void __diagServicevccmce9_212(DiagRequest * __req, DiagResponse * __resp )
{
  stack long __tableHandle;
  long __res, __paramLen, __bytePos;

   __bVerdict = __eVerdictPass;

  do {
    TestReportResetDiagObjectList();
    DiagSetReportDetailLevel("CVADAS_0001_00000000_000", EnumServiceDetails_onfail);
    // Request aspect
    {

      if (0 >= DiagSendReqAndWaitForResp("CVADAS_0001_00000000_000", __req, __resp, __res, -1, -1, -1, -1, -1, EnumResult_pos, EnumServiceDetails_onfail, EnumSendingMode_physical, EnumSuppressPosResBit_asconfigured, EnumVerdictOnInvalidValues_fail))
        break;
    }

    __res = DiagErrCodeTestStep(__res, "Can't retrieve last response for request! No check possible.") < 0;
    if(__res)
    {
	  __bVerdict = __eVerdictFail;
      break;
    }
    {
      __res = DiagInterpretAs(__resp, "DSC_PR");
      if(__res != 0)
      {
        __bVerdict = __eVerdictFail;
        DiagErrCodeTestStep(__res, "Can't interpret response as diagnostic primitive 'DSC_PR'.");
        break;
      }
      else
      {
        TestStepPass( "Received primitive can be interpreted as diagnostic primitive 'DSC_PR'.");
      }
    }
  }
  while(0);


  // Response, check & read aspect
  {
    __res = 1;
    __tableHandle = ReportTableHead5Columns(__cCheckCaption, __cTSym, __cTOp, __cRefVal, __cActual, __cRes);
    {
      __bDiagValueArrayCtr = DiagGetParameterErrorHandled(__resp, "DiagSessionType", __bDiagValueArray, elcount(__bDiagValueArray), __cDiagValueArray, elcount(__cDiagValueArray));
      {
        byte __bArray2[1] = { 0x01 };
        __bArrayCtr = __CopyBytes(__bDiagValueArray, __bDiagValueArrayCtr, __bArray);
        __bArrayCtr2 = elCount(__bArray2);
        __csr = CompareBytes(__bArray, __bArrayCtr, __bArray2, __bArrayCtr2) == 0;
        snprintf(__cArray, 8192, "%s", "Diagnostic parameter \'DiagSessionType\'");
        snprintf(__cArray2, 8192, "%s", __cArray);
        snprintf(__cArray3, 8192, "%s", "");
        ReportTableRow(__tableHandle, 0, __cArray2, "Bytes", __bArray2, __bArrayCtr2, __cArray3, __oneOfFlag, __bSetInCheckAlignment);
        ReportCell(__tableHandle, __bArray, __bArrayCtr);
        ReportCellResult(__tableHandle, __csr, __ePassFail);
      }
    
      __res = __res && __csr;
    
    }
    ReportTableEndVerdict(__tableHandle, __cEvaluateResponse, __res);
	__bVerdict = __bVerdict && __res;
  }
  if (__bVerdict == __eVerdictFail)
    TestReportWriteDiagObjectList();
}
void Ttvccmce9_Tet_Tc84_Completion()
{
  stack long __tableHandle;
  TestCompletionBegin();
  {
    {
      CreateTTEIFFunction("Ttvccmce9_General_Postconditions", __eFct, __eLocal);
      CallInterfaceFunction(__cEmpty, __cEmpty, "3d1998f6-ed4f-4d8f-9c0f-63439c24b6a7");
    }


  }
  TestCompletionEnd();
}

void Ttvccmce9_Tet_Tc85()
{
  CreateTTEIFFunction("Ttvccmce9_Tc85", __eTcDef, __eLocal);  
  AddIFParameterTestCaseAttribute("TC_ID", "");
  AddIFParameterTestCaseAttribute("Test Case ID", "");
  CallInterfaceFunction("TC_ID_18404948_Extended_Session", __cEmpty , __cEmpty );
}
testcase Ttvccmce9_Tc85()
{
  stack long __tableHandle;
  SetBreakOnFail(0);

  CreateTTEIFFunction("Ttvccmce9_Tet_Tc85_Completion", __eFct, __eLocal);
  
  AddIFAsCleanUpFunction();

  TestPreparationBegin();
  {
    {
      CreateTTEIFFunction("Ttvccmce9_General_Precondition", __eFct, __eLocal);
      CallInterfaceFunction(__cEmpty, __cEmpty, "b588ddda-8fe4-4271-93b3-dd1beefd9138");
    }


  }
  TestPreparationEnd();

  TestCommandBegin(__eDiagService, __cDiagService, "", "2");
  {
    if (DiagIsFunctionalGroup("CVADAS_0001_00000000_000"))
    {
      DiagResponse * __resp;
      DiagRequest CVADAS_0001_00000000_000.Default_Session_Start __req;
      __diagServicevccmce9_213(__req, __resp);
    }
    else
    {
      DiagResponse CVADAS_0001_00000000_000.* __resp;
      DiagRequest CVADAS_0001_00000000_000.Default_Session_Start __req;
      __diagServicevccmce9_213(__req, __resp);
    }
  }
  TestCommandEnd();


  TestCommandBegin(__eDiagService, __cDiagService, "", "3");
  {
    if (DiagIsFunctionalGroup("CVADAS_0001_00000000_000"))
    {
      DiagResponse * __resp;
      DiagRequest CVADAS_0001_00000000_000.Extended_Diagnostic_Session_Start __req;
      __diagServicevccmce9_214(__req, __resp);
    }
    else
    {
      DiagResponse CVADAS_0001_00000000_000.* __resp;
      DiagRequest CVADAS_0001_00000000_000.Extended_Diagnostic_Session_Start __req;
      __diagServicevccmce9_214(__req, __resp);
    }
  }
  TestCommandEnd();


  {
    CreateTTEIFFunction("Ttvccmce9_F186_DID_with_PhysicalAdd_ExtendedSession", __eFct, __eLocal);
    CallInterfaceFunction(__cEmpty, __cEmpty, "ef9ee47d-f468-4fc1-8d48-13fa51881535");
  }


  {
    CreateTTEIFFunction("Ttvccmce9_FD15_DID_with_Physical_Address", __eFct, __eLocal);
    CallInterfaceFunction(__cEmpty, __cEmpty, "82c3e1f2-a8db-4fc3-b7c5-ceb211a86e7f");
  }



}

  
void __diagServicevccmce9_213(DiagRequest * __req, DiagResponse * __resp )
{
  stack long __tableHandle;
  long __res, __paramLen, __bytePos;

   __bVerdict = __eVerdictPass;

  do {
    TestReportResetDiagObjectList();
    DiagSetReportDetailLevel("CVADAS_0001_00000000_000", EnumServiceDetails_onfail);
    // Request aspect
    {

      if (0 >= DiagSendReqAndWaitForResp("CVADAS_0001_00000000_000", __req, __resp, __res, -1, -1, -1, -1, -1, EnumResult_pos, EnumServiceDetails_onfail, EnumSendingMode_physical, EnumSuppressPosResBit_asconfigured, EnumVerdictOnInvalidValues_fail))
        break;
    }

    __res = DiagErrCodeTestStep(__res, "Can't retrieve last response for request! No check possible.") < 0;
    if(__res)
    {
	  __bVerdict = __eVerdictFail;
      break;
    }
    {
      __res = DiagInterpretAs(__resp, "DSC_PR");
      if(__res != 0)
      {
        __bVerdict = __eVerdictFail;
        DiagErrCodeTestStep(__res, "Can't interpret response as diagnostic primitive 'DSC_PR'.");
        break;
      }
      else
      {
        TestStepPass( "Received primitive can be interpreted as diagnostic primitive 'DSC_PR'.");
      }
    }
  }
  while(0);


  // Response, check & read aspect
  {
    __res = 1;
    __tableHandle = ReportTableHead5Columns(__cCheckCaption, __cTSym, __cTOp, __cRefVal, __cActual, __cRes);
    {
      __bDiagValueArrayCtr = DiagGetParameterErrorHandled(__resp, "DiagSessionType", __bDiagValueArray, elcount(__bDiagValueArray), __cDiagValueArray, elcount(__cDiagValueArray));
      {
        byte __bArray2[1] = { 0x01 };
        __bArrayCtr = __CopyBytes(__bDiagValueArray, __bDiagValueArrayCtr, __bArray);
        __bArrayCtr2 = elCount(__bArray2);
        __csr = CompareBytes(__bArray, __bArrayCtr, __bArray2, __bArrayCtr2) == 0;
        snprintf(__cArray, 8192, "%s", "Diagnostic parameter \'DiagSessionType\'");
        snprintf(__cArray2, 8192, "%s", __cArray);
        snprintf(__cArray3, 8192, "%s", "");
        ReportTableRow(__tableHandle, 0, __cArray2, "Bytes", __bArray2, __bArrayCtr2, __cArray3, __oneOfFlag, __bSetInCheckAlignment);
        ReportCell(__tableHandle, __bArray, __bArrayCtr);
        ReportCellResult(__tableHandle, __csr, __ePassFail);
      }
    
      __res = __res && __csr;
    
    }
    ReportTableEndVerdict(__tableHandle, __cEvaluateResponse, __res);
	__bVerdict = __bVerdict && __res;
  }
  if (__bVerdict == __eVerdictFail)
    TestReportWriteDiagObjectList();
}
  
void __diagServicevccmce9_214(DiagRequest * __req, DiagResponse * __resp )
{
  stack long __tableHandle;
  long __res, __paramLen, __bytePos;

   __bVerdict = __eVerdictPass;

  do {
    TestReportResetDiagObjectList();
    DiagSetReportDetailLevel("CVADAS_0001_00000000_000", EnumServiceDetails_onfail);
    // Request aspect
    {

      if (0 >= DiagSendReqAndWaitForResp("CVADAS_0001_00000000_000", __req, __resp, __res, -1, -1, -1, -1, -1, EnumResult_pos, EnumServiceDetails_onfail, EnumSendingMode_physical, EnumSuppressPosResBit_asconfigured, EnumVerdictOnInvalidValues_fail))
        break;
    }

    __res = DiagErrCodeTestStep(__res, "Can't retrieve last response for request! No check possible.") < 0;
    if(__res)
    {
	  __bVerdict = __eVerdictFail;
      break;
    }
    {
      __res = DiagInterpretAs(__resp, "DSC_PR");
      if(__res != 0)
      {
        __bVerdict = __eVerdictFail;
        DiagErrCodeTestStep(__res, "Can't interpret response as diagnostic primitive 'DSC_PR'.");
        break;
      }
      else
      {
        TestStepPass( "Received primitive can be interpreted as diagnostic primitive 'DSC_PR'.");
      }
    }
  }
  while(0);


  // Response, check & read aspect
  {
    __res = 1;
    __tableHandle = ReportTableHead5Columns(__cCheckCaption, __cTSym, __cTOp, __cRefVal, __cActual, __cRes);
    {
      __bDiagValueArrayCtr = DiagGetParameterErrorHandled(__resp, "DiagSessionType", __bDiagValueArray, elcount(__bDiagValueArray), __cDiagValueArray, elcount(__cDiagValueArray));
      {
        byte __bArray2[1] = { 0x03 };
        __bArrayCtr = __CopyBytes(__bDiagValueArray, __bDiagValueArrayCtr, __bArray);
        __bArrayCtr2 = elCount(__bArray2);
        __csr = CompareBytes(__bArray, __bArrayCtr, __bArray2, __bArrayCtr2) == 0;
        snprintf(__cArray, 8192, "%s", "Diagnostic parameter \'DiagSessionType\'");
        snprintf(__cArray2, 8192, "%s", __cArray);
        snprintf(__cArray3, 8192, "%s", "");
        ReportTableRow(__tableHandle, 0, __cArray2, "Bytes", __bArray2, __bArrayCtr2, __cArray3, __oneOfFlag, __bSetInCheckAlignment);
        ReportCell(__tableHandle, __bArray, __bArrayCtr);
        ReportCellResult(__tableHandle, __csr, __ePassFail);
      }
    
      __res = __res && __csr;
    
    }
    ReportTableEndVerdict(__tableHandle, __cEvaluateResponse, __res);
	__bVerdict = __bVerdict && __res;
  }
  if (__bVerdict == __eVerdictFail)
    TestReportWriteDiagObjectList();
}
void Ttvccmce9_Tet_Tc85_Completion()
{
  stack long __tableHandle;
  TestCompletionBegin();
  {
    {
      CreateTTEIFFunction("Ttvccmce9_General_Postconditions", __eFct, __eLocal);
      CallInterfaceFunction(__cEmpty, __cEmpty, "3d1998f6-ed4f-4d8f-9c0f-63439c24b6a7");
    }


  }
  TestCompletionEnd();
}

void Ttvccmce9_Tet_Tc86()
{
  CreateTTEIFFunction("Ttvccmce9_Tc86", __eTcDef, __eLocal);  
  AddIFParameterTestCaseAttribute("TC_ID", "");
  AddIFParameterTestCaseAttribute("Test Case ID", "");
  CallInterfaceFunction("TC_ID_18405235_Defaults_Session_Physical_and_Standard_Addressing", __cEmpty , __cEmpty );
}
testcase Ttvccmce9_Tc86()
{
  stack long __tableHandle;
  SetBreakOnFail(0);

  CreateTTEIFFunction("Ttvccmce9_Tet_Tc86_Completion", __eFct, __eLocal);
  
  AddIFAsCleanUpFunction();

  TestPreparationBegin();
  {
    {
      CreateTTEIFFunction("Ttvccmce9_General_Precondition", __eFct, __eLocal);
      CallInterfaceFunction(__cEmpty, __cEmpty, "b588ddda-8fe4-4271-93b3-dd1beefd9138");
    }


  }
  TestPreparationEnd();

  TestCommandBegin(__eDiagService, __cDiagService, "", "2");
  {
    if (DiagIsFunctionalGroup("CVADAS_0001_00000000_000"))
    {
      DiagResponse * __resp;
      DiagRequest CVADAS_0001_00000000_000.Default_Session_Start __req;
      __diagServicevccmce9_215(__req, __resp);
    }
    else
    {
      DiagResponse CVADAS_0001_00000000_000.* __resp;
      DiagRequest CVADAS_0001_00000000_000.Default_Session_Start __req;
      __diagServicevccmce9_215(__req, __resp);
    }
  }
  TestCommandEnd();


  {
    CreateTTEIFFunction("Ttvccmce9_F186_DID_with_PhysicalAdd_DefaultSession", __eFct, __eLocal);
    CallInterfaceFunction(__cEmpty, __cEmpty, "94cfa590-eac0-4499-adc5-5b1a2141e3ff");
  }


  {
    CreateTTEIFFunction("Ttvccmce9_FD16_DID_with_Physical_Address", __eFct, __eLocal);
    CallInterfaceFunction(__cEmpty, __cEmpty, "e4cf72ae-f984-465c-95d1-e1af21bda4f3");
  }



}

  
void __diagServicevccmce9_215(DiagRequest * __req, DiagResponse * __resp )
{
  stack long __tableHandle;
  long __res, __paramLen, __bytePos;

   __bVerdict = __eVerdictPass;

  do {
    TestReportResetDiagObjectList();
    DiagSetReportDetailLevel("CVADAS_0001_00000000_000", EnumServiceDetails_onfail);
    // Request aspect
    {

      if (0 >= DiagSendReqAndWaitForResp("CVADAS_0001_00000000_000", __req, __resp, __res, -1, -1, -1, -1, -1, EnumResult_pos, EnumServiceDetails_onfail, EnumSendingMode_physical, EnumSuppressPosResBit_asconfigured, EnumVerdictOnInvalidValues_fail))
        break;
    }

    __res = DiagErrCodeTestStep(__res, "Can't retrieve last response for request! No check possible.") < 0;
    if(__res)
    {
	  __bVerdict = __eVerdictFail;
      break;
    }
    {
      __res = DiagInterpretAs(__resp, "DSC_PR");
      if(__res != 0)
      {
        __bVerdict = __eVerdictFail;
        DiagErrCodeTestStep(__res, "Can't interpret response as diagnostic primitive 'DSC_PR'.");
        break;
      }
      else
      {
        TestStepPass( "Received primitive can be interpreted as diagnostic primitive 'DSC_PR'.");
      }
    }
  }
  while(0);


  // Response, check & read aspect
  {
    __res = 1;
    __tableHandle = ReportTableHead5Columns(__cCheckCaption, __cTSym, __cTOp, __cRefVal, __cActual, __cRes);
    {
      __bDiagValueArrayCtr = DiagGetParameterErrorHandled(__resp, "DiagSessionType", __bDiagValueArray, elcount(__bDiagValueArray), __cDiagValueArray, elcount(__cDiagValueArray));
      {
        byte __bArray2[1] = { 0x01 };
        __bArrayCtr = __CopyBytes(__bDiagValueArray, __bDiagValueArrayCtr, __bArray);
        __bArrayCtr2 = elCount(__bArray2);
        __csr = CompareBytes(__bArray, __bArrayCtr, __bArray2, __bArrayCtr2) == 0;
        snprintf(__cArray, 8192, "%s", "Diagnostic parameter \'DiagSessionType\'");
        snprintf(__cArray2, 8192, "%s", __cArray);
        snprintf(__cArray3, 8192, "%s", "");
        ReportTableRow(__tableHandle, 0, __cArray2, "Bytes", __bArray2, __bArrayCtr2, __cArray3, __oneOfFlag, __bSetInCheckAlignment);
        ReportCell(__tableHandle, __bArray, __bArrayCtr);
        ReportCellResult(__tableHandle, __csr, __ePassFail);
      }
    
      __res = __res && __csr;
    
    }
    ReportTableEndVerdict(__tableHandle, __cEvaluateResponse, __res);
	__bVerdict = __bVerdict && __res;
  }
  if (__bVerdict == __eVerdictFail)
    TestReportWriteDiagObjectList();
}
void Ttvccmce9_Tet_Tc86_Completion()
{
  stack long __tableHandle;
  TestCompletionBegin();
  {
    {
      CreateTTEIFFunction("Ttvccmce9_General_Postconditions", __eFct, __eLocal);
      CallInterfaceFunction(__cEmpty, __cEmpty, "3d1998f6-ed4f-4d8f-9c0f-63439c24b6a7");
    }


  }
  TestCompletionEnd();
}

void Ttvccmce9_Tet_Tc87()
{
  CreateTTEIFFunction("Ttvccmce9_Tc87", __eTcDef, __eLocal);  
  AddIFParameterTestCaseAttribute("TC_ID", "");
  AddIFParameterTestCaseAttribute("Test Case ID", "");
  CallInterfaceFunction("TC_ID_18405237_Extended_Session", __cEmpty , __cEmpty );
}
testcase Ttvccmce9_Tc87()
{
  stack long __tableHandle;
  SetBreakOnFail(0);

  CreateTTEIFFunction("Ttvccmce9_Tet_Tc87_Completion", __eFct, __eLocal);
  
  AddIFAsCleanUpFunction();

  TestPreparationBegin();
  {
    {
      CreateTTEIFFunction("Ttvccmce9_General_Precondition", __eFct, __eLocal);
      CallInterfaceFunction(__cEmpty, __cEmpty, "b588ddda-8fe4-4271-93b3-dd1beefd9138");
    }


  }
  TestPreparationEnd();

  TestCommandBegin(__eDiagService, __cDiagService, "", "2");
  {
    if (DiagIsFunctionalGroup("CVADAS_0001_00000000_000"))
    {
      DiagResponse * __resp;
      DiagRequest CVADAS_0001_00000000_000.Default_Session_Start __req;
      __diagServicevccmce9_216(__req, __resp);
    }
    else
    {
      DiagResponse CVADAS_0001_00000000_000.* __resp;
      DiagRequest CVADAS_0001_00000000_000.Default_Session_Start __req;
      __diagServicevccmce9_216(__req, __resp);
    }
  }
  TestCommandEnd();


  TestCommandBegin(__eDiagService, __cDiagService, "", "3");
  {
    if (DiagIsFunctionalGroup("CVADAS_0001_00000000_000"))
    {
      DiagResponse * __resp;
      DiagRequest CVADAS_0001_00000000_000.Extended_Diagnostic_Session_Start __req;
      __diagServicevccmce9_217(__req, __resp);
    }
    else
    {
      DiagResponse CVADAS_0001_00000000_000.* __resp;
      DiagRequest CVADAS_0001_00000000_000.Extended_Diagnostic_Session_Start __req;
      __diagServicevccmce9_217(__req, __resp);
    }
  }
  TestCommandEnd();


  {
    CreateTTEIFFunction("Ttvccmce9_F186_DID_with_PhysicalAdd_ExtendedSession", __eFct, __eLocal);
    CallInterfaceFunction(__cEmpty, __cEmpty, "ef9ee47d-f468-4fc1-8d48-13fa51881535");
  }


  {
    CreateTTEIFFunction("Ttvccmce9_FD16_DID_with_Physical_Address", __eFct, __eLocal);
    CallInterfaceFunction(__cEmpty, __cEmpty, "e4cf72ae-f984-465c-95d1-e1af21bda4f3");
  }



}

  
void __diagServicevccmce9_216(DiagRequest * __req, DiagResponse * __resp )
{
  stack long __tableHandle;
  long __res, __paramLen, __bytePos;

   __bVerdict = __eVerdictPass;

  do {
    TestReportResetDiagObjectList();
    DiagSetReportDetailLevel("CVADAS_0001_00000000_000", EnumServiceDetails_onfail);
    // Request aspect
    {

      if (0 >= DiagSendReqAndWaitForResp("CVADAS_0001_00000000_000", __req, __resp, __res, -1, -1, -1, -1, -1, EnumResult_pos, EnumServiceDetails_onfail, EnumSendingMode_physical, EnumSuppressPosResBit_asconfigured, EnumVerdictOnInvalidValues_fail))
        break;
    }

    __res = DiagErrCodeTestStep(__res, "Can't retrieve last response for request! No check possible.") < 0;
    if(__res)
    {
	  __bVerdict = __eVerdictFail;
      break;
    }
    {
      __res = DiagInterpretAs(__resp, "DSC_PR");
      if(__res != 0)
      {
        __bVerdict = __eVerdictFail;
        DiagErrCodeTestStep(__res, "Can't interpret response as diagnostic primitive 'DSC_PR'.");
        break;
      }
      else
      {
        TestStepPass( "Received primitive can be interpreted as diagnostic primitive 'DSC_PR'.");
      }
    }
  }
  while(0);


  // Response, check & read aspect
  {
    __res = 1;
    __tableHandle = ReportTableHead5Columns(__cCheckCaption, __cTSym, __cTOp, __cRefVal, __cActual, __cRes);
    {
      __bDiagValueArrayCtr = DiagGetParameterErrorHandled(__resp, "DiagSessionType", __bDiagValueArray, elcount(__bDiagValueArray), __cDiagValueArray, elcount(__cDiagValueArray));
      {
        byte __bArray2[1] = { 0x01 };
        __bArrayCtr = __CopyBytes(__bDiagValueArray, __bDiagValueArrayCtr, __bArray);
        __bArrayCtr2 = elCount(__bArray2);
        __csr = CompareBytes(__bArray, __bArrayCtr, __bArray2, __bArrayCtr2) == 0;
        snprintf(__cArray, 8192, "%s", "Diagnostic parameter \'DiagSessionType\'");
        snprintf(__cArray2, 8192, "%s", __cArray);
        snprintf(__cArray3, 8192, "%s", "");
        ReportTableRow(__tableHandle, 0, __cArray2, "Bytes", __bArray2, __bArrayCtr2, __cArray3, __oneOfFlag, __bSetInCheckAlignment);
        ReportCell(__tableHandle, __bArray, __bArrayCtr);
        ReportCellResult(__tableHandle, __csr, __ePassFail);
      }
    
      __res = __res && __csr;
    
    }
    ReportTableEndVerdict(__tableHandle, __cEvaluateResponse, __res);
	__bVerdict = __bVerdict && __res;
  }
  if (__bVerdict == __eVerdictFail)
    TestReportWriteDiagObjectList();
}
  
void __diagServicevccmce9_217(DiagRequest * __req, DiagResponse * __resp )
{
  stack long __tableHandle;
  long __res, __paramLen, __bytePos;

   __bVerdict = __eVerdictPass;

  do {
    TestReportResetDiagObjectList();
    DiagSetReportDetailLevel("CVADAS_0001_00000000_000", EnumServiceDetails_onfail);
    // Request aspect
    {

      if (0 >= DiagSendReqAndWaitForResp("CVADAS_0001_00000000_000", __req, __resp, __res, -1, -1, -1, -1, -1, EnumResult_pos, EnumServiceDetails_onfail, EnumSendingMode_physical, EnumSuppressPosResBit_asconfigured, EnumVerdictOnInvalidValues_fail))
        break;
    }

    __res = DiagErrCodeTestStep(__res, "Can't retrieve last response for request! No check possible.") < 0;
    if(__res)
    {
	  __bVerdict = __eVerdictFail;
      break;
    }
    {
      __res = DiagInterpretAs(__resp, "DSC_PR");
      if(__res != 0)
      {
        __bVerdict = __eVerdictFail;
        DiagErrCodeTestStep(__res, "Can't interpret response as diagnostic primitive 'DSC_PR'.");
        break;
      }
      else
      {
        TestStepPass( "Received primitive can be interpreted as diagnostic primitive 'DSC_PR'.");
      }
    }
  }
  while(0);


  // Response, check & read aspect
  {
    __res = 1;
    __tableHandle = ReportTableHead5Columns(__cCheckCaption, __cTSym, __cTOp, __cRefVal, __cActual, __cRes);
    {
      __bDiagValueArrayCtr = DiagGetParameterErrorHandled(__resp, "DiagSessionType", __bDiagValueArray, elcount(__bDiagValueArray), __cDiagValueArray, elcount(__cDiagValueArray));
      {
        byte __bArray2[1] = { 0x03 };
        __bArrayCtr = __CopyBytes(__bDiagValueArray, __bDiagValueArrayCtr, __bArray);
        __bArrayCtr2 = elCount(__bArray2);
        __csr = CompareBytes(__bArray, __bArrayCtr, __bArray2, __bArrayCtr2) == 0;
        snprintf(__cArray, 8192, "%s", "Diagnostic parameter \'DiagSessionType\'");
        snprintf(__cArray2, 8192, "%s", __cArray);
        snprintf(__cArray3, 8192, "%s", "");
        ReportTableRow(__tableHandle, 0, __cArray2, "Bytes", __bArray2, __bArrayCtr2, __cArray3, __oneOfFlag, __bSetInCheckAlignment);
        ReportCell(__tableHandle, __bArray, __bArrayCtr);
        ReportCellResult(__tableHandle, __csr, __ePassFail);
      }
    
      __res = __res && __csr;
    
    }
    ReportTableEndVerdict(__tableHandle, __cEvaluateResponse, __res);
	__bVerdict = __bVerdict && __res;
  }
  if (__bVerdict == __eVerdictFail)
    TestReportWriteDiagObjectList();
}
void Ttvccmce9_Tet_Tc87_Completion()
{
  stack long __tableHandle;
  TestCompletionBegin();
  {
    {
      CreateTTEIFFunction("Ttvccmce9_General_Postconditions", __eFct, __eLocal);
      CallInterfaceFunction(__cEmpty, __cEmpty, "3d1998f6-ed4f-4d8f-9c0f-63439c24b6a7");
    }


  }
  TestCompletionEnd();
}

void Ttvccmce9_Tet_Tc88()
{
  CreateTTEIFFunction("Ttvccmce9_Tc88", __eTcDef, __eLocal);  
  AddIFParameterTestCaseAttribute("TC_ID", "");
  AddIFParameterTestCaseAttribute("Test Case ID", "");
  CallInterfaceFunction("TC_ID_18406353_Defaults_Session_Physical_and_Standard_Addressing", __cEmpty , __cEmpty );
}
testcase Ttvccmce9_Tc88()
{
  stack long __tableHandle;
  SetBreakOnFail(0);

  CreateTTEIFFunction("Ttvccmce9_Tet_Tc88_Completion", __eFct, __eLocal);
  
  AddIFAsCleanUpFunction();

  TestPreparationBegin();
  {
    {
      CreateTTEIFFunction("Ttvccmce9_General_Precondition", __eFct, __eLocal);
      CallInterfaceFunction(__cEmpty, __cEmpty, "b588ddda-8fe4-4271-93b3-dd1beefd9138");
    }


  }
  TestPreparationEnd();

  TestCommandBegin(__eDiagService, __cDiagService, "", "2");
  {
    if (DiagIsFunctionalGroup("CVADAS_0001_00000000_000"))
    {
      DiagResponse * __resp;
      DiagRequest CVADAS_0001_00000000_000.Default_Session_Start __req;
      __diagServicevccmce9_218(__req, __resp);
    }
    else
    {
      DiagResponse CVADAS_0001_00000000_000.* __resp;
      DiagRequest CVADAS_0001_00000000_000.Default_Session_Start __req;
      __diagServicevccmce9_218(__req, __resp);
    }
  }
  TestCommandEnd();


  {
    CreateTTEIFFunction("Ttvccmce9_F186_DID_with_PhysicalAdd_DefaultSession", __eFct, __eLocal);
    CallInterfaceFunction(__cEmpty, __cEmpty, "94cfa590-eac0-4499-adc5-5b1a2141e3ff");
  }


  {
    CreateTTEIFFunction("Ttvccmce9_FD17_DID_with_Physical_Address", __eFct, __eLocal);
    CallInterfaceFunction(__cEmpty, __cEmpty, "78b4dc48-3216-48f4-9bf2-60774369d37a");
  }



}

  
void __diagServicevccmce9_218(DiagRequest * __req, DiagResponse * __resp )
{
  stack long __tableHandle;
  long __res, __paramLen, __bytePos;

   __bVerdict = __eVerdictPass;

  do {
    TestReportResetDiagObjectList();
    DiagSetReportDetailLevel("CVADAS_0001_00000000_000", EnumServiceDetails_onfail);
    // Request aspect
    {

      if (0 >= DiagSendReqAndWaitForResp("CVADAS_0001_00000000_000", __req, __resp, __res, -1, -1, -1, -1, -1, EnumResult_pos, EnumServiceDetails_onfail, EnumSendingMode_physical, EnumSuppressPosResBit_asconfigured, EnumVerdictOnInvalidValues_fail))
        break;
    }

    __res = DiagErrCodeTestStep(__res, "Can't retrieve last response for request! No check possible.") < 0;
    if(__res)
    {
	  __bVerdict = __eVerdictFail;
      break;
    }
    {
      __res = DiagInterpretAs(__resp, "DSC_PR");
      if(__res != 0)
      {
        __bVerdict = __eVerdictFail;
        DiagErrCodeTestStep(__res, "Can't interpret response as diagnostic primitive 'DSC_PR'.");
        break;
      }
      else
      {
        TestStepPass( "Received primitive can be interpreted as diagnostic primitive 'DSC_PR'.");
      }
    }
  }
  while(0);


  // Response, check & read aspect
  {
    __res = 1;
    __tableHandle = ReportTableHead5Columns(__cCheckCaption, __cTSym, __cTOp, __cRefVal, __cActual, __cRes);
    {
      __bDiagValueArrayCtr = DiagGetParameterErrorHandled(__resp, "DiagSessionType", __bDiagValueArray, elcount(__bDiagValueArray), __cDiagValueArray, elcount(__cDiagValueArray));
      {
        byte __bArray2[1] = { 0x01 };
        __bArrayCtr = __CopyBytes(__bDiagValueArray, __bDiagValueArrayCtr, __bArray);
        __bArrayCtr2 = elCount(__bArray2);
        __csr = CompareBytes(__bArray, __bArrayCtr, __bArray2, __bArrayCtr2) == 0;
        snprintf(__cArray, 8192, "%s", "Diagnostic parameter \'DiagSessionType\'");
        snprintf(__cArray2, 8192, "%s", __cArray);
        snprintf(__cArray3, 8192, "%s", "");
        ReportTableRow(__tableHandle, 0, __cArray2, "Bytes", __bArray2, __bArrayCtr2, __cArray3, __oneOfFlag, __bSetInCheckAlignment);
        ReportCell(__tableHandle, __bArray, __bArrayCtr);
        ReportCellResult(__tableHandle, __csr, __ePassFail);
      }
    
      __res = __res && __csr;
    
    }
    ReportTableEndVerdict(__tableHandle, __cEvaluateResponse, __res);
	__bVerdict = __bVerdict && __res;
  }
  if (__bVerdict == __eVerdictFail)
    TestReportWriteDiagObjectList();
}
void Ttvccmce9_Tet_Tc88_Completion()
{
  stack long __tableHandle;
  TestCompletionBegin();
  {
    {
      CreateTTEIFFunction("Ttvccmce9_General_Postconditions", __eFct, __eLocal);
      CallInterfaceFunction(__cEmpty, __cEmpty, "3d1998f6-ed4f-4d8f-9c0f-63439c24b6a7");
    }


  }
  TestCompletionEnd();
}

void Ttvccmce9_Tet_Tc89()
{
  CreateTTEIFFunction("Ttvccmce9_Tc89", __eTcDef, __eLocal);  
  AddIFParameterTestCaseAttribute("TC_ID", "");
  AddIFParameterTestCaseAttribute("Test Case ID", "");
  CallInterfaceFunction("TC_ID_18406355_Extended_Session", __cEmpty , __cEmpty );
}
testcase Ttvccmce9_Tc89()
{
  stack long __tableHandle;
  SetBreakOnFail(0);

  CreateTTEIFFunction("Ttvccmce9_Tet_Tc89_Completion", __eFct, __eLocal);
  
  AddIFAsCleanUpFunction();

  TestPreparationBegin();
  {
    {
      CreateTTEIFFunction("Ttvccmce9_General_Precondition", __eFct, __eLocal);
      CallInterfaceFunction(__cEmpty, __cEmpty, "b588ddda-8fe4-4271-93b3-dd1beefd9138");
    }


  }
  TestPreparationEnd();

  TestCommandBegin(__eDiagService, __cDiagService, "", "2");
  {
    if (DiagIsFunctionalGroup("CVADAS_0001_00000000_000"))
    {
      DiagResponse * __resp;
      DiagRequest CVADAS_0001_00000000_000.Default_Session_Start __req;
      __diagServicevccmce9_219(__req, __resp);
    }
    else
    {
      DiagResponse CVADAS_0001_00000000_000.* __resp;
      DiagRequest CVADAS_0001_00000000_000.Default_Session_Start __req;
      __diagServicevccmce9_219(__req, __resp);
    }
  }
  TestCommandEnd();


  TestCommandBegin(__eDiagService, __cDiagService, "", "3");
  {
    if (DiagIsFunctionalGroup("CVADAS_0001_00000000_000"))
    {
      DiagResponse * __resp;
      DiagRequest CVADAS_0001_00000000_000.Extended_Diagnostic_Session_Start __req;
      __diagServicevccmce9_220(__req, __resp);
    }
    else
    {
      DiagResponse CVADAS_0001_00000000_000.* __resp;
      DiagRequest CVADAS_0001_00000000_000.Extended_Diagnostic_Session_Start __req;
      __diagServicevccmce9_220(__req, __resp);
    }
  }
  TestCommandEnd();


  {
    CreateTTEIFFunction("Ttvccmce9_F186_DID_with_PhysicalAdd_ExtendedSession", __eFct, __eLocal);
    CallInterfaceFunction(__cEmpty, __cEmpty, "ef9ee47d-f468-4fc1-8d48-13fa51881535");
  }


  {
    CreateTTEIFFunction("Ttvccmce9_FD17_DID_with_Physical_Address", __eFct, __eLocal);
    CallInterfaceFunction(__cEmpty, __cEmpty, "78b4dc48-3216-48f4-9bf2-60774369d37a");
  }



}

  
void __diagServicevccmce9_219(DiagRequest * __req, DiagResponse * __resp )
{
  stack long __tableHandle;
  long __res, __paramLen, __bytePos;

   __bVerdict = __eVerdictPass;

  do {
    TestReportResetDiagObjectList();
    DiagSetReportDetailLevel("CVADAS_0001_00000000_000", EnumServiceDetails_onfail);
    // Request aspect
    {

      if (0 >= DiagSendReqAndWaitForResp("CVADAS_0001_00000000_000", __req, __resp, __res, -1, -1, -1, -1, -1, EnumResult_pos, EnumServiceDetails_onfail, EnumSendingMode_physical, EnumSuppressPosResBit_asconfigured, EnumVerdictOnInvalidValues_fail))
        break;
    }

    __res = DiagErrCodeTestStep(__res, "Can't retrieve last response for request! No check possible.") < 0;
    if(__res)
    {
	  __bVerdict = __eVerdictFail;
      break;
    }
    {
      __res = DiagInterpretAs(__resp, "DSC_PR");
      if(__res != 0)
      {
        __bVerdict = __eVerdictFail;
        DiagErrCodeTestStep(__res, "Can't interpret response as diagnostic primitive 'DSC_PR'.");
        break;
      }
      else
      {
        TestStepPass( "Received primitive can be interpreted as diagnostic primitive 'DSC_PR'.");
      }
    }
  }
  while(0);


  // Response, check & read aspect
  {
    __res = 1;
    __tableHandle = ReportTableHead5Columns(__cCheckCaption, __cTSym, __cTOp, __cRefVal, __cActual, __cRes);
    {
      __bDiagValueArrayCtr = DiagGetParameterErrorHandled(__resp, "DiagSessionType", __bDiagValueArray, elcount(__bDiagValueArray), __cDiagValueArray, elcount(__cDiagValueArray));
      {
        byte __bArray2[1] = { 0x01 };
        __bArrayCtr = __CopyBytes(__bDiagValueArray, __bDiagValueArrayCtr, __bArray);
        __bArrayCtr2 = elCount(__bArray2);
        __csr = CompareBytes(__bArray, __bArrayCtr, __bArray2, __bArrayCtr2) == 0;
        snprintf(__cArray, 8192, "%s", "Diagnostic parameter \'DiagSessionType\'");
        snprintf(__cArray2, 8192, "%s", __cArray);
        snprintf(__cArray3, 8192, "%s", "");
        ReportTableRow(__tableHandle, 0, __cArray2, "Bytes", __bArray2, __bArrayCtr2, __cArray3, __oneOfFlag, __bSetInCheckAlignment);
        ReportCell(__tableHandle, __bArray, __bArrayCtr);
        ReportCellResult(__tableHandle, __csr, __ePassFail);
      }
    
      __res = __res && __csr;
    
    }
    ReportTableEndVerdict(__tableHandle, __cEvaluateResponse, __res);
	__bVerdict = __bVerdict && __res;
  }
  if (__bVerdict == __eVerdictFail)
    TestReportWriteDiagObjectList();
}
  
void __diagServicevccmce9_220(DiagRequest * __req, DiagResponse * __resp )
{
  stack long __tableHandle;
  long __res, __paramLen, __bytePos;

   __bVerdict = __eVerdictPass;

  do {
    TestReportResetDiagObjectList();
    DiagSetReportDetailLevel("CVADAS_0001_00000000_000", EnumServiceDetails_onfail);
    // Request aspect
    {

      if (0 >= DiagSendReqAndWaitForResp("CVADAS_0001_00000000_000", __req, __resp, __res, -1, -1, -1, -1, -1, EnumResult_pos, EnumServiceDetails_onfail, EnumSendingMode_physical, EnumSuppressPosResBit_asconfigured, EnumVerdictOnInvalidValues_fail))
        break;
    }

    __res = DiagErrCodeTestStep(__res, "Can't retrieve last response for request! No check possible.") < 0;
    if(__res)
    {
	  __bVerdict = __eVerdictFail;
      break;
    }
    {
      __res = DiagInterpretAs(__resp, "DSC_PR");
      if(__res != 0)
      {
        __bVerdict = __eVerdictFail;
        DiagErrCodeTestStep(__res, "Can't interpret response as diagnostic primitive 'DSC_PR'.");
        break;
      }
      else
      {
        TestStepPass( "Received primitive can be interpreted as diagnostic primitive 'DSC_PR'.");
      }
    }
  }
  while(0);


  // Response, check & read aspect
  {
    __res = 1;
    __tableHandle = ReportTableHead5Columns(__cCheckCaption, __cTSym, __cTOp, __cRefVal, __cActual, __cRes);
    {
      __bDiagValueArrayCtr = DiagGetParameterErrorHandled(__resp, "DiagSessionType", __bDiagValueArray, elcount(__bDiagValueArray), __cDiagValueArray, elcount(__cDiagValueArray));
      {
        byte __bArray2[1] = { 0x03 };
        __bArrayCtr = __CopyBytes(__bDiagValueArray, __bDiagValueArrayCtr, __bArray);
        __bArrayCtr2 = elCount(__bArray2);
        __csr = CompareBytes(__bArray, __bArrayCtr, __bArray2, __bArrayCtr2) == 0;
        snprintf(__cArray, 8192, "%s", "Diagnostic parameter \'DiagSessionType\'");
        snprintf(__cArray2, 8192, "%s", __cArray);
        snprintf(__cArray3, 8192, "%s", "");
        ReportTableRow(__tableHandle, 0, __cArray2, "Bytes", __bArray2, __bArrayCtr2, __cArray3, __oneOfFlag, __bSetInCheckAlignment);
        ReportCell(__tableHandle, __bArray, __bArrayCtr);
        ReportCellResult(__tableHandle, __csr, __ePassFail);
      }
    
      __res = __res && __csr;
    
    }
    ReportTableEndVerdict(__tableHandle, __cEvaluateResponse, __res);
	__bVerdict = __bVerdict && __res;
  }
  if (__bVerdict == __eVerdictFail)
    TestReportWriteDiagObjectList();
}
void Ttvccmce9_Tet_Tc89_Completion()
{
  stack long __tableHandle;
  TestCompletionBegin();
  {
    {
      CreateTTEIFFunction("Ttvccmce9_General_Postconditions", __eFct, __eLocal);
      CallInterfaceFunction(__cEmpty, __cEmpty, "3d1998f6-ed4f-4d8f-9c0f-63439c24b6a7");
    }


  }
  TestCompletionEnd();
}

void Ttvccmce9_Tet_Tc90()
{
  CreateTTEIFFunction("Ttvccmce9_Tc90", __eTcDef, __eLocal);  
  AddIFParameterTestCaseAttribute("TC_ID", "");
  AddIFParameterTestCaseAttribute("Test Case ID", "");
  CallInterfaceFunction("TC_ID_20205317_Extended_Session", __cEmpty , __cEmpty );
}
testcase Ttvccmce9_Tc90()
{
  stack long __tableHandle;
  SetBreakOnFail(0);

  CreateTTEIFFunction("Ttvccmce9_Tet_Tc90_Completion", __eFct, __eLocal);
  
  AddIFAsCleanUpFunction();

  TestPreparationBegin();
  {
    {
      CreateTTEIFFunction("Ttvccmce9_General_Precondition", __eFct, __eLocal);
      CallInterfaceFunction(__cEmpty, __cEmpty, "b588ddda-8fe4-4271-93b3-dd1beefd9138");
    }


  }
  TestPreparationEnd();

  TestCommandBegin(__eDiagService, __cDiagService, "", "2");
  {
    if (DiagIsFunctionalGroup("CVADAS_0001_00000000_000"))
    {
      DiagResponse * __resp;
      DiagRequest CVADAS_0001_00000000_000.Default_Session_Start __req;
      __diagServicevccmce9_221(__req, __resp);
    }
    else
    {
      DiagResponse CVADAS_0001_00000000_000.* __resp;
      DiagRequest CVADAS_0001_00000000_000.Default_Session_Start __req;
      __diagServicevccmce9_221(__req, __resp);
    }
  }
  TestCommandEnd();


  TestCommandBegin(__eDiagService, __cDiagService, "", "3");
  {
    if (DiagIsFunctionalGroup("CVADAS_0001_00000000_000"))
    {
      DiagResponse * __resp;
      DiagRequest CVADAS_0001_00000000_000.Extended_Diagnostic_Session_Start __req;
      __diagServicevccmce9_222(__req, __resp);
    }
    else
    {
      DiagResponse CVADAS_0001_00000000_000.* __resp;
      DiagRequest CVADAS_0001_00000000_000.Extended_Diagnostic_Session_Start __req;
      __diagServicevccmce9_222(__req, __resp);
    }
  }
  TestCommandEnd();


  {
    CreateTTEIFFunction("Ttvccmce9_F186_DID_with_PhysicalAdd_ExtendedSession", __eFct, __eLocal);
    CallInterfaceFunction(__cEmpty, __cEmpty, "ef9ee47d-f468-4fc1-8d48-13fa51881535");
  }



}

  
void __diagServicevccmce9_221(DiagRequest * __req, DiagResponse * __resp )
{
  stack long __tableHandle;
  long __res, __paramLen, __bytePos;

   __bVerdict = __eVerdictPass;

  do {
    TestReportResetDiagObjectList();
    DiagSetReportDetailLevel("CVADAS_0001_00000000_000", EnumServiceDetails_onfail);
    // Request aspect
    {

      if (0 >= DiagSendReqAndWaitForResp("CVADAS_0001_00000000_000", __req, __resp, __res, -1, -1, -1, -1, -1, EnumResult_pos, EnumServiceDetails_onfail, EnumSendingMode_physical, EnumSuppressPosResBit_asconfigured, EnumVerdictOnInvalidValues_fail))
        break;
    }

    __res = DiagErrCodeTestStep(__res, "Can't retrieve last response for request! No check possible.") < 0;
    if(__res)
    {
	  __bVerdict = __eVerdictFail;
      break;
    }
    {
      __res = DiagInterpretAs(__resp, "DSC_PR");
      if(__res != 0)
      {
        __bVerdict = __eVerdictFail;
        DiagErrCodeTestStep(__res, "Can't interpret response as diagnostic primitive 'DSC_PR'.");
        break;
      }
      else
      {
        TestStepPass( "Received primitive can be interpreted as diagnostic primitive 'DSC_PR'.");
      }
    }
  }
  while(0);


  // Response, check & read aspect
  {
    __res = 1;
    __tableHandle = ReportTableHead5Columns(__cCheckCaption, __cTSym, __cTOp, __cRefVal, __cActual, __cRes);
    {
      __bDiagValueArrayCtr = DiagGetParameterErrorHandled(__resp, "DiagSessionType", __bDiagValueArray, elcount(__bDiagValueArray), __cDiagValueArray, elcount(__cDiagValueArray));
      {
        byte __bArray2[1] = { 0x01 };
        __bArrayCtr = __CopyBytes(__bDiagValueArray, __bDiagValueArrayCtr, __bArray);
        __bArrayCtr2 = elCount(__bArray2);
        __csr = CompareBytes(__bArray, __bArrayCtr, __bArray2, __bArrayCtr2) == 0;
        snprintf(__cArray, 8192, "%s", "Diagnostic parameter \'DiagSessionType\'");
        snprintf(__cArray2, 8192, "%s", __cArray);
        snprintf(__cArray3, 8192, "%s", "");
        ReportTableRow(__tableHandle, 0, __cArray2, "Bytes", __bArray2, __bArrayCtr2, __cArray3, __oneOfFlag, __bSetInCheckAlignment);
        ReportCell(__tableHandle, __bArray, __bArrayCtr);
        ReportCellResult(__tableHandle, __csr, __ePassFail);
      }
    
      __res = __res && __csr;
    
    }
    ReportTableEndVerdict(__tableHandle, __cEvaluateResponse, __res);
	__bVerdict = __bVerdict && __res;
  }
  if (__bVerdict == __eVerdictFail)
    TestReportWriteDiagObjectList();
}
  
void __diagServicevccmce9_222(DiagRequest * __req, DiagResponse * __resp )
{
  stack long __tableHandle;
  long __res, __paramLen, __bytePos;

   __bVerdict = __eVerdictPass;

  do {
    TestReportResetDiagObjectList();
    DiagSetReportDetailLevel("CVADAS_0001_00000000_000", EnumServiceDetails_onfail);
    // Request aspect
    {

      if (0 >= DiagSendReqAndWaitForResp("CVADAS_0001_00000000_000", __req, __resp, __res, -1, -1, -1, -1, -1, EnumResult_pos, EnumServiceDetails_onfail, EnumSendingMode_physical, EnumSuppressPosResBit_asconfigured, EnumVerdictOnInvalidValues_fail))
        break;
    }

    __res = DiagErrCodeTestStep(__res, "Can't retrieve last response for request! No check possible.") < 0;
    if(__res)
    {
	  __bVerdict = __eVerdictFail;
      break;
    }
    {
      __res = DiagInterpretAs(__resp, "DSC_PR");
      if(__res != 0)
      {
        __bVerdict = __eVerdictFail;
        DiagErrCodeTestStep(__res, "Can't interpret response as diagnostic primitive 'DSC_PR'.");
        break;
      }
      else
      {
        TestStepPass( "Received primitive can be interpreted as diagnostic primitive 'DSC_PR'.");
      }
    }
  }
  while(0);


  // Response, check & read aspect
  {
    __res = 1;
    __tableHandle = ReportTableHead5Columns(__cCheckCaption, __cTSym, __cTOp, __cRefVal, __cActual, __cRes);
    {
      __bDiagValueArrayCtr = DiagGetParameterErrorHandled(__resp, "DiagSessionType", __bDiagValueArray, elcount(__bDiagValueArray), __cDiagValueArray, elcount(__cDiagValueArray));
      {
        byte __bArray2[1] = { 0x03 };
        __bArrayCtr = __CopyBytes(__bDiagValueArray, __bDiagValueArrayCtr, __bArray);
        __bArrayCtr2 = elCount(__bArray2);
        __csr = CompareBytes(__bArray, __bArrayCtr, __bArray2, __bArrayCtr2) == 0;
        snprintf(__cArray, 8192, "%s", "Diagnostic parameter \'DiagSessionType\'");
        snprintf(__cArray2, 8192, "%s", __cArray);
        snprintf(__cArray3, 8192, "%s", "");
        ReportTableRow(__tableHandle, 0, __cArray2, "Bytes", __bArray2, __bArrayCtr2, __cArray3, __oneOfFlag, __bSetInCheckAlignment);
        ReportCell(__tableHandle, __bArray, __bArrayCtr);
        ReportCellResult(__tableHandle, __csr, __ePassFail);
      }
    
      __res = __res && __csr;
    
    }
    ReportTableEndVerdict(__tableHandle, __cEvaluateResponse, __res);
	__bVerdict = __bVerdict && __res;
  }
  if (__bVerdict == __eVerdictFail)
    TestReportWriteDiagObjectList();
}
void Ttvccmce9_Tet_Tc90_Completion()
{
  stack long __tableHandle;
  TestCompletionBegin();
  {
    {
      CreateTTEIFFunction("Ttvccmce9_General_Postconditions", __eFct, __eLocal);
      CallInterfaceFunction(__cEmpty, __cEmpty, "3d1998f6-ed4f-4d8f-9c0f-63439c24b6a7");
    }


  }
  TestCompletionEnd();
}

void Ttvccmce9_Tet_Tc91()
{
  CreateTTEIFFunction("Ttvccmce9_Tc91", __eTcDef, __eLocal);  
  AddIFParameterTestCaseAttribute("TC_ID", "");
  AddIFParameterTestCaseAttribute("Test Case ID", "");
  CallInterfaceFunction("TC_ID_20205322_Default_Session", __cEmpty , __cEmpty );
}
testcase Ttvccmce9_Tc91()
{
  stack long __tableHandle;
  SetBreakOnFail(0);

  CreateTTEIFFunction("Ttvccmce9_Tet_Tc91_Completion", __eFct, __eLocal);
  
  AddIFAsCleanUpFunction();

  TestPreparationBegin();
  {
    {
      CreateTTEIFFunction("Ttvccmce9_General_Precondition", __eFct, __eLocal);
      CallInterfaceFunction(__cEmpty, __cEmpty, "b588ddda-8fe4-4271-93b3-dd1beefd9138");
    }


  }
  TestPreparationEnd();

  TestCommandBegin(__eDiagService, __cDiagService, "", "2");
  {
    if (DiagIsFunctionalGroup("CVADAS_0001_00000000_000"))
    {
      DiagResponse * __resp;
      DiagRequest CVADAS_0001_00000000_000.Default_Session_Start __req;
      __diagServicevccmce9_223(__req, __resp);
    }
    else
    {
      DiagResponse CVADAS_0001_00000000_000.* __resp;
      DiagRequest CVADAS_0001_00000000_000.Default_Session_Start __req;
      __diagServicevccmce9_223(__req, __resp);
    }
  }
  TestCommandEnd();


  {
    CreateTTEIFFunction("Ttvccmce9_F186_DID_with_PhysicalAdd_DefaultSession", __eFct, __eLocal);
    CallInterfaceFunction(__cEmpty, __cEmpty, "94cfa590-eac0-4499-adc5-5b1a2141e3ff");
  }



}

  
void __diagServicevccmce9_223(DiagRequest * __req, DiagResponse * __resp )
{
  stack long __tableHandle;
  long __res, __paramLen, __bytePos;

   __bVerdict = __eVerdictPass;

  do {
    TestReportResetDiagObjectList();
    DiagSetReportDetailLevel("CVADAS_0001_00000000_000", EnumServiceDetails_onfail);
    // Request aspect
    {

      if (0 >= DiagSendReqAndWaitForResp("CVADAS_0001_00000000_000", __req, __resp, __res, -1, -1, -1, -1, -1, EnumResult_pos, EnumServiceDetails_onfail, EnumSendingMode_physical, EnumSuppressPosResBit_asconfigured, EnumVerdictOnInvalidValues_fail))
        break;
    }

    __res = DiagErrCodeTestStep(__res, "Can't retrieve last response for request! No check possible.") < 0;
    if(__res)
    {
	  __bVerdict = __eVerdictFail;
      break;
    }
    {
      __res = DiagInterpretAs(__resp, "DSC_PR");
      if(__res != 0)
      {
        __bVerdict = __eVerdictFail;
        DiagErrCodeTestStep(__res, "Can't interpret response as diagnostic primitive 'DSC_PR'.");
        break;
      }
      else
      {
        TestStepPass( "Received primitive can be interpreted as diagnostic primitive 'DSC_PR'.");
      }
    }
  }
  while(0);


  // Response, check & read aspect
  {
    __res = 1;
    __tableHandle = ReportTableHead5Columns(__cCheckCaption, __cTSym, __cTOp, __cRefVal, __cActual, __cRes);
    {
      __bDiagValueArrayCtr = DiagGetParameterErrorHandled(__resp, "DiagSessionType", __bDiagValueArray, elcount(__bDiagValueArray), __cDiagValueArray, elcount(__cDiagValueArray));
      {
        byte __bArray2[1] = { 0x01 };
        __bArrayCtr = __CopyBytes(__bDiagValueArray, __bDiagValueArrayCtr, __bArray);
        __bArrayCtr2 = elCount(__bArray2);
        __csr = CompareBytes(__bArray, __bArrayCtr, __bArray2, __bArrayCtr2) == 0;
        snprintf(__cArray, 8192, "%s", "Diagnostic parameter \'DiagSessionType\'");
        snprintf(__cArray2, 8192, "%s", __cArray);
        snprintf(__cArray3, 8192, "%s", "");
        ReportTableRow(__tableHandle, 0, __cArray2, "Bytes", __bArray2, __bArrayCtr2, __cArray3, __oneOfFlag, __bSetInCheckAlignment);
        ReportCell(__tableHandle, __bArray, __bArrayCtr);
        ReportCellResult(__tableHandle, __csr, __ePassFail);
      }
    
      __res = __res && __csr;
    
    }
    ReportTableEndVerdict(__tableHandle, __cEvaluateResponse, __res);
	__bVerdict = __bVerdict && __res;
  }
  if (__bVerdict == __eVerdictFail)
    TestReportWriteDiagObjectList();
}
void Ttvccmce9_Tet_Tc91_Completion()
{
  stack long __tableHandle;
  TestCompletionBegin();
  {
    {
      CreateTTEIFFunction("Ttvccmce9_General_Postconditions", __eFct, __eLocal);
      CallInterfaceFunction(__cEmpty, __cEmpty, "3d1998f6-ed4f-4d8f-9c0f-63439c24b6a7");
    }


  }
  TestCompletionEnd();
}

void Ttvccmce9_Tet_Tc92()
{
  CreateTTEIFFunction("Ttvccmce9_Tc92", __eTcDef, __eLocal);  
  AddIFParameterTestCaseAttribute("TC_ID", "");
  AddIFParameterTestCaseAttribute("Test Case ID", "");
  CallInterfaceFunction("TC_ID_20205307_Hard_Reset", __cEmpty , __cEmpty );
}
testcase Ttvccmce9_Tc92()
{
  stack long __tableHandle;
  SetBreakOnFail(0);

  CreateTTEIFFunction("Ttvccmce9_Tet_Tc92_Completion", __eFct, __eLocal);
  
  AddIFAsCleanUpFunction();

  TestPreparationBegin();
  {
    {
      CreateTTEIFFunction("Ttvccmce9_General_Precondition", __eFct, __eLocal);
      CallInterfaceFunction(__cEmpty, __cEmpty, "b588ddda-8fe4-4271-93b3-dd1beefd9138");
    }


  }
  TestPreparationEnd();

  {
    CreateCaplIFFunction("startTesterPresent", __eTestFct);
    CallInterfaceFunction("startTesterPresent ()", __cEmpty, "2");
  }


  TestCommandBegin(__eDiagService, __cDiagService, "", "3");
  {
    if (DiagIsFunctionalGroup("CVADAS_0001_00000000_000"))
    {
      DiagResponse * __resp;
      DiagRequest CVADAS_0001_00000000_000.Default_Session_Start __req;
      __diagServicevccmce9_224(__req, __resp);
    }
    else
    {
      DiagResponse CVADAS_0001_00000000_000.* __resp;
      DiagRequest CVADAS_0001_00000000_000.Default_Session_Start __req;
      __diagServicevccmce9_224(__req, __resp);
    }
  }
  TestCommandEnd();


  TestCommandBegin(__eDiagService, __cDiagService, "", "4");
  {
    if (DiagIsFunctionalGroup("CVADAS_0001_00000000_000"))
    {
      DiagResponse * __resp;
      DiagRequest CVADAS_0001_00000000_000.Extended_Diagnostic_Session_Start __req;
      __diagServicevccmce9_225(__req, __resp);
    }
    else
    {
      DiagResponse CVADAS_0001_00000000_000.* __resp;
      DiagRequest CVADAS_0001_00000000_000.Extended_Diagnostic_Session_Start __req;
      __diagServicevccmce9_225(__req, __resp);
    }
  }
  TestCommandEnd();


  {
    CreateTTEIFFunction("Ttvccmce9_F186_DID_with_PhysicalAdd_ExtendedSession", __eFct, __eLocal);
    CallInterfaceFunction(__cEmpty, __cEmpty, "ef9ee47d-f468-4fc1-8d48-13fa51881535");
  }


  {
    CreateTTEIFFunction("Ttvccmce9_Hard_Reset_with_Physical_Address", __eFct, __eLocal);
    CallInterfaceFunction(__cEmpty, __cEmpty, "3faededc-97af-4e0a-8dd6-c11f8fa26bfa");
  }


  TestCommandBegin(__eWait, __cWait, "", "7");
  {
    Wait("1", (15 * 1000000000LL), 1000000000, "");
  }
  TestCommandEnd();

  {
    CreateTTEIFFunction("Ttvccmce9_F186_DID_with_PhysicalAdd_DefaultSession", __eFct, __eLocal);
    CallInterfaceFunction(__cEmpty, __cEmpty, "94cfa590-eac0-4499-adc5-5b1a2141e3ff");
  }


  TestCommandBegin(__eWait, __cWait, "", "9");
  {
    Wait("1", (1000 * 1000000LL), 1000000, "");
  }
  TestCommandEnd();


}

  
void __diagServicevccmce9_224(DiagRequest * __req, DiagResponse * __resp )
{
  stack long __tableHandle;
  long __res, __paramLen, __bytePos;

   __bVerdict = __eVerdictPass;

  do {
    TestReportResetDiagObjectList();
    DiagSetReportDetailLevel("CVADAS_0001_00000000_000", EnumServiceDetails_onfail);
    // Request aspect
    {

      if (0 >= DiagSendReqAndWaitForResp("CVADAS_0001_00000000_000", __req, __resp, __res, -1, -1, -1, -1, -1, EnumResult_pos, EnumServiceDetails_onfail, EnumSendingMode_physical, EnumSuppressPosResBit_asconfigured, EnumVerdictOnInvalidValues_fail))
        break;
    }

    __res = DiagErrCodeTestStep(__res, "Can't retrieve last response for request! No check possible.") < 0;
    if(__res)
    {
	  __bVerdict = __eVerdictFail;
      break;
    }
    {
      __res = DiagInterpretAs(__resp, "DSC_PR");
      if(__res != 0)
      {
        __bVerdict = __eVerdictFail;
        DiagErrCodeTestStep(__res, "Can't interpret response as diagnostic primitive 'DSC_PR'.");
        break;
      }
      else
      {
        TestStepPass( "Received primitive can be interpreted as diagnostic primitive 'DSC_PR'.");
      }
    }
  }
  while(0);


  // Response, check & read aspect
  {
    __res = 1;
    __tableHandle = ReportTableHead5Columns(__cCheckCaption, __cTSym, __cTOp, __cRefVal, __cActual, __cRes);
    {
      __bDiagValueArrayCtr = DiagGetParameterErrorHandled(__resp, "DiagSessionType", __bDiagValueArray, elcount(__bDiagValueArray), __cDiagValueArray, elcount(__cDiagValueArray));
      {
        byte __bArray2[1] = { 0x01 };
        __bArrayCtr = __CopyBytes(__bDiagValueArray, __bDiagValueArrayCtr, __bArray);
        __bArrayCtr2 = elCount(__bArray2);
        __csr = CompareBytes(__bArray, __bArrayCtr, __bArray2, __bArrayCtr2) == 0;
        snprintf(__cArray, 8192, "%s", "Diagnostic parameter \'DiagSessionType\'");
        snprintf(__cArray2, 8192, "%s", __cArray);
        snprintf(__cArray3, 8192, "%s", "");
        ReportTableRow(__tableHandle, 0, __cArray2, "Bytes", __bArray2, __bArrayCtr2, __cArray3, __oneOfFlag, __bSetInCheckAlignment);
        ReportCell(__tableHandle, __bArray, __bArrayCtr);
        ReportCellResult(__tableHandle, __csr, __ePassFail);
      }
    
      __res = __res && __csr;
    
    }
    ReportTableEndVerdict(__tableHandle, __cEvaluateResponse, __res);
	__bVerdict = __bVerdict && __res;
  }
  if (__bVerdict == __eVerdictFail)
    TestReportWriteDiagObjectList();
}
  
void __diagServicevccmce9_225(DiagRequest * __req, DiagResponse * __resp )
{
  stack long __tableHandle;
  long __res, __paramLen, __bytePos;

   __bVerdict = __eVerdictPass;

  do {
    TestReportResetDiagObjectList();
    DiagSetReportDetailLevel("CVADAS_0001_00000000_000", EnumServiceDetails_onfail);
    // Request aspect
    {

      if (0 >= DiagSendReqAndWaitForResp("CVADAS_0001_00000000_000", __req, __resp, __res, -1, -1, -1, -1, -1, EnumResult_pos, EnumServiceDetails_onfail, EnumSendingMode_physical, EnumSuppressPosResBit_asconfigured, EnumVerdictOnInvalidValues_fail))
        break;
    }

    __res = DiagErrCodeTestStep(__res, "Can't retrieve last response for request! No check possible.") < 0;
    if(__res)
    {
	  __bVerdict = __eVerdictFail;
      break;
    }
    {
      __res = DiagInterpretAs(__resp, "DSC_PR");
      if(__res != 0)
      {
        __bVerdict = __eVerdictFail;
        DiagErrCodeTestStep(__res, "Can't interpret response as diagnostic primitive 'DSC_PR'.");
        break;
      }
      else
      {
        TestStepPass( "Received primitive can be interpreted as diagnostic primitive 'DSC_PR'.");
      }
    }
  }
  while(0);


  // Response, check & read aspect
  {
    __res = 1;
    __tableHandle = ReportTableHead5Columns(__cCheckCaption, __cTSym, __cTOp, __cRefVal, __cActual, __cRes);
    {
      __bDiagValueArrayCtr = DiagGetParameterErrorHandled(__resp, "DiagSessionType", __bDiagValueArray, elcount(__bDiagValueArray), __cDiagValueArray, elcount(__cDiagValueArray));
      {
        byte __bArray2[1] = { 0x03 };
        __bArrayCtr = __CopyBytes(__bDiagValueArray, __bDiagValueArrayCtr, __bArray);
        __bArrayCtr2 = elCount(__bArray2);
        __csr = CompareBytes(__bArray, __bArrayCtr, __bArray2, __bArrayCtr2) == 0;
        snprintf(__cArray, 8192, "%s", "Diagnostic parameter \'DiagSessionType\'");
        snprintf(__cArray2, 8192, "%s", __cArray);
        snprintf(__cArray3, 8192, "%s", "");
        ReportTableRow(__tableHandle, 0, __cArray2, "Bytes", __bArray2, __bArrayCtr2, __cArray3, __oneOfFlag, __bSetInCheckAlignment);
        ReportCell(__tableHandle, __bArray, __bArrayCtr);
        ReportCellResult(__tableHandle, __csr, __ePassFail);
      }
    
      __res = __res && __csr;
    
    }
    ReportTableEndVerdict(__tableHandle, __cEvaluateResponse, __res);
	__bVerdict = __bVerdict && __res;
  }
  if (__bVerdict == __eVerdictFail)
    TestReportWriteDiagObjectList();
}
void Ttvccmce9_Tet_Tc92_Completion()
{
  stack long __tableHandle;
  TestCompletionBegin();
  {
    {
      CreateTTEIFFunction("Ttvccmce9_General_Postconditions", __eFct, __eLocal);
      CallInterfaceFunction(__cEmpty, __cEmpty, "3d1998f6-ed4f-4d8f-9c0f-63439c24b6a7");
    }


  }
  TestCompletionEnd();
}

void Ttvccmce9_Tet_Tc93()
{
  CreateTTEIFFunction("Ttvccmce9_Tc93", __eTcDef, __eLocal);  
  AddIFParameterTestCaseAttribute("TC_ID", "");
  AddIFParameterTestCaseAttribute("Test Case ID", "");
  CallInterfaceFunction("TC_ID_20205310_Extended_Session", __cEmpty , __cEmpty );
}
testcase Ttvccmce9_Tc93()
{
  stack long __tableHandle;
  SetBreakOnFail(0);

  CreateTTEIFFunction("Ttvccmce9_Tet_Tc93_Completion", __eFct, __eLocal);
  
  AddIFAsCleanUpFunction();

  TestPreparationBegin();
  {
    {
      CreateTTEIFFunction("Ttvccmce9_General_Precondition", __eFct, __eLocal);
      CallInterfaceFunction(__cEmpty, __cEmpty, "b588ddda-8fe4-4271-93b3-dd1beefd9138");
    }


  }
  TestPreparationEnd();

  TestCommandBegin(__eDiagService, __cDiagService, "", "1");
  {
    if (DiagIsFunctionalGroup("CVADAS_0001_00000000_000"))
    {
      DiagResponse * __resp;
      DiagRequest CVADAS_0001_00000000_000.Extended_Diagnostic_Session_Start __req;
      __diagServicevccmce9_226(__req, __resp);
    }
    else
    {
      DiagResponse CVADAS_0001_00000000_000.* __resp;
      DiagRequest CVADAS_0001_00000000_000.Extended_Diagnostic_Session_Start __req;
      __diagServicevccmce9_226(__req, __resp);
    }
  }
  TestCommandEnd();


  {
    CreateTTEIFFunction("Ttvccmce9__14_Clear_Diag_Info_Physical_Add", __eFct, __eLocal);
    CallInterfaceFunction(__cEmpty, __cEmpty, "9ad40b92-2a41-4892-b147-932e78662376");
  }


  TestCommandBegin(__eWait, __cWait, "", "3");
  {
    Wait("1", (1000 * 1000000LL), 1000000, "");
  }
  TestCommandEnd();

  {
    CreateTTEIFFunction("Ttvccmce9__19_02_Report_DTC_By_Status_Mask_Physical_Add", __eFct, __eLocal);
    CallInterfaceFunction(__cEmpty, __cEmpty, "49d14f62-aa99-42aa-87c1-03b55e92f925");
  }



}

  
void __diagServicevccmce9_226(DiagRequest * __req, DiagResponse * __resp )
{
  stack long __tableHandle;
  long __res, __paramLen, __bytePos;

   __bVerdict = __eVerdictPass;

  do {
    TestReportResetDiagObjectList();
    DiagSetReportDetailLevel("CVADAS_0001_00000000_000", EnumServiceDetails_onfail);
    // Request aspect
    {

      if (0 >= DiagSendReqAndWaitForResp("CVADAS_0001_00000000_000", __req, __resp, __res, -1, -1, -1, -1, -1, EnumResult_pos, EnumServiceDetails_onfail, EnumSendingMode_physical, EnumSuppressPosResBit_asconfigured, EnumVerdictOnInvalidValues_fail))
        break;
    }

    __res = DiagErrCodeTestStep(__res, "Can't retrieve last response for request! No check possible.") < 0;
    if(__res)
    {
	  __bVerdict = __eVerdictFail;
      break;
    }
    {
      __res = DiagInterpretAs(__resp, "DSC_PR");
      if(__res != 0)
      {
        __bVerdict = __eVerdictFail;
        DiagErrCodeTestStep(__res, "Can't interpret response as diagnostic primitive 'DSC_PR'.");
        break;
      }
      else
      {
        TestStepPass( "Received primitive can be interpreted as diagnostic primitive 'DSC_PR'.");
      }
    }
  }
  while(0);


  // Response, check & read aspect
  {
    __res = 1;
    __tableHandle = ReportTableHead5Columns(__cCheckCaption, __cTSym, __cTOp, __cRefVal, __cActual, __cRes);
    {
      __bDiagValueArrayCtr = DiagGetParameterErrorHandled(__resp, "DiagSessionType", __bDiagValueArray, elcount(__bDiagValueArray), __cDiagValueArray, elcount(__cDiagValueArray));
      {
        byte __bArray2[1] = { 0x03 };
        __bArrayCtr = __CopyBytes(__bDiagValueArray, __bDiagValueArrayCtr, __bArray);
        __bArrayCtr2 = elCount(__bArray2);
        __csr = CompareBytes(__bArray, __bArrayCtr, __bArray2, __bArrayCtr2) == 0;
        snprintf(__cArray, 8192, "%s", "Diagnostic parameter \'DiagSessionType\'");
        snprintf(__cArray2, 8192, "%s", __cArray);
        snprintf(__cArray3, 8192, "%s", "");
        ReportTableRow(__tableHandle, 0, __cArray2, "Bytes", __bArray2, __bArrayCtr2, __cArray3, __oneOfFlag, __bSetInCheckAlignment);
        ReportCell(__tableHandle, __bArray, __bArrayCtr);
        ReportCellResult(__tableHandle, __csr, __ePassFail);
      }
    
      __res = __res && __csr;
    
    }
    ReportTableEndVerdict(__tableHandle, __cEvaluateResponse, __res);
	__bVerdict = __bVerdict && __res;
  }
  if (__bVerdict == __eVerdictFail)
    TestReportWriteDiagObjectList();
}
void Ttvccmce9_Tet_Tc93_Completion()
{
  stack long __tableHandle;
  TestCompletionBegin();
  {
    {
      CreateTTEIFFunction("Ttvccmce9_General_Postconditions", __eFct, __eLocal);
      CallInterfaceFunction(__cEmpty, __cEmpty, "3d1998f6-ed4f-4d8f-9c0f-63439c24b6a7");
    }


  }
  TestCompletionEnd();
}

void Ttvccmce9_Tet_Tc94()
{
  CreateTTEIFFunction("Ttvccmce9_Tc94", __eTcDef, __eLocal);  
  AddIFParameterTestCaseAttribute("TC_ID", "");
  AddIFParameterTestCaseAttribute("Test Case ID", "");
  CallInterfaceFunction("TC_ID_20205295_Hard_Reset", __cEmpty , __cEmpty );
}
testcase Ttvccmce9_Tc94()
{
  stack long __tableHandle;
  SetBreakOnFail(0);

  CreateTTEIFFunction("Ttvccmce9_Tet_Tc94_Completion", __eFct, __eLocal);
  
  AddIFAsCleanUpFunction();

  TestPreparationBegin();
  {
    {
      CreateTTEIFFunction("Ttvccmce9_General_Precondition", __eFct, __eLocal);
      CallInterfaceFunction(__cEmpty, __cEmpty, "b588ddda-8fe4-4271-93b3-dd1beefd9138");
    }


  }
  TestPreparationEnd();

  {
    CreateCaplIFFunction("startTesterPresent", __eTestFct);
    CallInterfaceFunction("startTesterPresent ()", __cEmpty, "2");
  }


  TestCommandBegin(__eDiagService, __cDiagService, "", "3");
  {
    if (DiagIsFunctionalGroup("CVADAS_0001_00000000_000"))
    {
      DiagResponse * __resp;
      DiagRequest CVADAS_0001_00000000_000.Default_Session_Start __req;
      __diagServicevccmce9_227(__req, __resp);
    }
    else
    {
      DiagResponse CVADAS_0001_00000000_000.* __resp;
      DiagRequest CVADAS_0001_00000000_000.Default_Session_Start __req;
      __diagServicevccmce9_227(__req, __resp);
    }
  }
  TestCommandEnd();


  TestCommandBegin(__eDiagService, __cDiagService, "", "4");
  {
    if (DiagIsFunctionalGroup("CVADAS_0001_00000000_000"))
    {
      DiagResponse * __resp;
      DiagRequest CVADAS_0001_00000000_000.Extended_Diagnostic_Session_Start __req;
      __diagServicevccmce9_228(__req, __resp);
    }
    else
    {
      DiagResponse CVADAS_0001_00000000_000.* __resp;
      DiagRequest CVADAS_0001_00000000_000.Extended_Diagnostic_Session_Start __req;
      __diagServicevccmce9_228(__req, __resp);
    }
  }
  TestCommandEnd();


  {
    CreateTTEIFFunction("Ttvccmce9_Hard_Reset_with_Physical_Address", __eFct, __eLocal);
    CallInterfaceFunction(__cEmpty, __cEmpty, "3faededc-97af-4e0a-8dd6-c11f8fa26bfa");
  }


  TestCommandBegin(__eWait, __cWait, "", "6");
  {
    Wait("1", (15 * 1000000000LL), 1000000000, "");
  }
  TestCommandEnd();

  {
    CreateTTEIFFunction("Ttvccmce9__14_Clear_Diag_Info_Physical_Add", __eFct, __eLocal);
    CallInterfaceFunction(__cEmpty, __cEmpty, "9ad40b92-2a41-4892-b147-932e78662376");
  }


  TestCommandBegin(__eWait, __cWait, "", "8");
  {
    Wait("1", (1000 * 1000000LL), 1000000, "");
  }
  TestCommandEnd();

  {
    CreateTTEIFFunction("Ttvccmce9__19_02_Report_DTC_By_Status_Mask_Physical_Add", __eFct, __eLocal);
    CallInterfaceFunction(__cEmpty, __cEmpty, "49d14f62-aa99-42aa-87c1-03b55e92f925");
  }



}

  
void __diagServicevccmce9_227(DiagRequest * __req, DiagResponse * __resp )
{
  stack long __tableHandle;
  long __res, __paramLen, __bytePos;

   __bVerdict = __eVerdictPass;

  do {
    TestReportResetDiagObjectList();
    DiagSetReportDetailLevel("CVADAS_0001_00000000_000", EnumServiceDetails_onfail);
    // Request aspect
    {

      if (0 >= DiagSendReqAndWaitForResp("CVADAS_0001_00000000_000", __req, __resp, __res, -1, -1, -1, -1, -1, EnumResult_pos, EnumServiceDetails_onfail, EnumSendingMode_physical, EnumSuppressPosResBit_asconfigured, EnumVerdictOnInvalidValues_fail))
        break;
    }

    __res = DiagErrCodeTestStep(__res, "Can't retrieve last response for request! No check possible.") < 0;
    if(__res)
    {
	  __bVerdict = __eVerdictFail;
      break;
    }
    {
      __res = DiagInterpretAs(__resp, "DSC_PR");
      if(__res != 0)
      {
        __bVerdict = __eVerdictFail;
        DiagErrCodeTestStep(__res, "Can't interpret response as diagnostic primitive 'DSC_PR'.");
        break;
      }
      else
      {
        TestStepPass( "Received primitive can be interpreted as diagnostic primitive 'DSC_PR'.");
      }
    }
  }
  while(0);


  // Response, check & read aspect
  {
    __res = 1;
    __tableHandle = ReportTableHead5Columns(__cCheckCaption, __cTSym, __cTOp, __cRefVal, __cActual, __cRes);
    {
      __bDiagValueArrayCtr = DiagGetParameterErrorHandled(__resp, "DiagSessionType", __bDiagValueArray, elcount(__bDiagValueArray), __cDiagValueArray, elcount(__cDiagValueArray));
      {
        byte __bArray2[1] = { 0x01 };
        __bArrayCtr = __CopyBytes(__bDiagValueArray, __bDiagValueArrayCtr, __bArray);
        __bArrayCtr2 = elCount(__bArray2);
        __csr = CompareBytes(__bArray, __bArrayCtr, __bArray2, __bArrayCtr2) == 0;
        snprintf(__cArray, 8192, "%s", "Diagnostic parameter \'DiagSessionType\'");
        snprintf(__cArray2, 8192, "%s", __cArray);
        snprintf(__cArray3, 8192, "%s", "");
        ReportTableRow(__tableHandle, 0, __cArray2, "Bytes", __bArray2, __bArrayCtr2, __cArray3, __oneOfFlag, __bSetInCheckAlignment);
        ReportCell(__tableHandle, __bArray, __bArrayCtr);
        ReportCellResult(__tableHandle, __csr, __ePassFail);
      }
    
      __res = __res && __csr;
    
    }
    ReportTableEndVerdict(__tableHandle, __cEvaluateResponse, __res);
	__bVerdict = __bVerdict && __res;
  }
  if (__bVerdict == __eVerdictFail)
    TestReportWriteDiagObjectList();
}
  
void __diagServicevccmce9_228(DiagRequest * __req, DiagResponse * __resp )
{
  stack long __tableHandle;
  long __res, __paramLen, __bytePos;

   __bVerdict = __eVerdictPass;

  do {
    TestReportResetDiagObjectList();
    DiagSetReportDetailLevel("CVADAS_0001_00000000_000", EnumServiceDetails_onfail);
    // Request aspect
    {

      if (0 >= DiagSendReqAndWaitForResp("CVADAS_0001_00000000_000", __req, __resp, __res, -1, -1, -1, -1, -1, EnumResult_pos, EnumServiceDetails_onfail, EnumSendingMode_physical, EnumSuppressPosResBit_asconfigured, EnumVerdictOnInvalidValues_fail))
        break;
    }

    __res = DiagErrCodeTestStep(__res, "Can't retrieve last response for request! No check possible.") < 0;
    if(__res)
    {
	  __bVerdict = __eVerdictFail;
      break;
    }
    {
      __res = DiagInterpretAs(__resp, "DSC_PR");
      if(__res != 0)
      {
        __bVerdict = __eVerdictFail;
        DiagErrCodeTestStep(__res, "Can't interpret response as diagnostic primitive 'DSC_PR'.");
        break;
      }
      else
      {
        TestStepPass( "Received primitive can be interpreted as diagnostic primitive 'DSC_PR'.");
      }
    }
  }
  while(0);


  // Response, check & read aspect
  {
    __res = 1;
    __tableHandle = ReportTableHead5Columns(__cCheckCaption, __cTSym, __cTOp, __cRefVal, __cActual, __cRes);
    {
      __bDiagValueArrayCtr = DiagGetParameterErrorHandled(__resp, "DiagSessionType", __bDiagValueArray, elcount(__bDiagValueArray), __cDiagValueArray, elcount(__cDiagValueArray));
      {
        byte __bArray2[1] = { 0x03 };
        __bArrayCtr = __CopyBytes(__bDiagValueArray, __bDiagValueArrayCtr, __bArray);
        __bArrayCtr2 = elCount(__bArray2);
        __csr = CompareBytes(__bArray, __bArrayCtr, __bArray2, __bArrayCtr2) == 0;
        snprintf(__cArray, 8192, "%s", "Diagnostic parameter \'DiagSessionType\'");
        snprintf(__cArray2, 8192, "%s", __cArray);
        snprintf(__cArray3, 8192, "%s", "");
        ReportTableRow(__tableHandle, 0, __cArray2, "Bytes", __bArray2, __bArrayCtr2, __cArray3, __oneOfFlag, __bSetInCheckAlignment);
        ReportCell(__tableHandle, __bArray, __bArrayCtr);
        ReportCellResult(__tableHandle, __csr, __ePassFail);
      }
    
      __res = __res && __csr;
    
    }
    ReportTableEndVerdict(__tableHandle, __cEvaluateResponse, __res);
	__bVerdict = __bVerdict && __res;
  }
  if (__bVerdict == __eVerdictFail)
    TestReportWriteDiagObjectList();
}
void Ttvccmce9_Tet_Tc94_Completion()
{
  stack long __tableHandle;
  TestCompletionBegin();
  {
    {
      CreateTTEIFFunction("Ttvccmce9_General_Postconditions", __eFct, __eLocal);
      CallInterfaceFunction(__cEmpty, __cEmpty, "3d1998f6-ed4f-4d8f-9c0f-63439c24b6a7");
    }


  }
  TestCompletionEnd();
}

void Ttvccmce9_Tet_Tc95()
{
  CreateTTEIFFunction("Ttvccmce9_Tc95", __eTcDef, __eLocal);  
  AddIFParameterTestCaseAttribute("TC_ID", "");
  AddIFParameterTestCaseAttribute("Test Case ID", "");
  CallInterfaceFunction("TC_ID_20205287", __cEmpty , __cEmpty );
}
testcase Ttvccmce9_Tc95()
{
  stack long __tableHandle;
  SetBreakOnFail(0);

  CreateTTEIFFunction("Ttvccmce9_Tet_Tc95_Completion", __eFct, __eLocal);
  
  AddIFAsCleanUpFunction();

  TestPreparationBegin();
  {
    {
      CreateTTEIFFunction("Ttvccmce9_General_Precondition", __eFct, __eLocal);
      CallInterfaceFunction(__cEmpty, __cEmpty, "b588ddda-8fe4-4271-93b3-dd1beefd9138");
    }


  }
  TestPreparationEnd();

  {
    CreateCaplIFFunction("Power_Supply_OFF", __eFct);
    CallInterfaceFunction(__cEmpty, __cEmpty, "1");
  }


  TestCommandBegin(__eWait, __cWait, "", "2");
  {
    Wait("1", (2000 * 1000000LL), 1000000, "");
  }
  TestCommandEnd();

  {
    CreateCaplIFFunction("Power_Supply_ON", __eFct);
    CallInterfaceFunction(__cEmpty, __cEmpty, "3");
  }


  TestCommandBegin(__eWait, __cWait, "", "4");
  {
    Wait("1", (3500 * 1000000LL), 1000000, "");
  }
  TestCommandEnd();

  TestCommandBegin(__eWait, __cWait, "", "21");
  {
    Wait("1", (200 * 1000000LL), 1000000, "");
  }
  TestCommandEnd();

  TestCommandBegin(__eWait, __cWait, "", "23");
  {
    Wait("1", (3100 * 1000000LL), 1000000, "");
  }
  TestCommandEnd();

  {
    CreateCaplIFFunction("startTesterPresent", __eTestFct);
    CallInterfaceFunction("startTesterPresent ()", __cEmpty, "24");
  }


  TestCommandBegin(__eWait, __cWait, "", "25");
  {
    Wait("1", (50 * 1000000LL), 1000000, "");
  }
  TestCommandEnd();

  TestCommandBegin(__eDiagService, __cDiagService, "", "26");
  {
    if (DiagIsFunctionalGroup("CVADAS_0001_00000000_000"))
    {
      DiagResponse * __resp;
      DiagRequest CVADAS_0001_00000000_000.Extended_Diagnostic_Session_Start __req;
      __diagServicevccmce9_229(__req, __resp);
    }
    else
    {
      DiagResponse CVADAS_0001_00000000_000.* __resp;
      DiagRequest CVADAS_0001_00000000_000.Extended_Diagnostic_Session_Start __req;
      __diagServicevccmce9_229(__req, __resp);
    }
  }
  TestCommandEnd();


  {
    CreateCaplIFFunction("startTesterPresent", __eTestFct);
    CallInterfaceFunction("startTesterPresent ()", __cEmpty, "27");
  }


  TestCommandBegin(__eWait, __cWait, "", "28");
  {
    Wait("1", (50 * 1000000LL), 1000000, "");
  }
  TestCommandEnd();

  TestCommandBegin(__eDiagService, __cDiagService, "", "29");
  {
    if (DiagIsFunctionalGroup("CVADAS_0001_00000000_000"))
    {
      DiagResponse * __resp;
      DiagRequest CVADAS_0001_00000000_000._221004_Battery_Voltage __req;
      __diagServicevccmce9_230(__req, __resp);
    }
    else
    {
      DiagResponse CVADAS_0001_00000000_000.* __resp;
      DiagRequest CVADAS_0001_00000000_000._221004_Battery_Voltage __req;
      __diagServicevccmce9_230(__req, __resp);
    }
  }
  TestCommandEnd();


  TestCommandBegin(__eWait, __cWait, "", "30");
  {
    Wait("1", (50 * 1000000LL), 1000000, "");
  }
  TestCommandEnd();

  {
    CreateTTEIFFunction("Ttvccmce9__14_Clear_Diag_Info_Physical_Add", __eFct, __eLocal);
    CallInterfaceFunction(__cEmpty, __cEmpty, "9ad40b92-2a41-4892-b147-932e78662376");
  }


  TestCommandBegin(__eWait, __cWait, "", "32");
  {
    Wait("1", (1000 * 1000000LL), 1000000, "");
  }
  TestCommandEnd();

  {
    CreateTTEIFFunction("Ttvccmce9__19_02_Report_DTC_By_Status_Mask_Physical_Add", __eFct, __eLocal);
    CallInterfaceFunction(__cEmpty, __cEmpty, "49d14f62-aa99-42aa-87c1-03b55e92f925");
  }



}

  
void __diagServicevccmce9_229(DiagRequest * __req, DiagResponse * __resp )
{
  stack long __tableHandle;
  long __res, __paramLen, __bytePos;

   __bVerdict = __eVerdictPass;

  do {
    TestReportResetDiagObjectList();
    DiagSetReportDetailLevel("CVADAS_0001_00000000_000", EnumServiceDetails_onfail);
    // Request aspect
    {

      if (0 >= DiagSendReqAndWaitForResp("CVADAS_0001_00000000_000", __req, __resp, __res, -1, -1, -1, -1, -1, EnumResult_pos, EnumServiceDetails_onfail, EnumSendingMode_physical, EnumSuppressPosResBit_asconfigured, EnumVerdictOnInvalidValues_fail))
        break;
    }

    __res = DiagErrCodeTestStep(__res, "Can't retrieve last response for request! No check possible.") < 0;
    if(__res)
    {
	  __bVerdict = __eVerdictFail;
      break;
    }
    {
      __res = DiagInterpretAs(__resp, "DSC_PR");
      if(__res != 0)
      {
        __bVerdict = __eVerdictFail;
        DiagErrCodeTestStep(__res, "Can't interpret response as diagnostic primitive 'DSC_PR'.");
        break;
      }
      else
      {
        TestStepPass( "Received primitive can be interpreted as diagnostic primitive 'DSC_PR'.");
      }
    }
  }
  while(0);


  // Response, check & read aspect
  {
    __res = 1;
    __tableHandle = ReportTableHead5Columns(__cCheckCaption, __cTSym, __cTOp, __cRefVal, __cActual, __cRes);
    {
      __bDiagValueArrayCtr = DiagGetParameterErrorHandled(__resp, "DiagSessionType", __bDiagValueArray, elcount(__bDiagValueArray), __cDiagValueArray, elcount(__cDiagValueArray));
      {
        byte __bArray2[1] = { 0x03 };
        __bArrayCtr = __CopyBytes(__bDiagValueArray, __bDiagValueArrayCtr, __bArray);
        __bArrayCtr2 = elCount(__bArray2);
        __csr = CompareBytes(__bArray, __bArrayCtr, __bArray2, __bArrayCtr2) == 0;
        snprintf(__cArray, 8192, "%s", "Diagnostic parameter \'DiagSessionType\'");
        snprintf(__cArray2, 8192, "%s", __cArray);
        snprintf(__cArray3, 8192, "%s", "");
        ReportTableRow(__tableHandle, 0, __cArray2, "Bytes", __bArray2, __bArrayCtr2, __cArray3, __oneOfFlag, __bSetInCheckAlignment);
        ReportCell(__tableHandle, __bArray, __bArrayCtr);
        ReportCellResult(__tableHandle, __csr, __ePassFail);
      }
    
      __res = __res && __csr;
    
    }
    ReportTableEndVerdict(__tableHandle, __cEvaluateResponse, __res);
	__bVerdict = __bVerdict && __res;
  }
  if (__bVerdict == __eVerdictFail)
    TestReportWriteDiagObjectList();
}
  
void __diagServicevccmce9_230(DiagRequest * __req, DiagResponse * __resp )
{
  stack long __tableHandle;
  long __res, __paramLen, __bytePos;

   __bVerdict = __eVerdictPass;

  do {
    TestReportResetDiagObjectList();
    DiagSetReportDetailLevel("CVADAS_0001_00000000_000", EnumServiceDetails_onfail);
    // Request aspect
    {

      if (0 >= DiagSendReqAndWaitForResp("CVADAS_0001_00000000_000", __req, __resp, __res, -1, -1, -1, -1, -1, EnumResult_pos, EnumServiceDetails_onfail, EnumSendingMode_physical, EnumSuppressPosResBit_asconfigured, EnumVerdictOnInvalidValues_fail))
        break;
    }

  }
  while(0);


  if (__bVerdict == __eVerdictFail)
    TestReportWriteDiagObjectList();
}
void Ttvccmce9_Tet_Tc95_Completion()
{
  stack long __tableHandle;
  TestCompletionBegin();
  {
    {
      CreateTTEIFFunction("Ttvccmce9_General_Postconditions", __eFct, __eLocal);
      CallInterfaceFunction(__cEmpty, __cEmpty, "3d1998f6-ed4f-4d8f-9c0f-63439c24b6a7");
    }


  }
  TestCompletionEnd();
}

void Ttvccmce9_Tet_Tc96()
{
  CreateTTEIFFunction("Ttvccmce9_Tc96", __eTcDef, __eLocal);  
  AddIFParameterTestCaseAttribute("TC_ID", "");
  AddIFParameterTestCaseAttribute("Test Case ID", "");
  CallInterfaceFunction("TC_ID_20205161_Extended_Session", __cEmpty , __cEmpty );
}
testcase Ttvccmce9_Tc96()
{
  stack long __tableHandle;
  SetBreakOnFail(0);

  CreateTTEIFFunction("Ttvccmce9_Tet_Tc96_Completion", __eFct, __eLocal);
  
  AddIFAsCleanUpFunction();

  TestPreparationBegin();
  {
    {
      CreateTTEIFFunction("Ttvccmce9_General_Precondition", __eFct, __eLocal);
      CallInterfaceFunction(__cEmpty, __cEmpty, "b588ddda-8fe4-4271-93b3-dd1beefd9138");
    }


  }
  TestPreparationEnd();

  TestCommandBegin(__eDiagService, __cDiagService, "", "2");
  {
    if (DiagIsFunctionalGroup("CVADAS_0001_00000000_000"))
    {
      DiagResponse * __resp;
      DiagRequest CVADAS_0001_00000000_000.Default_Session_Start __req;
      __diagServicevccmce9_231(__req, __resp);
    }
    else
    {
      DiagResponse CVADAS_0001_00000000_000.* __resp;
      DiagRequest CVADAS_0001_00000000_000.Default_Session_Start __req;
      __diagServicevccmce9_231(__req, __resp);
    }
  }
  TestCommandEnd();


  TestCommandBegin(__eDiagService, __cDiagService, "", "3");
  {
    if (DiagIsFunctionalGroup("CVADAS_0001_00000000_000"))
    {
      DiagResponse * __resp;
      DiagRequest CVADAS_0001_00000000_000.Extended_Diagnostic_Session_Start __req;
      __diagServicevccmce9_232(__req, __resp);
    }
    else
    {
      DiagResponse CVADAS_0001_00000000_000.* __resp;
      DiagRequest CVADAS_0001_00000000_000.Extended_Diagnostic_Session_Start __req;
      __diagServicevccmce9_232(__req, __resp);
    }
  }
  TestCommandEnd();



}

  
void __diagServicevccmce9_231(DiagRequest * __req, DiagResponse * __resp )
{
  stack long __tableHandle;
  long __res, __paramLen, __bytePos;

   __bVerdict = __eVerdictPass;

  do {
    TestReportResetDiagObjectList();
    DiagSetReportDetailLevel("CVADAS_0001_00000000_000", EnumServiceDetails_onfail);
    // Request aspect
    {

      if (0 >= DiagSendReqAndWaitForResp("CVADAS_0001_00000000_000", __req, __resp, __res, -1, -1, -1, -1, -1, EnumResult_pos, EnumServiceDetails_onfail, EnumSendingMode_physical, EnumSuppressPosResBit_asconfigured, EnumVerdictOnInvalidValues_fail))
        break;
    }

    __res = DiagErrCodeTestStep(__res, "Can't retrieve last response for request! No check possible.") < 0;
    if(__res)
    {
	  __bVerdict = __eVerdictFail;
      break;
    }
    {
      __res = DiagInterpretAs(__resp, "DSC_PR");
      if(__res != 0)
      {
        __bVerdict = __eVerdictFail;
        DiagErrCodeTestStep(__res, "Can't interpret response as diagnostic primitive 'DSC_PR'.");
        break;
      }
      else
      {
        TestStepPass( "Received primitive can be interpreted as diagnostic primitive 'DSC_PR'.");
      }
    }
  }
  while(0);


  // Response, check & read aspect
  {
    __res = 1;
    __tableHandle = ReportTableHead5Columns(__cCheckCaption, __cTSym, __cTOp, __cRefVal, __cActual, __cRes);
    {
      __bDiagValueArrayCtr = DiagGetParameterErrorHandled(__resp, "DiagSessionType", __bDiagValueArray, elcount(__bDiagValueArray), __cDiagValueArray, elcount(__cDiagValueArray));
      {
        byte __bArray2[1] = { 0x01 };
        __bArrayCtr = __CopyBytes(__bDiagValueArray, __bDiagValueArrayCtr, __bArray);
        __bArrayCtr2 = elCount(__bArray2);
        __csr = CompareBytes(__bArray, __bArrayCtr, __bArray2, __bArrayCtr2) == 0;
        snprintf(__cArray, 8192, "%s", "Diagnostic parameter \'DiagSessionType\'");
        snprintf(__cArray2, 8192, "%s", __cArray);
        snprintf(__cArray3, 8192, "%s", "");
        ReportTableRow(__tableHandle, 0, __cArray2, "Bytes", __bArray2, __bArrayCtr2, __cArray3, __oneOfFlag, __bSetInCheckAlignment);
        ReportCell(__tableHandle, __bArray, __bArrayCtr);
        ReportCellResult(__tableHandle, __csr, __ePassFail);
      }
    
      __res = __res && __csr;
    
    }
    ReportTableEndVerdict(__tableHandle, __cEvaluateResponse, __res);
	__bVerdict = __bVerdict && __res;
  }
  if (__bVerdict == __eVerdictFail)
    TestReportWriteDiagObjectList();
}
  
void __diagServicevccmce9_232(DiagRequest * __req, DiagResponse * __resp )
{
  stack long __tableHandle;
  long __res, __paramLen, __bytePos;

   __bVerdict = __eVerdictPass;

  do {
    TestReportResetDiagObjectList();
    DiagSetReportDetailLevel("CVADAS_0001_00000000_000", EnumServiceDetails_onfail);
    // Request aspect
    {

      if (0 >= DiagSendReqAndWaitForResp("CVADAS_0001_00000000_000", __req, __resp, __res, -1, -1, -1, -1, -1, EnumResult_pos, EnumServiceDetails_onfail, EnumSendingMode_physical, EnumSuppressPosResBit_asconfigured, EnumVerdictOnInvalidValues_fail))
        break;
    }

    __res = DiagErrCodeTestStep(__res, "Can't retrieve last response for request! No check possible.") < 0;
    if(__res)
    {
	  __bVerdict = __eVerdictFail;
      break;
    }
    {
      __res = DiagInterpretAs(__resp, "DSC_PR");
      if(__res != 0)
      {
        __bVerdict = __eVerdictFail;
        DiagErrCodeTestStep(__res, "Can't interpret response as diagnostic primitive 'DSC_PR'.");
        break;
      }
      else
      {
        TestStepPass( "Received primitive can be interpreted as diagnostic primitive 'DSC_PR'.");
      }
    }
  }
  while(0);


  // Response, check & read aspect
  {
    __res = 1;
    __tableHandle = ReportTableHead5Columns(__cCheckCaption, __cTSym, __cTOp, __cRefVal, __cActual, __cRes);
    {
      __bDiagValueArrayCtr = DiagGetParameterErrorHandled(__resp, "DiagSessionType", __bDiagValueArray, elcount(__bDiagValueArray), __cDiagValueArray, elcount(__cDiagValueArray));
      {
        byte __bArray2[1] = { 0x03 };
        __bArrayCtr = __CopyBytes(__bDiagValueArray, __bDiagValueArrayCtr, __bArray);
        __bArrayCtr2 = elCount(__bArray2);
        __csr = CompareBytes(__bArray, __bArrayCtr, __bArray2, __bArrayCtr2) == 0;
        snprintf(__cArray, 8192, "%s", "Diagnostic parameter \'DiagSessionType\'");
        snprintf(__cArray2, 8192, "%s", __cArray);
        snprintf(__cArray3, 8192, "%s", "");
        ReportTableRow(__tableHandle, 0, __cArray2, "Bytes", __bArray2, __bArrayCtr2, __cArray3, __oneOfFlag, __bSetInCheckAlignment);
        ReportCell(__tableHandle, __bArray, __bArrayCtr);
        ReportCellResult(__tableHandle, __csr, __ePassFail);
      }
    
      __res = __res && __csr;
    
    }
    ReportTableEndVerdict(__tableHandle, __cEvaluateResponse, __res);
	__bVerdict = __bVerdict && __res;
  }
  if (__bVerdict == __eVerdictFail)
    TestReportWriteDiagObjectList();
}
void Ttvccmce9_Tet_Tc96_Completion()
{
  stack long __tableHandle;
  TestCompletionBegin();
  {
    {
      CreateTTEIFFunction("Ttvccmce9_General_Postconditions", __eFct, __eLocal);
      CallInterfaceFunction(__cEmpty, __cEmpty, "3d1998f6-ed4f-4d8f-9c0f-63439c24b6a7");
    }


  }
  TestCompletionEnd();
}

void Ttvccmce9_Tet_Tc97()
{
  CreateTTEIFFunction("Ttvccmce9_Tc97", __eTcDef, __eLocal);  
  AddIFParameterTestCaseAttribute("TC_ID", "18129218");
  AddIFParameterTestCaseAttribute("Test Case ID", "");
  CallInterfaceFunction("Test Case_20205066_ECU_Reset_Service_in_Default_Session", __cEmpty , __cEmpty );
}
testcase Ttvccmce9_Tc97()
{
  stack long __tableHandle;
  SetBreakOnFail(1);

  CreateTTEIFFunction("Ttvccmce9_Tet_Tc97_Completion", __eFct, __eLocal);
  
  AddIFAsCleanUpFunction();

  TestPreparationBegin();
  {
    {
      CreateTTEIFFunction("Ttvccmce9_General_Precondition", __eFct, __eLocal);
      CallInterfaceFunction(__cEmpty, __cEmpty, "b588ddda-8fe4-4271-93b3-dd1beefd9138");
    }


  }
  TestPreparationEnd();

  TestCaseDescription("$11 ECU Reset with Physical Address in Default Session");

  {
    CreateCaplIFFunction("startTesterPresent", __eTestFct);
    CallInterfaceFunction("startTesterPresent ()", __cEmpty, "1");
  }


  TestCommandBegin(__eDiagService, __cDiagService, "", "2");
  {
    if (DiagIsFunctionalGroup("CVADAS_0001_00000000_000"))
    {
      DiagResponse * __resp;
      DiagRequest CVADAS_0001_00000000_000.Default_Session_Start __req;
      __diagServicevccmce9_233(__req, __resp);
    }
    else
    {
      DiagResponse CVADAS_0001_00000000_000.* __resp;
      DiagRequest CVADAS_0001_00000000_000.Default_Session_Start __req;
      __diagServicevccmce9_233(__req, __resp);
    }
  }
  TestCommandEnd();


  {
    CreateTTEIFFunction("Ttvccmce9_F186_DID_with_PhysicalAdd_DefaultSession", __eFct, __eLocal);
    CallInterfaceFunction(__cEmpty, __cEmpty, "94cfa590-eac0-4499-adc5-5b1a2141e3ff");
  }


  {
    CreateTTEIFFunction("Ttvccmce9_Hard_Reset_with_Physical_Address", __eFct, __eLocal);
    CallInterfaceFunction(__cEmpty, __cEmpty, "3faededc-97af-4e0a-8dd6-c11f8fa26bfa");
  }


  TestCommandBegin(__eWait, __cWait, "", "5");
  {
    Wait("1", (15 * 1000000000LL), 1000000000, "");
  }
  TestCommandEnd();

  {
    CreateTTEIFFunction("Ttvccmce9_F186_DID_with_PhysicalAdd_DefaultSession", __eFct, __eLocal);
    CallInterfaceFunction(__cEmpty, __cEmpty, "94cfa590-eac0-4499-adc5-5b1a2141e3ff");
  }



}

  
void __diagServicevccmce9_233(DiagRequest * __req, DiagResponse * __resp )
{
  stack long __tableHandle;
  long __res, __paramLen, __bytePos;

   __bVerdict = __eVerdictPass;

  do {
    TestReportResetDiagObjectList();
    DiagSetReportDetailLevel("CVADAS_0001_00000000_000", EnumServiceDetails_onfail);
    // Request aspect
    {

      if (0 >= DiagSendReqAndWaitForResp("CVADAS_0001_00000000_000", __req, __resp, __res, -1, -1, -1, -1, -1, EnumResult_pos, EnumServiceDetails_onfail, EnumSendingMode_physical, EnumSuppressPosResBit_asconfigured, EnumVerdictOnInvalidValues_fail))
        break;
    }

    __res = DiagErrCodeTestStep(__res, "Can't retrieve last response for request! No check possible.") < 0;
    if(__res)
    {
	  __bVerdict = __eVerdictFail;
      break;
    }
    {
      __res = DiagInterpretAs(__resp, "DSC_PR");
      if(__res != 0)
      {
        __bVerdict = __eVerdictFail;
        DiagErrCodeTestStep(__res, "Can't interpret response as diagnostic primitive 'DSC_PR'.");
        break;
      }
      else
      {
        TestStepPass( "Received primitive can be interpreted as diagnostic primitive 'DSC_PR'.");
      }
    }
  }
  while(0);


  // Response, check & read aspect
  {
    __res = 1;
    __tableHandle = ReportTableHead5Columns(__cCheckCaption, __cTSym, __cTOp, __cRefVal, __cActual, __cRes);
    {
      __bDiagValueArrayCtr = DiagGetParameterErrorHandled(__resp, "DiagSessionType", __bDiagValueArray, elcount(__bDiagValueArray), __cDiagValueArray, elcount(__cDiagValueArray));
      {
        byte __bArray2[1] = { 0x01 };
        __bArrayCtr = __CopyBytes(__bDiagValueArray, __bDiagValueArrayCtr, __bArray);
        __bArrayCtr2 = elCount(__bArray2);
        __csr = CompareBytes(__bArray, __bArrayCtr, __bArray2, __bArrayCtr2) == 0;
        snprintf(__cArray, 8192, "%s", "Diagnostic parameter \'DiagSessionType\'");
        snprintf(__cArray2, 8192, "%s", __cArray);
        snprintf(__cArray3, 8192, "%s", "");
        ReportTableRow(__tableHandle, 0, __cArray2, "Bytes", __bArray2, __bArrayCtr2, __cArray3, __oneOfFlag, __bSetInCheckAlignment);
        ReportCell(__tableHandle, __bArray, __bArrayCtr);
        ReportCellResult(__tableHandle, __csr, __ePassFail);
      }
    
      __res = __res && __csr;
    
    }
    ReportTableEndVerdict(__tableHandle, __cEvaluateResponse, __res);
	__bVerdict = __bVerdict && __res;
  }
  if (__bVerdict == __eVerdictFail)
    TestReportWriteDiagObjectList();
}
void Ttvccmce9_Tet_Tc97_Completion()
{
  stack long __tableHandle;
  TestCompletionBegin();
  {
    {
      CreateTTEIFFunction("Ttvccmce9_General_Postconditions", __eFct, __eLocal);
      CallInterfaceFunction(__cEmpty, __cEmpty, "3d1998f6-ed4f-4d8f-9c0f-63439c24b6a7");
    }


  }
  TestCompletionEnd();
}

void Ttvccmce9_Tet_Tc98()
{
  CreateTTEIFFunction("Ttvccmce9_Tc98", __eTcDef, __eLocal);  
  AddIFParameterTestCaseAttribute("TC_ID", "18137867");
  AddIFParameterTestCaseAttribute("Test Case ID", "");
  CallInterfaceFunction("Test Case_20205046_ECU_Reset_Service_in_Default_Session_Functional_Request", __cEmpty , __cEmpty );
}
testcase Ttvccmce9_Tc98()
{
  stack long __tableHandle;
  SetBreakOnFail(1);

  CreateTTEIFFunction("Ttvccmce9_Tet_Tc98_Completion", __eFct, __eLocal);
  
  AddIFAsCleanUpFunction();

  TestPreparationBegin();
  {
    {
      CreateTTEIFFunction("Ttvccmce9_General_Precondition", __eFct, __eLocal);
      CallInterfaceFunction(__cEmpty, __cEmpty, "b588ddda-8fe4-4271-93b3-dd1beefd9138");
    }


  }
  TestPreparationEnd();

  TestCaseDescription("$11 ECU Reset with Physical Address in Default Session");

  {
    CreateCaplIFFunction("startTesterPresent", __eTestFct);
    CallInterfaceFunction("startTesterPresent ()", __cEmpty, "1");
  }


  TestCommandBegin(__eDiagService, __cDiagService, "", "2");
  {
    if (DiagIsFunctionalGroup("CVADAS_0001_00000000_000"))
    {
      DiagResponse * __resp;
      DiagRequest CVADAS_0001_00000000_000.Default_Session_Start __req;
      __diagServicevccmce9_234(__req, __resp);
    }
    else
    {
      DiagResponse CVADAS_0001_00000000_000.* __resp;
      DiagRequest CVADAS_0001_00000000_000.Default_Session_Start __req;
      __diagServicevccmce9_234(__req, __resp);
    }
  }
  TestCommandEnd();


  {
    CreateTTEIFFunction("Ttvccmce9_F186_DID_with_FunctionalAdd_DefaultSession", __eFct, __eLocal);
    CallInterfaceFunction(__cEmpty, __cEmpty, "b4633bb0-9d5e-4a82-9fab-a439769bfc4e");
  }


  {
    CreateTTEIFFunction("Ttvccmce9_Hard_Reset_with_Functional_Address", __eFct, __eLocal);
    CallInterfaceFunction(__cEmpty, __cEmpty, "059764d9-b86a-4a2a-98bb-eca8d0f20fa3");
  }


  TestCommandBegin(__eWait, __cWait, "", "5");
  {
    Wait("1", (15 * 1000000000LL), 1000000000, "");
  }
  TestCommandEnd();

  {
    CreateTTEIFFunction("Ttvccmce9_F186_DID_with_FunctionalAdd_DefaultSession", __eFct, __eLocal);
    CallInterfaceFunction(__cEmpty, __cEmpty, "b4633bb0-9d5e-4a82-9fab-a439769bfc4e");
  }



}

  
void __diagServicevccmce9_234(DiagRequest * __req, DiagResponse * __resp )
{
  stack long __tableHandle;
  long __res, __paramLen, __bytePos;

   __bVerdict = __eVerdictPass;

  do {
    TestReportResetDiagObjectList();
    DiagSetReportDetailLevel("CVADAS_0001_00000000_000", EnumServiceDetails_onfail);
    // Request aspect
    {

      if (0 >= DiagSendReqAndWaitForResp("CVADAS_0001_00000000_000", __req, __resp, __res, -1, -1, -1, -1, -1, EnumResult_pos, EnumServiceDetails_onfail, EnumSendingMode_functional, EnumSuppressPosResBit_asconfigured, EnumVerdictOnInvalidValues_fail))
        break;
    }

    __res = DiagErrCodeTestStep(__res, "Can't retrieve last response for request! No check possible.") < 0;
    if(__res)
    {
	  __bVerdict = __eVerdictFail;
      break;
    }
    {
      __res = DiagInterpretAs(__resp, "DSC_PR");
      if(__res != 0)
      {
        __bVerdict = __eVerdictFail;
        DiagErrCodeTestStep(__res, "Can't interpret response as diagnostic primitive 'DSC_PR'.");
        break;
      }
      else
      {
        TestStepPass( "Received primitive can be interpreted as diagnostic primitive 'DSC_PR'.");
      }
    }
  }
  while(0);


  // Response, check & read aspect
  {
    __res = 1;
    __tableHandle = ReportTableHead5Columns(__cCheckCaption, __cTSym, __cTOp, __cRefVal, __cActual, __cRes);
    {
      __bDiagValueArrayCtr = DiagGetParameterErrorHandled(__resp, "DiagSessionType", __bDiagValueArray, elcount(__bDiagValueArray), __cDiagValueArray, elcount(__cDiagValueArray));
      {
        byte __bArray2[1] = { 0x01 };
        __bArrayCtr = __CopyBytes(__bDiagValueArray, __bDiagValueArrayCtr, __bArray);
        __bArrayCtr2 = elCount(__bArray2);
        __csr = CompareBytes(__bArray, __bArrayCtr, __bArray2, __bArrayCtr2) == 0;
        snprintf(__cArray, 8192, "%s", "Diagnostic parameter \'DiagSessionType\'");
        snprintf(__cArray2, 8192, "%s", __cArray);
        snprintf(__cArray3, 8192, "%s", "");
        ReportTableRow(__tableHandle, 0, __cArray2, "Bytes", __bArray2, __bArrayCtr2, __cArray3, __oneOfFlag, __bSetInCheckAlignment);
        ReportCell(__tableHandle, __bArray, __bArrayCtr);
        ReportCellResult(__tableHandle, __csr, __ePassFail);
      }
    
      __res = __res && __csr;
    
    }
    ReportTableEndVerdict(__tableHandle, __cEvaluateResponse, __res);
	__bVerdict = __bVerdict && __res;
  }
  if (__bVerdict == __eVerdictFail)
    TestReportWriteDiagObjectList();
}
void Ttvccmce9_Tet_Tc98_Completion()
{
  stack long __tableHandle;
  TestCompletionBegin();
  {
    {
      CreateTTEIFFunction("Ttvccmce9_General_Postconditions", __eFct, __eLocal);
      CallInterfaceFunction(__cEmpty, __cEmpty, "3d1998f6-ed4f-4d8f-9c0f-63439c24b6a7");
    }


  }
  TestCompletionEnd();
}

void Ttvccmce9_Tet_Tc99()
{
  CreateTTEIFFunction("Ttvccmce9_Tc99", __eTcDef, __eLocal);  
  AddIFParameterTestCaseAttribute("TC_ID", "18129233");
  AddIFParameterTestCaseAttribute("Test Case ID", "");
  CallInterfaceFunction("Test Case_20205060_ECU_Reset_Service_in_Extended_Session", __cEmpty , __cEmpty );
}
testcase Ttvccmce9_Tc99()
{
  stack long __tableHandle;
  SetBreakOnFail(1);

  CreateTTEIFFunction("Ttvccmce9_Tet_Tc99_Completion", __eFct, __eLocal);
  
  AddIFAsCleanUpFunction();

  TestPreparationBegin();
  {
    {
      CreateTTEIFFunction("Ttvccmce9_General_Precondition", __eFct, __eLocal);
      CallInterfaceFunction(__cEmpty, __cEmpty, "b588ddda-8fe4-4271-93b3-dd1beefd9138");
    }


  }
  TestPreparationEnd();

  TestCaseDescription("$11 ECU Reset with Physical Address in Programming Session ");

  {
    CreateCaplIFFunction("startTesterPresent", __eTestFct);
    CallInterfaceFunction("startTesterPresent ()", __cEmpty, "1");
  }


  TestCommandBegin(__eDiagService, __cDiagService, "", "2");
  {
    if (DiagIsFunctionalGroup("CVADAS_0001_00000000_000"))
    {
      DiagResponse * __resp;
      DiagRequest CVADAS_0001_00000000_000.Default_Session_Start __req;
      __diagServicevccmce9_235(__req, __resp);
    }
    else
    {
      DiagResponse CVADAS_0001_00000000_000.* __resp;
      DiagRequest CVADAS_0001_00000000_000.Default_Session_Start __req;
      __diagServicevccmce9_235(__req, __resp);
    }
  }
  TestCommandEnd();


  TestCommandBegin(__eDiagService, __cDiagService, "", "3");
  {
    if (DiagIsFunctionalGroup("CVADAS_0001_00000000_000"))
    {
      DiagResponse * __resp;
      DiagRequest CVADAS_0001_00000000_000.Extended_Diagnostic_Session_Start __req;
      __diagServicevccmce9_236(__req, __resp);
    }
    else
    {
      DiagResponse CVADAS_0001_00000000_000.* __resp;
      DiagRequest CVADAS_0001_00000000_000.Extended_Diagnostic_Session_Start __req;
      __diagServicevccmce9_236(__req, __resp);
    }
  }
  TestCommandEnd();


  {
    CreateTTEIFFunction("Ttvccmce9_F186_DID_with_PhysicalAdd_ExtendedSession", __eFct, __eLocal);
    CallInterfaceFunction(__cEmpty, __cEmpty, "ef9ee47d-f468-4fc1-8d48-13fa51881535");
  }


  {
    CreateTTEIFFunction("Ttvccmce9_Hard_Reset_with_Physical_Address", __eFct, __eLocal);
    CallInterfaceFunction(__cEmpty, __cEmpty, "3faededc-97af-4e0a-8dd6-c11f8fa26bfa");
  }


  TestCommandBegin(__eWait, __cWait, "", "6");
  {
    Wait("1", (15 * 1000000000LL), 1000000000, "");
  }
  TestCommandEnd();

  {
    CreateTTEIFFunction("Ttvccmce9_F186_DID_with_PhysicalAdd_DefaultSession", __eFct, __eLocal);
    CallInterfaceFunction(__cEmpty, __cEmpty, "94cfa590-eac0-4499-adc5-5b1a2141e3ff");
  }



}

  
void __diagServicevccmce9_235(DiagRequest * __req, DiagResponse * __resp )
{
  stack long __tableHandle;
  long __res, __paramLen, __bytePos;

   __bVerdict = __eVerdictPass;

  do {
    TestReportResetDiagObjectList();
    DiagSetReportDetailLevel("CVADAS_0001_00000000_000", EnumServiceDetails_onfail);
    // Request aspect
    {

      if (0 >= DiagSendReqAndWaitForResp("CVADAS_0001_00000000_000", __req, __resp, __res, -1, -1, -1, -1, -1, EnumResult_pos, EnumServiceDetails_onfail, EnumSendingMode_physical, EnumSuppressPosResBit_asconfigured, EnumVerdictOnInvalidValues_fail))
        break;
    }

    __res = DiagErrCodeTestStep(__res, "Can't retrieve last response for request! No check possible.") < 0;
    if(__res)
    {
	  __bVerdict = __eVerdictFail;
      break;
    }
    {
      __res = DiagInterpretAs(__resp, "DSC_PR");
      if(__res != 0)
      {
        __bVerdict = __eVerdictFail;
        DiagErrCodeTestStep(__res, "Can't interpret response as diagnostic primitive 'DSC_PR'.");
        break;
      }
      else
      {
        TestStepPass( "Received primitive can be interpreted as diagnostic primitive 'DSC_PR'.");
      }
    }
  }
  while(0);


  // Response, check & read aspect
  {
    __res = 1;
    __tableHandle = ReportTableHead5Columns(__cCheckCaption, __cTSym, __cTOp, __cRefVal, __cActual, __cRes);
    {
      __bDiagValueArrayCtr = DiagGetParameterErrorHandled(__resp, "DiagSessionType", __bDiagValueArray, elcount(__bDiagValueArray), __cDiagValueArray, elcount(__cDiagValueArray));
      {
        byte __bArray2[1] = { 0x01 };
        __bArrayCtr = __CopyBytes(__bDiagValueArray, __bDiagValueArrayCtr, __bArray);
        __bArrayCtr2 = elCount(__bArray2);
        __csr = CompareBytes(__bArray, __bArrayCtr, __bArray2, __bArrayCtr2) == 0;
        snprintf(__cArray, 8192, "%s", "Diagnostic parameter \'DiagSessionType\'");
        snprintf(__cArray2, 8192, "%s", __cArray);
        snprintf(__cArray3, 8192, "%s", "");
        ReportTableRow(__tableHandle, 0, __cArray2, "Bytes", __bArray2, __bArrayCtr2, __cArray3, __oneOfFlag, __bSetInCheckAlignment);
        ReportCell(__tableHandle, __bArray, __bArrayCtr);
        ReportCellResult(__tableHandle, __csr, __ePassFail);
      }
    
      __res = __res && __csr;
    
    }
    ReportTableEndVerdict(__tableHandle, __cEvaluateResponse, __res);
	__bVerdict = __bVerdict && __res;
  }
  if (__bVerdict == __eVerdictFail)
    TestReportWriteDiagObjectList();
}
  
void __diagServicevccmce9_236(DiagRequest * __req, DiagResponse * __resp )
{
  stack long __tableHandle;
  long __res, __paramLen, __bytePos;

   __bVerdict = __eVerdictPass;

  do {
    TestReportResetDiagObjectList();
    DiagSetReportDetailLevel("CVADAS_0001_00000000_000", EnumServiceDetails_onfail);
    // Request aspect
    {

      if (0 >= DiagSendReqAndWaitForResp("CVADAS_0001_00000000_000", __req, __resp, __res, -1, -1, -1, -1, -1, EnumResult_pos, EnumServiceDetails_onfail, EnumSendingMode_physical, EnumSuppressPosResBit_asconfigured, EnumVerdictOnInvalidValues_fail))
        break;
    }

    __res = DiagErrCodeTestStep(__res, "Can't retrieve last response for request! No check possible.") < 0;
    if(__res)
    {
	  __bVerdict = __eVerdictFail;
      break;
    }
    {
      __res = DiagInterpretAs(__resp, "DSC_PR");
      if(__res != 0)
      {
        __bVerdict = __eVerdictFail;
        DiagErrCodeTestStep(__res, "Can't interpret response as diagnostic primitive 'DSC_PR'.");
        break;
      }
      else
      {
        TestStepPass( "Received primitive can be interpreted as diagnostic primitive 'DSC_PR'.");
      }
    }
  }
  while(0);


  // Response, check & read aspect
  {
    __res = 1;
    __tableHandle = ReportTableHead5Columns(__cCheckCaption, __cTSym, __cTOp, __cRefVal, __cActual, __cRes);
    {
      __bDiagValueArrayCtr = DiagGetParameterErrorHandled(__resp, "DiagSessionType", __bDiagValueArray, elcount(__bDiagValueArray), __cDiagValueArray, elcount(__cDiagValueArray));
      {
        byte __bArray2[1] = { 0x03 };
        __bArrayCtr = __CopyBytes(__bDiagValueArray, __bDiagValueArrayCtr, __bArray);
        __bArrayCtr2 = elCount(__bArray2);
        __csr = CompareBytes(__bArray, __bArrayCtr, __bArray2, __bArrayCtr2) == 0;
        snprintf(__cArray, 8192, "%s", "Diagnostic parameter \'DiagSessionType\'");
        snprintf(__cArray2, 8192, "%s", __cArray);
        snprintf(__cArray3, 8192, "%s", "");
        ReportTableRow(__tableHandle, 0, __cArray2, "Bytes", __bArray2, __bArrayCtr2, __cArray3, __oneOfFlag, __bSetInCheckAlignment);
        ReportCell(__tableHandle, __bArray, __bArrayCtr);
        ReportCellResult(__tableHandle, __csr, __ePassFail);
      }
    
      __res = __res && __csr;
    
    }
    ReportTableEndVerdict(__tableHandle, __cEvaluateResponse, __res);
	__bVerdict = __bVerdict && __res;
  }
  if (__bVerdict == __eVerdictFail)
    TestReportWriteDiagObjectList();
}
void Ttvccmce9_Tet_Tc99_Completion()
{
  stack long __tableHandle;
  TestCompletionBegin();
  {
    {
      CreateTTEIFFunction("Ttvccmce9_General_Postconditions", __eFct, __eLocal);
      CallInterfaceFunction(__cEmpty, __cEmpty, "3d1998f6-ed4f-4d8f-9c0f-63439c24b6a7");
    }


  }
  TestCompletionEnd();
}

void Ttvccmce9_Tet_Tc100()
{
  CreateTTEIFFunction("Ttvccmce9_Tc100", __eTcDef, __eLocal);  
  AddIFParameterTestCaseAttribute("TC_ID", "18129239");
  AddIFParameterTestCaseAttribute("Test Case ID", "");
  CallInterfaceFunction("Test Case_20205058_ECU_Reset_Service_in_Extended_Session_Functional ", __cEmpty , __cEmpty );
}
testcase Ttvccmce9_Tc100()
{
  stack long __tableHandle;
  SetBreakOnFail(1);

  CreateTTEIFFunction("Ttvccmce9_Tet_Tc100_Completion", __eFct, __eLocal);
  
  AddIFAsCleanUpFunction();

  TestPreparationBegin();
  {
    {
      CreateTTEIFFunction("Ttvccmce9_General_Precondition", __eFct, __eLocal);
      CallInterfaceFunction(__cEmpty, __cEmpty, "b588ddda-8fe4-4271-93b3-dd1beefd9138");
    }


  }
  TestPreparationEnd();

  TestCaseDescription("$11 ECU Reset with Physical Address in Programming Session ");

  {
    CreateCaplIFFunction("startTesterPresent", __eTestFct);
    CallInterfaceFunction("startTesterPresent ()", __cEmpty, "1");
  }


  TestCommandBegin(__eDiagService, __cDiagService, "", "2");
  {
    if (DiagIsFunctionalGroup("CVADAS_0001_00000000_000"))
    {
      DiagResponse * __resp;
      DiagRequest CVADAS_0001_00000000_000.Default_Session_Start __req;
      __diagServicevccmce9_237(__req, __resp);
    }
    else
    {
      DiagResponse CVADAS_0001_00000000_000.* __resp;
      DiagRequest CVADAS_0001_00000000_000.Default_Session_Start __req;
      __diagServicevccmce9_237(__req, __resp);
    }
  }
  TestCommandEnd();


  TestCommandBegin(__eDiagService, __cDiagService, "", "3");
  {
    if (DiagIsFunctionalGroup("CVADAS_0001_00000000_000"))
    {
      DiagResponse * __resp;
      DiagRequest CVADAS_0001_00000000_000.Extended_Diagnostic_Session_Start __req;
      __diagServicevccmce9_238(__req, __resp);
    }
    else
    {
      DiagResponse CVADAS_0001_00000000_000.* __resp;
      DiagRequest CVADAS_0001_00000000_000.Extended_Diagnostic_Session_Start __req;
      __diagServicevccmce9_238(__req, __resp);
    }
  }
  TestCommandEnd();


  {
    CreateTTEIFFunction("Ttvccmce9_F186_DID_with_FunctionalAdd_ExtendedSession", __eFct, __eLocal);
    CallInterfaceFunction(__cEmpty, __cEmpty, "f56c2d81-81b1-4baa-8ba7-a88ca96627fd");
  }


  {
    CreateTTEIFFunction("Ttvccmce9_Hard_Reset_with_Functional_Address", __eFct, __eLocal);
    CallInterfaceFunction(__cEmpty, __cEmpty, "059764d9-b86a-4a2a-98bb-eca8d0f20fa3");
  }


  TestCommandBegin(__eWait, __cWait, "", "6");
  {
    Wait("1", (15 * 1000000000LL), 1000000000, "");
  }
  TestCommandEnd();

  {
    CreateTTEIFFunction("Ttvccmce9_F186_DID_with_FunctionalAdd_DefaultSession", __eFct, __eLocal);
    CallInterfaceFunction(__cEmpty, __cEmpty, "b4633bb0-9d5e-4a82-9fab-a439769bfc4e");
  }



}

  
void __diagServicevccmce9_237(DiagRequest * __req, DiagResponse * __resp )
{
  stack long __tableHandle;
  long __res, __paramLen, __bytePos;

   __bVerdict = __eVerdictPass;

  do {
    TestReportResetDiagObjectList();
    DiagSetReportDetailLevel("CVADAS_0001_00000000_000", EnumServiceDetails_onfail);
    // Request aspect
    {

      if (0 >= DiagSendReqAndWaitForResp("CVADAS_0001_00000000_000", __req, __resp, __res, -1, -1, -1, -1, -1, EnumResult_pos, EnumServiceDetails_onfail, EnumSendingMode_functional, EnumSuppressPosResBit_asconfigured, EnumVerdictOnInvalidValues_fail))
        break;
    }

    __res = DiagErrCodeTestStep(__res, "Can't retrieve last response for request! No check possible.") < 0;
    if(__res)
    {
	  __bVerdict = __eVerdictFail;
      break;
    }
    {
      __res = DiagInterpretAs(__resp, "DSC_PR");
      if(__res != 0)
      {
        __bVerdict = __eVerdictFail;
        DiagErrCodeTestStep(__res, "Can't interpret response as diagnostic primitive 'DSC_PR'.");
        break;
      }
      else
      {
        TestStepPass( "Received primitive can be interpreted as diagnostic primitive 'DSC_PR'.");
      }
    }
  }
  while(0);


  // Response, check & read aspect
  {
    __res = 1;
    __tableHandle = ReportTableHead5Columns(__cCheckCaption, __cTSym, __cTOp, __cRefVal, __cActual, __cRes);
    {
      __bDiagValueArrayCtr = DiagGetParameterErrorHandled(__resp, "DiagSessionType", __bDiagValueArray, elcount(__bDiagValueArray), __cDiagValueArray, elcount(__cDiagValueArray));
      {
        byte __bArray2[1] = { 0x01 };
        __bArrayCtr = __CopyBytes(__bDiagValueArray, __bDiagValueArrayCtr, __bArray);
        __bArrayCtr2 = elCount(__bArray2);
        __csr = CompareBytes(__bArray, __bArrayCtr, __bArray2, __bArrayCtr2) == 0;
        snprintf(__cArray, 8192, "%s", "Diagnostic parameter \'DiagSessionType\'");
        snprintf(__cArray2, 8192, "%s", __cArray);
        snprintf(__cArray3, 8192, "%s", "");
        ReportTableRow(__tableHandle, 0, __cArray2, "Bytes", __bArray2, __bArrayCtr2, __cArray3, __oneOfFlag, __bSetInCheckAlignment);
        ReportCell(__tableHandle, __bArray, __bArrayCtr);
        ReportCellResult(__tableHandle, __csr, __ePassFail);
      }
    
      __res = __res && __csr;
    
    }
    ReportTableEndVerdict(__tableHandle, __cEvaluateResponse, __res);
	__bVerdict = __bVerdict && __res;
  }
  if (__bVerdict == __eVerdictFail)
    TestReportWriteDiagObjectList();
}
  
void __diagServicevccmce9_238(DiagRequest * __req, DiagResponse * __resp )
{
  stack long __tableHandle;
  long __res, __paramLen, __bytePos;

   __bVerdict = __eVerdictPass;

  do {
    TestReportResetDiagObjectList();
    DiagSetReportDetailLevel("CVADAS_0001_00000000_000", EnumServiceDetails_onfail);
    // Request aspect
    {

      if (0 >= DiagSendReqAndWaitForResp("CVADAS_0001_00000000_000", __req, __resp, __res, -1, -1, -1, -1, -1, EnumResult_pos, EnumServiceDetails_onfail, EnumSendingMode_functional, EnumSuppressPosResBit_asconfigured, EnumVerdictOnInvalidValues_fail))
        break;
    }

    __res = DiagErrCodeTestStep(__res, "Can't retrieve last response for request! No check possible.") < 0;
    if(__res)
    {
	  __bVerdict = __eVerdictFail;
      break;
    }
    {
      __res = DiagInterpretAs(__resp, "DSC_PR");
      if(__res != 0)
      {
        __bVerdict = __eVerdictFail;
        DiagErrCodeTestStep(__res, "Can't interpret response as diagnostic primitive 'DSC_PR'.");
        break;
      }
      else
      {
        TestStepPass( "Received primitive can be interpreted as diagnostic primitive 'DSC_PR'.");
      }
    }
  }
  while(0);


  // Response, check & read aspect
  {
    __res = 1;
    __tableHandle = ReportTableHead5Columns(__cCheckCaption, __cTSym, __cTOp, __cRefVal, __cActual, __cRes);
    {
      __bDiagValueArrayCtr = DiagGetParameterErrorHandled(__resp, "DiagSessionType", __bDiagValueArray, elcount(__bDiagValueArray), __cDiagValueArray, elcount(__cDiagValueArray));
      {
        byte __bArray2[1] = { 0x03 };
        __bArrayCtr = __CopyBytes(__bDiagValueArray, __bDiagValueArrayCtr, __bArray);
        __bArrayCtr2 = elCount(__bArray2);
        __csr = CompareBytes(__bArray, __bArrayCtr, __bArray2, __bArrayCtr2) == 0;
        snprintf(__cArray, 8192, "%s", "Diagnostic parameter \'DiagSessionType\'");
        snprintf(__cArray2, 8192, "%s", __cArray);
        snprintf(__cArray3, 8192, "%s", "");
        ReportTableRow(__tableHandle, 0, __cArray2, "Bytes", __bArray2, __bArrayCtr2, __cArray3, __oneOfFlag, __bSetInCheckAlignment);
        ReportCell(__tableHandle, __bArray, __bArrayCtr);
        ReportCellResult(__tableHandle, __csr, __ePassFail);
      }
    
      __res = __res && __csr;
    
    }
    ReportTableEndVerdict(__tableHandle, __cEvaluateResponse, __res);
	__bVerdict = __bVerdict && __res;
  }
  if (__bVerdict == __eVerdictFail)
    TestReportWriteDiagObjectList();
}
void Ttvccmce9_Tet_Tc100_Completion()
{
  stack long __tableHandle;
  TestCompletionBegin();
  {
    {
      CreateTTEIFFunction("Ttvccmce9_General_Postconditions", __eFct, __eLocal);
      CallInterfaceFunction(__cEmpty, __cEmpty, "3d1998f6-ed4f-4d8f-9c0f-63439c24b6a7");
    }


  }
  TestCompletionEnd();
}

void Ttvccmce9_Tet_Tc101()
{
  CreateTTEIFFunction("Ttvccmce9_Tc101", __eTcDef, __eLocal);  
  AddIFParameterTestCaseAttribute("TC_ID", "17003096");
  AddIFParameterTestCaseAttribute("Test Case ID", "");
  CallInterfaceFunction("TC_ID_20205343", __cEmpty , __cEmpty );
}
testcase Ttvccmce9_Tc101()
{
  stack long __tableHandle;
  SetBreakOnFail(0);

  CreateTTEIFFunction("Ttvccmce9_Tet_Tc101_Completion", __eFct, __eLocal);
  
  AddIFAsCleanUpFunction();

  TestPreparationBegin();
  {
    {
      CreateTTEIFFunction("Ttvccmce9_General_Precondition", __eFct, __eLocal);
      CallInterfaceFunction(__cEmpty, __cEmpty, "b588ddda-8fe4-4271-93b3-dd1beefd9138");
    }


  }
  TestPreparationEnd();

  {
    CreateCaplIFFunction("CAN_communication_Start", __eFct);
    CallInterfaceFunction(__cEmpty, __cEmpty, "1");
  }


  {
    CreateCaplIFFunction("CAN_communication_Stop", __eFct);
    CallInterfaceFunction(__cEmpty, __cEmpty, "2");
  }


  {
    CreateCaplIFFunction("Check_Both_Can_Messages", __eFct);
    CallInterfaceFunction(__cEmpty, __cEmpty, "3");
  }



}

void Ttvccmce9_Tet_Tc101_Completion()
{
  stack long __tableHandle;
  TestCompletionBegin();
  {
    {
      CreateTTEIFFunction("Ttvccmce9_General_Postconditions", __eFct, __eLocal);
      CallInterfaceFunction(__cEmpty, __cEmpty, "3d1998f6-ed4f-4d8f-9c0f-63439c24b6a7");
    }


  }
  TestCompletionEnd();
}

void Ttvccmce9_Tet_Tc102()
{
  CreateTTEIFFunction("Ttvccmce9_Tc102", __eTcDef, __eLocal);  
  AddIFParameterTestCaseAttribute("TC_ID", "17003120");
  AddIFParameterTestCaseAttribute("Test Case ID", "");
  CallInterfaceFunction("TC_ID_20205360", __cEmpty , __cEmpty );
}
testcase Ttvccmce9_Tc102()
{
  stack long __tableHandle;
  SetBreakOnFail(0);

  CreateTTEIFFunction("Ttvccmce9_Tet_Tc102_Completion", __eFct, __eLocal);
  
  AddIFAsCleanUpFunction();

  TestPreparationBegin();
  {
    {
      CreateTTEIFFunction("Ttvccmce9_General_Precondition", __eFct, __eLocal);
      CallInterfaceFunction(__cEmpty, __cEmpty, "b588ddda-8fe4-4271-93b3-dd1beefd9138");
    }


  }
  TestPreparationEnd();

  {
    CreateCaplIFFunction("CAN_communication_Start", __eFct);
    CallInterfaceFunction(__cEmpty, __cEmpty, "1");
  }


  {
    CreateCaplIFFunction("CAN_communication_Stop", __eFct);
    CallInterfaceFunction(__cEmpty, __cEmpty, "2");
  }


  {
    CreateCaplIFFunction("Check_Both_Can_Messages", __eFct);
    CallInterfaceFunction(__cEmpty, __cEmpty, "3");
  }



}

void Ttvccmce9_Tet_Tc102_Completion()
{
  stack long __tableHandle;
  TestCompletionBegin();
  {
    {
      CreateTTEIFFunction("Ttvccmce9_General_Postconditions", __eFct, __eLocal);
      CallInterfaceFunction(__cEmpty, __cEmpty, "3d1998f6-ed4f-4d8f-9c0f-63439c24b6a7");
    }


  }
  TestCompletionEnd();
}

void Ttvccmce9_Tet_Tc103()
{
  CreateTTEIFFunction("Ttvccmce9_Tc103", __eTcDef, __eLocal);  
  AddIFParameterTestCaseAttribute("TC_ID", "");
  AddIFParameterTestCaseAttribute("Test Case ID", "");
  CallInterfaceFunction("TC_ID_20205368", __cEmpty , __cEmpty );
}
testcase Ttvccmce9_Tc103()
{
  stack long __tableHandle;
  SetBreakOnFail(0);

  CreateTTEIFFunction("Ttvccmce9_Tet_Tc103_Completion", __eFct, __eLocal);
  
  AddIFAsCleanUpFunction();

  TestPreparationBegin();
  {
    {
      CreateTTEIFFunction("Ttvccmce9_General_Precondition", __eFct, __eLocal);
      CallInterfaceFunction(__cEmpty, __cEmpty, "b588ddda-8fe4-4271-93b3-dd1beefd9138");
    }


  }
  TestPreparationEnd();

  {
    CreateCaplIFFunction("Power_Cycle", __eFct);
    AddIFParameterLong(7000);
    CallInterfaceFunction(__cEmpty, __cEmpty, "1");
  }


  TestCommandBegin(__eWait, __cWait, "", "2");
  {
    Wait("1", (2000 * 1000000LL), 1000000, "");
  }
  TestCommandEnd();

  TestCommandBegin(__eWait, __cWait, "", "3");
  {
    Wait("1", (250 * 1000000LL), 1000000, "");
  }
  TestCommandEnd();

  {
    CreateCaplIFFunction("Check_Both_Can_Messages", __eFct);
    CallInterfaceFunction(__cEmpty, __cEmpty, "4");
  }


  TestCommandBegin(__eWait, __cWait, "", "5");
  {
    Wait("1", (500 * 1000000LL), 1000000, "");
  }
  TestCommandEnd();


}

void Ttvccmce9_Tet_Tc103_Completion()
{
  stack long __tableHandle;
  TestCompletionBegin();
  {
    {
      CreateTTEIFFunction("Ttvccmce9_General_Postconditions", __eFct, __eLocal);
      CallInterfaceFunction(__cEmpty, __cEmpty, "3d1998f6-ed4f-4d8f-9c0f-63439c24b6a7");
    }


  }
  TestCompletionEnd();
}

void Ttvccmce9_Tet_Tc104()
{
  CreateTTEIFFunction("Ttvccmce9_Tc104", __eTcDef, __eLocal);  
  AddIFParameterTestCaseAttribute("TC_ID", "17003096");
  AddIFParameterTestCaseAttribute("Test Case ID", "");
  CallInterfaceFunction("TC_ID_20211987", __cEmpty , __cEmpty );
}
testcase Ttvccmce9_Tc104()
{
  stack long __tableHandle;
  SetBreakOnFail(0);

  CreateTTEIFFunction("Ttvccmce9_Tet_Tc104_Completion", __eFct, __eLocal);
  
  AddIFAsCleanUpFunction();

  TestPreparationBegin();
  {
    {
      CreateTTEIFFunction("Ttvccmce9_General_Precondition", __eFct, __eLocal);
      CallInterfaceFunction(__cEmpty, __cEmpty, "b588ddda-8fe4-4271-93b3-dd1beefd9138");
    }


  }
  TestPreparationEnd();

  TestCommandBegin(__eWait, __cWait, "", "1");
  {
    Wait("1", (1000 * 1000000LL), 1000000, "");
  }
  TestCommandEnd();

  {
    CreateCaplIFFunction("RX_Messages_Cycletimecheck", __eFct);
    CallInterfaceFunction(__cEmpty, __cEmpty, "2");
  }



}

void Ttvccmce9_Tet_Tc104_Completion()
{
  stack long __tableHandle;
  TestCompletionBegin();
  {
    {
      CreateTTEIFFunction("Ttvccmce9_General_Postconditions", __eFct, __eLocal);
      CallInterfaceFunction(__cEmpty, __cEmpty, "3d1998f6-ed4f-4d8f-9c0f-63439c24b6a7");
    }


  }
  TestCompletionEnd();
}

void Ttvccmce9_Tet_Tc105()
{
  CreateTTEIFFunction("Ttvccmce9_Tc105", __eTcDef, __eLocal);  
  AddIFParameterTestCaseAttribute("TC_ID", "");
  AddIFParameterTestCaseAttribute("Test Case ID", "");
  CallInterfaceFunction("NVMReset", __cEmpty , __cEmpty );
}
testcase Ttvccmce9_Tc105()
{
  stack long __tableHandle;
  SetBreakOnFail(0);

  TestCommandBegin(__eDiagService, __cDiagService, "", "0");
  {
    if (DiagIsFunctionalGroup("CVADAS_0001_00000000_000"))
    {
      DiagResponse * __resp;
      DiagRequest CVADAS_0001_00000000_000.Extended_Diagnostic_Session_Start __req;
      __diagServicevccmce9_239(__req, __resp);
    }
    else
    {
      DiagResponse CVADAS_0001_00000000_000.* __resp;
      DiagRequest CVADAS_0001_00000000_000.Extended_Diagnostic_Session_Start __req;
      __diagServicevccmce9_239(__req, __resp);
    }
  }
  TestCommandEnd();


  TestCommandBegin(__eWait, __cWait, "", "1");
  {
    Wait("1", (1000 * 1000000LL), 1000000, "");
  }
  TestCommandEnd();

  TestCommandBegin(__eDiagService, __cDiagService, "", "2");
  {
    if (DiagIsFunctionalGroup("CVADAS_0001_00000000_000"))
    {
      DiagResponse * __resp;
      DiagRequest CVADAS_0001_00000000_000._2EFD4E_Reset_NVM_Write __req;
      __diagServicevccmce9_240(__req, __resp);
    }
    else
    {
      DiagResponse CVADAS_0001_00000000_000.* __resp;
      DiagRequest CVADAS_0001_00000000_000._2EFD4E_Reset_NVM_Write __req;
      __diagServicevccmce9_240(__req, __resp);
    }
  }
  TestCommandEnd();


  TestCommandBegin(__eWait, __cWait, "", "3");
  {
    Wait("1", (35000 * 1000000LL), 1000000, "");
  }
  TestCommandEnd();

  {
    CreateCaplIFFunction("Hard_Reset", __eFct);
    CallInterfaceFunction(__cEmpty, __cEmpty, "4");
  }


}

  
void __diagServicevccmce9_239(DiagRequest * __req, DiagResponse * __resp )
{
  stack long __tableHandle;
  long __res, __paramLen, __bytePos;

   __bVerdict = __eVerdictPass;

  do {
    TestReportResetDiagObjectList();
    DiagSetReportDetailLevel("CVADAS_0001_00000000_000", EnumServiceDetails_onfail);
    // Request aspect
    {

      if (0 >= DiagSendReqAndWaitForResp("CVADAS_0001_00000000_000", __req, __resp, __res, -1, -1, -1, -1, -1, EnumResult_pos, EnumServiceDetails_onfail, EnumSendingMode_physical, EnumSuppressPosResBit_asconfigured, EnumVerdictOnInvalidValues_fail))
        break;
    }

    __res = DiagErrCodeTestStep(__res, "Can't retrieve last response for request! No check possible.") < 0;
    if(__res)
    {
	  __bVerdict = __eVerdictFail;
      break;
    }
    {
      __res = DiagInterpretAs(__resp, "DSC_PR");
      if(__res != 0)
      {
        __bVerdict = __eVerdictFail;
        DiagErrCodeTestStep(__res, "Can't interpret response as diagnostic primitive 'DSC_PR'.");
        break;
      }
      else
      {
        TestStepPass( "Received primitive can be interpreted as diagnostic primitive 'DSC_PR'.");
      }
    }
  }
  while(0);


  // Response, check & read aspect
  {
    __res = 1;
    __tableHandle = ReportTableHead5Columns(__cCheckCaption, __cTSym, __cTOp, __cRefVal, __cActual, __cRes);
    {
      double __nDiagValue;
      DiagGetParameterErrorHandled(__resp, "DiagSessionType", __nDiagValue);
      __csr = CheckSignalMatch(__nDiagValue, 03, "==") == 1;
      snprintf(__cArray, 8192, "%s", "Diagnostic parameter \'DiagSessionType\'");
      snprintf(__cArray2, 8192, "%s", __cArray);
      snprintf(__cArray3, 8192, "%s", "");
      ReportTableRow(__tableHandle, 0, __cArray2, "==", 03, __cArray3, __oneOfFlag, __bSetInCheckAlignment);
      ReportCell(__tableHandle, __nDiagValue);
      ReportCellResult(__tableHandle, __csr, __ePassFail);
    
      __res = __res && __csr;
    
    }
    ReportTableEndVerdict(__tableHandle, __cEvaluateResponse, __res);
	__bVerdict = __bVerdict && __res;
  }
  if (__bVerdict == __eVerdictFail)
    TestReportWriteDiagObjectList();
}
  
void __diagServicevccmce9_240(DiagRequest * __req, DiagResponse * __resp )
{
  stack long __tableHandle;
  long __res, __paramLen, __bytePos;

   __bVerdict = __eVerdictPass;

  do {
    TestReportResetDiagObjectList();
    DiagSetReportDetailLevel("CVADAS_0001_00000000_000", EnumServiceDetails_onfail);
    // Request aspect
    {

      if (0 >= DiagSendReqAndWaitForResp("CVADAS_0001_00000000_000", __req, __resp, __res, -1, -1, -1, -1, -1, EnumResult_pos, EnumServiceDetails_onfail, EnumSendingMode_physical, EnumSuppressPosResBit_asconfigured, EnumVerdictOnInvalidValues_fail))
        break;
    }

    __res = DiagErrCodeTestStep(__res, "Can't retrieve last response for request! No check possible.") < 0;
    if(__res)
    {
	  __bVerdict = __eVerdictFail;
      break;
    }
    {
      __res = DiagInterpretAs(__resp, "WDBI_PR");
      if(__res != 0)
      {
        __bVerdict = __eVerdictFail;
        DiagErrCodeTestStep(__res, "Can't interpret response as diagnostic primitive 'WDBI_PR'.");
        break;
      }
      else
      {
        TestStepPass( "Received primitive can be interpreted as diagnostic primitive 'WDBI_PR'.");
      }
    }
  }
  while(0);


  if (__bVerdict == __eVerdictFail)
    TestReportWriteDiagObjectList();
}

void Ttvccmce9_Tet_TsCall14()
{
  stack long __tableHandle;
  CreateTTEIFFunction("Ttvccmce9_EOL_Calibration", __eTsDef, __eLocal);
  CallInterfaceFunction(__cEmpty , __cEmpty, __cEmpty );
}

void Ttvccmce9_Tet_Tc106()
{
  CreateTTEIFFunction("Ttvccmce9_Tc106", __eTcDef, __eLocal);  
  AddIFParameterTestCaseAttribute("TC_ID", "");
  AddIFParameterTestCaseAttribute("Test Case ID", "");
  CallInterfaceFunction("265412_DTC_Test", __cEmpty , __cEmpty );
}
testcase Ttvccmce9_Tc106()
{
  stack long __tableHandle;
  SetBreakOnFail(0);

  CreateTTEIFFunction("Ttvccmce9_Tet_Tc106_Completion", __eFct, __eLocal);
  
  AddIFAsCleanUpFunction();

  TestPreparationBegin();
  {
    {
      CreateTTEIFFunction("Ttvccmce9_General_Precondition", __eFct, __eLocal);
      CallInterfaceFunction(__cEmpty, __cEmpty, "b588ddda-8fe4-4271-93b3-dd1beefd9138");
    }


    TestCommandBegin(__eWait, __cWait, "", "1");
    {
      Wait("1", (1000 * 1000000LL), 1000000, "");
    }
    TestCommandEnd();

  }
  TestPreparationEnd();

  TestCommandBegin(__eWait, __cWait, "", "2");
  {
    Wait("1", (1000 * 1000000LL), 1000000, "");
  }
  TestCommandEnd();

  {
    CreateCaplIFFunction("Check_DTC", __eFct);
    CallInterfaceFunction(__cEmpty, __cEmpty, "3");
  }


  TestCommandBegin(__eWait, __cWait, "", "4");
  {
    Wait("1", (1000 * 1000000LL), 1000000, "");
  }
  TestCommandEnd();


}

void Ttvccmce9_Tet_Tc106_Completion()
{
  stack long __tableHandle;
  TestCompletionBegin();
  {
    {
      CreateTTEIFFunction("Ttvccmce9_General_Postconditions", __eFct, __eLocal);
      CallInterfaceFunction(__cEmpty, __cEmpty, "3d1998f6-ed4f-4d8f-9c0f-63439c24b6a7");
    }


  }
  TestCompletionEnd();
}

void Ttvccmce9_Tet_CaplTcCall12()
{
  stack long __tableHandle;
  CreateCaplIFFunction("MCU1_0", __eTcDef);
  AddIFParameterTestCaseAttribute("TC_ID", "");
  AddIFParameterTestCaseAttribute("Test Case ID", "");
  AddIFParameterInt(1);
  CallInterfaceFunction(__cEmpty , "", __cEmpty );
}

void Ttvccmce9_Tet_CaplTcCall13()
{
  stack long __tableHandle;
  CreateCaplIFFunction("CPU_load_A72", __eTcDef);
  AddIFParameterTestCaseAttribute("TC_ID", "");
  AddIFParameterTestCaseAttribute("Test Case ID", "");
  AddIFParameterInt(1);
  CallInterfaceFunction(__cEmpty , "", __cEmpty );
}

void Ttvccmce9_Tet_CaplTcCall14()
{
  stack long __tableHandle;
  CreateCaplIFFunction("CPU_Load_Test_MCU2_0", __eTcDef);
  AddIFParameterTestCaseAttribute("TC_ID", "");
  AddIFParameterTestCaseAttribute("Test Case ID", "");
  AddIFParameterInt(1);
  CallInterfaceFunction(__cEmpty , "", __cEmpty );
}

void Ttvccmce9_Tet_CaplTcCall15()
{
  stack long __tableHandle;
  CreateCaplIFFunction("CPU_Load_Test_MCU2_1", __eTcDef);
  AddIFParameterTestCaseAttribute("TC_ID", "");
  AddIFParameterTestCaseAttribute("Test Case ID", "");
  AddIFParameterInt(1);
  CallInterfaceFunction(__cEmpty , "", __cEmpty );
}

