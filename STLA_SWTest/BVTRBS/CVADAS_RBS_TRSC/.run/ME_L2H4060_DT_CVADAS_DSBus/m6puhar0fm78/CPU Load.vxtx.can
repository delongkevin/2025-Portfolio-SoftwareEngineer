/* !Encoding: 65001  */
includes
{
  #include "__VariablesLib.cin"
  #include "__CaplGeneratorLib.cin"
  #include "__CANoeReportFuntionsLib.cin"
}

variables
{
  // Global variables defined within this CAPL file
}

void Tt785qh4u_CPU_Load_MCU2_0()
{
  stack long __tableHandle;
  TestCommandBegin(__eCANoeStandardService, __cCANoeStandardService, "testValidateSystemCall", "0");
  {
    snprintf(__cArray3, 8192, "%s", "PythonPath");
    snprintf(__cArray4, 8192, "\"%s\"", "pythonw CPU_Load_MCU2_0.py");
    snprintf(__cArray5, 8192, "%s", "600000");
    testStep(2, __cEmpty, "Execute testValidateSystemCall(%s, %s, %s)", __cArray3, __cArray4, __cArray5);
  
    CheckPlainParameterGetStringBufferConsistency(syspar::`PythonPath,"syspar::`PythonPath", 8192);
    snprintf(__cArray3, 8192, "%s", syspar::`PythonPath);
    CheckLiteralGetStringBufferConsistency("pythonw CPU_Load_MCU2_0.py", 8192);
    snprintf(__cArray4, 8192, "%s", "pythonw CPU_Load_MCU2_0.py");
    testValidateSystemCall(__cArray3, __cArray4, 600000);
  
  }
  TestCommandEnd();


}

void Tt785qh4u_CPU_Load_MCU2_1()
{
  stack long __tableHandle;
  TestCommandBegin(__eCANoeStandardService, __cCANoeStandardService, "testValidateSystemCall", "0");
  {
    snprintf(__cArray3, 8192, "%s", "PythonPath");
    snprintf(__cArray4, 8192, "\"%s\"", "pythonw CPU_Load_MCU2_1.py");
    snprintf(__cArray5, 8192, "%s", "600000");
    testStep(2, __cEmpty, "Execute testValidateSystemCall(%s, %s, %s)", __cArray3, __cArray4, __cArray5);
  
    CheckPlainParameterGetStringBufferConsistency(syspar::`PythonPath,"syspar::`PythonPath", 8192);
    snprintf(__cArray3, 8192, "%s", syspar::`PythonPath);
    CheckLiteralGetStringBufferConsistency("pythonw CPU_Load_MCU2_1.py", 8192);
    snprintf(__cArray4, 8192, "%s", "pythonw CPU_Load_MCU2_1.py");
    testValidateSystemCall(__cArray3, __cArray4, 600000);
  
  }
  TestCommandEnd();


}

void Tt785qh4u_CPU_Load_A72()
{
  stack long __tableHandle;
  TestCommandBegin(__eCANoeStandardService, __cCANoeStandardService, "testValidateSystemCall", "0");
  {
    snprintf(__cArray3, 8192, "%s", "PythonPath");
    snprintf(__cArray4, 8192, "\"%s\"", "pythonw CPU_Load_A72.py");
    snprintf(__cArray5, 8192, "%s", "600000");
    testStep(2, __cEmpty, "Execute testValidateSystemCall(%s, %s, %s)", __cArray3, __cArray4, __cArray5);
  
    CheckPlainParameterGetStringBufferConsistency(syspar::`PythonPath,"syspar::`PythonPath", 8192);
    snprintf(__cArray3, 8192, "%s", syspar::`PythonPath);
    CheckLiteralGetStringBufferConsistency("pythonw CPU_Load_A72.py", 8192);
    snprintf(__cArray4, 8192, "%s", "pythonw CPU_Load_A72.py");
    testValidateSystemCall(__cArray3, __cArray4, 600000);
  
  }
  TestCommandEnd();


}

void Tt785qh4u_SecureUnlock()
{
  stack long __tableHandle;
  TestCommandBegin(__eCANoeStandardService, __cCANoeStandardService, "testValidateSystemCall", "0");
  {
    snprintf(__cArray3, 8192, "%s", "PythonPath");
    snprintf(__cArray4, 8192, "\"%s\"", "pythonw SecureUnlock.py");
    snprintf(__cArray5, 8192, "%s", "600000");
    testStep(2, __cEmpty, "Execute testValidateSystemCall(%s, %s, %s)", __cArray3, __cArray4, __cArray5);
  
    CheckPlainParameterGetStringBufferConsistency(syspar::`PythonPath,"syspar::`PythonPath", 8192);
    snprintf(__cArray3, 8192, "%s", syspar::`PythonPath);
    CheckLiteralGetStringBufferConsistency("pythonw SecureUnlock.py", 8192);
    snprintf(__cArray4, 8192, "%s", "pythonw SecureUnlock.py");
    testValidateSystemCall(__cArray3, __cArray4, 600000);
  
  }
  TestCommandEnd();


}

void Tt785qh4u_Tet_TtInit()
{
  stack long __tableHandle;
}

void Tt785qh4u_Tet_CaplTcCall0()
{
  stack long __tableHandle;
  CreateCaplIFFunction("MCU1_0", __eTcDef);
  AddIFParameterTestCaseAttribute("TC_ID", "");
  AddIFParameterTestCaseAttribute("Test Case ID", "");
  CallInterfaceFunction(__cEmpty , "", __cEmpty );
}

void Tt785qh4u_Tet_Tc0()
{
  CreateTTEIFFunction("Tt785qh4u_Tc0", __eTcDef, __eLocal);  
  AddIFParameterTestCaseAttribute("TC_ID", "");
  AddIFParameterTestCaseAttribute("Test Case ID", "");
  CallInterfaceFunction("MCU2_0", __cEmpty , __cEmpty );
}
testcase Tt785qh4u_Tc0()
{
  stack long __tableHandle;
  SetBreakOnFail(0);

  {
    CreateTTEIFFunction("Tt785qh4u_SecureUnlock", __eFct, __eLocal);
    CallInterfaceFunction(__cEmpty, __cEmpty, "1098edc7-512a-4121-aa50-b8e475597a18");
  }


  TestCommandBegin(__eWait, __cWait, "", "1");
  {
    Wait("1", (syspar::`sleep * 1000000000LL), 1000000000, "sleep");
  }
  TestCommandEnd();

  {
    CreateTTEIFFunction("Tt785qh4u_CPU_Load_MCU2_0", __eFct, __eLocal);
    CallInterfaceFunction(__cEmpty, __cEmpty, "5291f33b-731d-46be-b783-55b6604f7e07");
  }


  {
    CreateCaplIFFunction("Hard_Reset", __eFct);
    CallInterfaceFunction(__cEmpty, __cEmpty, "3");
  }


  TestCommandBegin(__eWait, __cWait, "", "4");
  {
    Wait("1", (syspar::`after_hardreset_sleep * 1000000000LL), 1000000000, "after_hardreset_sleep");
  }
  TestCommandEnd();

}

void Tt785qh4u_Tet_Tc1()
{
  CreateTTEIFFunction("Tt785qh4u_Tc1", __eTcDef, __eLocal);  
  AddIFParameterTestCaseAttribute("TC_ID", "");
  AddIFParameterTestCaseAttribute("Test Case ID", "");
  CallInterfaceFunction("MCU2_1", __cEmpty , __cEmpty );
}
testcase Tt785qh4u_Tc1()
{
  stack long __tableHandle;
  SetBreakOnFail(0);

  {
    CreateTTEIFFunction("Tt785qh4u_SecureUnlock", __eFct, __eLocal);
    CallInterfaceFunction(__cEmpty, __cEmpty, "1098edc7-512a-4121-aa50-b8e475597a18");
  }


  TestCommandBegin(__eWait, __cWait, "", "1");
  {
    Wait("1", (syspar::`sleep * 1000000000LL), 1000000000, "sleep");
  }
  TestCommandEnd();

  {
    CreateTTEIFFunction("Tt785qh4u_CPU_Load_MCU2_1", __eFct, __eLocal);
    CallInterfaceFunction(__cEmpty, __cEmpty, "11b8b59c-04ce-4947-934a-a497a849e97f");
  }


  {
    CreateCaplIFFunction("Hard_Reset", __eFct);
    CallInterfaceFunction(__cEmpty, __cEmpty, "3");
  }


  TestCommandBegin(__eWait, __cWait, "", "4");
  {
    Wait("1", (syspar::`after_hardreset_sleep * 1000000000LL), 1000000000, "after_hardreset_sleep");
  }
  TestCommandEnd();

}

void Tt785qh4u_Tet_Tc2()
{
  CreateTTEIFFunction("Tt785qh4u_Tc2", __eTcDef, __eLocal);  
  AddIFParameterTestCaseAttribute("TC_ID", "");
  AddIFParameterTestCaseAttribute("Test Case ID", "");
  CallInterfaceFunction("A72", __cEmpty , __cEmpty );
}
testcase Tt785qh4u_Tc2()
{
  stack long __tableHandle;
  SetBreakOnFail(0);

  TestCommandBegin(__eWait, __cWait, "", "0");
  {
    Wait("1", (syspar::`sleep * 1000000000LL), 1000000000, "sleep");
  }
  TestCommandEnd();

  {
    CreateTTEIFFunction("Tt785qh4u_CPU_Load_A72", __eFct, __eLocal);
    CallInterfaceFunction(__cEmpty, __cEmpty, "c5b3f89a-5dd1-415a-8735-8e3a39fbd53e");
  }


  {
    CreateCaplIFFunction("Hard_Reset", __eFct);
    CallInterfaceFunction(__cEmpty, __cEmpty, "2");
  }


  TestCommandBegin(__eWait, __cWait, "", "3");
  {
    Wait("1", (syspar::`after_hardreset_sleep * 1000000000LL), 1000000000, "after_hardreset_sleep");
  }
  TestCommandEnd();

}

