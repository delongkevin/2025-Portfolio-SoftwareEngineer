/*@!Encoding:65001*/
includes
{

}

variables
{
  char pythonFolder[500] = "";
  char viewName[16][30] = {"Default", "FVTV_RVTV", "BackupRearView", "FFCV", "Idle", "TRG", "TrailerLeftTowView", "TrailerRightTowView", "BlindSpotLeftView", "BlindSpotRightView", "Idle", "FVTV", "RVTV", "FrontCrossPathView", "RearCrossPathView", "Idle"};
  char ecuName[100] = "CVADAS_0001_00000000_000";
  mstimer t;
  long timeOut = 1;
  long canChannel = 0;
  float timeStart;
  float spentTime;
  float TTFFDCAN2 = 0;
  float TTFFDCAN14 = 0;
  float timeSinceLastFDCAN2;
  float timeSinceLastFDCAN14;
  float lastCANSleep;
  float timeForFDCAN2Wake = 1;
  float timeForFDCAN14Wake = 1;
  long reverseOnWake = 0;
  double fileHandle;
  int fileOpen = 0;
  dword measurementStartTime;
  double didLogFile;
  int logFileReady = 0;
  dword logFile;
}  


export testcase FDF6_Runtimestats()
{
diagRequest CVADAS_0001_00000000_000._22FDF6_RunTimeStatsData_Read req;
diagResponse CVADAS_0001_00000000_000._22FDF6_RunTimeStatsData_Read resp;

dword responseDataLength;
byte rawResponseData[4096]; // Use a large enough buffer for extended responses
dword i;
dword logFileHandle;
char filePath[500] = "RunTimeStats_FDF6.txt";
char logString[500];
  
diagSendRequest(req);
testWaitForDiagResponse(req, 10000);
logFileHandle = openFileWrite(filePath, 0);

  if (diagIsPositiveResponse(resp))
  {
    // Get the length and fill the buffer with the raw response data
    responseDataLength = elCount(rawResponseData);
    if (diagGetPrimitiveData(resp, rawResponseData, responseDataLength) == 0)
    {
      snprintf(logString, elcount(logString), "%s: Positive response for DID. Raw data:", timeNow());
      filePutString(logString, strlen(logString), logFileHandle);
      write ("%s", logString);
      
      // Print all bytes of the response
      for (i = 0; i < responseDataLength; i++)
      {
        snprintf(logString, elcount(logString), " %02X", rawResponseData[i]);
        filePutString(logString,strlen(logString), logFileHandle);
        write ("%s", logString);
      }
      filePutString("\n",5, logFileHandle); // Add newline
    }
  }
  else
  {
    // Log negative response
    snprintf(logString, elcount(logString), "%s: Negative response received. Error code: 0x%X\n", timeNow(), diagGetResponseCode(resp));
    filePutString(logString,strlen(logString), logFileHandle);
  }
  
  fileClose(logFileHandle);
}

export void General_Precondition()
{
  long response;
  Enable_CAN_Communication();
  diagStopTesterPresent();
  diagStopTesterPresent();
  
  testStep("","Set TGW_CAMERA_DISP_STAT = 4 (Surround View configuration)");
  setSignal(TGW_CAMERA_DISP_STAT,4);
  $TGW_CAMERA_DISP_STAT == 4;
  
  testStep("", "Wait for 7000 ms");
  testWaitForTimeout(7000);
  
  testStep("", "Set view to default");
  $CameraDisplaySts2 = 0;
  
}

export testcase HMI_View_Robustness(int gear, int angle, int ignition)
{
  long response, i;
  General_Precondition();
  $TargetGear=ignition;
  $CmdIgnSts=ignition;
  $ShiftLeverPosition = gear; 
  //$LwsAngle_SCCM = angle;
  $SVC_Guidelines=1;
  $Fwrd_Cam_Guidelines=1;
  testStep("","Gear is set to: %d", gear);
  testStep("","Ignition set to: %d", ignition);
  testStep("","Steering Angle is set to: %d",angle);
  for(i = 1; i <= 15; i++)
  {
    $CameraDisplaySts2 = i;
    response = testWaitForSyscall("","python CaptureImage.pyw",1,8000); // default directory root of canoe rbs,  run python script to capture image, timeout is 8 seconds. exit code is 1 from python script.
    if (response != 1)
    {
      testStepFail("","Failed to capture from image grabber!");
    }
    else
    {
      testStepPass("Successfully captured Image from image grabber!");
    }
    Check_Both_Can_Messages();
  }
  General_Postcondition();
}

export void General_Postcondition()
{
  long response;
  testStep("", "Set view to default");
  $CameraDisplaySts2 = 2;
  
}

export testcase HMI_Robustness_Proxi(char proxi[])
{
  long response;
  response = Write_Proxi(proxi);
  if (response != 1)
  {
    testStepFail("","Proxy was not written!");
  }
  else{
    testStepPass("","Proxy was written successfully!");
  }
}

void MainTest ()
{

}

export Power_Supply_SET(double volt)
{
  char voltInString[3] = "";
  char fullMessage[10] = "";
  int voltInInt;
  int temp;
  int i = 0;

  volt *= 10;
  voltInInt = volt;
  
  for(i = 2; i >= 0; i--)
  {
    temp = voltInInt % 10;
    voltInString[i] = temp + '0';
    voltInInt /= 10;
  
  }
  
  strncpy(fullMessage, "VOLT", 5);
  strncat(fullMessage, voltInString, 8);
  strncat(fullMessage, "\r", 10);
  PowerSupply_Control(fullMessage);
}

export void Power_Cycle(long waitTime)
{
  Power_Supply_OFF();
  
  testStep("","Wait for %dms", waitTime);
  testWaitForTimeout(waitTime);
  
  Power_Supply_ON();
  
  testStep("","Wait for %dms", waitTime);
  testWaitForTimeout(waitTime);
  
}

export void Power_Cycle_Immediate_Return(long waitTime)
{
  Power_Supply_OFF();
  testStep("","Wait for %dms", waitTime);
  testWaitForTimeout(waitTime);
  Power_Supply_ON();
  
}

double Get_Comparison_Score(char image1[], char image2[], char resolution[])
{
  long response;
  char batchFileNameWithASpace [50] = "Image_Comparison.bat ";
  char fullCommand [256] = "";
  
  strncpy(fullCommand, batchFileNameWithASpace, 256);
  strncat(fullCommand, resolution, 256); 
  strncat(fullCommand, " compareTwoImages ", 256); 
  strncat(fullCommand, image1, 256);
  strncat(fullCommand, " ", 256);
  strncat(fullCommand, image2, 256);
  
  write("start comparing %s and %s", image1, image2);
  testStep("", "start comparing %s and %s", image1, image2);
  response = testWaitForSyscall(pythonFolder, fullCommand, 0, 60000);
  
  if(response == 1)
  {
    char buffer[64];
    double score = 0;
    dword glbHandle = 0;
    
    setFilePath (pythonFolder, 0);
    glbHandle = OpenFileRead ("score.txt", 0);

    if ( glbHandle!=0 )
    {
      fileGetStringSZ(buffer,elcount(buffer),glbHandle);
      score = atodbl (buffer);
      fileClose (glbHandle);
      write ("score: %f", score);
      testStep("", "score: %f", score);
      return score;
    }
    else
    {
      write ("File 'score.txt' was not opened for read access.");
    }
  }
  else
  {
    write ("failed to finish image comparison, exit code: %d", response);
  }
  return 0;
}

long View_Name_To_Number(char viewName[])
{
  if(strncmp(viewName, "Default", strlen("Default")) == 0) return 0;
  else if(strncmp(viewName, "FVTV_RVTV", strlen("FVTV_RVTV")) == 0) return 1;
  else if(strncmp(viewName, "BackupRearView", strlen("BackupRearView")) == 0) return 2;
  else if(strncmp(viewName, "FFCV", strlen("FFCV")) == 0) return 3;
  else if(strncmp(viewName, "TRG", strlen("TRG")) == 0) return 5;
  else if(strncmp(viewName, "TrailerLeftTowView", strlen("TrailerLeftTowView")) == 0) return 6;
  else if(strncmp(viewName, "TrailerRightTowView", strlen("TrailerRightTowView")) == 0) return 7;
  else if(strncmp(viewName, "BlindSpotLeftView", strlen("BlindSpotLeftView")) == 0) return 8;
  else if(strncmp(viewName, "BlindSpotRightView", strlen("BlindSpotRightView")) == 0) return 9;
  else if(strncmp(viewName, "FVTV", strlen("FVTV")) == 0) return 11;
  else if(strncmp(viewName, "RVTV", strlen("RVTV")) == 0) return 12;
  else if(strncmp(viewName, "FrontCrossPathView", strlen("FrontCrossPathView")) == 0) return 13;
  else if(strncmp(viewName, "RearCrossPathView", strlen("RearCrossPathView")) == 0) return 14;
  return -1;
}


export void HMI_test(char gear[], long masterViewNumber, char resolution[])
{
  char masterViewNumberInString [5];
  char masterImageName [30];
  
  ltoa(masterViewNumber, masterViewNumberInString, 10);
  strncpy(masterImageName, resolution, 10);
  strncat(masterImageName, "_", 15);
  strncat(masterImageName, gear, 20);
  strncat(masterImageName, masterViewNumberInString, 30);
  Capture_Image(masterImageName, resolution);
  
  Capture_And_Compare(masterImageName, masterViewNumberInString, resolution);
  
}

export void Capture_And_Compare(char masterImageName[], char viewNumber[], char resolution[])
{
  long response, retries;
  char batchFileNameWithASpace [50] = "Image_Comparison.bat ";
  char fullCommand [256] = "";
  
  retries = 0;
  
  strncpy(fullCommand, batchFileNameWithASpace, 256);
  strncat(fullCommand, resolution, 256); 
  strncat(fullCommand, " captureAndCompare ", 256); 
  strncat(fullCommand, masterImageName, 256);
  strncat(fullCommand, " ", 256);
  strncat(fullCommand, viewNumber, 256);
  
  do
  {
    testStep("", "start running image comparison with %s, retries: %d", masterImageName, retries);
    response = testWaitForSyscall(pythonFolder, fullCommand, 0, 60000);
    retries ++;
  }while(response != 1 && retries < 3);
  
  if(response == 1)
  {
    char buffer[64];
    char takenImagePath[500];
    char masterImagePath[500];
    double score = 0;
    dword glbHandle = 0;
    dword glbHandle2 = 0;
    
    setFilePath (pythonFolder, 0);
    glbHandle = OpenFileRead ("score.txt", 0);

    if ( glbHandle!=0 )
    {
      fileGetStringSZ(buffer,elcount(buffer),glbHandle);
      score = atodbl (buffer);
      
      write ("score: %f", score);
      if (score >= 0.001 )  { testStepPass(" ", "Passed image comparison with %s, score: %f", masterImageName, score); } 
      else { testStepFail(" ", "Failed image comparison with %s, score: %f", masterImageName, score); }
      
      glbHandle2 = OpenFileRead ("takenImageName.txt", 0);
      
      if ( glbHandle2!=0 )
      {
        fileGetStringSZ(buffer,elcount(buffer),glbHandle2);
        strncpy(takenImagePath, pythonFolder, 500);
        strncat(takenImagePath, buffer, 500);
        strncpy(masterImagePath, pythonFolder, 500); 
        strncat(masterImagePath, "images/", 500);
        strncat(masterImagePath, masterImageName, 500);
        strncat(masterImagePath, ".png", 500);
        testReportAddImage("image taken", takenImagePath);
        testReportAddImage("master image", masterImagePath);
        
      }
      else
      {
        write ("File 'takenImageName.txt' was not opened for read access.");
      }
      
    }
    else
    {
      write ("File 'score.txt' was not opened for read access.");
    }
    
    fileClose (glbHandle);
    fileClose (glbHandle2);
  }
  else
  {
    write ("failed to finish image comparison, exit code: %d", response);
  }
  
}

export void Capture_And_Compare_With_RGB(char masterImageName[], char resolution[])
{
  long response, retries;
  char batchFileNameWithASpace [50] = "Image_Comparison.bat ";
  char fullCommand [256] = "";
  
  retries = 0;
  
  strncpy(fullCommand, batchFileNameWithASpace, 256);
  strncat(fullCommand, resolution, 256);
  strncat(fullCommand, " captureAndCompareWithRGB ", 256); 
  strncat(fullCommand, masterImageName, 256);
  
  do
  {
    testStep("", "start running RGB image comparison with %s, retries: %d", masterImageName, retries);
    response = testWaitForSyscall(pythonFolder, fullCommand, 0, 60000);
    retries ++;
  }while(response != 1 && retries < 3);
  
  if(response == 1)
  {
    char buffer[64];
    char takenImagePath[500];
    char masterImagePath[500];
    char diffImagePath[500];
    double RGBDifference = 0;
    dword glbHandle = 0;
    dword glbHandle2 = 0;
    dword glbHandle3 = 0;
    
    setFilePath (pythonFolder, 0);
    glbHandle = OpenFileRead ("RGBDifference.txt", 0);

    if ( glbHandle!=0 )
    {
      fileGetStringSZ(buffer,elcount(buffer),glbHandle);
      RGBDifference = atodbl (buffer);
      
      write ("RGBDifference: %f", RGBDifference);
      if (RGBDifference <= 200 )  { testStepPass(" ", "Passed image comparison with %s, max RGB Difference: %.2f", masterImageName, RGBDifference); } 
      else { testStepFail(" ", "Failed image comparison with %s, max RGB Difference: %.2f", masterImageName, RGBDifference); }
      
      glbHandle2 = OpenFileRead ("takenImageName.txt", 0);
      
      if ( glbHandle2!=0 )
      {
        fileGetStringSZ(buffer,elcount(buffer),glbHandle2);
        strncpy(takenImagePath, pythonFolder, 500);
        strncat(takenImagePath, buffer, 500);
        strncpy(masterImagePath, pythonFolder, 500); 
        strncat(masterImagePath, "images/", 500);
        strncat(masterImagePath, masterImageName, 500);
        strncat(masterImagePath, ".png", 500);
        testReportAddImage("image taken", takenImagePath);
        testReportAddImage("master image", masterImagePath);
        
        glbHandle3 = OpenFileRead ("RGBDiffImageName.txt", 0);
        
        if ( glbHandle3!=0 )
        {
          fileGetStringSZ(buffer,elcount(buffer),glbHandle3);
          strncpy(diffImagePath, pythonFolder, 500);
          strncat(diffImagePath, buffer, 500);
          testReportAddImage("Image difference", diffImagePath);
        }
        else
        {
          write ("File 'RGBDiffImageName.txt' was not opened for read access.");
        }
      }
      else
      {
        write ("File 'takenImageName.txt' was not opened for read access.");

      }
      
    }
    else
    {
      write ("File 'RGBDifference.txt' was not opened for read access.");
    }
    
    fileClose (glbHandle);
    fileClose (glbHandle2);
    fileClose (glbHandle3);
  }
  else
  {
    write ("failed to finish RGB image comparison, exit code: %d", response);
    testStepFail("", "failed to finish RGB image comparison, exit code: %d", response);
  }
  
}

export void Capture_Image(char imageName[], char resolution[])
{
  long response, retries;
  char batchFileNameWithASpace[50] = "Image_Comparison.bat ";
  char fullCommand[256];
  
  response = 0;
  retries = 0;
  
  strncpy(fullCommand, batchFileNameWithASpace, 256); 
  strncat(fullCommand, resolution, 256);
  strncat(fullCommand, " captureOnly ", 256);
  strncat(fullCommand, imageName, 256);
  
  while(response != 1 && retries < 3)
  {
    testStep("", "start running image capture, retries: %d", retries);
    response = testWaitForSyscall(pythonFolder, fullCommand, 0, 60000);
    retries ++;
  }
  
  if(response == 1)
  {
    char takenImagePath[500];
    strncpy(takenImagePath, pythonFolder, 500);
    strncat(takenImagePath, "images/", 500);
    strncat(takenImagePath, imageName, 500);
    strncat(takenImagePath, ".png", 500);
    
    testStep("", "image name: %s", imageName);
    testStepPass();
  }
  else
  {
    write ("failed to finish image capture, exit code: %d", response);
     testStepFail("", "failed to finish image capture, exit code: %d", response);
  }
}

export void Switch_Gear_With_String(char gear[])
{
  if(strncmp(gear, "P", 10) == 0)
  {
    $ShiftLeverPosition = 1;
  }
  else if(strncmp(gear, "R", 10) == 0)
  {
    $ShiftLeverPosition = 2;
  }
  else if(strncmp(gear, "N", 10) == 0)
  {
    $ShiftLeverPosition = 3;
  }
  else if(strncmp(gear, "D", 10) == 0)
  {
    $ShiftLeverPosition = 4;
  }
  else if(strncmp(gear, "L", 10) == 0)
  {
    $ShiftLeverPosition = 5;
  }
  testStep("","Set $ShiftLeverPosition = %s", gear);
}

export void View_Switch(char gear[], long from, long to)
{
  Switch_Gear_With_String(gear);
  
  testStep("","Wait for 2000ms");
  testWaitForTimeout(2000);
  
  testStep("","Set $CameraDisplaySts2 = %d", from);
  $CameraDisplaySts2 = from;
  
  testStep("","Wait for 2000ms");
  testWaitForTimeout(2000);
  
  testStep("","Set $CameraDisplaySts2 = %d", to);
  $CameraDisplaySts2 = to;
  
  testStep("","Wait for 2000ms");
  testWaitForTimeout(2000);
  
  testStep("", "DisplayView2 = %f", getSignal(DisplayView2));
  
}

export testcase View_Switch_HMI_Test(char gear[], char view[], char resolution[])
{
  long i = 0;
  long viewNumber;
  
  testStep("","Set $CameraDisplaySts2 = 2");
  $CameraDisplaySts2 = 2;
  viewNumber = View_Name_To_Number(view);
  for (i = 1; i <= 14; i++)
  {
    if(i == 4 || i == 10 || i == viewNumber || (viewNumber >= 11 && i == 1))
    {
      continue;
    }
    View_Switch(gear, viewNumber, i);
    HMI_test(gear, i, resolution);
  }
}

export testcase Sanity_HMI_Test()
{
  CmdIgnSts_HMI_Test();
  Gear_Switch_Test();
}

export testcase Gear_Switch_Test()
{
  char timeStampInString[10];
  char takenImageName[50];
  int i = 0;
  
  for(i = 0; i<= 10; i++) 
  {
  testStep("", "Set view to default");
  $CameraDisplaySts2 = 0;
  
  Switch_Gear_With_String("P");
  
  testStep("", "Wait 2 seconds");
  testWaitForTimeout(2000);
  snprintf(takenImageName, elcount(takenImageName), "%d-Park-Gear", i);
  Capture_Image(takenImageName, "1200x900");
  
  Switch_Gear_With_String("R");
  
  testStep("", "Wait 2 seconds");
  testWaitForTimeout(2000);
  
  snprintf(takenImageName, elcount(takenImageName), "%d-Reverse-Gear", i);
  Capture_Image(takenImageName, "1200x900");
  
  testStep("", "Set view to default");
  $CameraDisplaySts2 = 0;
  
  Switch_Gear_With_String("D");
  
  testStep("", "Wait 2 seconds");
  testWaitForTimeout(2000);
  
  snprintf(takenImageName, elcount(takenImageName), "%d-Drive-Gear", i);
  Capture_Image(takenImageName, "1200x900");
  
  }
}

export testcase CmdIgnSts_HMI_Test()
{
  long response;
  char imageName [50];
 
  testStep("", "Set CmdIgnSts to lock");
  $CmdIgnSts = 0;
  
  testStep("","Wait for 2000ms");
  testWaitForTimeout(2000);
  
  strncpy("CmdIgnSts_Lock", "CmdIgnSts_Lock", 50);
  Capture_Image("CmdIgnSts_Lock", "1200x900");
  strncpy("CmdIgnSts_ACC", "CmdIgnSts_ACC", 50);
  $CmdIgnSts = 3;
  strncpy("CmdIgnSts_Run", "CmdIgnSts_Run", 50);
  $CmdIgnSts = 4;
  Capture_Image("CmdIgnSts_Run", "1200x900");
  
  response = Check_If_Black_Screen("CmdIgnSts_Run", "1200x900");
  
  if(response == 1) testStepPass("");
  

}

export int Check_If_Black_Screen(char imageName[], char resolution[])
{
  
  long response;
  char batchFileNameWithASpace [50] = "Image_Comparison.bat ";
  char fullCommand [256] = "";
 
  
  strncpy(fullCommand, batchFileNameWithASpace, 256); 
  strncat(fullCommand, resolution, 256); 
  strncat(fullCommand, " compareTwoImages ", 256);
  strncat(fullCommand, resolution, 256);
  strncat(fullCommand, "_BlackScreen_A", 256);
  strncat(fullCommand, " ", 256); 
  strncat(fullCommand, imageName, 256); 
  Capture_Image("_BlackScreen_A", "1200x900");
  

  testStep("", "start running image comparison with Black Screen A");
  response = testWaitForSyscall(pythonFolder, fullCommand, 0, 60000);
  
  if(response == 1)
  {
    char buffer[64];
    double score = 0;
    dword glbHandle = 0;

    setFilePath (pythonFolder, 0);
    glbHandle = OpenFileRead ("score.txt", 0);

    if ( glbHandle!=0 )
    {
      fileGetStringSZ(buffer,elcount(buffer),glbHandle);
      score = atodbl (buffer);
      fileClose (glbHandle);
      write ("score: %f", score);
      if (score >= 0.8 )  
      { 
        testStep(" ", "Detect black screen A, score: %f", score);
        return 1;
      } 
      else 
      {
        strncpy(fullCommand, batchFileNameWithASpace, 256); 
        strncat(fullCommand, resolution, 256); 
        strncat(fullCommand, " compareTwoImages ", 256);
        strncat(fullCommand, resolution, 256);
        strncat(fullCommand, "_BlackScreen_A", 256);
        strncat(fullCommand, " ", 256); 
        strncat(fullCommand, imageName, 256); 
        Capture_Image("_BlackScreen_B", "1200x900");

        testStep("", "start running image comparison with Black Screen B");
        response = testWaitForSyscall(pythonFolder, fullCommand, 0, 60000);
        
        if(response == 1)
        {
          char bufferB[64];
          double scoreB = 0;
          dword glbHandleB = 0;
          
          setFilePath (pythonFolder, 0);
          glbHandleB = OpenFileRead ("score.txt", 0);

          if ( glbHandleB!=0 )
          {
            fileGetStringSZ(bufferB,elcount(bufferB),glbHandleB);
            scoreB = atodbl (bufferB);
            fileClose (glbHandleB);
            write ("score: %f", scoreB);
            if (scoreB >= 0.8 )  
            { 
              testStep(" ", "Detect black screen B, score: %f", scoreB); 
              testStepFail("","Detect black screen B, score: %f", scoreB); 
              return 1;
            } 
            else 
            {
              testStep(" ", "Camera view is working, scores: %f, %f", score, scoreB);
              return 0;
            }
          }
          else
          {
            write ("File 'score.txt' was not opened for read access.");
          }
        }
        else
        {
          write ("failed to finish image comparison, exit code: %d", response);
          testStepFail("", "failed to finish image comparison, exit code: %d", response);
        }
      }
    }
    else
    {
      write ("File 'score.txt' was not opened for read access.");
    }
  }
  else
  {
    write ("failed to finish image comparison, exit code: %d", response);
  }
  return -1;
}


export testcase Power_Cycle_CAN(long iterations)
{
  long i;
  General_Precondition();
  
  for(i = 0; i < iterations; i++)
  {
    testStep("", "Iteration %d", i);
    Power_Cycle(10000);
  
    if(Check_Both_Can_Messages() == 1)
    {
      testStepPass("", "Got CAN messages from both channels");
    }
  }
  
  General_Postcondition();
}

export testcase Power_Cycle_Test(long iterations)
{
  char imageName[80];
  char defaultImageName[80];
  char timeStampInString[10];
  long i;
  long response;
  
 for(i = 0; i < iterations; i++)
  {
  Power_Cycle(8000);
  testStep("", "Wait for 15000ms");
  testWaitForTimeout(20000);
 
  Check_Both_Can_Messages();
   $CameraDisplaySts2 = 2; 
  response = testWaitForSyscall("","C:\\prjtools\\python\\ver_3.7.6_p7\\python.exe CaptureImage.py",1,8000); // default directory root of canoe rbs,  run python script to capture image, timeout is 8 seconds. exit code is 1 from python script.
    if (response != 1)
    {
      testStepFail("","Failed to capture from image grabber!");
    }
    else
    {
      testStepPass("Successfully captured Image from image grabber!");
    }
    if ($DisplayView2 == 0)
    {
      testStepFail("DisplayView2 did not change!");
    }
  }
}

export testcase Hard_Reset_CAN(long iterations)
{
  long i;
  General_Precondition();
  
  Power_Supply_ON();
  testStep("", "Wait for 7000ms");
  testWaitForTimeout(7000);
  
  for(i = 0; i < iterations; i++)
  {
    testStep("", "Iteration %d", i);
    
    Hard_Reset();
    
    testStep("", "Wait 15 seconds");
    testWaitForTimeout(15000);
    
  
    if(Check_Both_Can_Messages() == 1)
    {
      testStepPass("", "Got CAN messages from both channels");
    }
  }
  
  General_Postcondition();
}

export testcase Hard_Reset_Test(long iterations)
{
  char imageName[80];
  char defaultImageName[80];
  char timeStampInString[10];
  long i;
  long response;
  
   for(i = 0; i < iterations; i++)
  {
  Hard_Reset();
  testStep("", "Wait for 7000ms");
  testWaitForTimeout(7000);
  Check_Both_Can_Messages();
  response = testWaitForSyscall("","C:\\prjtools\\python\\ver_3.7.6_p7\\python.exe CaptureImage.py",1,8000); // default directory root of canoe rbs,  run python script to capture image, timeout is 8 seconds. exit code is 1 from python script.
    if (response != 1)
    {
      testStepFail("","Failed to capture from image grabber!");
    }
    else
    {
      testStepPass("Successfully captured Image from image grabber!");
    }
  }
  
}

export void Check_DTC()
{
  BYTE primitiveRaw[200];
  long retries, response, size, dataStart, i;
  diagRequest CVADAS_0001_00000000_000.FaultMemory_Report_First_Confirmed_DTC reqFirst;
  diagResponse CVADAS_0001_00000000_000.FaultMemory_Report_First_Confirmed_DTC respFirst;
  diagRequest CVADAS_0001_00000000_000.FaultMemory_Report_Most_Recent_Confirmed_DTC reqRecent;
  diagResponse CVADAS_0001_00000000_000.FaultMemory_Report_Most_Recent_Confirmed_DTC respRecent;
  diagRequest CVADAS_0001_00000000_000.FaultMemory_Report_Number_of_DTC_By_Severity_Mask_Record reqAllDTC;
  diagResponse CVADAS_0001_00000000_000.FaultMemory_Report_Number_of_DTC_By_Severity_Mask_Record respAllDTC;
  
  char errorMessage[50];
  char errorCode[10];
  char buffer[3];
  char hexString[500];
  
  retries = 0;
  
  while(retries <= 5)
  {
    retries ++;
    response = 0;
    
    reqFirst.SendRequest();
    response = TestWaitForDiagRequestSent(reqFirst, 2000);
    if(response != 1)
    {
      strncpy(errorMessage, "Failed to send diagnostic request, error code: ", 100);
      ltoa(response, errorCode, 10);
      strncat(errorMessage, errorCode, 100);
      write("%s", errorMessage);
      continue;
    }
    
    response = TestWaitForDiagResponse(reqFirst, 2000);
    if(response != 1)
    {
      strncpy(errorMessage, "Failed to receive diagnostic response, error code:  ", 100);
      ltoa(response, errorCode, 10);
      strncat(errorMessage, errorCode, 100);
      write("%s", errorMessage);
      continue;
    }
    
    diagGetLastResponse(respFirst);
    response = diagGetResponseCode(respFirst);
    if(response != -1)
    {
      strncpy(errorMessage, "Diagnostic response error, error code: ", 100);
      ltoa(response, errorCode, 10);
      strncat(errorMessage, errorCode, 100);
      write("%s", errorMessage);
      testStepWarning("","%s", errorMessage);
      continue;
    }
    size = 0;
    size = DiagGetPrimitiveData(respFirst, primitiveRaw, elCount(primitiveRaw));
    if(size == 0)
    {
      strncpy(errorMessage, "Cannot read primitive data from diagnostic request", 100);
      write("%s", errorMessage);
      continue;
    }
    else if(size == 3)
     {
       testStepPass("", "No DTC");
       break;
     }
    
    dataStart = 3;
      
    strncpy(hexString, "", 500);
    for(i = dataStart; i < size; i++)
    {
      snprintf(buffer, 3, "%02x", primitiveRaw[i]);
      strncat(hexString, buffer, 500);
      if(i < size-1)
        strncat(hexString, " ", 500);
    }
  
    write("", "Hex string: %s", hexString);
    break;
  }
  
  retries = 0;
  
  while(retries <= 5)
  {
    retries ++;
    response = 0;
    
    reqRecent.SendRequest();
    response = TestWaitForDiagRequestSent(reqRecent, 2000);
    if(response != 1)
    {
      strncpy(errorMessage, "Failed to send diagnostic request, error code: ", 100);
      ltoa(response, errorCode, 10);
      strncat(errorMessage, errorCode, 100);
      write("%s", errorMessage);
      testStepFail("","Unable to read DTC faults - %s", errorMessage);
      continue;
    }
    
    response = TestWaitForDiagResponse(reqRecent, 2000);
    if(response != 1)
    {
      strncpy(errorMessage, "Failed to receive diagnostic response, error code:  ", 100);
      testStepFail("","Unable to read DTC faults - %s", errorMessage);
      ltoa(response, errorCode, 10);
      strncat(errorMessage, errorCode, 100);
      write("%s", errorMessage);
      continue;
    }
    
    diagGetLastResponse(respRecent);
    response = diagGetResponseCode(respRecent);
    if(response != -1)
    {
      strncpy(errorMessage, "Diagnostic response error, error code: ", 100);
      testStepFail("","Unable to read DTC faults - %s", errorMessage);
      ltoa(response, errorCode, 10);
      strncat(errorMessage, errorCode, 100);
      write("%s", errorMessage);
      continue;
    }
    size = 0;
    size = DiagGetPrimitiveData(respRecent, primitiveRaw, elCount(primitiveRaw));
    if(size == 0)
    {
      strncpy(errorMessage, "Cannot read primitive data from diagnostic request", 100);
      testStepFail("","Unable to read DTC faults - %s", errorMessage);
      write("%s", errorMessage);
      continue;
    }
    else if(size == 3)
     {
       testStepPass("", "No DTC");
       break;
     }
    
    dataStart = 3;
      
    strncpy(hexString, "", 500);
    for(i = dataStart; i < size; i++)
    {
      snprintf(buffer, 3, "%02x", primitiveRaw[i]);
      strncat(hexString, buffer, 500);
      if(i < size-1)
        strncat(hexString, " ", 500);
    }
  
    testStepFail("", "Received DTC response:\n%s", hexString);
    write("", "Hex string: %s", hexString);
    break;
  }
}

export void Clear_DTC()
{
  long response;
  diagRequest CVADAS_0001_00000000_000.FaultMemory_Clear req14;
  diagResponse CVADAS_0001_00000000_000.FaultMemory_Clear resp14;
  
  req14.SetParameter("GroupofDtc", "All groups  -  0xFF 0xFF 0xFF");
  testStep("", "Send request to clear DTC");
  req14.SendRequest();
  response = TestWaitForDiagRequestSent(req14, 2000);
  if(response != 1)
  {
    testStepFail("","Error code: %d",response);
    return;
  }
  
  response = TestWaitForDiagResponse(req14, 5000);
  if(response != 1)
  {
    testStepFail("","Error code: %d",response);
    return;
  }
  
  diagGetLastResponse(resp14);
  response = diagGetResponseCode(resp14);
  if(response != -1)
  {
    testStepFail("","Error code: %d",response);
    return;
  }
  testStepPass("","DTC cleared");
}

// not in use 08/21
export testcase Sleep_Wakeup(long iterations)
{
  long i, j;
  char batchFileNameWithASpace [50] = "Image_Comparison.bat ";
  char fullCommand [256] = "";
  long response;
  float switchTime;
  float totalTTFFDCAN2, totalTTFFDCAN14, totalTTFI;
  
  totalTTFFDCAN2 = 0;
  totalTTFFDCAN14 = 0;
  totalTTFI = 0;
  General_Precondition();
 
  for(i = 0; i < iterations; i++)
  {
    char takenImageName[16];
    testStep("", "Iteration %d", i);
    Clear_DTC();
    
    Disable_CAN_Communication();
  
    Enable_CAN_Communication();
    
    strncpy(fullCommand, batchFileNameWithASpace, 256);
    strncat(fullCommand, "1200x900 checkWhenSwitchAway 1200x900", 256); 
    strncat(fullCommand, "_BlackScreen", 256);
    
    testStep("", "start looking for the first valid image");
    response = testWaitForSyscall(pythonFolder, fullCommand, 0, 300000);
    
    if(response == 1)
    {
      char buffer[64];
      char bufferA[64];
      char bufferB[64];
      char beforeImagePath[500];
      char afterImagePath[500];
      dword glbHandle = 0;
      dword glbHandleA = 0;
      dword glbHandleB = 0;
      
      setFilePath (pythonFolder, 0);
      glbHandle = OpenFileRead ("switchTime.txt", 0);

      if ( glbHandle!=0 )
      {
        fileGetStringSZ(buffer,elcount(buffer),glbHandle);
        switchTime = atodbl (buffer);
        fileClose (glbHandle);
        if (switchTime < 0) 
        {
          switchTime *= -1;
        }
        else
        {
          testStepPass("", "spent %f seconds to receive first valid image", switchTime);
        }
        
        glbHandleB = OpenFileRead ("beforeSwitch.txt", 0);
        glbHandleA = OpenFileRead ("afterSwitch.txt", 0);
        
        if ( glbHandleA != 0 && glbHandleB != 0)
        {
          long k;
          fileGetStringSZ(bufferB,elcount(buffer),glbHandleB);
          fileGetStringSZ(bufferA,elcount(buffer),glbHandleA);
          
          fileClose(glbHandleA);
          fileClose(glbHandleB);
          
          strncpy(beforeImagePath, pythonFolder, 500);
          strncat(beforeImagePath, bufferB, 500);
          strncpy(afterImagePath, pythonFolder, 500);
          strncat(afterImagePath, bufferA, 500);
         
          
          testReportAddImage("before", beforeImagePath);
          testReportAddImage("after", afterImagePath);
          
          for(k = 0; k < 15; k++)
          {
            takenImageName[k] = bufferA[k+7];
          }
          response = Check_If_Black_Screen(takenImageName, "1200x900");
          if(response == 1) testStepFail("", "Unexpected blackscreen detected!");
          
        }
        else
        {
          write ("File 'beforeSwitch.txt' or 'afterSwitch.txt' was not opened for read access.");
        }
        
      }
      else
      {
        write ("File 'switchTime.txt' was not opened for read access.");
      }
    }
    else
    {
      write ("failed to finish TTFI test, exit code: %d", response);
    }

    j = 0;
    while(j < 5)
    {
      testStep("", "Wait for 5 seconds");
      testWaitForTimeout(5000);
      if(timeForFDCAN2Wake != 0 && timeForFDCAN14Wake != 0)
      {
        testStepPass("", "FD-CAN2 = %f seconds, FD-CAN14 = %f seconds, TTFI = %f seconds", timeForFDCAN2Wake, timeForFDCAN14Wake, switchTime);
        totalTTFFDCAN2 += timeForFDCAN2Wake;
        totalTTFFDCAN14 += timeForFDCAN14Wake;
        totalTTFI += switchTime;
        break;
      }
      j++;
    }
    
    Check_DTC();
  }
  
  testStepPass("", "average FD-CAN2 = %f seconds, average FD-CAN14 = %f seconds, average TTFI = %f seconds", totalTTFFDCAN2 / iterations, totalTTFFDCAN14 / iterations, totalTTFI / iterations);
  General_Postcondition();
}



export testcase _5_1_Sleep_Wake_Cycle_Test()
{
  double current, Volt;
  int i;
  for (i = 1; i <= 3000; i++)
  {
    testStep("","Start 5.1 Sleep / Wake Cycle Test");
    current = Power_Supply_Get_Current();
    Volt = Power_Supply_Get_Voltage();
    if (current <= 0) { testStepFail(); }
    if (Volt <= 0) {testCaseFail(); }
    testWaitForTimeout(10000);//per spec: SD.00344.pdf
    Enable_CAN_Communication();
    testWaitForTimeout(5000); //per spec: SD.00344.pdf
    Check_FD_CAN_2_trace();
    Check_FD_CAN_14_trace();
    Sleep_Wakeup_New(); //perform sleep wake up conditions and check HMI
    Disable_CAN_Communication();
  }
}

export testcase _5_2_Sleep_Wake_Interruption_Test()
{
  double current, Volt;
  char timeStampInString[10];
  int i, j;
  j = 0;
  j = timeNowFloat()/100000.0;

  testStep("","Start 5.1 Sleep / Wake Cycle Test");
  current = Power_Supply_Get_Current();
  Volt = Power_Supply_Get_Voltage();
  if (current <= 0) { testStepFail(); }
  if (Volt <= 0) {testCaseFail(); }
  testWaitForTimeout(10000);//per spec: SD.00344.pdf
  Enable_CAN_Communication();
  testWaitForTimeout(5000); //per spec: SD.00344.pdf
  Check_FD_CAN_2_trace();
  Check_FD_CAN_14_trace();
  Sleep_Wakeup_New(); //perform sleep wake up conditions and check HMI
  Disable_CAN_Communcation_NoSleep();
  testWaitForTimeout(j); 
  ltoa(j, timeStampInString, 5);
  j = j + 5; //add 5 ms to time for each interruption case.
  testStep("","Twait is set to: %d",j);

}

export testcase Sleep_Wakeup_Interrupt(long starttimer, long incrementtimer, long stoptimer)
{
  long i, j;
  char view[5];
  char timeStampInString[10];
  char batchFileNameWithASpace [50] = "Image_Comparison.bat ";
  char fullCommand [256] = "";
  long response;
  char takenImageName[16];
  char masterImageName[16];
  long k;
  j = 0;
  General_Precondition();
  Clear_DTC();
  
  for (i = starttimer; i <= stoptimer; i = i + incrementtimer)
  {
    testStep("","Start: %d \n End: %d \n Increment: %d \n Delta: %d",starttimer, stoptimer, incrementtimer, i);
    testWaitForTimeout(starttimer); 
    Disable_CAN_Communcation_NoSleep();  // Turns off igntion/power - no sleep time in function
    testWaitForTimeout(stoptimer);  
    Enable_CAN_Communication();  // Turns on ignition/power
    testWaitForTimeout(i);  
    write("Start: %d, Stop: %d, Increment: %d Delta: %d",starttimer,stoptimer, incrementtimer, i);
    $CmdIgnSts = 4;
    Switch_Gear_With_String("P");
    $CameraDisplaySts2 = 2;
    ltoa(i, timeStampInString, 10);
    Capture_Image(timeStampInString,"1200x900"); //Check HMI
    if ($CVADAS::DisplayView2 == 0) { testStepFail("","DisplayView2 == %d",$CVADAS::DisplayView2); }
    else  { testStepPass(); }
   }
  
  Check_DTC();
  General_Postcondition();
}


export testcase Sleep_Wakeup_New()
{
  long response;
  General_Precondition();
  Disable_CAN_Communication();
  Enable_CAN_Communication();  
  $CmdIgnSts = 4;
  $CameraDisplaySts2 = 4;
  testWaitForTimeout(8000);
  response = testWaitForSyscall("","C:\\prjtools\\python\\ver_3.7.6_p7\\python.exe CaptureImage.py",1,8000); // default directory root of canoe rbs,  run python script to capture image, timeout is 8 seconds. exit code is 1 from python script.
    if (response != 1)
    {
      testStepFail("","Failed to capture from image grabber!");
    }
    else
    {
      testStepPass("Successfully captured Image from image grabber!");
    }
}

export testcase SetCalibrationData()
{
  diagRequest CVADAS_0001_00000000_000._22FD00_Plant_Camera_Calibration_Data_Write req;
  diagResponse CVADAS_0001_00000000_000._22FD00_Plant_Camera_Calibration_Data_Write resp;
  
  Enable_CAN_Communication();
  Set_Extended_Session();
  
  Hard_Reset();
}

export testcase variantProxy(int variant, char proxi[])
{
  diagRequest CVADAS_0001_00000000_000._22FD61_Vehicle_Variant_Coding_Data_Read FD61request;
  diagresponse CVADAS_0001_00000000_000._22FD61_Vehicle_Variant_Coding_Data_Read FD61response;
  int i, j, k;
  char tmp[500]; //buffer
  char out[500];
  byte response[500];
  
  out[0] = 0; //clear output string
  General_Precondition();
  Enable_CAN_Communication();
  Set_Extended_Session();
  testStep("","Variant %d proxy is sent!",variant);
  Write_Proxi(proxi);
  Hard_Reset();
  testWaitForTimeout(35000);
  $DisplayView2 == 5;
  FD61request.SendRequest();
  testWaitForDiagRequestSent(FD61request, 10000); //send request
  testWaitForTimeout(5000);
  FD61response.GetLastResponse();  //get last response
  i = diagGetPrimitiveData(FD61response, response, elcount(response));
    for (k = 0; k<=i; k++)
    {
      tmp[k] = response[k];
      snprintf(tmp, elcount(tmp), "%.2X", response[k]); //convert to hex into string
      strncat(out, tmp, elcount(out));
      //teststep("","FD6: %.2X",out[k]); debugging
    }
    if ($DisplayView2 == 0)
    {
      testStepFail("","No HMI Views!");
    }
    testStepPass("","FD61 Readout: %s",out);
  
  General_Postcondition();
}


export testcase variantProxyTest()
{
  diagRequest CVADAS_0001_00000000_000._22FD61_Vehicle_Variant_Coding_Data_Read FD61request;
  diagresponse CVADAS_0001_00000000_000._22FD61_Vehicle_Variant_Coding_Data_Read FD61response;
  int i, j, k;
  char tmp[500]; //buffer
  char out[500];
  byte response[500];
  
  out[0] = 0; //clear output string
  General_Precondition();
  Enable_CAN_Communication();
  Set_Extended_Session();
  testStep("","Sending HD Variant 5 proxi data");
  Write_Proxi("303030303030303236303245303032302D3032202020220317CF4DC6AD184124010AC018AC0302C151CF0DC62D184024F02ACC18640302815130F03DC1868009D2915B68105531580008000042043FE3290103C1384E0048080022000084010F500A50090C001004820002079560572C58661800D01C3A0087BFF9501AC00000220B014F1B813E0400000082000000061824008980A80F5066113C020000C1000020006E00730800006824009A1C349E2B6A8000CA24667F0940000000000000000F80000001040000004001000000000000FC0002000000000000000080000000001000000004000000000000");
  Hard_Reset();
  testWaitForTimeout(35000);
  $DisplayView2 == 5;
  FD61request.SendRequest();
  testWaitForDiagRequestSent(FD61request, 10000); //send request
  testWaitForTimeout(5000);
  FD61response.GetLastResponse();  //get last response
  i = diagGetPrimitiveData(FD61response, response, elcount(response));
    for (k = 0; k<=i; k++)
    {
      tmp[k] = response[k];
      snprintf(tmp, elcount(tmp), "%.2X", response[k]); //convert to hex into string
      strncat(out, tmp, elcount(out));
      //teststep("","FD6: %.2X",out[k]); debugging
    }
    if ($DisplayView2 == 0)
    {
      testStepFail("","No HMI Views!");
    }
    testStepPass("","FD61 Readout: %s",out);
  
  General_Postcondition();
}

export testcase DV_PV_PowerCycleTest()
{
  
  diagRequest CVADAS_0001_00000000_000._22FD64_ASIL_B_Fault_Status_Read FD64request;
  diagresponse CVADAS_0001_00000000_000._22FD64_ASIL_B_Fault_Status_Read FD64response;
  diagRequest CVADAS_0001_00000000_000._221004_Battery_Voltage batteryvoltreq;
  diagResponse CVADAS_0001_00000000_000._221004_Battery_Voltage batteryvoltresp;
  diagRequest CVADAS_0001_00000000_000._22FD4A_Ultrasonic_Sensors_Power_supply_and_Current_Level_Read FD4Arequest;
  diagResponse CVADAS_0001_00000000_000._22FD4A_Ultrasonic_Sensors_Power_supply_and_Current_Level_Read FD4Aresponse;
  
  char takenImageName[50];
  char imageName[80];
  char defaultImageName[80];
  char timeStampInString[10];
  int i, j, k;
  char tmp[32]; //buffer
  char out[500];
  byte response[500];
  

  out[0] = 0; //clear output string
  General_Precondition();
  testStep("","Proy Data: 303030303030363534303945303032302D3032202020220317CF4DC6AD184124810AC018AC0302C151CF0DC62D184024F02ACC18640302815130F03DC1868009D2915B68105511580008000042043FE3290103C1384E0048080022000084010F500A50090C001002680002079560572C58661800D01C3A0087BFF95016C00000220B014F1B813E0400000082000000061824008980A80F5066113C020000C1000020006E00730800006824009A1C349E2B6A8000CA24667F0740000000000000000F80000001040000004001000000000000FC00020000000000");
  Write_Proxi("303030303030353736353745303032302D3032202020220317CF4DC6AD184124810AC018AC0302C151CF0DC62D184024F02ACC18640302815130F03DC1868009D2915B68105511580008000042043FE3290103C1384E0048080022000084010F500A50090C001002680002079560572C58661800D01C3A0087BFF95016C00000220B014F1B813E0400000082000000061824008980A80F5066113C020000C1000020006E00730800006824009A1C349E2B6A8000CA24667F0240000000000000000F80000001040000004001000000000000FC00020000000000");
  Hard_Reset();
  testWaitForTimeout(35000);
  ltoa((long)(timeNowFloat()/100000.0), timeStampInString, 10);
  
  Enable_CAN_Communication();
  Switch_Gear_With_String("R");
  testwaitfortimeout(10000);
  PowerSupply_Control("VOLT060\r");
  Switch_Gear_With_String("D");
  Power_Cycle(10000);
  strncpy(defaultImageName, "Drive-Gear", 80);
  strncat(defaultImageName, timeStampInString, 80);
  Capture_Image(defaultImageName,"1200x900");
  PowerSupply_Control("VOLT135\r");
  Switch_Gear_With_String("P");
  Power_Cycle(10000);
  strncpy(defaultImageName, "Park-Gear", 80);
  strncat(defaultImageName, timeStampInString, 80);
  Capture_Image(defaultImageName,"1200x900");
  PowerSupply_Control("VOLT170\r");
  Switch_Gear_With_String("R");
  Power_Cycle(10000);
  strncpy(defaultImageName, "Reverse-Gear", 80);
  strncat(defaultImageName, timeStampInString, 80);
  Capture_Image(defaultImageName,"1200x900");
  Switch_Gear_With_String("N");
  Power_Cycle(10000);
  PowerSupply_Control("VOLT135\r");
  strncpy(defaultImageName, "Netural-Gear", 80);
  strncat(defaultImageName, timeStampInString, 80);
  Capture_Image(defaultImageName,"1200x900");

  //Check HMI
   for (j = 0; j < 15; j++)  {
   $CameraDisplaySts2 = j;
    testWaitForTimeout(15000);
  snprintf(defaultImageName, elcount(defaultImageName), "CameraDisplaySts_%d", j);
  strncat(defaultImageName, timeStampInString, 80);
  Capture_Image(defaultImageName,"1200x900");
    }
  Set_Extended_Session();

  FD64request.SendRequest();
  testWaitForDiagRequestSent(FD64request, 2000);
  FD64response.GetLastResponse();
  i = diagGetPrimitiveData(FD64response, response, elcount(response));
  
    for (k = 0; k<=i; k++)
    {
      snprintf(tmp, elcount(tmp), "%X", response[k]);
      strncat(out, tmp, elcount(out));
    }
  teststep("","FD64 Readout: %s",out);
  out[0] = 0; //clear output string
    
  batteryvoltreq.SendRequest();
  testWaitForDiagRequestSent(batteryvoltreq, 2000);
  batteryvoltresp.GetLastResponse();
  i = diagGetPrimitiveData(batteryvoltresp, response, elcount(response));
  
    for (k = 0; k<=i; k++)
    {
      snprintf(tmp, elcount(tmp), "%X", response[k]);
      strncat(out, tmp, elcount(out));
    }
  teststep("","Battery Read: %s",out);
    
  out[0] = 0; //clear output string
  FD4Arequest.SendRequest();
  testWaitForDiagRequestSent(FD4Arequest, 2000);
  FD4Aresponse.GetLastResponse();
  i = diagGetPrimitiveData(FD4Aresponse, response, elcount(response));

    for (k = 0; k<=i; k++)
    {
      snprintf(tmp, elcount(tmp), "%X", response[k]);
      strncat(out, tmp, elcount(out));
    }
  teststep("","USS Current/voltage read(FD4A): %s",out);


  //Check DTCs
  Check_DTC();

  //prepare for next cycle
  General_Postcondition();
  
}



export testcase Power_Cycle_Interrupt_ECU_Shutdown()
{
  char takenImageName[50];
  char imageName[80];
  char defaultImageName[80];
  char timeStampInString[10];
  int i, j, k;
  char tmp[32]; //buffer
  char out[500];
  byte response[500];
  
  //Run_Init_Port(); //connect to power supply
  $CameraDisplaySts2 = 0; //set to default for gear switch test below

  $CmdIgnSts = 0;
  testStep("", "$CmdIgnSts set to 'LK'");
  @sysvar::IL::Klemme30=0;
  @sysvar::IL::Klemme15=0;
  testStep("", "Ignition and power turned OFF");
  testWaitForTimeout(5000);
  
  $CmdIgnSts = 4;
  testStep("", "$CmdIgnSts set to 'On'");
  @sysvar::IL::Klemme30=1;
  @sysvar::IL::Klemme15=1;
  testStep("", "Ignition and power turned on");
  Switch_Gear_With_String("P");
  testStep("", "Set TGW_CAMERA_DISP_STAT = 4");
  $TGW_CAMERA_DISP_STAT = 4;
  testWaitForTimeout(5000);

  ltoa((long)(timeNowFloat()/100000.0), timeStampInString, 10);
  Power_Cycle(5000);
  Switch_Gear_With_String("D");
  strncpy(defaultImageName, "Check_View-Drive-Gear_", 80);
  strncat(defaultImageName, timeStampInString, 80);
  Capture_Image(defaultImageName,"1200x900");
  Switch_Gear_With_String("R");
  strncpy(defaultImageName, "Check_View-Reverse-Gear_", 80);
  strncat(defaultImageName, timeStampInString, 80);
  Capture_Image(defaultImageName,"1200x900");
  Switch_Gear_With_String("N");
  strncpy(defaultImageName, "Check_View-Netural-Gear_", 80);
  strncat(defaultImageName, timeStampInString, 80);
  Capture_Image(defaultImageName,"1200x900");
  Switch_Gear_With_String("P");
  strncpy(defaultImageName, "Check_View-Park-Gear_", 80);
  strncat(defaultImageName, timeStampInString, 80);
  Capture_Image(defaultImageName,"1200x900");
  
  //Can Check - change display status to check for displayview2 validation!
  Check_Both_Can_Messages();
  $CameraDisplaySts2 = 1;
  testWaitForTimeout(3000);
  if ($CVADAS::DisplayView2 == 0)
  {
    testStepFail("","DisplayView2 == %d",$CVADAS::DisplayView2);
    Hard_Reset();
    testWaitForTimeout(15000);
  }
  else
    testStepPass();
  
}

export testcase TTFI(long iterations)
{
  long i, j;
  char batchFileNameWithASpace [50] = "Image_Comparison.bat ";
  char fullCommand [256] = "";
  long response;
  float switchTime;
  long validIterations;
  float totalTTFFDCAN2, totalTTFFDCAN14, totalTTFI;
  
  totalTTFFDCAN2 = 0;
  totalTTFFDCAN14 = 0;
  totalTTFI = 0;
  validIterations = iterations;
  
  General_Precondition();
  
  for(i = 0; i < iterations; i++)
  {
    long k;
    char takenImageName[16];
    testStep("", "Iteration %d", i);
    Clear_DTC();
    
    testStep("", "Open driver door");
    $DriverDoorSts = 1;
    
    Disable_CAN_Communication();
  
    Enable_CAN_Communication();
    
    testStep("", "Wait until CAN wakeup");
    testWaitForTimeout(5000);
    

    
    strncpy(fullCommand, batchFileNameWithASpace, 256);
    strncat(fullCommand, "1200x900 checkWhenSwitchAway 1200x900", 256); 
    strncat(fullCommand, "_BlackScreen", 256);
    
    testStep("", "start looking for the first valid image");
    response = testWaitForSyscall(pythonFolder, fullCommand, 0, 300000);
    
    if(response == 1)
    {
      char buffer[64];
      char bufferA[64];
      char bufferB[64];
      char beforeImagePath[500];
      char afterImagePath[500];
      dword glbHandle = 0;
      dword glbHandleA = 0;
      dword glbHandleB = 0;
      
      setFilePath (pythonFolder, 0);
      glbHandle = OpenFileRead ("switchTime.txt", 0);

      if ( glbHandle!=0 )
      {
        fileGetStringSZ(buffer,elcount(buffer),glbHandle);
        switchTime = atodbl (buffer);
        fileClose (glbHandle);
        if (switchTime < 0) 
        {
          switchTime *= -1;
          testStepFail(" ", "Failed to maintain correct display after received first image");
        }
        else if(switchTime == 10)
        {
          validIterations --;
          testStepFail("", "Failed to get any valid image in 10 seconds");
        }
        else
        {
          totalTTFI += switchTime;
          if(switchTime <= 2) testStepPass("", "TTFI = %f seconds", switchTime);
          else testStepFail("", "TTFI = %f seconds", switchTime);
        }
        
        glbHandleB = OpenFileRead ("beforeSwitch.txt", 0);
        glbHandleA = OpenFileRead ("afterSwitch.txt", 0);
        
        if ( glbHandleA != 0 && glbHandleB != 0)
        {
          long k;
          fileGetStringSZ(bufferB,elcount(buffer),glbHandleB);
          fileGetStringSZ(bufferA,elcount(buffer),glbHandleA);
          
          fileClose(glbHandleA);
          fileClose(glbHandleB);
          
          strncpy(beforeImagePath, pythonFolder, 500);
          strncat(beforeImagePath, bufferB, 500);
          strncpy(afterImagePath, pythonFolder, 500);
          strncat(afterImagePath, bufferA, 500);
         
          
          testReportAddImage("before", beforeImagePath);
          testReportAddImage("after", afterImagePath);
          
          for(k = 0; k < 15; k++)
          {
            takenImageName[k] = bufferA[k+7];
          }
          response = Check_If_Black_Screen(takenImageName, "1200x900");
          if(response == 1) testStepFail("", "Unexpected blackscreen detected!");
          
        }
        else
        {
          write ("File 'beforeSwitch.txt' or 'afterSwitch.txt' was not opened for read access.");
          testStepFail("File 'beforeSwitch.txt' or 'afterSwitch.txt' was not opened for read access.");
        }
        
      }
      else
      {
        write ("File 'switchTime.txt' was not opened for read access.");
      }
    }
    else
    {
      write ("failed to finish TTFI test, exit code: %d", response);
    }
    
    j = 0;
    while(j < 5)
    {
      testStep("", "Wait for 5 seconds");
      testWaitForTimeout(5000);
      if(timeForFDCAN2Wake != 0 && timeForFDCAN14Wake != 0)
      {
        testStepPass("", "FD-CAN2 = %f seconds, FD-CAN14 = %f seconds, TTFI = %f seconds", timeForFDCAN2Wake, timeForFDCAN14Wake, switchTime);
        totalTTFFDCAN2 += timeForFDCAN2Wake;
        totalTTFFDCAN14 += timeForFDCAN14Wake;
        if(timeForFDCAN2Wake > 0.5) testStepFail("", "timeForFDCAN2Wake > 0.5 seconds");
        if(timeForFDCAN14Wake > 0.9) testStepFail("", "timeForFDCAN14Wake > 0.9 seconds");
        break;
      }
      j++;
    }
    if(j >= 5) testStepFail("", "ECU failed to wake up");
  
    Check_DTC();
  }
    testStep("", "Close driver door");
    $DriverDoorSts = 0;
  
  testStep("", "average FD-CAN2 = %f seconds, average FD-CAN14 = %f seconds, average TTFI = %f seconds", totalTTFFDCAN2 / iterations, totalTTFFDCAN14 / iterations, totalTTFI / validIterations);
  General_Postcondition();

}

export testcase Voltage_Drop(double minVoltage, long cycles, char resolution[])
{
  double maxVoltage = 12.0;
  long iter;
  double waitTime = 0;
  char minVoltageInString [10];
  
  Power_Supply_ON();
  
  _gcvt(minVoltage, 10, minVoltageInString);
  waitTime = 120000 / (maxVoltage - minVoltage) / 10;
  for(iter = 1; iter <= cycles; iter++)
  {
    char imageName[50];
    char iterInString[10];
    double j;
    
    for(j = maxVoltage; j >= minVoltage; j -= 0.1)
    {
      testStep("","Set power supply to %fV", j);
      Power_Supply_SET(j);
      testStep("","Wait for %fms", waitTime);
      testWaitForTimeout(waitTime);
    }
    
    testStep("","Set power supply to 12V", 12);
      Power_Supply_SET(12);
    
    testStep("","Wait for 10000ms");
    testWaitForTimeout(10000);
    
    ltoa(iter, iterInString, 10);
    strncpy(imageName, "Voltage_Drop/", 50);
    strncat(imageName, minVoltageInString, 50);
    strncat(imageName, "V/", 50);
    strncat(imageName, resolution, 50);
    strncat(imageName, "_", 50);
    strncat(imageName, iterInString, 50);
    Capture_Image(imageName, resolution);
  }
}

export testcase Take_Master_Images(char gear[], char resolution[])
{
  long iter;
  long lastView;
  char imageName[20];
  char lastImageName[20];
  char iterInString[5];
  
  iter = 0;
  lastView = 2;
  
  General_Precondition();
  
  strncpy(lastImageName, resolution, 20);
  strncat(lastImageName, "_old", 20);
  strncat(lastImageName, gear, 20);
  ltoa(lastView, iterInString, 20);
  write(iterInString);
  strncat(lastImageName, iterInString, 20);
  
  View_Switch(gear, lastView, lastView);
  Capture_Image(lastImageName, resolution);
  
  for (iter = 14; iter >= 1; iter--)
  {
    if(iter == 4 || iter == 10)
    {
      continue;
    }
    strncpy(imageName, resolution, 20);
    strncat(imageName, "_", 20);
    strncat(imageName, gear, 20);
    ltoa(iter, iterInString, 10);
    strncat(imageName, iterInString, 20);
    
    View_Switch(gear, lastView, iter);

    Capture_Image(imageName, resolution);
    
    if(Get_Comparison_Score(lastImageName, imageName, resolution) > 0.95)
    {
      testStepFail("", "failed to view swtich from %s to %s", viewName[lastView], viewName[iter]);
    }
    else
    {
      testStepPass("", "Captured %s", imageName);
    }
    strncpy(lastImageName, imageName, 20);
    lastView = iter;
  }
  write("Done capturing master images for gear %s, please double check the results", gear);
  testStepPass("", "Done capturing master images for gear %s, please double check the results", gear);
  
  General_Postcondition();
}

export testcase Send_Proxi(char proxi[])
{
  long response;
  General_Precondition();
  testStep("", "Go to Default Session...");
  Retry("Set_Default_Session");
  testStep("", "Go into Extended Diagnostic Session...");
  Retry("Set_Extended_Session");
  testStep("","Writing Proxy...");
  Write_Proxi(proxi);
  Hard_Reset();
  testStep("","Set to Default View: Rear View...");
  $CameraDisplaySts2=1;
  testWaitForTimeout(20000);
  response = Check_Both_Can_Messages();
  if (response != 1)
  {
    testStepFail("","Not able to retrive rx from can-bus! %d",response);
  }
  else
  {
    testStepPass();
  }
  General_Postcondition();
}

void Test_Pattern_Capture_And_Compare(char camera[], char resolution[])
{
  long response;
  
  Retry("Set_Extended_Session");
  response = Test_Pattern_Start(camera);
  
  testStep("", "Wait for 5 seconds");
  testWaitForTimeout(5000);
  
  if(response == 1)
  {
    testStepPass("","Test_Pattern_Start succeeded");
    
    if(camera[0] == 'F')
      Capture_And_Compare_With_RGB("FTP100", resolution);
    else if(camera[0] == 'L')
      Capture_And_Compare_With_RGB("LTP100", resolution);
    else if(camera[1] == 'e')
      Capture_And_Compare_With_RGB("ReTP100", resolution);
    else if(camera[1] == 'i')
      Capture_And_Compare_With_RGB("RiTP100", resolution);
    
    response = Test_Pattern_Stop();
    
    if(response == 1)
    {
      testStepPass("","Test_Pattern_Stop succeeded");
    }
    else
    {
      testStepFail("","Test_Pattern_Stop failed, response: %d", response);
    }
  }
  else
  {
    testStepFail("","Test_Pattern_Start failed, response: %d", response);
  }
}

void Test_Pattern_Capture_With_Power_Cycle(char camera[], char resolution[])
{
  long response;
  char timeStampInString[10];
    
  testStep("", "$CmdIgnsts = 'on'");
  $CmdIgnSts = 4;
  
  Retry("Set_Extended_Session");
  response = Test_Pattern_Start(camera);
  
  testStep("", "Wait for 5 seconds");
  testWaitForTimeout(5000);
  
  if(response == 1)
  {
    testStepPass("","Test_Pattern_Start succeeded");
    
    ltoa((long)(timeNowFloat()/100000.0), timeStampInString, 10);
    Capture_Image(timeStampInString, resolution);
    
    response = Test_Pattern_Stop();
    
    if(response == 1)
    {
      testStepPass("","Test_Pattern_Stop succeeded");
    }
    else
    {
      testStepFail("","Test_Pattern_Stop failed, response: %d", response);
    }
  }
  else
  {
    testStepFail("","Test_Pattern_Start failed, response: %d", response);
  }
  
  testStep("", "Wait for 5 seconds");
  testWaitForTimeout(5000);
  
  testStep("", "$CmdIgnsts = 'lock'");
  $CmdIgnSts = 0;
  
  Power_Cycle(5000);
}

void Test_Pattern_Capture_With_Hard_Reset(char camera[], char resolution[])
{
  long response;
  char timeStampInString[10];
  
  Retry("Set_Extended_Session");
  response = Test_Pattern_Start(camera);
  
  testStep("", "Wait for 5 seconds");
  testWaitForTimeout(5000);
  
  if(response == 1)
  {
    testStepPass("","Test_Pattern_Start succeeded");
    
    ltoa((long)(timeNowFloat()/100000.0), timeStampInString, 10);
    Capture_Image(timeStampInString, resolution);
    
    /*response = Test_Pattern_Stop();
    
    if(response == 1)
    {
      testStepPass("","Test_Pattern_Stop succeeded");
    }
    else
    {
      testStepFail("","Test_Pattern_Stop failed, response: %d", response);
    }*/
  }
  else
  {
    testStepFail("","Test_Pattern_Start failed, response: %d", response);
  }
  
  Retry("Hard_Reset");
  
  testStep("", "Wait for 10 seconds");
  testWaitForTimeout(10000);
  
  ltoa((long)(timeNowFloat()/100000.0), timeStampInString, 10);
  Capture_Image(timeStampInString, resolution);
}
export testcase Test_Pattern_Test(long set, char resolution[])
{
  long j;
  
  General_Precondition();
  
  for(j = 0; j < 25; j++)
  {
    testStep("", "Set %d, Iteration %d", set, j);
    
    Test_Pattern_Capture_And_Compare("Front Camera", resolution);
    Test_Pattern_Capture_And_Compare("Left Camera", resolution);
    Test_Pattern_Capture_And_Compare("Rear Camera", resolution);
    Test_Pattern_Capture_And_Compare("Right  Camera", resolution);
  }
  
  General_Postcondition();
}

export testcase Test_Pattern_Test_With_Power_Cycle(long set, char resolution[])
{
  long j;
  
  General_Precondition();
  
  for(j = 0; j < 25; j++)
  {
    testStep("", "Set %d, Iteration %d", set, j);
    Test_Pattern_Capture_With_Power_Cycle("Front Camera", resolution);
    Test_Pattern_Capture_With_Power_Cycle("Left Camera", resolution);
    Test_Pattern_Capture_With_Power_Cycle("Rear Camera", resolution);
    Test_Pattern_Capture_With_Power_Cycle("Right  Camera", resolution);
  }
  
  General_Postcondition();
}

export testcase Test_Pattern_Test_With_Hard_Reset(long set, char resolution[])
{
  long j;
  
  General_Precondition();
  
  for(j = 0; j < 25; j++)
  {
    testStep("", "Set %d, Iteration %d", set, j);
    Test_Pattern_Capture_With_Hard_Reset("Front Camera", resolution);
    Test_Pattern_Capture_With_Hard_Reset("Left Camera", resolution);
    Test_Pattern_Capture_With_Hard_Reset("Rear Camera", resolution);
    Test_Pattern_Capture_With_Hard_Reset("Right  Camera", resolution);
  }
  
  General_Postcondition();
}

export testcase HMI_Frame_Rate_Test(char resolution[])
{
  long iter;
  long lastView;
  char imageName[20];
  char lastImageName[20];
  char iterInString[5];
  
  iter = 0;
  lastView = 2;
  
  General_Precondition();
  
  Switch_Gear_With_String("P");
  
  strncpy(lastImageName, resolution, 20);
  strncat(lastImageName, "_old", 20);;
  ltoa(lastView, iterInString, 20);
  write(iterInString);
  strncat(lastImageName, iterInString, 20);
  
  Capture_Image(lastImageName, resolution);
  
  for (iter = 14; iter >= 1; iter--)
  {
    if(iter == 4 || iter == 10)
    {
      continue;
    }
    testStep("", "Start frame rate testing for %s", viewName[iter]);
    
    testStep("", "Switch view to %s", viewName[iter]);
    $CameraDisplaySts2 = iter;
    
    strncpy(imageName, resolution, 20);
    strncat(imageName, "_", 20);
    ltoa(iter, iterInString, 10);
    strncat(imageName, iterInString, 20);
    
    Capture_Image(imageName, resolution);
    
    if(Get_Comparison_Score(lastImageName, imageName, resolution) > 0.95)
    {
      testStepPass("", "View switched");
    }
    else
    {
      testStepFail("", "failed to view swtich from %s to %s", viewName[lastView], viewName[iter]);
    }
    
    strncpy(lastImageName, imageName, 20);
    lastView = iter;
  }
  
  General_Postcondition();
}

//export void Retry_With_Arguments(char functionName[], char arguments[][])
//{
//  int retries;
//  long response;

//  response = Write_Proxi(arguments[0]);
//  if (response == 1)
//  {
//    testStepPass();
//  }
//  else
//  {
//    testStepFail();
//  }
 
//}

long Set_Default_Session()
{
  long response;
  diagRequest CVADAS_0001_00000000_000.Default_Session_Start defaultSessionStart;
  diagResponse CVADAS_0001_00000000_000.Default_Session_Start defaultSessionStartResp;
  
  testStep("","Set Default Session");
  defaultSessionStart.SendRequest();
  TestWaitForDiagRequestSent(defaultSessionStart, 1000);
  response = TestWaitForDiagResponse(defaultSessionStart, 1000);
  
  return response;
  
}

long Set_Extended_Session()
{
  long response;
  diagRequest CVADAS_0001_00000000_000.Extended_Diagnostic_Session_Start extendedSessionStart;
  
  testStep("","Set Extended Session");
  extendedSessionStart.SendRequest();
  TestWaitForDiagRequestSent(extendedSessionStart, 1000);
  response = TestWaitForDiagResponse(extendedSessionStart, 1000);
  return response;
  
}

export long Hard_Reset()
{
  long response;
  diagRequest CVADAS_0001_00000000_000.HardReset_Reset hardReset;
  
  testStep("","ECU hard reset");
  hardReset.SendRequest();
  TestWaitForDiagRequestSent(hardReset, 1000);
  response = TestWaitForDiagResponse(hardReset, 20000);

  return response;
}

export long Write_Proxi(char proxi[])
{
  long response;
  diagRequest CVADAS_0001_00000000_000._2E2023_PROXI_Data proxiData;
  
  testStep("", "Write proxi data");
  proxiData.SetParameter("_Data_24", proxi);
  proxiData.SendRequest();
  response = TestWaitForDiagResponse(proxiData, 7000);
  if(response == 1)
  {
    response = diagGetLastResponseCode(proxiData);
    if(response == -1)
    {
      testStepPass("","Successfully Wrote Proxy!" );
      Hard_Reset();
      testWaitForTimeout(10000);
      return 1;
    }
    if(response == 1){
      testStepFail("","Failed to write proxy variant!");
      return -1;
    }

  }
  return response;
}

long Test_Pattern_Start(char cameraIdentifier[])
{
  long response;
  diagRequest CVADAS_0001_00000000_000._3101FE0E_Test_Pattern_Control_Start req;
  diagResponse CVADAS_0001_00000000_000._3101FE0E_Test_Pattern_Control_Start resp;
    
  testStep("", "Test pattern start with %s", cameraIdentifier);
  req.SetParameter("Camera_Identifier", cameraIdentifier);
  req.SetParameter("Test_Pattern", "100% Vertical Color Bars Test Pattern");
  req.SendRequest();
  response = TestWaitForDiagRequestSent(req, 2000);
  if(response != 1) return response;
  response = TestWaitForDiagResponse(req, 2000);
  if(response != 1) return response;
  
  diagGetLastResponse(resp);
  response = diagGetResponseCode(resp);
  if(response != -1) return response;
  return 1;
}

long Test_Pattern_Stop()
{
  long response;
  diagRequest CVADAS_0001_00000000_000._3102FE0E_Test_Pattern_Control_Stop req;
  diagResponse CVADAS_0001_00000000_000._3102FE0E_Test_Pattern_Control_Stop resp;
  
  testStep("", "Test pattern stop");
  req.SendRequest();
  response = TestWaitForDiagRequestSent(req, 2000);
  if(response != 1) return response;
  response = TestWaitForDiagResponse(req, 2000);
  if(response != 1) return response;
  
  diagGetLastResponse(resp);
  response = diagGetResponseCode(resp);
  if(response != -1) return response;
  return 1;
  
}

long Check_FD_CAN_2_trace()
{
   if(((timeNowFloat() / 100) - timeSinceLastFDCAN2) <= 200) return 1;
   else return 0;
}

export void Disable_CAN_Communcation_NoSleep()
{
  long response, j;
  dword context;
  
  Switch_Gear_With_String("P");
  
  testStep("", "Set view to default");
  $CameraDisplaySts2 = 0;
  
  $CmdIgnSts = 0;
  testStep("", "$CmdIgnSts set to 'lock'");
  
  testStep("", "Wait for 250ms");
  testWaitForTimeout(250);
  
  @sysvar::IL::Klemme15=0;
  @sysvar::IL::Klemme30=0;
  testStep("", "Ignition and power turned off");
  
  response = diagStopTesterPresent(ecuName);
  if(response != 0) testStepFail("", "Failed to stop Tester Present, error: %d", response);
  else testStep("", "Stopped Tester Present");
  
}

export void Disable_CAN_Communication()
{
  long response, j;
  dword context;
  
  Switch_Gear_With_String("P");
  
  testStep("", "Set view to default");
  $CameraDisplaySts2 = 0;
  
  $CmdIgnSts = 0;
  testStep("", "$CmdIgnSts set to 'lock'");
  
  testStep("", "Wait for 250ms");
  testWaitForTimeout(250);
  
  @sysvar::IL::Klemme15=0;
  @sysvar::IL::Klemme30=0;
  testStep("", "Ignition and power turned off");
  
  response = diagStopTesterPresent(ecuName);
  if(response != 0) testStepFail("", "Failed to stop Tester Present, error: %d", response);
  else testStep("", "Stopped Tester Present");
  
  j = 0;
  while(j < 6)
  {
    testStep("", "Wait for 5 seconds");
    testWaitForTimeout(5000);
    
    j++;
    
    if(((timeNowFloat() / 100) - timeSinceLastFDCAN2) >= 3000 && ((timeNowFloat() / 100) - timeSinceLastFDCAN14) >= 3000)
    {
      testStepPass("", "ECU went to sleep");
      break;
    }
  }
  
  if(j >= 6) testStepFail("", "ECU failed to sleep in 27 seconds");
  while(j < 6)
  {
    testStep("", "Wait for 5 seconds");
    testWaitForTimeout(5000);
    j++;
  }
}

export void Enable_CAN_Communication()
{
  long response;
  dword context;
  
  @sysvar::IL::Klemme15=1;
  @sysvar::IL::Klemme30=1;
  testStep("", "Ignition and power turned on");
  
  $CmdIgnSts = 4;
  testStep("", "$CmdIgnSts set to 'on'");
  
  Switch_Gear_With_String("P");
  reverseOnWake = 1;
  
  testStep("", "Set view to default");
  $CameraDisplaySts2 = 0;

  

  //testStep("", "Reset timer for TTFI and can wake up");
  //lastCANSleep = timeNowFloat() / 100.0;
  //timeForFDCAN2Wake = 0;
  //timeForFDCAN14Wake = 0;

  //response = diagStartTesterPresent(ecuName);
  //if(response != 0) testStepFail("", "Failed to start Tester Present, error: %d", response);
  //else testStep("", "Started Tester Present");
  
}

//not in use
export void Time_To_View_Switch_From_Reverse(char prevImageName[])
{
  long i, j;
  char batchFileNameWithASpace [50] = "Image_Comparison.bat ";
  char fullCommand [256] = "";
  long response;
  float switchTime;
  char takenImageName[16];
  
  Switch_Gear_With_String("R");
  
  strncpy(fullCommand, batchFileNameWithASpace, 256);
  strncat(fullCommand, "1200x900 checkWhenSwitchAway ", 256); 
  strncat(fullCommand, "prevImageName", 256);
  
  testStep("", "start looking for the first valid image");
  response = testWaitForSyscall(pythonFolder, fullCommand, 0, 300000);
  
  if(response == 1)
  {
    char buffer[64];
    char bufferA[64];
    char bufferB[64];
    char beforeImagePath[500];
    char afterImagePath[500];
    dword glbHandle = 0;
    dword glbHandleA = 0;
    dword glbHandleB = 0;
    
    setFilePath (pythonFolder, 0);
    glbHandle = OpenFileRead ("switchTime.txt", 0);

    if ( glbHandle!=0 )
    {
      fileGetStringSZ(buffer,elcount(buffer),glbHandle);
      switchTime = atodbl (buffer);
      fileClose (glbHandle);
      if (switchTime < 0) 
      {
        switchTime *= -1;
      }
      else
      {
        testStepPass("", "spent %f seconds to receive first valid image", switchTime);
      }
      
      glbHandleB = OpenFileRead ("beforeSwitch.txt", 0);
      glbHandleA = OpenFileRead ("afterSwitch.txt", 0);
      
      if ( glbHandleA != 0 && glbHandleB != 0)
      {
        long k;
        fileGetStringSZ(bufferB,elcount(buffer),glbHandleB);
        fileGetStringSZ(bufferA,elcount(buffer),glbHandleA);
        
        fileClose(glbHandleA);
        fileClose(glbHandleB);
        
        strncpy(beforeImagePath, pythonFolder, 500);
        strncat(beforeImagePath, bufferB, 500);
        strncpy(afterImagePath, pythonFolder, 500);
        strncat(afterImagePath, bufferA, 500);
       
        
        testReportAddImage("before", beforeImagePath);
        testReportAddImage("after", afterImagePath);
        
        for(k = 0; k < 15; k++)
        {
          takenImageName[k] = bufferA[k+7];
        }
        response = Check_If_Black_Screen(takenImageName, "1200x900");
        if(response == 1) testStepFail("", "Unexpected blackscreen detected!");
        
      }
      else
      {
        write ("File 'beforeSwitch.txt' or 'afterSwitch.txt' was not opened for read access.");
      }
      
    }
    else
    {
      write ("File 'switchTime.txt' was not opened for read access.");
    }
  }
  else
  {
    write ("failed to finish TTFI test, exit code: %d", response);
  }
}

long Check_FD_CAN_14_trace()
{
   if(((timeNowFloat() / 100) - timeSinceLastFDCAN14) <= 200) return 1;
   else return 0;
}

export long Check_Both_Can_Messages()
{
  long gotBothMessages;
  
  gotBothMessages = 1;
  if(Check_FD_CAN_2_trace() != 1)
  {
    gotBothMessages = 0;
  }
  if(Check_FD_CAN_14_trace() != 1)
  {
    gotBothMessages = 0;
  }
  return gotBothMessages;
}
on message Can1.* 
{
  if(this.dir == rx)
  {
    timeSinceLastFDCAN2 = timeNowFloat() / 100;
    if(timeForFDCAN2Wake == 0)timeForFDCAN2Wake = (timeNowFloat() / 100 - lastCANSleep) / 1000.0;
  }
}

on message Can2.* 
{
  if(this.dir == rx)
  {
    timeSinceLastFDCAN14 = timeNowFloat() / 100;
    if(timeForFDCAN14Wake == 0) timeForFDCAN14Wake = (timeNowFloat() / 100 - lastCANSleep) / 1000.0;
    if(reverseOnWake == 1 && timeForFDCAN2Wake != 0)
    {
      Switch_Gear_With_String("R");
      reverseOnWake = 0;
    }
  }
}

on timer t
{
  timeOut = 1;
}

// not in use 08/21
export testcase DTC_Test()
{
  long i;
  for(i = 0; i < 10; i++)
  {
    Clear_DTC();
    Check_DTC();
  }
}

export void Main_Precondition()
{
  
  @sysvar::IL::Klemme15=1;
  @sysvar::IL::Klemme30=1;
  testStep("", "Ignition and power turned on");
  
  $CmdIgnSts = 4;
  testStep("", "$CmdIgnSts set to 'on'");
  
  testStep("", "Set view to default");
  $CameraDisplaySts2 = 0;
  
  testStep("", "Set Gear to Park");
  $ShiftLeverPosition = 1;
  
  testWaitForTimeout(15000); //boot up
  testStepPass("","ECU is powered up successfully!");
  
  $TGW_CAMERA_DISP_STAT=4;
  $Fwrd_Cam_Guidelines=1;
  $SVC_Guidelines=1;
 // $LwsAngle_SCCM=0;
  
  
  
}

export void Main_Postcondition()
{
   testStepPass("","ECU Test has been completed!");
}

export testfunction startTesterPresent()
{
  diagStartTesterPresent();
  
}

export testfunction stopTesterPresent()
{
  diagStopTesterPresent();
  
}

export CAN_communication_Stop()
{
  canSetChannelOutput(1,0);
  canSetChannelOutput(2,0);
}

export CAN_communication_Start()
{ 
  canSetChannelOutput(1,1);
  canSetChannelOutput(2,1);
}


export void Retry(char functionName[])
{
  int retries;
  long response;
  
  retries = 0;
  testWaitForTimeout(15000);  //Wait for ECU to get ready..
  do
  {
    if(retries == 0) //print the test step at first try.
    {
      testStep("", "Try %s", functionName);
    }
    else
    {
      testStep("", "Retry %s, error code %d", functionName, response);
    }
    if(strncmp(functionName, "Set_Default_Session", 19) == 0)
    {
      response = Set_Default_Session();
    }
    else if(strncmp(functionName, "Set_Programming_Session", 23) == 0)
    {
      response = Set_Programming_Session();
    }
    else if(strncmp(functionName, "Set_Extended_Session", 20) == 0)
    {
      response = Set_Extended_Session();
    }
    else if(strncmp(functionName, "Hard_Reset", 10) == 0)
    {
      response = Hard_Reset();
    }
    else if(strncmp(functionName, "Write_Proxy", 11) == 0)
    {
      response = Write_Proxy();
    }
    else
    {
      testStepFail("", "Function not found to retry");
      return;
    }
    
    if(response == 1){
      testStepPass("","%s succeeded", functionName);
      return;
    }
    
    retries += 1;
    testStep("", "Wait for 10 seconds");
    testWaitForTimeout(10000);
  }
  while(retries < 3);
  //Exiting do while, if reached here, test step failed.  Otherwise it will return for response = 1 for test step pass.
  testStepFail("","%s failed, error code: %d", functionName, response);
}

export long Set_Programming_Session()
{
  long response;
  diagRequest CVADAS_0001_00000000_000.Programming_Session_Start programmingSessionStart;
  
  testStep("","Set Programming Session");
  programmingSessionStart.SendRequest();
  response = TestWaitForDiagRequestSent(programmingSessionStart, 15000);
  response = testWaitForDiagResponse(programmingSessionStart, 15000);
  return response;
  
}

export long Write_Proxy()
{
  long response;
  diagRequest CVADAS_0001_00000000_000._2E2023_PROXI_Data proxiData;

  
  testStep("", "Write proxi data");
  proxiData.SetParameter("_Data_24", "303030303030323735393445303032302D3032202020220317CF4DC6AD184124810AC0182C0302C151CF0DC62D184024F02ACC18640302815130F03DC1868009D2915B68105511580008000042043FE3290103C1384E0048080022000084010F500A50110C0010027C0002079560572C58661800D01C3A0087BFF95019C00000220B014F1B813E0400000082000000061824008980A80F5066113C020000C1000020006E00730800006824009A1C349E2B6A8000CA24667F0940000000000000000F80000001040000005801000000000000F800020000000000000000000000000000000000");
  proxiData.SendRequest();
  response = TestWaitForDiagResponse(proxiData, 1000);
  if(response == 1)
  {
    response = diagGetLastResponseCode(proxiData);
    if(response == -1)
    {
      return 1;
    }
    if(response == 1){
      return -1;
    }
  }
  return response;
}

//export void Compare_Diag_Request_Bytes(char DID[], char diagnosticSession[], diagRequest * req, diagResponse * resp)
//{
//  BYTE primitiveRaw[200];
//  long size;
//  long i;
//  long dataStart;
//  char hexString[500];
//  char buffer[3];
//  char textFileName[10];
//  dword glbHandle;
//  char correctString[500];
//  long response;
//  long retries;
//  char errorMessage[100];
//  char errorCode[10];
  
//  setFilePath (pythonFolder, 0);

//  strncpy(textFileName, DID, 10);
//  strncat(textFileName, ".txt", 10);
  
//  glbHandle = OpenFileRead (textFileName, 0);
//  if( glbHandle!=0 )
//  {
//    fileGetStringSZ(correctString,elCount(correctString),glbHandle);
//    write("Reference:\n%s", correctString);
//    if(strncmp(DID, "F1A2", 10) == 0)
//    {
//      char tempString[251];
//      if(strncmp(diagnosticSession, "Programming", elCount(diagnosticSession)) == 0)
//      {
//        long i;
//        for(i = 0; i < strlen(correctString)/2 + 1; i++)
//        {
//          tempString[i] = correctString[i + strlen(correctString)/2 + 1];
//        }
//        strncpy(correctString, tempString, strlen(correctString)/2 + 1);
//      }
//      else
//      {
//        strncpy(correctString, correctString, strlen(correctString)/2 + 1);
//      }
//    }
//  }
//  else
//  {
//    write ("File '%s' was not opened for read access.", textFileName);
//  }
  
//  if(strncmp(diagnosticSession, "Default", elCount(diagnosticSession)) == 0)
//  {
//    Retry("Set_Default_Session");
//  }
//  else if(strncmp(diagnosticSession, "Programming", elCount(diagnosticSession)) == 0)
//  {
//    Retry("Set_Programming_Session");
//  }
//  else if(strncmp(diagnosticSession, "Extended", elCount(diagnosticSession)) == 0)
//  {
//    Retry("Set_Extended_Session");
//  }
  
//  retries = 1;
//  while(retries <= 1)
//  {
//    retries ++;
//    response = 0;
//    testStep("", "Wait for 500 ms");
//    testWaitForTimeout(500);
//    req.SendRequest();
//    response = TestWaitForDiagRequestSent(req, 2000);
//    if(response != 1)
//    {
//      strncpy(errorMessage, "Failed to send diagnostic request, error code: ", 100);
//      ltoa(response, errorCode, 10);
//      strncat(errorMessage, errorCode, 100);
//      write("%s", errorMessage);
//      continue;
//    }
    
//    response = TestWaitForDiagResponse(req, 2000);
//    if(response != 1)
//    {
//      strncpy(errorMessage, "Failed to receive diagnostic response, error code:  ", 100);
//      ltoa(response, errorCode, 10);
//      strncat(errorMessage, errorCode, 100);
//      write("%s", errorMessage);
//      continue;
//    }
    
//    diagGetLastResponse(resp);
//    response = diagGetResponseCode(resp);
//    if(response != -1)
//    {
//      strncpy(errorMessage, "Diagnostic response error, error code: ", 100);
//      ltoa(response, errorCode, 10);
//      strncat(errorMessage, errorCode, 100);
//      write("%s", errorMessage);
//      continue;
//    }
//    size = 0;
//    size = DiagGetPrimitiveData(resp, primitiveRaw, elCount(primitiveRaw));
//    if(size == 0)
//    {
//      strncpy(errorMessage, "Cannot read primitive data from diagnostic request", 100);
//      write("%s", errorMessage);
//      continue;
//    }
    
//    dataStart = 3;
//    if(strncmp(DID, "F180", elCount(DID)) == 0 || strncmp(DID, "F181", elCount(DID)) == 0 || strncmp(DID, "F182", elCount(DID)) == 0)
//      dataStart ++;
      
//    strncpy(hexString, "", 500);
//    for(i = dataStart; i < size; i++)
//    {
//      snprintf(buffer, 3, "%02x", primitiveRaw[i]);
//      strncat(hexString, buffer, 500);
//      if(i < size-1)
//        strncat(hexString, " ", 500);
//    }
  
//    if(elCount(hexString) == elCount(correctString) && strncmp(hexString, correctString, elCount(hexString)) == 0)
//    {
//      write("", "Diagnostic response matched part numbers");
//      testStepPass("", "%s matches from release notes!\n %s\n==\n%s ", DID, correctString,hexString);
//      break;
//    }
//    else
//    {
//      //strncpy(errorMessage, "Diagnostic response did not match part numbers", 100);
//      //testStepFail("", "%s Does not Match!\n%s\n!=\n%s ", DID, correctString,hexString);
//    }
//  }

//}

export void parsePartNumbers()
{
  long response, retries;
  char batchFileNameWithASpace [250] = "Parse_Excel.bat ";
  char fullCommand [256] = "";
  
  setFilePath(batchFileNameWithASpace,0);
  
  retries = 0;
  strncpy(fullCommand, batchFileNameWithASpace, 256);
  
  testStep("", "Start parsing part numbers");
  response = testWaitForSyscall(batchFileNameWithASpace, fullCommand, 0, 60000);

}

export void PowerSupply_Control(char vtg[])
{
  dword length, port;
  int i, response;
  byte buffer[100];
  
  port = 8;//EAHMSJENKINS33 PC
  
  rs232Open(port);
  length = strlen(vtg); 
  for(i=0;i<=length;i++) { buffer[i]= vtg[i]; }
  response = RS232Send(port,buffer,length);
  RS232Receive(port, buffer, 100);

  if (response != 1 )  { write("Failed to send %s to power supply", vtg); } 
  else { testStepPass("", "Sent command to power supply: %s",vtg); }
}

export Power_Supply_OFF()
{
  PowerSupply_Control("SOUT1\r"); //OFF
}

export Power_Supply_ON()
{
  PowerSupply_Control("SOUT0\r"); //ON
}


export double Power_Supply_Get_Voltage()
{
  double voltage;
 // voltage = Run_Power_Supply_Batch_File("readVoltage");
  
  if(voltage != -1)
  {
    testStepPass("", "Power supply voltage: %.2fV", voltage);
  }
  else
  {
    write("", "Fail to get power supply voltage");
  }
  return voltage;
}

export double Power_Supply_Get_Current()
{
  double current;
 // current = Run_Power_Supply_Batch_File("readCurrent");
  
  if(current != -1)
  {
    testStepPass("", "Power supply current: %.2fA", current);
  }
  else
  {
    write("", "Fail to get power supply current");
  }
  return current;
}

//double Run_Power_Supply_Batch_File(char command[])
//{
//  dword port;
//  long response, retries;
//  char batchFileNameWithASpace[50] = "Power_Supply_Control.bat ";
//  char fullCommand[256] = "";
  
//  response = 0;
//  retries = 0;
//  port = sysGetVariableInt("PowerControl", "port");
//  rs232Close(port);

//  strncpy(fullCommand, batchFileNameWithASpace, 256); 
//  strncat(fullCommand, command, 256);
  
//  while(response != 1 && retries < 3)
//  {
//    testStep("", "start running power control batch file, retries: %d", retries);
//    response = testWaitForSyscall( fullCommand, 0, 60000);
//    retries ++;
//    testWaitForTimeout(5000);
  
//  }
  
//  if(response == 1)
//  {
//    char buffer[64];
//    double value = 0;
//    dword glbHandle = 0;
    
//    //
//    // Opens the file in ASCII mode for read access.
//    //
//    // To determine the absolute path, the search procedure will be used.
//    // The file must be located in the directory of the databases or the
//    // configuration directory.
//    //
//    setFilePath (pythonFolder, 0);
//    glbHandle = OpenFileRead("PSC.txt", 0);

//    if ( glbHandle!=0 )
//    {
//      fileGetStringSZ(buffer,elcount(buffer),glbHandle);
//      value = atodbl (buffer);
//      fileClose (glbHandle);
//      return value;
//    }
//    else
//    {
//      write("File 'PSC.txt' was not opened for read access.");
//      testStepFail("File 'PSC.txt' was not opened for read access.");
//    }
    
//    fileClose(glbHandle);
//  }
//  else
//  {
//    write("failed to finish power supply control, exit code: %d", response);
//    testStepFail(" ", "failed to finish power supply control, exit code: %d", response);
//  }
//  return -1;
//}
void CaptureMCU_2_0()
{
  //Implement a function to call from tera term to have a print out in A72 core.  
  //./ti_fs/vision_apps/vx_app_arm_remote_log.out &
  
}

//export void Run_Init_Port(){
//  Init_Port();
//}

//void Init_Port()
//{
//  // look for power supply port number by calling python script
//  char absPath[256];
//  long response;

//  sysDefineNamespace("PowerControl");
//  sysDefineVariableInt("PowerControl", "port", 999);

//  write("looking for power supply");
//  testStep("", "looking for power supply");
//  response = testWaitForSyscall(pythonFolder, "Check_Port.bat",  0, 60000);

//  if(response == 1)
//  {
//    char buffer[64];
//    dword glbHandle;
//    int port = 8;
      
//    //
//    // Opens the file in ASCII mode for read access.
//    //
//    // To determine the absolute path, the search procedure will be used.
//    // The file must be located in the directory of the databases or the
//    // configuration directory.
//    //
//    setFilePath (pythonFolder, 0);
//    glbHandle = OpenFileRead ("port.txt", 0);
   
//    if ( glbHandle!=0 )
//    {
//      fileGetStringSZ(buffer,elcount(buffer),glbHandle);
//      sysSetVariableInt("PowerControl", "port", atol (buffer));
//      port = sysGetVariableInt("PowerControl", "port");
//      fileClose (glbHandle);
      
//      if (port != 999)
//      {
//        testStepPass("", "Found power supply at COM%d!", port);
//        // Check if the port is avaliable
//        rs232Open(port);
//        if (1 == rs232Configure(port,9600,8,1,0))
//        {
//          write ("Connected COM%d!",port);
//          testStepPass("", "Connected COM%d!",port);
//        }
//        else
//        {
//          write ("Failed to connect to COM%d", port);
//          testStepFail(" ","Failed to connect to COM%d", port);
//        }
//        rs232Close(port);
//      }
//      else
//      {
//        write ("Failed to find power supply port");
//        testStepFail("Failed to find power supply port");
//        rs232Close(port);
//      }
//    }
//    else
//    {
//      write ("File 'port.txt' was not opened for read access.");
//      testStepFail("File 'port.txt' was not opened for read access.");
//      rs232Close(port);
//    }
//  }
//  else
//  {
//    write ("Failed to execute Check_Port.bat, exit code: %d", response);
//    testStepFail(" ","Failed to execute Check_Port.bat, exit code: %d", response);
//  }
//}

//export testcase THA_Sanity()
//{
//  long response;
//  int i;
//  long j;
//  char temp[50];
//  char defaultImageName[50];
//  char timeStampInString[10];
//  diagRequest CVADAS_0001_00000000_000._31011000_USS_Debug_Signals_Enable_Disable_Start req;
//  diagResponse CVADAS_0001_00000000_000._31011000_USS_Debug_Signals_Enable_Disable_Start resp;
//  
//  Enable_CAN_Communication();
//  Check_Both_Can_Messages();
//  Set_Default_Session();
//  Set_Extended_Session();
//  diagSendRequest(req);
//  testWaitForTimeout(3000);
//  response = diagGetResponseCode(resp);
//  if (response == -1)
//  {
//    testStepFail("","NRC on enabling USS debug mode for testing!");
//  }
//  testStep("","Starting testing THA-Trailer Hitch Assist!");
//  Write_Proxy();
//  $GearEngaged = 3;
//  $CmdIgnSts = 4;
//  $FDCAN2::EPS::EPS_FD_2::EPS_SteeringTouq_Resp = 1;
//  $FDCAN2::EPS::EPS_FD_1::LwsCalibration = 1; //calibrated
//  testStep("","Switching to THA view");
//  $TGW_CAMERA_DISP_STAT = 4; //Surround View
//  $CameraDisplaySts2 = 0; //default
//  $FDCAN2::EPS::EPS_FD_2::THA_SteeringTouchStat = 0;
//  $FDCAN2::EPS::EPS_FD_2::THA_SteeringTouchStat = 1;
//  $FDCAN2::EPS::EPS_FD_2::THA_SteeringTouchStat = 0;
//  
//  testWaitForTimeout(2000);
//  Capture_Image("THA_View","1200x900");
//  $TrailerConnectionSts = 0; //Not connected
//  $TrailerConnectionSts = 1;//Connected
//  $ITBM_TrlrStat = 1; //Trailer is present, check gridlines (should disappear)
//  if($DisplayView2 == 0){
//    testStepFail("","HMI View did not change!");
//  }
//  Capture_Image("Trailer_View","1200x900");
//  
//  $TrailerConnectionSts = 0; //not Connected
//  $ITBM_TrlrStat = 0; //Trailer not present
//  teststep("","Check for gridlines after disconnecting Trailer!");
//
//  for (i = 0; i<= 720; i++)
//  {
//    testStep("","LwsAngle is set to: %d",i);
//    $FDCAN14::EPS::EPS_FD_1::LwsAngle = i;
//    i = i + 50;
//    ltoa((long)i, temp, 100);
//    strncat(defaultImageName, temp, 100);
//    Capture_Image(defaultImageName,"1200x900");
//  }
//  for (i = 720; i>= -720; i--)
//  {
//    testStep("","LwsAngle is set to: %d",i);
//    $FDCAN14::EPS::EPS_FD_1::LwsAngle = i;
//    i = i - 50;
//    ltoa((long)i, temp, 100);
//    strncat(defaultImageName, temp, 100);
//    Capture_Image(defaultImageName,"1200x900");
//  }
//  
//  testStep("","DisplayView2 != 0 check");
//  if($DisplayView2 == 0)
//  {
//    testStepFail("","View did not update!");
//  }
//  else{
//  testStepPass();
//  }
//  
//}

export testcase FDF6(int iterations, char path[], int waitTime)
{
  diagRequest CVADAS_0001_00000000_000._22FDF6_RunTimeStatsData_Read req;
  diagResponse CVADAS_0001_00000000_000._22FDF6_RunTimeStatsData_Read resp;
  
  byte response[500];
  char outBuffer[1000];
  char temp[200]; // Temporary buffer for snprintf
  int len;
  dword logFile;
  dword resp_diag;
  int i, j;
  int offset;
  char hex_str[20];
  
  // Declare task name arrays without initialization
  char mcu1_0_tasks[19][50];
  char mcu2_1_tasks[11][50];
  char mcu2_0_tasks[8][50];
  char a_core_tasks[31][50];
  
  // Initialize task names at runtime
  for (j = 0; j < 19; j++) mcu1_0_tasks[j][0] = '\0';
  strncat(mcu1_0_tasks[0], "BootAppOsTask", elcount(mcu1_0_tasks[0]) - 1);
  strncat(mcu1_0_tasks[1], "IdleTask_OsCore0", elcount(mcu1_0_tasks[1]) - 1);
  strncat(mcu1_0_tasks[2], "QM_ComTask_10ms", elcount(mcu1_0_tasks[2]) - 1);
  strncat(mcu1_0_tasks[3], "QM_ComTask_5ms", elcount(mcu1_0_tasks[3]) - 1);
  strncat(mcu1_0_tasks[4], "QM_DiagTask_10ms", elcount(mcu1_0_tasks[4]) - 1);
  strncat(mcu1_0_tasks[5], "QM_MemTask_10ms", elcount(mcu1_0_tasks[5]) - 1);
  strncat(mcu1_0_tasks[6], "QM_Task_00_10ms", elcount(mcu1_0_tasks[6]) - 1);
  strncat(mcu1_0_tasks[7], "QM_Task_01_10ms", elcount(mcu1_0_tasks[7]) - 1);
  strncat(mcu1_0_tasks[8], "QM_Task_200ms", elcount(mcu1_0_tasks[8]) - 1);
  strncat(mcu1_0_tasks[9], "QM_Task_Init", elcount(mcu1_0_tasks[9]) - 1);
  strncat(mcu1_0_tasks[10], "Safety_Task_00_10", elcount(mcu1_0_tasks[10]) - 1);
  strncat(mcu1_0_tasks[11], "Safety_Task_01_10", elcount(mcu1_0_tasks[11]) - 1);
  strncat(mcu1_0_tasks[12], "Safety_Task_200ms", elcount(mcu1_0_tasks[12]) - 1);
  strncat(mcu1_0_tasks[13], "Safety_Task_Init", elcount(mcu1_0_tasks[13]) - 1);
  strncat(mcu1_0_tasks[14], "Safety_WdgTask_10ms", elcount(mcu1_0_tasks[14]) - 1);
  strncat(mcu1_0_tasks[15], "SciServerHighOsTask", elcount(mcu1_0_tasks[15]) - 1);
  strncat(mcu1_0_tasks[16], "SciServerLowOsTask", elcount(mcu1_0_tasks[16]) - 1);
  strncat(mcu1_0_tasks[17], "ShutdownTask", elcount(mcu1_0_tasks[17]) - 1);
  strncat(mcu1_0_tasks[18], "StartUpTask", elcount(mcu1_0_tasks[18]) - 1);
  
  for (j = 0; j < 11; j++) mcu2_1_tasks[j][0] = '\0';
  strncat(mcu2_1_tasks[0], "en_Task_BSW_B_Idle", elcount(mcu2_1_tasks[0]) - 1);
  strncat(mcu2_1_tasks[1], "en_Task_BSW_B_1msec", elcount(mcu2_1_tasks[1]) - 1);
  strncat(mcu2_1_tasks[2], "en_Task_BSW_B_10msec", elcount(mcu2_1_tasks[2]) - 1);
  strncat(mcu2_1_tasks[3], "en_TasK_BSW_QM_10msec", elcount(mcu2_1_tasks[3]) - 1);
  strncat(mcu2_1_tasks[4], "en_TasK_BSW_QM1_10msec", elcount(mcu2_1_tasks[4]) - 1);
  strncat(mcu2_1_tasks[5], "en_Task_BSW_QM_UssCfg", elcount(mcu2_1_tasks[5]) - 1);
  strncat(mcu2_1_tasks[6], "en_Task_en_TasK_BSW_QM_HighPriority_OnEvent", elcount(mcu2_1_tasks[6]) - 1);
  strncat(mcu2_1_tasks[7], "en_Task_APP_B_30msec", elcount(mcu2_1_tasks[7]) - 1);
  strncat(mcu2_1_tasks[8], "en_TasK_APP_QM_30msec", elcount(mcu2_1_tasks[8]) - 1);
  strncat(mcu2_1_tasks[9], "en_Task_SAFETY_APP_50msec", elcount(mcu2_1_tasks[9]) - 1);
  strncat(mcu2_1_tasks[10], "en_TasK_SAFETY_BSW_10msec", elcount(mcu2_1_tasks[10]) - 1);
  
  for (j = 0; j < 8; j++) mcu2_0_tasks[j][0] = '\0';
  strncat(mcu2_0_tasks[0], "en_Task_BSW_B_10msec", elcount(mcu2_0_tasks[0]) - 1);
  strncat(mcu2_0_tasks[1], "en_TasK_BSW_QM_10msec", elcount(mcu2_0_tasks[1]) - 1);
  strncat(mcu2_0_tasks[2], "en_TasK_BSW_QM1_10msec", elcount(mcu2_0_tasks[2]) - 1);
  strncat(mcu2_0_tasks[3], "en_Task_en_TasK_BSW_QM_HighPriority_OnEvent", elcount(mcu2_0_tasks[3]) - 1);
  strncat(mcu2_0_tasks[4], "en_TasK_BSW_QM_TI_10msec", elcount(mcu2_0_tasks[4]) - 1);
  strncat(mcu2_0_tasks[5], "en_Task_APP_B_10msec", elcount(mcu2_0_tasks[5]) - 1);
  strncat(mcu2_0_tasks[6], "en_TasK_APP_QM_10msec", elcount(mcu2_0_tasks[6]) - 1);
  strncat(mcu2_0_tasks[7], "en_Task_APP_B_30msec", elcount(mcu2_0_tasks[7]) - 1);
  
  for (j = 0; j < 31; j++) a_core_tasks[j][0] = '\0';
  strncat(a_core_tasks[0], "APA", elcount(a_core_tasks[0]) - 1);
  strncat(a_core_tasks[1], "CALSM", elcount(a_core_tasks[1]) - 1);
  strncat(a_core_tasks[2], "CALSM_Thread", elcount(a_core_tasks[2]) - 1);
  strncat(a_core_tasks[3], "DLDThread", elcount(a_core_tasks[3]) - 1);
  strncat(a_core_tasks[4], "DLD", elcount(a_core_tasks[4]) - 1);
  strncat(a_core_tasks[5], "EOL", elcount(a_core_tasks[5]) - 1);
  strncat(a_core_tasks[6], "EOLThread", elcount(a_core_tasks[6]) - 1);
  strncat(a_core_tasks[7], "MOT", elcount(a_core_tasks[7]) - 1);
  strncat(a_core_tasks[8], "OC", elcount(a_core_tasks[8]) - 1);
  strncat(a_core_tasks[9], "OCThread", elcount(a_core_tasks[9]) - 1);
  strncat(a_core_tasks[10], "OD", elcount(a_core_tasks[10]) - 1);
  strncat(a_core_tasks[11], "OVL3D", elcount(a_core_tasks[11]) - 1);
  strncat(a_core_tasks[12], "RenderThread", elcount(a_core_tasks[12]) - 1);
  strncat(a_core_tasks[13], "TAD2", elcount(a_core_tasks[13]) - 1);
  strncat(a_core_tasks[14], "TAD2Thread", elcount(a_core_tasks[14]) - 1);
  strncat(a_core_tasks[15], "TIOVX", elcount(a_core_tasks[15]) - 1);
  strncat(a_core_tasks[16], "CameraCalib", elcount(a_core_tasks[16]) - 1);
  strncat(a_core_tasks[17], "VideoInput", elcount(a_core_tasks[17]) - 1);
  strncat(a_core_tasks[18], "AppM", elcount(a_core_tasks[18]) - 1);
  strncat(a_core_tasks[19], "LogM", elcount(a_core_tasks[19]) - 1);
  strncat(a_core_tasks[20], "KeepAlive", elcount(a_core_tasks[20]) - 1);
  strncat(a_core_tasks[21], "ThreadMsgSndr", elcount(a_core_tasks[21]) - 1);
  strncat(a_core_tasks[22], "SigM", elcount(a_core_tasks[22]) - 1);
  strncat(a_core_tasks[23], "ThreadSigM", elcount(a_core_tasks[23]) - 1);
  strncat(a_core_tasks[24], "Sys", elcount(a_core_tasks[24]) - 1);
  strncat(a_core_tasks[25], "SysMon", elcount(a_core_tasks[25]) - 1);
  strncat(a_core_tasks[26], "VarM", elcount(a_core_tasks[26]) - 1);
  strncat(a_core_tasks[27], "AlgoViewThread", elcount(a_core_tasks[27]) - 1);
  strncat(a_core_tasks[28], "InputBuffer", elcount(a_core_tasks[28]) - 1);
  strncat(a_core_tasks[29], "TAD3", elcount(a_core_tasks[29]) - 1);
  strncat(a_core_tasks[30], "TAD3Thread", elcount(a_core_tasks[30]) - 1);
  
  // Validate file path and open file
  setFilePath(path, 1);
  logFile = openFileWrite("RunTimeStats_FDF6.txt", 2); // Use 0 to overwrite for debugging
  if (logFile == 0)
  {
    write("Error: Failed to open file at path %s", path);
    testStepFail("Failed to open log file!");
    return;
  }
  
  for (i = 1; i <= iterations; i++)
  {
    write("Starting iteration %d", i);
    testWaitForTimeout(waitTime); //~2 mins
   
    // Read Runtime stats
    Set_Extended_Session();
    req.SendRequest();
    resp_diag = testWaitForDiagResponse(req, 10000);
    if (resp_diag == 0)
    {
      write("Error: No response for read request");
      testStepFail("RunTime Stats Read - No Response!");
      snprintf(temp, elcount(temp), "Iteration %d: RunTime Stats Read - No Response\n", i);
      filePutString(temp, strlen(temp), logFile);
      fileClose(logFile);
      return;
    }
    diagGetLastResponse(resp);
    resp_diag = diagGetResponseCode(resp);
    write("Read response code: %d", resp_diag);
    if (resp_diag == -1)
    {
      testStepPass("RunTime Stats Read Successful!");
    }
    else
    {
      testStepFail("","RunTime Stats Read Failed! Response code: %d", resp_diag);
      snprintf(temp, elcount(temp), "Iteration %d: RunTime Stats Read Failed, code: %d\n", i, resp_diag);
      filePutString(temp, strlen(temp), logFile);
      fileClose(logFile);
      return;
    }
    
    // Get response data
    len = diagGetPrimitiveData(resp, response, 500);
    write("Response length: %d bytes", len);
    snprintf(temp, elcount(temp), "Iteration %d: Response length = %d bytes\n", i, len);
    filePutString(temp, strlen(temp), logFile);
    
    if (len <= 0)
    {
      write("Error: No data received in response");
      testStepFail("No data in RunTime Stats response!");
      snprintf(temp, elcount(temp), "Iteration %d: No data received\n", i);
      filePutString(temp, strlen(temp), logFile);
      continue; // Skip to next iteration
    }
    
    // Log raw response for debugging
    write("Raw response bytes:");
    for (j = 0; j < len; j++)
    {
      write(" %02X", response[j]);
    }
    
    // Convert byte array to hex string
    outBuffer[0] = 0;
    for (j = 0; j < len; j++)
    {
      char tmpHex[10];
      snprintf(tmpHex, elcount(tmpHex), "%02X ", response[j]);
      strncat(outBuffer, tmpHex, elcount(outBuffer) - strlen(outBuffer) - 1);
      if ((j + 1) % 16 == 0)
      {
        strncat(outBuffer, "\n", elcount(outBuffer) - strlen(outBuffer) - 1);
      }
    }
    
    // Log hex to test report and file
    testStepPass("RunTimeStats (Hex)", "%s", outBuffer);
    snprintf(temp, elcount(temp), "Iteration %d: RunTimeStats Hex Data:\n%s\n", i, outBuffer);
    filePutString(temp, strlen(temp), logFile);
    
    // Parse and log physical values (improved parsing)
    if (len < 298) // Minimum expected length for all sections
    {
      snprintf(temp, elcount(temp), "Warning: Response too short for full parsing (%d bytes)\n", len);
      filePutString(temp, strlen(temp), logFile);
    }
    
    offset = 3;
    
    // MCU1_0 section: 19 tasks, 4 bytes each, divisor 100.0
    snprintf(temp, elcount(temp), "Rx\t    MCU1_0\t    ");
    filePutString(temp, strlen(temp), logFile);
    for (j = 0; j < 76 && offset + j < len; j++) // 19*4=76 bytes
    {
      snprintf(temp, elcount(temp), "0x%02X ", response[offset + j]);
      filePutString(temp, strlen(temp), logFile);
      if ((j + 1) % 20 == 0 || j == 75)
      {
        snprintf(temp, elcount(temp), "\n");
        filePutString(temp, strlen(temp), logFile);
        if (j < 75)
        {
          snprintf(temp, elcount(temp), "Rx\t\t    ");
          filePutString(temp, strlen(temp), logFile);
        }
      }
    }
    for (j = 0; j < 19 && offset + 4 <= len; j++)
    {
      long period_val;
      long time_val;
      float period;
      float avg_time;
      period_val = (response[offset] << 8) | response[offset + 1];
      time_val = (response[offset + 2] << 8) | response[offset + 3];
      period = (float)period_val / 100.0;
      avg_time = (float)time_val / 100.0;
      hex_str[0] = '\0'; // Initialize
      if (period_val == 0 && time_val == 0)
      {
        strncat(hex_str, "0x00", elcount(hex_str) - strlen(hex_str) - 1);
      }
      else
      {
        char tmpHexPart[20];
        snprintf(tmpHexPart, elcount(tmpHexPart), "%02X%02X%02X%02X", response[offset], response[offset+1], response[offset+2], response[offset+3]);
        strncat(hex_str, "0x", elcount(hex_str) - strlen(hex_str) - 1);
        strncat(hex_str, tmpHexPart, elcount(hex_str) - strlen(hex_str) - 1);
      }
      snprintf(temp, elcount(temp), "Rx\t    %s\t    %s\n", mcu1_0_tasks[j], hex_str);
      filePutString(temp, strlen(temp), logFile);
      snprintf(temp, elcount(temp), "Rx\t    %s .AverageTime\t    %.2f [ms]\n", mcu1_0_tasks[j], avg_time);
      filePutString(temp, strlen(temp), logFile);
      snprintf(temp, elcount(temp), "Rx\t    %s .Average Periodicity\t    %.2f [ms]\n", mcu1_0_tasks[j], period);
      filePutString(temp, strlen(temp), logFile);
      offset += 4;
    }
    
    // MCU2_1 section: 11 tasks, 6 bytes each, divisor 1000.0
    snprintf(temp, elcount(temp), "Rx\t    MCU2_1\t    ");
    filePutString(temp, strlen(temp), logFile);
    for (j = 0; j < 66 && offset + j < len; j++)
    {
      snprintf(temp, elcount(temp), "0x%02X ", response[offset + j]);
      filePutString(temp, strlen(temp), logFile);
      if ((j + 1) % 20 == 0 || j == 65)
      {
        snprintf(temp, elcount(temp), "\n");
        filePutString(temp, strlen(temp), logFile);
        if (j < 65)
        {
          snprintf(temp, elcount(temp), "Rx\t\t    ");
          filePutString(temp, strlen(temp), logFile);
        }
      }
    }
    for (j = 0; j < 11 && offset + 6 <= len; j++)
    {
      long period_val;
      long time_val;
      float period;
      float avg_time;
      period_val = (response[offset] << 16) | (response[offset + 1] << 8) | response[offset + 2];
      time_val = (response[offset + 3] << 16) | (response[offset + 4] << 8) | response[offset + 5];
      avg_time = (float)time_val / 1000.0;
      period = (float)period_val / 1000.0;
      hex_str[0] = '\0'; // Initialize
      if (period_val == 0 && time_val == 0)
      {
        strncat(hex_str, "0x00", elcount(hex_str) - strlen(hex_str) - 1);
      }
      else
      {
        char tmpHexPart[30];
        snprintf(tmpHexPart, elcount(tmpHexPart), "%02X %02X %02X %02X %02X %02X", 
                 response[offset], response[offset+1], response[offset+2], 
                 response[offset+3], response[offset+4], response[offset+5]);
        //strncat(hex_str, "0x", elcount(hex_str) - strlen(hex_str) - 1);
        //strncat(hex_str, tmpHexPart, elcount(hex_str) - strlen(hex_str) - 1);
        snprintf(hex_str, elcount(hex_str), "0x%s", tmpHexPart);
      }
      snprintf(temp, elcount(temp), "Rx\t    %s\t    %s\n", mcu2_1_tasks[j], hex_str);
      filePutString(temp, strlen(temp), logFile);
      snprintf(temp, elcount(temp), "Rx\t    %s .AverageTime\t    %.3f [ms]\n", mcu2_1_tasks[j], avg_time); // Use %.3f for more precision as in log
      filePutString(temp, strlen(temp), logFile);
      snprintf(temp, elcount(temp), "Rx\t    %s .Average Periodicity\t    %.3f [ms]\n", mcu2_1_tasks[j], period);
      filePutString(temp, strlen(temp), logFile);
      offset += 6;
    }
    //offset += 3;
    // MCU2_0 section: 8 tasks, 4 bytes each, divisor 100.0
    snprintf(temp, elcount(temp), "Rx\t    MCU2_0\t    ");
    filePutString(temp, strlen(temp), logFile);
    for (j = 0; j < 32 && offset + j < len; j++)
    {
      snprintf(temp, elcount(temp), "0x%02X ", response[offset + j]);
      filePutString(temp, strlen(temp), logFile);
      if ((j + 1) % 20 == 0 || j == 31)
      {
        snprintf(temp, elcount(temp), "\n");
        filePutString(temp, strlen(temp), logFile);
        if (j < 31)
        {
          snprintf(temp, elcount(temp), "Rx\t\t    ");
          filePutString(temp, strlen(temp), logFile);
        }
      }
    }
    for (j = 0; j < 8 && offset + 4 <= len; j++)
    {
      long period_val;
      long time_val;
      float period;
      float avg_time;
      period_val = (response[offset] << 8) | response[offset + 1];
      time_val = (response[offset + 2] << 8) | response[offset + 3];
      avg_time = (float)time_val / 100.0;
      period = (float)period_val / 100.0;
      hex_str[0] = '\0'; // Initialize
      if (period_val == 0 && time_val == 0)
      {
        strncat(hex_str, "0x00", elcount(hex_str) - strlen(hex_str) - 1);
      }
      else
      {
        char tmpHexPart[20];
        snprintf(tmpHexPart, elcount(tmpHexPart), "%02X%02X%02X%02X", response[offset], response[offset+1], response[offset+2], response[offset+3]);
        strncat(hex_str, "0x", elcount(hex_str) - strlen(hex_str) - 1);
        strncat(hex_str, tmpHexPart, elcount(hex_str) - strlen(hex_str) - 1);
      }
      snprintf(temp, elcount(temp), "Rx\t    %s\t    %s\n", mcu2_0_tasks[j], hex_str);
      filePutString(temp, strlen(temp), logFile);
      snprintf(temp, elcount(temp), "Rx\t    %s .AverageTime\t    %.2f [ms]\n", mcu2_0_tasks[j], avg_time);
      filePutString(temp, strlen(temp), logFile);
      snprintf(temp, elcount(temp), "Rx\t    %s .Average Periodicity\t    %.2f [ms]\n", mcu2_0_tasks[j], period);
      filePutString(temp, strlen(temp), logFile);
      offset += 4;
    }
    
    // A CORE section: 31 tasks, 4 bytes each, divisor 100.0 (all zero in example)
    snprintf(temp, elcount(temp), "Rx\t    A CORE\t    ");
    filePutString(temp, strlen(temp), logFile);
    for (j = 0; j < 124 && offset + j < len; j++)
    {
      snprintf(temp, elcount(temp), "0x%02X ", response[offset + j]);
      filePutString(temp, strlen(temp), logFile);
      if ((j + 1) % 20 == 0 || j == 123)
      {
        snprintf(temp, elcount(temp), "\n");
        filePutString(temp, strlen(temp), logFile);
        if (j < 123)
        {
          snprintf(temp, elcount(temp), "Rx\t\t    ");
          filePutString(temp, strlen(temp), logFile);
        }
      }
    }
    for (j = 0; j < 31 && offset + 4 <= len; j++)
    {
      long period_val;
      long time_val;
      float period;
      float avg_time;
      period_val = (response[offset] << 8) | response[offset + 1];
      time_val = (response[offset + 2] << 8) | response[offset + 3];
      period = (float)period_val / 100.0;
      avg_time = (float)time_val / 100.0;
      hex_str[0] = '\0'; // Initialize
      if (period_val == 0 && time_val == 0)
      {
        strncat(hex_str, "0x00", elcount(hex_str) - strlen(hex_str) - 1);
      }
      else
      {
        char tmpHexPart[20];
        snprintf(tmpHexPart, elcount(tmpHexPart), "%02X%02X%02X%02X", response[offset], response[offset+1], response[offset+2], response[offset+3]);
        strncat(hex_str, "0x", elcount(hex_str) - strlen(hex_str) - 1);
        strncat(hex_str, tmpHexPart, elcount(hex_str) - strlen(hex_str) - 1);
      }
      snprintf(temp, elcount(temp), "Rx\t    %s\t    %s\n", a_core_tasks[j], hex_str);
      filePutString(temp, strlen(temp), logFile);
      snprintf(temp, elcount(temp), "Rx\t    %s .AverageTime\t    %.2f [ms]\n", a_core_tasks[j], avg_time);
      filePutString(temp, strlen(temp), logFile);
      snprintf(temp, elcount(temp), "Rx\t    %s .Average Periodicity\t    %.2f [ms]\n", a_core_tasks[j], period);
      filePutString(temp, strlen(temp), logFile);
      offset += 4;
    }
  }
  fileClose(logFile);
}

export testcase FDF8(int iterations, char path[], int waitTime)
{
  diagRequest CVADAS_0001_00000000_000._22FDF8_StackUsage_Read req;
  diagResponse CVADAS_0001_00000000_000._22FDF8_StackUsage_Read resp;
  
  byte response[500];
  char outBuffer[1000];
  char temp[200];
  int len;
  dword logFile;
  dword resp_diag;
  int i, j;
  int offset;
  int stack_usage = 0;
  int mcu1_0_values[19];
  int mcu2_1_values[10];
  int mcu2_0_values[8];
  
  // Declare task name arrays in ORIGINAL ORDER (as data comes in)
  char mcu1_0_tasks[19][50];
  char mcu2_1_tasks[10][50];
  char mcu2_0_tasks[8][50];
  
  // Initialize MCU1_0 task names (ORIGINAL ORDER - matches data order)
  for (j = 0; j < 19; j++) mcu1_0_tasks[j][0] = '\0';
  strncat(mcu1_0_tasks[0], "MCU1_0.StartUpTask", elcount(mcu1_0_tasks[0]) - 1);
  strncat(mcu1_0_tasks[1], "MCU1_0.ShutdownTask", elcount(mcu1_0_tasks[1]) - 1);
  strncat(mcu1_0_tasks[2], "MCU1_0.SciServerLowOsTask", elcount(mcu1_0_tasks[2]) - 1);
  strncat(mcu1_0_tasks[3], "MCU1_0.SciServerHighOsTask", elcount(mcu1_0_tasks[3]) - 1);
  strncat(mcu1_0_tasks[4], "MCU1_0.Safety_WdgTask_10ms", elcount(mcu1_0_tasks[4]) - 1);
  strncat(mcu1_0_tasks[5], "MCU1_0.Safety_Task_Init", elcount(mcu1_0_tasks[5]) - 1);
  strncat(mcu1_0_tasks[6], "MCU1_0.Safety_Task_200ms", elcount(mcu1_0_tasks[6]) - 1);
  strncat(mcu1_0_tasks[7], "MCU1_0.Safety_Task_01_10", elcount(mcu1_0_tasks[7]) - 1);
  strncat(mcu1_0_tasks[8], "MCU1_0.Safety_Task_00_10", elcount(mcu1_0_tasks[8]) - 1);
  strncat(mcu1_0_tasks[9], "MCU1_0.QM_Task_Init", elcount(mcu1_0_tasks[9]) - 1);
  strncat(mcu1_0_tasks[10], "MCU1_0.QM_Task_200ms", elcount(mcu1_0_tasks[10]) - 1);
  strncat(mcu1_0_tasks[11], "MCU1_0.QM_Task_01_10ms", elcount(mcu1_0_tasks[11]) - 1);
  strncat(mcu1_0_tasks[12], "MCU1_0.QM_Task_00_10ms", elcount(mcu1_0_tasks[12]) - 1);
  strncat(mcu1_0_tasks[13], "MCU1_0.QM_MemTask_10ms", elcount(mcu1_0_tasks[13]) - 1);
  strncat(mcu1_0_tasks[14], "MCU1_0.QM_DiagTask_10ms", elcount(mcu1_0_tasks[14]) - 1);
  strncat(mcu1_0_tasks[15], "MCU1_0.QM_ComTask_5ms", elcount(mcu1_0_tasks[15]) - 1);
  strncat(mcu1_0_tasks[16], "MCU1_0.QM_ComTask_10ms", elcount(mcu1_0_tasks[16]) - 1);
  strncat(mcu1_0_tasks[17], "MCU1_0.IdleTask_OsCore0", elcount(mcu1_0_tasks[17]) - 1);
  strncat(mcu1_0_tasks[18], "MCU1_0.BootAppOsTask", elcount(mcu1_0_tasks[18]) - 1);
  
  // Initialize MCU2_1 task names (ORIGINAL ORDER - matches data order)
  for (j = 0; j < 10; j++) mcu2_1_tasks[j][0] = '\0';
  strncat(mcu2_1_tasks[0], "MCU2_1.en_TasK_SAFETY_BSW_10msec", elcount(mcu2_1_tasks[0]) - 1);
  strncat(mcu2_1_tasks[1], "MCU2_1.en_Task_SAFETY_APP_50msec", elcount(mcu2_1_tasks[1]) - 1);
  strncat(mcu2_1_tasks[2], "MCU2_1.en_TasK_APP_QM_10msec", elcount(mcu2_1_tasks[2]) - 1);
  strncat(mcu2_1_tasks[3], "MCU2_1.en_Task_APP_B_10msec", elcount(mcu2_1_tasks[3]) - 1);
  strncat(mcu2_1_tasks[4], "MCU2_1.en_Task_en_TasK_BSW_QM_HighPriority_OnEvent", elcount(mcu2_1_tasks[4]) - 1);
  strncat(mcu2_1_tasks[5], "MCU2_1.en_TasK_BSW_QM1_10msec", elcount(mcu2_1_tasks[5]) - 1);
  strncat(mcu2_1_tasks[6], "MCU2_1.en_TasK_BSW_QM_10msec", elcount(mcu2_1_tasks[6]) - 1);
  strncat(mcu2_1_tasks[7], "MCU2_1.en_Task_BSW_B_10msec", elcount(mcu2_1_tasks[7]) - 1);
  strncat(mcu2_1_tasks[8], "MCU2_1.en_Task_BSW_B_1msec", elcount(mcu2_1_tasks[8]) - 1);
  strncat(mcu2_1_tasks[9], "MCU2_1.en_Task_BSW_B_Idle", elcount(mcu2_1_tasks[9]) - 1);
  
  // Initialize MCU2_0 task names (ORIGINAL ORDER - matches data order)
  for (j = 0; j < 8; j++) mcu2_0_tasks[j][0] = '\0';
  strncat(mcu2_0_tasks[0], "MCU2_0.en_Task_APP_B_30msec", elcount(mcu2_0_tasks[0]) - 1);
  strncat(mcu2_0_tasks[1], "MCU2_0.en_TasK_APP_QM_10msec", elcount(mcu2_0_tasks[1]) - 1);
  strncat(mcu2_0_tasks[2], "MCU2_0.en_Task_APP_B_10msec", elcount(mcu2_0_tasks[2]) - 1);
  strncat(mcu2_0_tasks[3], "MCU2_0.en_TasK_BSW_QM_TI_10msec", elcount(mcu2_0_tasks[3]) - 1);
  strncat(mcu2_0_tasks[4], "MCU2_0.en_Task_en_TasK_BSW_QM_HighPriority_OnEvent", elcount(mcu2_0_tasks[4]) - 1);
  strncat(mcu2_0_tasks[5], "MCU2_0.en_TasK_BSW_QM1_10msec", elcount(mcu2_0_tasks[5]) - 1);
  strncat(mcu2_0_tasks[6], "MCU2_0.en_TasK_BSW_QM_10msec", elcount(mcu2_0_tasks[6]) - 1);
  strncat(mcu2_0_tasks[7], "MCU2_0.en_Task_BSW_B_10msec", elcount(mcu2_0_tasks[7]) - 1);
  
  // Validate file path and open file
  setFilePath(path, 1);
  logFile = openFileWrite("StackUsage_FDF8.txt", 2);
  if (logFile == 0)
  {
    write("Error: Failed to open file at path %s", path);
    testStepFail("Failed to open log file!");
    return;
  }
  
  for (i = 1; i <= iterations; i++)
  {
    write("Starting iteration %d", i);
    
    offset = 3;  // Reset to skip positive response (0x62 0xFD 0xF8) for each iteration
    
    if (i > 1 && waitTime > 0)
    {
      testWaitForTimeout(waitTime);
    }
   
    // Read Stack Usage
    Set_Extended_Session();
    req.SendRequest();
    resp_diag = testWaitForDiagResponse(req, 10000);
    if (resp_diag == 0)
    {
      write("Error: No response for read request");
      testStepFail("Stack Usage Read - No Response!");
      snprintf(temp, elcount(temp), "Iteration %d: Stack Usage Read - No Response\n", i);
      filePutString(temp, strlen(temp), logFile);
      continue;
    }
    
    diagGetLastResponse(resp);
    resp_diag = diagGetResponseCode(resp);
    write("Read response code: %d", resp_diag);
    
    if (resp_diag == -1)
    {
      testStepPass("Stack Usage Read Successful!");
    }
    else
    {
      testStepFail("","Stack Usage Read Failed! Response code: %d", resp_diag);
      snprintf(temp, elcount(temp), "Iteration %d: Stack Usage Read Failed, code: %d\n", i, resp_diag);
      filePutString(temp, strlen(temp), logFile);
      continue;
    }
    
    // Get response data
    len = diagGetPrimitiveData(resp, response, 500);
    write("Response length: %d bytes", len);
    snprintf(temp, elcount(temp), "Iteration %d: Response length = %d bytes\n", i, len);
    filePutString(temp, strlen(temp), logFile);
    
    if (len <= 0)
    {
      write("Error: No data received in response");
      testStepFail("No data in Stack Usage response!");
      snprintf(temp, elcount(temp), "Iteration %d: No data received\n", i);
      filePutString(temp, strlen(temp), logFile);
      continue;
    }
    
    // Convert byte array to hex string
    outBuffer[0] = 0;
    for (j = 0; j < len; j++)
    {
      char tmpHex[10];
      snprintf(tmpHex, elcount(tmpHex), "%02X ", response[j]);
      strncat(outBuffer, tmpHex, elcount(outBuffer) - strlen(outBuffer) - 1);
      if ((j + 1) % 16 == 0)
      {
        strncat(outBuffer, "\n", elcount(outBuffer) - strlen(outBuffer) - 1);
      }
    }
    
    // Log hex to test report and file
    testStepPass("StackUsage (Hex)", "%s", outBuffer);
    snprintf(temp, elcount(temp), "Iteration %d: StackUsage Hex Data:\n%s\n", i, outBuffer);
    filePutString(temp, strlen(temp), logFile);
    
    // Parse and log stack usage values - SIMPLE APPROACH
    if (len < 37)
    {
      snprintf(temp, elcount(temp), "Warning: Response too short for full parsing (%d bytes)\n", len);
      filePutString(temp, strlen(temp), logFile);
    }
    
    // MCU1_0 section: Parse data in ORIGINAL ORDER but STORE for later
    
    snprintf(temp, elcount(temp), "Rx\t    MCU1_0\t    ");
    filePutString(temp, strlen(temp), logFile);
    for (j = 0; j < 19 && offset + j < len; j++)
    {
      mcu1_0_values[j] = response[offset + j];
      snprintf(temp, elcount(temp), "0x%02X ", response[offset + j]);
      filePutString(temp, strlen(temp), logFile);
      if ((j + 1) % 16 == 0 && j < 18)
      {
        snprintf(temp, elcount(temp), "\nRx\t\t    ");
        filePutString(temp, strlen(temp), logFile);
      }
    }
    snprintf(temp, elcount(temp), "\n");
    filePutString(temp, strlen(temp), logFile);
    
    // NOW PRINT MCU1_0 IN REVERSE ORDER (from last task to first)
    for (j = 18; j >= 0; j--)
    {
      snprintf(temp, elcount(temp), "Rx\t    %s\t    %d [%%]\n", mcu1_0_tasks[j], mcu1_0_values[j]);
      filePutString(temp, strlen(temp), logFile);
    }
    offset += 19;
    snprintf(temp, elcount(temp), "\n");
    filePutString(temp, strlen(temp), logFile);
    
    // MCU2_1 section: Parse data in ORIGINAL ORDER but STORE for later
    
    snprintf(temp, elcount(temp), "Rx\t    MCU2_1\t    ");
    filePutString(temp, strlen(temp), logFile);
    for (j = 0; j < 10 && offset + j < len; j++)
    {
      mcu2_1_values[j] = response[offset + j];
      snprintf(temp, elcount(temp), "0x%02X ", response[offset + j]);
      filePutString(temp, strlen(temp), logFile);
    }
    snprintf(temp, elcount(temp), "\n");
    filePutString(temp, strlen(temp), logFile);
    
    // NOW PRINT MCU2_1 IN REVERSE ORDER (from last task to first)
    for (j = 9; j >= 0; j--)
    {
      snprintf(temp, elcount(temp), "Rx\t    %s\t    %d [%%]\n", mcu2_1_tasks[j], mcu2_1_values[j]);
      filePutString(temp, strlen(temp), logFile);
    }
    offset += 10;
    snprintf(temp, elcount(temp), "\n");
    filePutString(temp, strlen(temp), logFile);
    
    // MCU2_0 section: Parse data in ORIGINAL ORDER but STORE for later
    
    snprintf(temp, elcount(temp), "Rx\t    MCU2_0\t    ");
    filePutString(temp, strlen(temp), logFile);
    for (j = 0; j < 8 && offset + j < len; j++)
    {
      mcu2_0_values[j] = response[offset + j];
      snprintf(temp, elcount(temp), "0x%02X ", response[offset + j]);
      filePutString(temp, strlen(temp), logFile);
    }
    snprintf(temp, elcount(temp), "\n");
    filePutString(temp, strlen(temp), logFile);
    
    // NOW PRINT MCU2_0 IN REVERSE ORDER (from last task to first)
    for (j = 7; j >= 0; j--)
    {
      snprintf(temp, elcount(temp), "Rx\t    %s\t    %d [%%]\n", mcu2_0_tasks[j], mcu2_0_values[j]);
      filePutString(temp, strlen(temp), logFile);
    }
    offset += 8;
    snprintf(temp, elcount(temp), "\n");
    filePutString(temp, strlen(temp), logFile);
  }
  
  fileClose(logFile);
  testStepPass("Stack Usage test completed successfully");
}

void appendToString(char dest[], char src[], int destSize)
{
  char temp[5000];
  snprintf(temp, elcount(temp), "%s%s", dest, src);
  snprintf(dest, destSize, "%s", temp);
}

export testcase Stack_Usage_MCU2_1(int iterations, char command[], char path[])
{
  long SecureUnlock, MCU2_0_resp;
  int i = 0;
  
  setFilePath(path, 1);
  testStep("","%s from %s", command, path);
  for (i = 1; i <= iterations; i++)
  {
    SecureUnlock = testWaitForSyscall(path,"python SecureUnlock.py", 0, 35000);
    if(SecureUnlock == 1)
    {
      testWaitForTimeout(10000);
    }
    else
    {
      testStepFail("ECU did not Unlock!");
    }
    MCU2_0_resp = testWaitForSyscall(path, command, 0, 600000);
  
    if (MCU2_0_resp !=1 )
    {
      testStepFail("","Failed to retieve cpu load data from MCU2_0 core!");
    }
    else
    {
      testStepPass();
    }
  }
}

export testcase CPU_Load_Test_MCU2_0(int iterations, char command[], char path[])
{
  long SecureUnlock, MCU2_0_resp;
  int i = 0;

  setFilePath(path, 1);
  testStep("","%s from %s", command, path);
  for (i = 1; i <= iterations; i++)
  {
    SecureUnlock = testWaitForSyscall(path,"python SecureUnlock.py", 0, 35000);
    if(SecureUnlock == 1)
    {
      testWaitForTimeout(10000);
    }
    else
    {
      testStepFail("ECU did not Unlock!");
    }
    MCU2_0_resp = testWaitForSyscall(path, command, 0, 600000);
  
    if (MCU2_0_resp == 2 )
    {
      testStepFail("","Failed to retieve cpu load data from MCU2_0 core!");
    }
    else
    {
      testStepPass();
    }
  }
}

export testcase CPU_Load_Test_MCU2_1(int iterations, char command[], char path[])
{
  long SecureUnlock, MCU2_1_resp;
  int i =0;
  setFilePath(path, 1);
  testStep("","%s from %s", command, path);
  for (i = 1; i <=iterations; i++)
  {
    SecureUnlock = testWaitForSyscall(path,"python SecureUnlock.py", 0, 35000);
    if(SecureUnlock == 1)
    {
      testWaitForTimeout(10000);
    }
    else
    {
      testStepFail("ECU did not Unlock!");
    }
    MCU2_1_resp = testWaitForSyscall(path, command, 0, 600000);
  
    if (MCU2_1_resp == 2 )
    {
      testStepFail("","Failed to retieve cpu load data from MCU2_1 core!");
    }
    else
    {
      testStepPass();
    }
  }
}



void SendTop()
{
  //TODO:  create a function to send top command for 3 iterations on serial com port of A72 core
  //Command to send is:  top -z 40 -t -i3
}

