/* !Encoding: 65001  */
includes
{
  #include "__DiagLibrary.cin"
  #include "__VariablesLib.cin"
  #include "__CaplGeneratorLib.cin"
  #include "__CANoeReportFuntionsLib.cin"
}

variables
{
  // Global variables defined within this CAPL file
}

void Tto7rkndv_Tet_TtInit()
{
  stack long __tableHandle;
}

void Tto7rkndv_Tet_Tc0()
{
  CreateTTEIFFunction("Tto7rkndv_Tc0", __eTcDef, __eLocal);  
  AddIFParameterTestCaseAttribute("TC_ID", "");
  AddIFParameterTestCaseAttribute("Test Case ID", "");
  CallInterfaceFunction("Enable_RuntimeStats_And_StackUsage", __cEmpty , __cEmpty );
}
testcase Tto7rkndv_Tc0()
{
  stack long __tableHandle;
  SetBreakOnFail(1);

  TestCommandBegin(__eDiagService, __cDiagService, "", "0");
  {
    if (DiagIsFunctionalGroup("CVADAS_0001_00000000_000"))
    {
      DiagResponse * __resp;
      DiagRequest CVADAS_0001_00000000_000._2EFDF5_PerformanceStatEnable_Write __req;
      __diagServiceo7rkndv_0(__req, __resp);
    }
    else
    {
      DiagResponse CVADAS_0001_00000000_000.* __resp;
      DiagRequest CVADAS_0001_00000000_000._2EFDF5_PerformanceStatEnable_Write __req;
      __diagServiceo7rkndv_0(__req, __resp);
    }
  }
  TestCommandEnd();


  TestCommandBegin(__eWait, __cWait, "", "1");
  {
    Wait("1", (1 * 1000000000LL), 1000000000, "");
  }
  TestCommandEnd();

  TestCommandBegin(__eDiagService, __cDiagService, "", "2");
  {
    if (DiagIsFunctionalGroup("CVADAS_0001_00000000_000"))
    {
      DiagResponse * __resp;
      DiagRequest CVADAS_0001_00000000_000._22FDF6_RunTimeStatsData_Read __req;
      __diagServiceo7rkndv_1(__req, __resp);
    }
    else
    {
      DiagResponse CVADAS_0001_00000000_000.* __resp;
      DiagRequest CVADAS_0001_00000000_000._22FDF6_RunTimeStatsData_Read __req;
      __diagServiceo7rkndv_1(__req, __resp);
    }
  }
  TestCommandEnd();


  TestCommandBegin(__eWait, __cWait, "", "3");
  {
    Wait("1", (1 * 1000000000LL), 1000000000, "");
  }
  TestCommandEnd();

  TestCommandBegin(__eDiagService, __cDiagService, "", "4");
  {
    if (DiagIsFunctionalGroup("CVADAS_0001_00000000_000"))
    {
      DiagResponse * __resp;
      DiagRequest CVADAS_0001_00000000_000._22FDF8_StackUsage_Read __req;
      __diagServiceo7rkndv_2(__req, __resp);
    }
    else
    {
      DiagResponse CVADAS_0001_00000000_000.* __resp;
      DiagRequest CVADAS_0001_00000000_000._22FDF8_StackUsage_Read __req;
      __diagServiceo7rkndv_2(__req, __resp);
    }
  }
  TestCommandEnd();


}

  
void __diagServiceo7rkndv_0(DiagRequest * __req, DiagResponse * __resp )
{
  stack long __tableHandle;
  long __res, __paramLen, __bytePos;

   __bVerdict = __eVerdictPass;

  do {
    TestReportResetDiagObjectList();
    DiagSetReportDetailLevel("CVADAS_0001_00000000_000", EnumServiceDetails_onfail);
    // Request aspect
    {
      {
        __res = DiagSetParameterErrorHandled(__req, "RunTimeStat", "Enable");
        if(__res < 0)
        {
          __bVerdict = __eVerdictFail;
          DiagErrCodeTestStep(__res, "Cannot set diagnostic parameter 'RunTimeStat'");
          break;
        }
      }
      {
        __res = DiagSetParameterErrorHandled(__req, "StackUsageStat", "Enable");
        if(__res < 0)
        {
          __bVerdict = __eVerdictFail;
          DiagErrCodeTestStep(__res, "Cannot set diagnostic parameter 'StackUsageStat'");
          break;
        }
      }

      if (0 >= DiagSendReqAndWaitForResp("CVADAS_0001_00000000_000", __req, __resp, __res, -1, -1, -1, -1, -1, EnumResult_pos, EnumServiceDetails_onfail, EnumSendingMode_physical, EnumSuppressPosResBit_asconfigured, EnumVerdictOnInvalidValues_fail))
        break;
    }

    __res = DiagErrCodeTestStep(__res, "Can't retrieve last response for request! No check possible.") < 0;
    if(__res)
    {
	  __bVerdict = __eVerdictFail;
      break;
    }
    {
      __res = DiagInterpretAs(__resp, "WDBI_PR");
      if(__res != 0)
      {
        __bVerdict = __eVerdictFail;
        DiagErrCodeTestStep(__res, "Can't interpret response as diagnostic primitive 'WDBI_PR'.");
        break;
      }
      else
      {
        TestStepPass( "Received primitive can be interpreted as diagnostic primitive 'WDBI_PR'.");
      }
    }
  }
  while(0);


  // Response, check & read aspect
  {
    __res = 1;
    __tableHandle = ReportTableHead5Columns(__cCheckCaption, __cTSym, __cTOp, __cRefVal, __cActual, __cRes);
    {
      DiagGetParameterErrorHandled(__resp, "RecordDataIdentifier", __bDiagValueArray, elcount(__bDiagValueArray), __cDiagValueArray, elcount(__cDiagValueArray));
      {
        __bSetInCheckAlignment = 1;	
        CheckCaplGenVarStringBufferConsistency(__cDiagValueArray, 8192);
        snprintf(__cArray, 8192, "%s", __cDiagValueArray);
        {
          sysvar * __systemVariable;
          __systemVariable = sysvarString::`RunTimeStats::`RunTimeStats_Str;
          CheckSysVarSetBufferConsistency(sysSetVariableString(sysvarString::`RunTimeStats::`RunTimeStats_Str, __cArray), __systemVariable.name);
        }
        snprintf(__cArray2, 8192, "%s", "RunTimeStats_Str");
        snprintf(__cArray3, 8192, "%s '%s'", __cSysVar, __cArray2);
        snprintf(__cArray4, 8192, "%s", "RecordDataIdentifier");
        
        ReportTableRow(__tableHandle, 0, __cArray3, __cAOp, __cArray, __cArray4, __oneOfFlag, __bSetInCheckAlignment);
        
    
        __bSetInCheckAlignment = 0;
      }
    }
    ReportTableEndVerdict(__tableHandle, __cEvaluateResponse, __res);
	__bVerdict = __bVerdict && __res;
  }
  if (__bVerdict == __eVerdictFail)
    TestReportWriteDiagObjectList();
}
  
void __diagServiceo7rkndv_1(DiagRequest * __req, DiagResponse * __resp )
{
  stack long __tableHandle;
  long __res, __paramLen, __bytePos;

   __bVerdict = __eVerdictPass;

  do {
    TestReportResetDiagObjectList();
    DiagSetReportDetailLevel("CVADAS_0001_00000000_000", EnumServiceDetails_always);
    // Request aspect
    {

      if (0 >= DiagSendReqAndWaitForResp("CVADAS_0001_00000000_000", __req, __resp, __res, -1, -1, -1, -1, -1, EnumResult_pos, EnumServiceDetails_always, EnumSendingMode_physical, EnumSuppressPosResBit_asconfigured, EnumVerdictOnInvalidValues_fail))
        break;
    }

    __res = DiagErrCodeTestStep(__res, "Can't retrieve last response for request! No check possible.") < 0;
    if(__res)
    {
	  __bVerdict = __eVerdictFail;
      break;
    }
    {
      __res = DiagInterpretAs(__resp, "RDBI_PR");
      if(__res != 0)
      {
        __bVerdict = __eVerdictFail;
        DiagErrCodeTestStep(__res, "Can't interpret response as diagnostic primitive 'RDBI_PR'.");
        break;
      }
      else
      {
        TestStepPass( "Received primitive can be interpreted as diagnostic primitive 'RDBI_PR'.");
      }
    }
  }
  while(0);


  if (__bVerdict == __eVerdictFail)
    TestReportWriteDiagObjectList();
}
  
void __diagServiceo7rkndv_2(DiagRequest * __req, DiagResponse * __resp )
{
  stack long __tableHandle;
  long __res, __paramLen, __bytePos;

   __bVerdict = __eVerdictPass;

  do {
    TestReportResetDiagObjectList();
    DiagSetReportDetailLevel("CVADAS_0001_00000000_000", EnumServiceDetails_always);
    // Request aspect
    {

      if (0 >= DiagSendReqAndWaitForResp("CVADAS_0001_00000000_000", __req, __resp, __res, -1, -1, -1, -1, -1, EnumResult_pos, EnumServiceDetails_always, EnumSendingMode_physical, EnumSuppressPosResBit_asconfigured, EnumVerdictOnInvalidValues_fail))
        break;
    }

    __res = DiagErrCodeTestStep(__res, "Can't retrieve last response for request! No check possible.") < 0;
    if(__res)
    {
	  __bVerdict = __eVerdictFail;
      break;
    }
    {
      __res = DiagInterpretAs(__resp, "RDBI_PR");
      if(__res != 0)
      {
        __bVerdict = __eVerdictFail;
        DiagErrCodeTestStep(__res, "Can't interpret response as diagnostic primitive 'RDBI_PR'.");
        break;
      }
      else
      {
        TestStepPass( "Received primitive can be interpreted as diagnostic primitive 'RDBI_PR'.");
      }
    }
  }
  while(0);


  if (__bVerdict == __eVerdictFail)
    TestReportWriteDiagObjectList();
}

void Tto7rkndv_Tet_Tc1()
{
  CreateTTEIFFunction("Tto7rkndv_Tc1", __eTcDef, __eLocal);  
  AddIFParameterTestCaseAttribute("TC_ID", "");
  AddIFParameterTestCaseAttribute("Test Case ID", "");
  CallInterfaceFunction("Read_FDF6_RunTimeStats", __cEmpty , __cEmpty );
}
testcase Tto7rkndv_Tc1()
{
  stack long __tableHandle;
  SetBreakOnFail(1);

  TestCommandBegin(__eDiagService, __cDiagService, "", "0");
  {
    if (DiagIsFunctionalGroup("CVADAS_0001_00000000_000"))
    {
      DiagResponse * __resp;
      DiagRequest CVADAS_0001_00000000_000._22FDF6_RunTimeStatsData_Read __req;
      __diagServiceo7rkndv_3(__req, __resp);
    }
    else
    {
      DiagResponse CVADAS_0001_00000000_000.* __resp;
      DiagRequest CVADAS_0001_00000000_000._22FDF6_RunTimeStatsData_Read __req;
      __diagServiceo7rkndv_3(__req, __resp);
    }
  }
  TestCommandEnd();


  TestCommandBegin(__eWait, __cWait, "", "1");
  {
    Wait("1", (1000 * 1000000LL), 1000000, "");
  }
  TestCommandEnd();

  TestCommandBegin(__eDiagService, __cDiagService, "", "2");
  {
    if (DiagIsFunctionalGroup("CVADAS_0001_00000000_000"))
    {
      DiagResponse * __resp;
      DiagRequest CVADAS_0001_00000000_000._22FDF6_RunTimeStatsData_Read __req;
      __diagServiceo7rkndv_4(__req, __resp);
    }
    else
    {
      DiagResponse CVADAS_0001_00000000_000.* __resp;
      DiagRequest CVADAS_0001_00000000_000._22FDF6_RunTimeStatsData_Read __req;
      __diagServiceo7rkndv_4(__req, __resp);
    }
  }
  TestCommandEnd();


  TestCommandBegin(__eWait, __cWait, "", "3");
  {
    Wait("1", (1000 * 1000000LL), 1000000, "");
  }
  TestCommandEnd();

  TestCommandBegin(__eDiagService, __cDiagService, "", "4");
  {
    if (DiagIsFunctionalGroup("CVADAS_0001_00000000_000"))
    {
      DiagResponse * __resp;
      DiagRequest CVADAS_0001_00000000_000._22FDF6_RunTimeStatsData_Read __req;
      __diagServiceo7rkndv_5(__req, __resp);
    }
    else
    {
      DiagResponse CVADAS_0001_00000000_000.* __resp;
      DiagRequest CVADAS_0001_00000000_000._22FDF6_RunTimeStatsData_Read __req;
      __diagServiceo7rkndv_5(__req, __resp);
    }
  }
  TestCommandEnd();


  TestCommandBegin(__eWait, __cWait, "", "5");
  {
    Wait("1", (1000 * 1000000LL), 1000000, "");
  }
  TestCommandEnd();

}

  
void __diagServiceo7rkndv_3(DiagRequest * __req, DiagResponse * __resp )
{
  stack long __tableHandle;
  long __res, __paramLen, __bytePos;

   __bVerdict = __eVerdictPass;

  do {
    TestReportResetDiagObjectList();
    DiagSetReportDetailLevel("CVADAS_0001_00000000_000", EnumServiceDetails_always);
    // Request aspect
    {

      if (0 >= DiagSendReqAndWaitForResp("CVADAS_0001_00000000_000", __req, __resp, __res, -1, -1, -1, -1, -1, EnumResult_pos, EnumServiceDetails_always, EnumSendingMode_physical, EnumSuppressPosResBit_asconfigured, EnumVerdictOnInvalidValues_fail))
        break;
    }

    __res = DiagErrCodeTestStep(__res, "Can't retrieve last response for request! No check possible.") < 0;
    if(__res)
    {
	  __bVerdict = __eVerdictFail;
      break;
    }
    {
      __res = DiagInterpretAs(__resp, "RDBI_PR");
      if(__res != 0)
      {
        __bVerdict = __eVerdictFail;
        DiagErrCodeTestStep(__res, "Can't interpret response as diagnostic primitive 'RDBI_PR'.");
        break;
      }
      else
      {
        TestStepPass( "Received primitive can be interpreted as diagnostic primitive 'RDBI_PR'.");
      }
    }
  }
  while(0);


  if (__bVerdict == __eVerdictFail)
    TestReportWriteDiagObjectList();
}
  
void __diagServiceo7rkndv_4(DiagRequest * __req, DiagResponse * __resp )
{
  stack long __tableHandle;
  long __res, __paramLen, __bytePos;

   __bVerdict = __eVerdictPass;

  do {
    TestReportResetDiagObjectList();
    DiagSetReportDetailLevel("CVADAS_0001_00000000_000", EnumServiceDetails_always);
    // Request aspect
    {

      if (0 >= DiagSendReqAndWaitForResp("CVADAS_0001_00000000_000", __req, __resp, __res, -1, -1, -1, -1, -1, EnumResult_pos, EnumServiceDetails_always, EnumSendingMode_physical, EnumSuppressPosResBit_asconfigured, EnumVerdictOnInvalidValues_fail))
        break;
    }

    __res = DiagErrCodeTestStep(__res, "Can't retrieve last response for request! No check possible.") < 0;
    if(__res)
    {
	  __bVerdict = __eVerdictFail;
      break;
    }
    {
      __res = DiagInterpretAs(__resp, "RDBI_PR");
      if(__res != 0)
      {
        __bVerdict = __eVerdictFail;
        DiagErrCodeTestStep(__res, "Can't interpret response as diagnostic primitive 'RDBI_PR'.");
        break;
      }
      else
      {
        TestStepPass( "Received primitive can be interpreted as diagnostic primitive 'RDBI_PR'.");
      }
    }
  }
  while(0);


  if (__bVerdict == __eVerdictFail)
    TestReportWriteDiagObjectList();
}
  
void __diagServiceo7rkndv_5(DiagRequest * __req, DiagResponse * __resp )
{
  stack long __tableHandle;
  long __res, __paramLen, __bytePos;

   __bVerdict = __eVerdictPass;

  do {
    TestReportResetDiagObjectList();
    DiagSetReportDetailLevel("CVADAS_0001_00000000_000", EnumServiceDetails_always);
    // Request aspect
    {

      if (0 >= DiagSendReqAndWaitForResp("CVADAS_0001_00000000_000", __req, __resp, __res, -1, -1, -1, -1, -1, EnumResult_pos, EnumServiceDetails_always, EnumSendingMode_physical, EnumSuppressPosResBit_asconfigured, EnumVerdictOnInvalidValues_fail))
        break;
    }

    __res = DiagErrCodeTestStep(__res, "Can't retrieve last response for request! No check possible.") < 0;
    if(__res)
    {
	  __bVerdict = __eVerdictFail;
      break;
    }
    {
      __res = DiagInterpretAs(__resp, "RDBI_PR");
      if(__res != 0)
      {
        __bVerdict = __eVerdictFail;
        DiagErrCodeTestStep(__res, "Can't interpret response as diagnostic primitive 'RDBI_PR'.");
        break;
      }
      else
      {
        TestStepPass( "Received primitive can be interpreted as diagnostic primitive 'RDBI_PR'.");
      }
    }
  }
  while(0);


  if (__bVerdict == __eVerdictFail)
    TestReportWriteDiagObjectList();
}

void Tto7rkndv_Tet_Tc2()
{
  CreateTTEIFFunction("Tto7rkndv_Tc2", __eTcDef, __eLocal);  
  AddIFParameterTestCaseAttribute("TC_ID", "");
  AddIFParameterTestCaseAttribute("Test Case ID", "");
  CallInterfaceFunction("Read_FDF8_StackUsage", __cEmpty , __cEmpty );
}
testcase Tto7rkndv_Tc2()
{
  stack long __tableHandle;
  SetBreakOnFail(1);

  TestCommandBegin(__eDiagService, __cDiagService, "", "0");
  {
    if (DiagIsFunctionalGroup("CVADAS_0001_00000000_000"))
    {
      DiagResponse * __resp;
      DiagRequest CVADAS_0001_00000000_000._22FDF8_StackUsage_Read __req;
      __diagServiceo7rkndv_6(__req, __resp);
    }
    else
    {
      DiagResponse CVADAS_0001_00000000_000.* __resp;
      DiagRequest CVADAS_0001_00000000_000._22FDF8_StackUsage_Read __req;
      __diagServiceo7rkndv_6(__req, __resp);
    }
  }
  TestCommandEnd();


  TestCommandBegin(__eWait, __cWait, "", "1");
  {
    Wait("1", (1000 * 1000000LL), 1000000, "");
  }
  TestCommandEnd();

  TestCommandBegin(__eDiagService, __cDiagService, "", "2");
  {
    if (DiagIsFunctionalGroup("CVADAS_0001_00000000_000"))
    {
      DiagResponse * __resp;
      DiagRequest CVADAS_0001_00000000_000._22FDF8_StackUsage_Read __req;
      __diagServiceo7rkndv_7(__req, __resp);
    }
    else
    {
      DiagResponse CVADAS_0001_00000000_000.* __resp;
      DiagRequest CVADAS_0001_00000000_000._22FDF8_StackUsage_Read __req;
      __diagServiceo7rkndv_7(__req, __resp);
    }
  }
  TestCommandEnd();


  TestCommandBegin(__eWait, __cWait, "", "3");
  {
    Wait("1", (1000 * 1000000LL), 1000000, "");
  }
  TestCommandEnd();

  TestCommandBegin(__eDiagService, __cDiagService, "", "4");
  {
    if (DiagIsFunctionalGroup("CVADAS_0001_00000000_000"))
    {
      DiagResponse * __resp;
      DiagRequest CVADAS_0001_00000000_000._22FDF8_StackUsage_Read __req;
      __diagServiceo7rkndv_8(__req, __resp);
    }
    else
    {
      DiagResponse CVADAS_0001_00000000_000.* __resp;
      DiagRequest CVADAS_0001_00000000_000._22FDF8_StackUsage_Read __req;
      __diagServiceo7rkndv_8(__req, __resp);
    }
  }
  TestCommandEnd();


  TestCommandBegin(__eWait, __cWait, "", "5");
  {
    Wait("1", (1000 * 1000000LL), 1000000, "");
  }
  TestCommandEnd();

}

  
void __diagServiceo7rkndv_6(DiagRequest * __req, DiagResponse * __resp )
{
  stack long __tableHandle;
  long __res, __paramLen, __bytePos;

   __bVerdict = __eVerdictPass;

  do {
    TestReportResetDiagObjectList();
    DiagSetReportDetailLevel("CVADAS_0001_00000000_000", EnumServiceDetails_always);
    // Request aspect
    {

      if (0 >= DiagSendReqAndWaitForResp("CVADAS_0001_00000000_000", __req, __resp, __res, -1, -1, -1, -1, -1, EnumResult_pos, EnumServiceDetails_always, EnumSendingMode_physical, EnumSuppressPosResBit_asconfigured, EnumVerdictOnInvalidValues_fail))
        break;
    }

    __res = DiagErrCodeTestStep(__res, "Can't retrieve last response for request! No check possible.") < 0;
    if(__res)
    {
	  __bVerdict = __eVerdictFail;
      break;
    }
    {
      __res = DiagInterpretAs(__resp, "RDBI_PR");
      if(__res != 0)
      {
        __bVerdict = __eVerdictFail;
        DiagErrCodeTestStep(__res, "Can't interpret response as diagnostic primitive 'RDBI_PR'.");
        break;
      }
      else
      {
        TestStepPass( "Received primitive can be interpreted as diagnostic primitive 'RDBI_PR'.");
      }
    }
  }
  while(0);


  if (__bVerdict == __eVerdictFail)
    TestReportWriteDiagObjectList();
}
  
void __diagServiceo7rkndv_7(DiagRequest * __req, DiagResponse * __resp )
{
  stack long __tableHandle;
  long __res, __paramLen, __bytePos;

   __bVerdict = __eVerdictPass;

  do {
    TestReportResetDiagObjectList();
    DiagSetReportDetailLevel("CVADAS_0001_00000000_000", EnumServiceDetails_always);
    // Request aspect
    {

      if (0 >= DiagSendReqAndWaitForResp("CVADAS_0001_00000000_000", __req, __resp, __res, -1, -1, -1, -1, -1, EnumResult_pos, EnumServiceDetails_always, EnumSendingMode_physical, EnumSuppressPosResBit_asconfigured, EnumVerdictOnInvalidValues_fail))
        break;
    }

    __res = DiagErrCodeTestStep(__res, "Can't retrieve last response for request! No check possible.") < 0;
    if(__res)
    {
	  __bVerdict = __eVerdictFail;
      break;
    }
    {
      __res = DiagInterpretAs(__resp, "RDBI_PR");
      if(__res != 0)
      {
        __bVerdict = __eVerdictFail;
        DiagErrCodeTestStep(__res, "Can't interpret response as diagnostic primitive 'RDBI_PR'.");
        break;
      }
      else
      {
        TestStepPass( "Received primitive can be interpreted as diagnostic primitive 'RDBI_PR'.");
      }
    }
  }
  while(0);


  if (__bVerdict == __eVerdictFail)
    TestReportWriteDiagObjectList();
}
  
void __diagServiceo7rkndv_8(DiagRequest * __req, DiagResponse * __resp )
{
  stack long __tableHandle;
  long __res, __paramLen, __bytePos;

   __bVerdict = __eVerdictPass;

  do {
    TestReportResetDiagObjectList();
    DiagSetReportDetailLevel("CVADAS_0001_00000000_000", EnumServiceDetails_always);
    // Request aspect
    {

      if (0 >= DiagSendReqAndWaitForResp("CVADAS_0001_00000000_000", __req, __resp, __res, -1, -1, -1, -1, -1, EnumResult_pos, EnumServiceDetails_always, EnumSendingMode_physical, EnumSuppressPosResBit_asconfigured, EnumVerdictOnInvalidValues_fail))
        break;
    }

    __res = DiagErrCodeTestStep(__res, "Can't retrieve last response for request! No check possible.") < 0;
    if(__res)
    {
	  __bVerdict = __eVerdictFail;
      break;
    }
    {
      __res = DiagInterpretAs(__resp, "RDBI_PR");
      if(__res != 0)
      {
        __bVerdict = __eVerdictFail;
        DiagErrCodeTestStep(__res, "Can't interpret response as diagnostic primitive 'RDBI_PR'.");
        break;
      }
      else
      {
        TestStepPass( "Received primitive can be interpreted as diagnostic primitive 'RDBI_PR'.");
      }
    }
  }
  while(0);


  if (__bVerdict == __eVerdictFail)
    TestReportWriteDiagObjectList();
}

void Tto7rkndv_Tet_CaplTcCall0()
{
  stack long __tableHandle;
  CreateCaplIFFunction("FDF6", __eTcDef);
  AddIFParameterTestCaseAttribute("TC_ID", "");
  AddIFParameterTestCaseAttribute("Test Case ID", "");
  AddIFParameterInt(syspar::`iterations);
  AddIFParameterChar(syspar::`path);
  AddIFParameterInt(syspar::`waitTime);
  CallInterfaceFunction(__cEmpty , "", __cEmpty );
}

void Tto7rkndv_Tet_CaplTcCall1()
{
  stack long __tableHandle;
  CreateCaplIFFunction("FDF8", __eTcDef);
  AddIFParameterTestCaseAttribute("TC_ID", "");
  AddIFParameterTestCaseAttribute("Test Case ID", "");
  AddIFParameterInt(syspar::`iterations);
  AddIFParameterChar(syspar::`path);
  AddIFParameterInt(syspar::`waitTime);
  CallInterfaceFunction(__cEmpty , "", __cEmpty );
}

