/* !Encoding: 65001  */
includes
{
  #include "__DiagLibrary.cin"
  #include "__VariablesLib.cin"
  #include "__CaplGeneratorLib.cin"
  #include "__CANoeReportFuntionsLib.cin"
}

variables
{
  // Global variables defined within this CAPL file
  int64 __tt2LoopVar1;
  double __tt2LoopVar2;
}

void Tt56gpegf_General_Precondition()
{
  stack long __tableHandle;
  TestCommandBegin(__eDiagService, __cDiagService, "", "0");
  {
    if (DiagIsFunctionalGroup("CVADAS_0001_00000000_000"))
    {
      DiagResponse * __resp;
      DiagRequest CVADAS_0001_00000000_000.Default_Session_Start __req;
      __diagService56gpegf_0(__req, __resp);
    }
    else
    {
      DiagResponse CVADAS_0001_00000000_000.* __resp;
      DiagRequest CVADAS_0001_00000000_000.Default_Session_Start __req;
      __diagService56gpegf_0(__req, __resp);
    }
  }
  TestCommandEnd();


  TestCommandBegin(__eWait, __cWait, "", "1");
  {
    Wait("1", (1000 * 1000000LL), 1000000, "");
  }
  TestCommandEnd();

  TestCommandBegin(__eDiagService, __cDiagService, "", "2");
  {
    if (DiagIsFunctionalGroup("CVADAS_0001_00000000_000"))
    {
      DiagResponse * __resp;
      DiagRequest CVADAS_0001_00000000_000.FaultMemory_Clear __req;
      __diagService56gpegf_1(__req, __resp);
    }
    else
    {
      DiagResponse CVADAS_0001_00000000_000.* __resp;
      DiagRequest CVADAS_0001_00000000_000.FaultMemory_Clear __req;
      __diagService56gpegf_1(__req, __resp);
    }
  }
  TestCommandEnd();


  TestCommandBegin(__eWait, __cWait, "", "3");
  {
    Wait("1", (1000 * 1000000LL), 1000000, "");
  }
  TestCommandEnd();

}

  
void __diagService56gpegf_0(DiagRequest * __req, DiagResponse * __resp )
{
  stack long __tableHandle;
  long __res, __paramLen, __bytePos;

   __bVerdict = __eVerdictPass;

  do {
    TestReportResetDiagObjectList();
    DiagSetReportDetailLevel("CVADAS_0001_00000000_000", EnumServiceDetails_onfail);
    // Request aspect
    {
      {
        {
          byte __bArray[1] = { 0x01 };
          __bArrayCtr = elCount(__bArray);
          __bDiagValueArrayCtr = __CopyBytes(__bArray, __bArrayCtr, __bDiagValueArray);
        }
      
        __res = DiagSetParameterErrorHandled(__req, "DiagSessionType", __bDiagValueArray, __bDiagValueArrayCtr);
        if(__res < 0)
        {
          __bVerdict = __eVerdictFail;
          DiagErrCodeTestStep(__res, "Cannot set diagnostic parameter 'DiagSessionType'");
          break;
        }
      }

      if (0 >= DiagSendReqAndWaitForResp("CVADAS_0001_00000000_000", __req, __resp, __res, -1, -1, -1, -1, -1, EnumResult_pos, EnumServiceDetails_onfail, EnumSendingMode_physical, EnumSuppressPosResBit_asconfigured, EnumVerdictOnInvalidValues_fail))
        break;
    }

    __res = DiagErrCodeTestStep(__res, "Can't retrieve last response for request! No check possible.") < 0;
    if(__res)
    {
	  __bVerdict = __eVerdictFail;
      break;
    }
    {
      __res = DiagInterpretAs(__resp, "DSC_PR");
      if(__res != 0)
      {
        __bVerdict = __eVerdictFail;
        DiagErrCodeTestStep(__res, "Can't interpret response as diagnostic primitive 'DSC_PR'.");
        break;
      }
      else
      {
        TestStepPass( "Received primitive can be interpreted as diagnostic primitive 'DSC_PR'.");
      }
    }
  }
  while(0);


  // Response, check & read aspect
  {
    __res = 1;
    __tableHandle = ReportTableHead5Columns(__cCheckCaption, __cTSym, __cTOp, __cRefVal, __cActual, __cRes);
    {
      __bDiagValueArrayCtr = DiagGetParameterErrorHandled(__resp, "DiagSessionType", __bDiagValueArray, elcount(__bDiagValueArray), __cDiagValueArray, elcount(__cDiagValueArray));
      {
        byte __bArray2[1] = { 0x01 };
        __bArrayCtr = __CopyBytes(__bDiagValueArray, __bDiagValueArrayCtr, __bArray);
        __bArrayCtr2 = elCount(__bArray2);
        __csr = CompareBytes(__bArray, __bArrayCtr, __bArray2, __bArrayCtr2) == 0;
        snprintf(__cArray, 8192, "%s", "Diagnostic parameter \'DiagSessionType\'");
        snprintf(__cArray2, 8192, "%s", __cArray);
        snprintf(__cArray3, 8192, "%s", "");
        ReportTableRow(__tableHandle, 0, __cArray2, "Bytes", __bArray2, __bArrayCtr2, __cArray3, __oneOfFlag, __bSetInCheckAlignment);
        ReportCell(__tableHandle, __bArray, __bArrayCtr);
        ReportCellResult(__tableHandle, __csr, __ePassFail);
      }
    
      __res = __res && __csr;
    
    }
    ReportTableEndVerdict(__tableHandle, __cEvaluateResponse, __res);
	__bVerdict = __bVerdict && __res;
  }
  if (__bVerdict == __eVerdictFail)
    TestReportWriteDiagObjectList();
}
  
void __diagService56gpegf_1(DiagRequest * __req, DiagResponse * __resp )
{
  stack long __tableHandle;
  long __res, __paramLen, __bytePos;

   __bVerdict = __eVerdictPass;

  do {
    TestReportResetDiagObjectList();
    DiagSetReportDetailLevel("CVADAS_0001_00000000_000", EnumServiceDetails_onfail);
    // Request aspect
    {
      {
        CheckLiteralGetStringBufferConsistency("FFFFFF", 8192);
      snprintf(__cDiagValueArray, 8192, "%s", "FFFFFF");
        __bDiagValueArrayCtr = __MapChar2ByteAtDiagSet(__cDiagValueArray, __bDiagValueArray);
        if (__bDiagValueArrayCtr >= 0)
        {
          __res = DiagSetParameterErrorHandled(__req, "GroupOfDtc", __bDiagValueArray, __bDiagValueArrayCtr);
          if(__res < 0)
          {
            __bVerdict = __eVerdictFail;
            DiagErrCodeTestStep(__res, "Cannot set diagnostic parameter 'GroupOfDtc'");
            break;
          }
        }
        else
        {
      	__bVerdict = __eVerdictFail;
          snprintf(__cArray2, 8192, "SetParameter: illegal byte sequence: '%s' (parameter %s). Use hex tuples like '01 AF ...'", __cDiagValueArray, "GroupOfDtc");
          DiagErrCodeTestStep(__bDiagValueArrayCtr, __cArray2);
          DiagErrCodeTestStep(-1, "Cannot set diagnostic parameter 'GroupOfDtc'");
      	break;
        }
      }

      if (0 >= DiagSendReqAndWaitForResp("CVADAS_0001_00000000_000", __req, __resp, __res, -1, -1, -1, -1, -1, EnumResult_pos, EnumServiceDetails_onfail, EnumSendingMode_physical, EnumSuppressPosResBit_asconfigured, EnumVerdictOnInvalidValues_fail))
        break;
    }

    __res = DiagErrCodeTestStep(__res, "Can't retrieve last response for request! No check possible.") < 0;
    if(__res)
    {
	  __bVerdict = __eVerdictFail;
      break;
    }
    {
      __res = DiagInterpretAs(__resp, "CDI_PR");
      if(__res != 0)
      {
        __bVerdict = __eVerdictFail;
        DiagErrCodeTestStep(__res, "Can't interpret response as diagnostic primitive 'CDI_PR'.");
        break;
      }
      else
      {
        TestStepPass( "Received primitive can be interpreted as diagnostic primitive 'CDI_PR'.");
      }
    }
  }
  while(0);


  if (__bVerdict == __eVerdictFail)
    TestReportWriteDiagObjectList();
}

void Tt56gpegf_HMI_General_Precondition()
{
  stack long __tableHandle;
  TestCommandBegin(__eSet, __cSet, "", "0");
  {
    __tableHandle = ReportTableHead3Columns(__cSetCaption , __cTSym, __cTOp, __cAssigned); 
    {
      $`FDCAN2::dbNode::`BCM::`TRANSM_FD_4::`ShiftLeverPosition.phys = 1;
      snprintf(__cArray, 8192, "%s", "ShiftLeverPosition");
      snprintf(__cArray2, 8192, "%s '%s'", __cCANSignal, __cArray);
      snprintf(__cArray3, 8192, "%s", "");
      
      ReportSetLValueOrSignalNotOnline(getSignalTime(`FDCAN2::dbNode::`BCM::`TRANSM_FD_4::`ShiftLeverPosition), __cArray2, __cArray4, 8192);
      ReportTableRow(__tableHandle, 0, __cArray4, __cAOp, 1, __cArray3, __oneOfFlag, __bSetInCheckAlignment);
      
  
    }
    ReportTableEndTestStep(__tableHandle, "1");
  }
  TestCommandEnd();


  TestCommandBegin(__eSet, __cSet, "", "1");
  {
    __tableHandle = ReportTableHead3Columns(__cSetCaption , __cTSym, __cTOp, __cAssigned); 
    {
      $`FDCAN2::dbNode::`SGW::`TELEMATIC_FD_5::`CameraDisplaySts2.phys = 0;
      snprintf(__cArray, 8192, "%s", "CameraDisplaySts2");
      snprintf(__cArray2, 8192, "%s '%s'", __cCANSignal, __cArray);
      snprintf(__cArray3, 8192, "%s", "");
      
      ReportSetLValueOrSignalNotOnline(getSignalTime(`FDCAN2::dbNode::`SGW::`TELEMATIC_FD_5::`CameraDisplaySts2), __cArray2, __cArray4, 8192);
      ReportTableRow(__tableHandle, 0, __cArray4, __cAOp, 0, __cArray3, __oneOfFlag, __bSetInCheckAlignment);
      
  
    }
    ReportTableEndTestStep(__tableHandle, "1");
  }
  TestCommandEnd();


  TestCommandBegin(__eSet, __cSet, "", "2");
  {
    __tableHandle = ReportTableHead3Columns(__cSetCaption , __cTSym, __cTOp, __cAssigned); 
    {
      $`FDCAN2::dbNode::`BCM::`TRANSM_FD_4::`ShiftLeverPosition.phys = 2;
      snprintf(__cArray, 8192, "%s", "ShiftLeverPosition");
      snprintf(__cArray2, 8192, "%s '%s'", __cCANSignal, __cArray);
      snprintf(__cArray3, 8192, "%s", "");
      
      ReportSetLValueOrSignalNotOnline(getSignalTime(`FDCAN2::dbNode::`BCM::`TRANSM_FD_4::`ShiftLeverPosition), __cArray2, __cArray4, 8192);
      ReportTableRow(__tableHandle, 0, __cArray4, __cAOp, 2, __cArray3, __oneOfFlag, __bSetInCheckAlignment);
      
  
    }
    ReportTableEndTestStep(__tableHandle, "1");
  }
  TestCommandEnd();


  TestCommandBegin(__eWait, __cWait, "", "3");
  {
    Wait("1", (500 * 1000000LL), 1000000, "");
  }
  TestCommandEnd();

  TestCommandBegin(__eSet, __cSet, "", "4");
  {
    __tableHandle = ReportTableHead3Columns(__cSetCaption , __cTSym, __cTOp, __cAssigned); 
    {
      $`FDCAN2::dbNode::`SGW::`TELEMATIC_FD_14::`TGW_CAMERA_DISP_STAT.phys = 0;
      snprintf(__cArray, 8192, "%s", "TGW_CAMERA_DISP_STAT");
      snprintf(__cArray2, 8192, "%s '%s'", __cCANSignal, __cArray);
      snprintf(__cArray3, 8192, "%s", "");
      
      ReportSetLValueOrSignalNotOnline(getSignalTime(`FDCAN2::dbNode::`SGW::`TELEMATIC_FD_14::`TGW_CAMERA_DISP_STAT), __cArray2, __cArray4, 8192);
      ReportTableRow(__tableHandle, 0, __cArray4, __cAOp, 0, __cArray3, __oneOfFlag, __bSetInCheckAlignment);
      
  
    }
    ReportTableEndTestStep(__tableHandle, "1");
  }
  TestCommandEnd();


  TestCommandBegin(__eWait, __cWait, "", "5");
  {
    Wait("1", (500 * 1000000LL), 1000000, "");
  }
  TestCommandEnd();

  TestCommandBegin(__eSet, __cSet, "", "6");
  {
    __tableHandle = ReportTableHead3Columns(__cSetCaption , __cTSym, __cTOp, __cAssigned); 
    {
      $`FDCAN2::dbNode::`SGW::`TELEMATIC_FD_5::`CameraDisplaySts2.phys = 0;
      snprintf(__cArray, 8192, "%s", "CameraDisplaySts2");
      snprintf(__cArray2, 8192, "%s '%s'", __cCANSignal, __cArray);
      snprintf(__cArray3, 8192, "%s", "");
      
      ReportSetLValueOrSignalNotOnline(getSignalTime(`FDCAN2::dbNode::`SGW::`TELEMATIC_FD_5::`CameraDisplaySts2), __cArray2, __cArray4, 8192);
      ReportTableRow(__tableHandle, 0, __cArray4, __cAOp, 0, __cArray3, __oneOfFlag, __bSetInCheckAlignment);
      
  
    }
    ReportTableEndTestStep(__tableHandle, "1");
  }
  TestCommandEnd();


  TestCommandBegin(__eWait, __cWait, "", "7");
  {
    Wait("1", (500 * 1000000LL), 1000000, "");
  }
  TestCommandEnd();

  TestCommandBegin(__eSet, __cSet, "", "8");
  {
    __tableHandle = ReportTableHead3Columns(__cSetCaption , __cTSym, __cTOp, __cAssigned); 
    {
      $`FDCAN2::dbNode::`BCM::`BRAKE_FD_2::`VehicleSpeedVSOSig.phys = 0;
      snprintf(__cArray, 8192, "%s", "BCM::BRAKE_FD_2::VehicleSpeedVSOSig");
      snprintf(__cArray2, 8192, "%s '%s'", __cCANSignal, __cArray);
      snprintf(__cArray3, 8192, "%s", "");
      
      ReportSetLValueOrSignalNotOnline(getSignalTime(`FDCAN2::dbNode::`BCM::`BRAKE_FD_2::`VehicleSpeedVSOSig), __cArray2, __cArray4, 8192);
      ReportTableRow(__tableHandle, 0, __cArray4, __cAOp, 0, __cArray3, __oneOfFlag, __bSetInCheckAlignment);
      
  
    }
    ReportTableEndTestStep(__tableHandle, "1");
  }
  TestCommandEnd();


  TestCommandBegin(__eWait, __cWait, "", "9");
  {
    Wait("1", (500 * 1000000LL), 1000000, "");
  }
  TestCommandEnd();

  TestCommandBegin(__eSet, __cSet, "", "10");
  {
    __tableHandle = ReportTableHead3Columns(__cSetCaption , __cTSym, __cTOp, __cAssigned); 
    {
      $`FDCAN2::dbNode::`BCM::`BRAKE_FD_2::`VehicleSpeedVSOSig.phys = 0;
      snprintf(__cArray, 8192, "%s", "BCM::BRAKE_FD_2::VehicleSpeedVSOSig");
      snprintf(__cArray2, 8192, "%s '%s'", __cCANSignal, __cArray);
      snprintf(__cArray3, 8192, "%s", "");
      
      ReportSetLValueOrSignalNotOnline(getSignalTime(`FDCAN2::dbNode::`BCM::`BRAKE_FD_2::`VehicleSpeedVSOSig), __cArray2, __cArray4, 8192);
      ReportTableRow(__tableHandle, 0, __cArray4, __cAOp, 0, __cArray3, __oneOfFlag, __bSetInCheckAlignment);
      
  
    }
    ReportTableEndTestStep(__tableHandle, "1");
  }
  TestCommandEnd();


  TestCommandBegin(__eWait, __cWait, "", "11");
  {
    Wait("1", (500 * 1000000LL), 1000000, "");
  }
  TestCommandEnd();

  TestCommandBegin(__eSet, __cSet, "", "12");
  {
    __tableHandle = ReportTableHead3Columns(__cSetCaption , __cTSym, __cTOp, __cAssigned); 
    {
      $`FDCAN2::dbNode::`BCM::`TRANSM_FD_4::`ShiftLeverPosition.phys = 2;
      snprintf(__cArray, 8192, "%s", "ShiftLeverPosition");
      snprintf(__cArray2, 8192, "%s '%s'", __cCANSignal, __cArray);
      snprintf(__cArray3, 8192, "%s", "");
      
      ReportSetLValueOrSignalNotOnline(getSignalTime(`FDCAN2::dbNode::`BCM::`TRANSM_FD_4::`ShiftLeverPosition), __cArray2, __cArray4, 8192);
      ReportTableRow(__tableHandle, 0, __cArray4, __cAOp, 2, __cArray3, __oneOfFlag, __bSetInCheckAlignment);
      
  
    }
    ReportTableEndTestStep(__tableHandle, "1");
  }
  TestCommandEnd();


  TestCommandBegin(__eWait, __cWait, "", "13");
  {
    Wait("1", (6000 * 1000000LL), 1000000, "");
  }
  TestCommandEnd();

}

void Tt56gpegf_General_Postconditions()
{
  stack long __tableHandle;
  TestCommandBegin(__eWait, __cWait, "", "0");
  {
    Wait("1", (200 * 1000000LL), 1000000, "");
  }
  TestCommandEnd();

  {
    CreateCaplIFFunction("Disable_CAN_Communcation_NoSleep", __eFct);
    CallInterfaceFunction(__cEmpty, __cEmpty, "1");
  }


  TestCommandBegin(__eWait, __cWait, "", "2");
  {
    Wait("1", (30000 * 1000000LL), 1000000, "");
  }
  TestCommandEnd();

  {
    CreateCaplIFFunction("Enable_CAN_Communication", __eFct);
    CallInterfaceFunction(__cEmpty, __cEmpty, "3");
  }


}

void Tt56gpegf_CaptureMasterImage()
{
  stack long __tableHandle;
  TestCommandBegin(__eCAPLInline, __cCAPLInline, "CaptureImage", "0");
  {
    __ci56gpegfCaplInline0();
  }
  TestCommandEnd();

}

void __ci56gpegfCaplInline0()
{
  stack long __tableHandle;
  {
    long response;
response = testWaitForSyscall("pythonw Image_Comparison.py --capture_image --master_frame_mode", 0, 10000);

if (response == 2)
{
  testStepFail("Check Image");
}
else{
testStepPass();
}

  }
}

void Tt56gpegf_CaptureImage()
{
  stack long __tableHandle;
  TestCommandBegin(__eCAPLInline, __cCAPLInline, "CaptureImage", "0");
  {
    __ci56gpegfCaplInline1();
  }
  TestCommandEnd();

}

void __ci56gpegfCaplInline1()
{
  stack long __tableHandle;
  {
    long response;
response = testWaitForSyscall("pythonw Image_Comparison.py --capture_image", 0, 10000);

if (response == 2)
{
  testStepFail("Check Image");
}
else{
testStepPass();
}

  }
}

testcase Tt56gpegf_HMI_Views_Steering_Angle_Test()
{
  stack long __tableHandle;
double __tt2LoopVar0;

  SetBreakOnFail(1);

  {
    __type_of(-500) __tcLocVar0;
    __type_of(0) __tcLocVar1;
    __type_of(100) __tcLocVar2;
  
    __tcLocVar0 = -500;
    __tcLocVar1 = 0;
    __tcLocVar2 = 100;
  
    snprintf(__cArray, 8192, "%s", "-500");
    snprintf(__cArray2, 8192, "%s", "0");
    snprintf(__cArray3, 8192, "%s", "100");
  
    snprintf(__cArray4, 8192, "For (For i=%s..%s, increment=%s)", __cArray, __cArray2, __cArray3);
    TestControlStructBegin(__cFor, __cArray4, "0");  
    for(__tt2LoopVar0 = __tcLocVar0; (__tcLocVar2 < 0) ? (CheckSignalMatch(__tt2LoopVar0, __tcLocVar1, ">=" ) == 1) : (CheckSignalMatch(__tt2LoopVar0, __tcLocVar1, "<=") == 1); __tt2LoopVar0 += __tcLocVar2)
    {
      if(__LoopIsBlocking())  
        break;
  
      snprintf(__cArray, 8192, "%s", "-500");
      snprintf(__cArray2, 8192, "%s", "0");
      snprintf(__cArray3, 8192, "%s", "100");
      snprintf(__cArray4, 8192, "For (For i=%s..%s, increment=%s; current i = %.15g)", __cArray, __cArray2, __cArray3, __tt2LoopVar0);
      TestControlStructBegin(__cForIteration, __cArray4, "0");
      TestCommandBegin(__eSet, __cSet, "", "1");
      {
        __tableHandle = ReportTableHead3Columns(__cSetCaption , __cTSym, __cTOp, __cAssigned); 
        {
          $`FDCAN2::dbNode::`BCM::`IPC_VEHICLE_SETUP::`SVC_Guidelines.phys = 1;
          snprintf(__cArray, 8192, "%s", "SVC_Guidelines");
          snprintf(__cArray2, 8192, "%s '%s'", __cCANSignal, __cArray);
          snprintf(__cArray3, 8192, "%s", "");
          
          ReportSetLValueOrSignalNotOnline(getSignalTime(`FDCAN2::dbNode::`BCM::`IPC_VEHICLE_SETUP::`SVC_Guidelines), __cArray2, __cArray4, 8192);
          ReportTableRow(__tableHandle, 0, __cArray4, __cAOp, 1, __cArray3, __oneOfFlag, __bSetInCheckAlignment);
          
      
        }
        ReportTableEndTestStep(__tableHandle, "1");
      }
      TestCommandEnd();


      TestCommandBegin(__eSet, __cSet, "", "2");
      {
        __tableHandle = ReportTableHead3Columns(__cSetCaption , __cTSym, __cTOp, __cAssigned); 
        {
          $`FDCAN2::dbNode::`BCM::`IPC_VEHICLE_SETUP::`Fwrd_Cam_Guidelines.phys = 1;
          snprintf(__cArray, 8192, "%s", "Fwrd_Cam_Guidelines");
          snprintf(__cArray2, 8192, "%s '%s'", __cCANSignal, __cArray);
          snprintf(__cArray3, 8192, "%s", "");
          
          ReportSetLValueOrSignalNotOnline(getSignalTime(`FDCAN2::dbNode::`BCM::`IPC_VEHICLE_SETUP::`Fwrd_Cam_Guidelines), __cArray2, __cArray4, 8192);
          ReportTableRow(__tableHandle, 0, __cArray4, __cAOp, 1, __cArray3, __oneOfFlag, __bSetInCheckAlignment);
          
      
        }
        ReportTableEndTestStep(__tableHandle, "1");
      }
      TestCommandEnd();


      TestCommandBegin(__eSet, __cSet, "", "3");
      {
        __tableHandle = ReportTableHead3Columns(__cSetCaption , __cTSym, __cTOp, __cAssigned); 
        {
          $`FDCAN14::dbNode::`EPS::`EPS_FD_1::`LwsAngle.phys = __tt2LoopVar0;
          snprintf(__cArray, 8192, "%s", "FDCAN14::EPS::EPS_FD_1::LwsAngle");
          snprintf(__cArray2, 8192, "%s '%s'", __cCANSignal, __cArray);
          snprintf(__cArray3, 8192, "%s", "i");
          
          ReportSetLValueOrSignalNotOnline(getSignalTime(`FDCAN14::dbNode::`EPS::`EPS_FD_1::`LwsAngle), __cArray2, __cArray4, 8192);
          ReportTableRow(__tableHandle, 0, __cArray4, __cAOp, __tt2LoopVar0, __cArray3, __oneOfFlag, __bSetInCheckAlignment);
          
      
        }
        ReportTableEndTestStep(__tableHandle, "1");
      }
      TestCommandEnd();


      TestControlStructEnd(__eUndefined);
    }
    TestControlStructEnd(__eUndefined);
  }

}

testcase Tt56gpegf_TRSC_Calibrating_CurState_5()
{
  stack long __tableHandle;
  SetBreakOnFail(1);

  TestCommandBegin(__eDiagService, __cDiagService, "", "0");
  {
    if (DiagIsFunctionalGroup("CVADAS_0001_00000000_000"))
    {
      DiagResponse * __resp;
      DiagRequest CVADAS_0001_00000000_000.Extended_Diagnostic_Session_Start __req;
      __diagService56gpegf_2(__req, __resp);
    }
    else
    {
      DiagResponse CVADAS_0001_00000000_000.* __resp;
      DiagRequest CVADAS_0001_00000000_000.Extended_Diagnostic_Session_Start __req;
      __diagService56gpegf_2(__req, __resp);
    }
  }
  TestCommandEnd();


  TestCommandBegin(__eWait, __cWait, "", "1");
  {
    Wait("1", (150 * 1000000LL), 1000000, "");
  }
  TestCommandEnd();

  TestCommandBegin(__eDiagService, __cDiagService, "", "2");
  {
    if (DiagIsFunctionalGroup("CVADAS_0001_00000000_000"))
    {
      DiagResponse * __resp;
      DiagRequest CVADAS_0001_00000000_000._31011000_USS_Debug_Signals_Enable_Disable_Start __req;
      __diagService56gpegf_3(__req, __resp);
    }
    else
    {
      DiagResponse CVADAS_0001_00000000_000.* __resp;
      DiagRequest CVADAS_0001_00000000_000._31011000_USS_Debug_Signals_Enable_Disable_Start __req;
      __diagService56gpegf_3(__req, __resp);
    }
  }
  TestCommandEnd();


  TestCommandBegin(__eWait, __cWait, "", "3");
  {
    Wait("1", (500 * 1000000LL), 1000000, "");
  }
  TestCommandEnd();

  TestCommandBegin(__eSet, __cSet, "", "4");
  {
    __tableHandle = ReportTableHead3Columns(__cSetCaption , __cTSym, __cTOp, __cAssigned); 
    {
      $`FDCAN2::dbNode::`SGW::`TELEMATIC_FD_14::`TGW_CAMERA_DISP_STAT.phys = 4;
      snprintf(__cArray, 8192, "%s", "TGW_CAMERA_DISP_STAT");
      snprintf(__cArray2, 8192, "%s '%s'", __cCANSignal, __cArray);
      snprintf(__cArray3, 8192, "%s", "");
      
      ReportSetLValueOrSignalNotOnline(getSignalTime(`FDCAN2::dbNode::`SGW::`TELEMATIC_FD_14::`TGW_CAMERA_DISP_STAT), __cArray2, __cArray4, 8192);
      ReportTableRow(__tableHandle, 0, __cArray4, __cAOp, 4, __cArray3, __oneOfFlag, __bSetInCheckAlignment);
      
  
    }
    {
      $`FDCAN2::dbNode::`BCM::`TRANSM_FD_4::`ShiftLeverPosition.phys = 4;
      snprintf(__cArray, 8192, "%s", "ShiftLeverPosition");
      snprintf(__cArray2, 8192, "%s '%s'", __cCANSignal, __cArray);
      snprintf(__cArray3, 8192, "%s", "");
      
      ReportSetLValueOrSignalNotOnline(getSignalTime(`FDCAN2::dbNode::`BCM::`TRANSM_FD_4::`ShiftLeverPosition), __cArray2, __cArray4, 8192);
      ReportTableRow(__tableHandle, 0, __cArray4, __cAOp, 4, __cArray3, __oneOfFlag, __bSetInCheckAlignment);
      
  
    }
    {
      $`FDCAN2::dbNode::`BCM::`BCM_FD_27::`TrailerConnectionSts.phys = 1;
      snprintf(__cArray, 8192, "%s", "TrailerConnectionSts");
      snprintf(__cArray2, 8192, "%s '%s'", __cCANSignal, __cArray);
      snprintf(__cArray3, 8192, "%s", "");
      
      ReportSetLValueOrSignalNotOnline(getSignalTime(`FDCAN2::dbNode::`BCM::`BCM_FD_27::`TrailerConnectionSts), __cArray2, __cArray4, 8192);
      ReportTableRow(__tableHandle, 0, __cArray4, __cAOp, 1, __cArray3, __oneOfFlag, __bSetInCheckAlignment);
      
  
    }
    {
      $`FDCAN2::dbNode::`BCM::`BCM_FD_29::`ITBM_TrlrStat.phys = 1;
      snprintf(__cArray, 8192, "%s", "ITBM_TrlrStat");
      snprintf(__cArray2, 8192, "%s '%s'", __cCANSignal, __cArray);
      snprintf(__cArray3, 8192, "%s", "");
      
      ReportSetLValueOrSignalNotOnline(getSignalTime(`FDCAN2::dbNode::`BCM::`BCM_FD_29::`ITBM_TrlrStat), __cArray2, __cArray4, 8192);
      ReportTableRow(__tableHandle, 0, __cArray4, __cAOp, 1, __cArray3, __oneOfFlag, __bSetInCheckAlignment);
      
  
    }
    {
      $`FDCAN2::dbNode::`BCM::`BRAKE_FD_2::`VehicleSpeedVSOSig.phys = 10;
      snprintf(__cArray, 8192, "%s", "BCM::BRAKE_FD_2::VehicleSpeedVSOSig");
      snprintf(__cArray2, 8192, "%s '%s'", __cCANSignal, __cArray);
      snprintf(__cArray3, 8192, "%s", "");
      
      ReportSetLValueOrSignalNotOnline(getSignalTime(`FDCAN2::dbNode::`BCM::`BRAKE_FD_2::`VehicleSpeedVSOSig), __cArray2, __cArray4, 8192);
      ReportTableRow(__tableHandle, 0, __cArray4, __cAOp, 10, __cArray3, __oneOfFlag, __bSetInCheckAlignment);
      
  
    }
    ReportTableEndTestStep(__tableHandle, "1");
  }
  TestCommandEnd();


  TestCommandBegin(__eWait, __cWait, "", "5");
  {
    Wait("1", (50 * 1000000LL), 1000000, "");
  }
  TestCommandEnd();

  TestCommandBegin(__eSet, __cSet, "", "6");
  {
    __tableHandle = ReportTableHead3Columns(__cSetCaption , __cTSym, __cTOp, __cAssigned); 
    {
      $`FDCAN2::dbNode::`BCM::`TRANSM_FD_2::`GearEngagedForDisplay.phys = 15;
      snprintf(__cArray, 8192, "%s", "GearEngagedForDisplay");
      snprintf(__cArray2, 8192, "%s '%s'", __cCANSignal, __cArray);
      snprintf(__cArray3, 8192, "%s", "D");
      
      ReportSetLValueOrSignalNotOnline(getSignalTime(`FDCAN2::dbNode::`BCM::`TRANSM_FD_2::`GearEngagedForDisplay), __cArray2, __cArray4, 8192);
      ReportTableRow(__tableHandle, 0, __cArray4, __cAOp, 15, __cArray3, __oneOfFlag, __bSetInCheckAlignment);
      
  
    }
    {
      $`FDCAN14::dbNode::`EPS::`EPS_FD_1::`LwsAngle.phys = 0;
      snprintf(__cArray, 8192, "%s", "FDCAN14::EPS::EPS_FD_1::LwsAngle");
      snprintf(__cArray2, 8192, "%s '%s'", __cCANSignal, __cArray);
      snprintf(__cArray3, 8192, "%s", "");
      
      ReportSetLValueOrSignalNotOnline(getSignalTime(`FDCAN14::dbNode::`EPS::`EPS_FD_1::`LwsAngle), __cArray2, __cArray4, 8192);
      ReportTableRow(__tableHandle, 0, __cArray4, __cAOp, 0, __cArray3, __oneOfFlag, __bSetInCheckAlignment);
      
  
    }
    {
      $`FDCAN14::dbNode::`EPS::`EPS_FD_1::`LwsAngle.phys = 500;
      snprintf(__cArray, 8192, "%s", "FDCAN14::EPS::EPS_FD_1::LwsAngle");
      snprintf(__cArray2, 8192, "%s '%s'", __cCANSignal, __cArray);
      snprintf(__cArray3, 8192, "%s", "");
      
      ReportSetLValueOrSignalNotOnline(getSignalTime(`FDCAN14::dbNode::`EPS::`EPS_FD_1::`LwsAngle), __cArray2, __cArray4, 8192);
      ReportTableRow(__tableHandle, 0, __cArray4, __cAOp, 500, __cArray3, __oneOfFlag, __bSetInCheckAlignment);
      
  
    }
    {
      $`FDCAN14::dbNode::`EPS::`EPS_FD_1::`LwsAngle.phys = 0;
      snprintf(__cArray, 8192, "%s", "FDCAN14::EPS::EPS_FD_1::LwsAngle");
      snprintf(__cArray2, 8192, "%s '%s'", __cCANSignal, __cArray);
      snprintf(__cArray3, 8192, "%s", "");
      
      ReportSetLValueOrSignalNotOnline(getSignalTime(`FDCAN14::dbNode::`EPS::`EPS_FD_1::`LwsAngle), __cArray2, __cArray4, 8192);
      ReportTableRow(__tableHandle, 0, __cArray4, __cAOp, 0, __cArray3, __oneOfFlag, __bSetInCheckAlignment);
      
  
    }
    ReportTableEndTestStep(__tableHandle, "1");
  }
  TestCommandEnd();


  TestCommandBegin(__eWait, __cWait, "", "7");
  {
    Wait("1", (1500 * 1000000LL), 1000000, "");
  }
  TestCommandEnd();

  TestCommandBegin(__eSet, __cSet, "", "8");
  {
    __tableHandle = ReportTableHead3Columns(__cSetCaption , __cTSym, __cTOp, __cAssigned); 
    {
      $`FDCAN2::dbNode::`BCM::`BCM_FD_27::`TrailerConnectionSts.phys = 1;
      snprintf(__cArray, 8192, "%s", "TrailerConnectionSts");
      snprintf(__cArray2, 8192, "%s '%s'", __cCANSignal, __cArray);
      snprintf(__cArray3, 8192, "%s", "Connected");
      
      ReportSetLValueOrSignalNotOnline(getSignalTime(`FDCAN2::dbNode::`BCM::`BCM_FD_27::`TrailerConnectionSts), __cArray2, __cArray4, 8192);
      ReportTableRow(__tableHandle, 0, __cArray4, __cAOp, 1, __cArray3, __oneOfFlag, __bSetInCheckAlignment);
      
  
    }
    ReportTableEndTestStep(__tableHandle, "1");
  }
  TestCommandEnd();


  TestCommandBegin(__eWait, __cWait, "", "9");
  {
    Wait("1", (300 * 1000000LL), 1000000, "");
  }
  TestCommandEnd();

  TestCommandBegin(__eSet, __cSet, "", "10");
  {
    __tableHandle = ReportTableHead3Columns(__cSetCaption , __cTSym, __cTOp, __cAssigned); 
    {
      $`FDCAN2::dbNode::`BCM::`BCM_FD_29::`ITBM_TrlrStat.phys = 1;
      snprintf(__cArray, 8192, "%s", "ITBM_TrlrStat");
      snprintf(__cArray2, 8192, "%s '%s'", __cCANSignal, __cArray);
      snprintf(__cArray3, 8192, "%s", "TRLR_PRSNT");
      
      ReportSetLValueOrSignalNotOnline(getSignalTime(`FDCAN2::dbNode::`BCM::`BCM_FD_29::`ITBM_TrlrStat), __cArray2, __cArray4, 8192);
      ReportTableRow(__tableHandle, 0, __cArray4, __cAOp, 1, __cArray3, __oneOfFlag, __bSetInCheckAlignment);
      
  
    }
    ReportTableEndTestStep(__tableHandle, "1");
  }
  TestCommandEnd();


  TestCommandBegin(__eWait, __cWait, "", "11");
  {
    Wait("1", (300 * 1000000LL), 1000000, "");
  }
  TestCommandEnd();

  TestCommandBegin(__eSet, __cSet, "", "12");
  {
    __tableHandle = ReportTableHead3Columns(__cSetCaption , __cTSym, __cTOp, __cAssigned); 
    {
      $`FDCAN2::dbNode::`BCM::`BRAKE_FD_2::`VehicleSpeedVSOSig.phys = 10;
      snprintf(__cArray, 8192, "%s", "BCM::BRAKE_FD_2::VehicleSpeedVSOSig");
      snprintf(__cArray2, 8192, "%s '%s'", __cCANSignal, __cArray);
      snprintf(__cArray3, 8192, "%s", "");
      
      ReportSetLValueOrSignalNotOnline(getSignalTime(`FDCAN2::dbNode::`BCM::`BRAKE_FD_2::`VehicleSpeedVSOSig), __cArray2, __cArray4, 8192);
      ReportTableRow(__tableHandle, 0, __cArray4, __cAOp, 10, __cArray3, __oneOfFlag, __bSetInCheckAlignment);
      
  
    }
    ReportTableEndTestStep(__tableHandle, "1");
  }
  TestCommandEnd();


  TestCommandBegin(__eWait, __cWait, "", "13");
  {
    Wait("1", (2000 * 1000000LL), 1000000, "");
  }
  TestCommandEnd();

  TestCommandBegin(__eSet, __cSet, "", "14");
  {
    __tableHandle = ReportTableHead3Columns(__cSetCaption , __cTSym, __cTOp, __cAssigned); 
    {
      $`FDCAN2::dbNode::`TRSKM::`TRSKM_FD_1::`TRSC_EnableBtn_Sts.phys = 1;
      snprintf(__cArray, 8192, "%s", "TRSC_EnableBtn_Sts");
      snprintf(__cArray2, 8192, "%s '%s'", __cCANSignal, __cArray);
      snprintf(__cArray3, 8192, "%s", "Pressed");
      
      ReportSetLValueOrSignalNotOnline(getSignalTime(`FDCAN2::dbNode::`TRSKM::`TRSKM_FD_1::`TRSC_EnableBtn_Sts), __cArray2, __cArray4, 8192);
      ReportTableRow(__tableHandle, 0, __cArray4, __cAOp, 1, __cArray3, __oneOfFlag, __bSetInCheckAlignment);
      
  
    }
    ReportTableEndTestStep(__tableHandle, "1");
  }
  TestCommandEnd();


  TestCommandBegin(__eWait, __cWait, "", "15");
  {
    Wait("1", (1500 * 1000000LL), 1000000, "");
  }
  TestCommandEnd();

  TestCommandBegin(__eSet, __cSet, "", "16");
  {
    __tableHandle = ReportTableHead3Columns(__cSetCaption , __cTSym, __cTOp, __cAssigned); 
    {
      $`FDCAN2::dbNode::`TRSKM::`TRSKM_FD_1::`TRSC_EnableBtn_Sts.phys = 0;
      snprintf(__cArray, 8192, "%s", "TRSC_EnableBtn_Sts");
      snprintf(__cArray2, 8192, "%s '%s'", __cCANSignal, __cArray);
      snprintf(__cArray3, 8192, "%s", "NOT_Pressed");
      
      ReportSetLValueOrSignalNotOnline(getSignalTime(`FDCAN2::dbNode::`TRSKM::`TRSKM_FD_1::`TRSC_EnableBtn_Sts), __cArray2, __cArray4, 8192);
      ReportTableRow(__tableHandle, 0, __cArray4, __cAOp, 0, __cArray3, __oneOfFlag, __bSetInCheckAlignment);
      
  
    }
    ReportTableEndTestStep(__tableHandle, "1");
  }
  TestCommandEnd();


  TestCommandBegin(__eWait, __cWait, "", "17");
  {
    Wait("1", (15000 * 1000000LL), 1000000, "");
  }
  TestCommandEnd();

  TestCommandBegin(__eSet, __cSet, "", "18");
  {
    __tableHandle = ReportTableHead3Columns(__cSetCaption , __cTSym, __cTOp, __cAssigned); 
    {
      $`FDCAN14::dbNode::`EPS::`EPS_FD_1::`LwsAngle.phys = 500;
      snprintf(__cArray, 8192, "%s", "FDCAN14::EPS::EPS_FD_1::LwsAngle");
      snprintf(__cArray2, 8192, "%s '%s'", __cCANSignal, __cArray);
      snprintf(__cArray3, 8192, "%s", "");
      
      ReportSetLValueOrSignalNotOnline(getSignalTime(`FDCAN14::dbNode::`EPS::`EPS_FD_1::`LwsAngle), __cArray2, __cArray4, 8192);
      ReportTableRow(__tableHandle, 0, __cArray4, __cAOp, 500, __cArray3, __oneOfFlag, __bSetInCheckAlignment);
      
  
    }
    ReportTableEndTestStep(__tableHandle, "1");
  }
  TestCommandEnd();


  TestCommandBegin(__eWait, __cWait, "", "19");
  {
    Wait("1", (2500 * 1000000LL), 1000000, "");
  }
  TestCommandEnd();

  TestCommandBegin(__eSet, __cSet, "", "20");
  {
    __tableHandle = ReportTableHead3Columns(__cSetCaption , __cTSym, __cTOp, __cAssigned); 
    {
      $`FDCAN14::dbNode::`EPS::`EPS_FD_1::`LwsAngle.phys = 0;
      snprintf(__cArray, 8192, "%s", "FDCAN14::EPS::EPS_FD_1::LwsAngle");
      snprintf(__cArray2, 8192, "%s '%s'", __cCANSignal, __cArray);
      snprintf(__cArray3, 8192, "%s", "");
      
      ReportSetLValueOrSignalNotOnline(getSignalTime(`FDCAN14::dbNode::`EPS::`EPS_FD_1::`LwsAngle), __cArray2, __cArray4, 8192);
      ReportTableRow(__tableHandle, 0, __cArray4, __cAOp, 0, __cArray3, __oneOfFlag, __bSetInCheckAlignment);
      
  
    }
    ReportTableEndTestStep(__tableHandle, "1");
  }
  TestCommandEnd();


  TestCommandBegin(__eWait, __cWait, "", "21");
  {
    Wait("1", (500 * 1000000LL), 1000000, "");
  }
  TestCommandEnd();

  TestCommandBegin(__eWait, __cWait, "", "22");
  {
    Wait("1", (10000 * 1000000LL), 1000000, "");
  }
  TestCommandEnd();

}

  
void __diagService56gpegf_2(DiagRequest * __req, DiagResponse * __resp )
{
  stack long __tableHandle;
  long __res, __paramLen, __bytePos;

   __bVerdict = __eVerdictPass;

  do {
    TestReportResetDiagObjectList();
    DiagSetReportDetailLevel("CVADAS_0001_00000000_000", EnumServiceDetails_onfail);
    // Request aspect
    {

      if (0 >= DiagSendReqAndWaitForResp("CVADAS_0001_00000000_000", __req, __resp, __res, -1, -1, -1, -1, -1, EnumResult_pos, EnumServiceDetails_onfail, EnumSendingMode_physical, EnumSuppressPosResBit_asconfigured, EnumVerdictOnInvalidValues_fail))
        break;
    }

    __res = DiagErrCodeTestStep(__res, "Can't retrieve last response for request! No check possible.") < 0;
    if(__res)
    {
	  __bVerdict = __eVerdictFail;
      break;
    }
    {
      __res = DiagInterpretAs(__resp, "DSC_PR");
      if(__res != 0)
      {
        __bVerdict = __eVerdictFail;
        DiagErrCodeTestStep(__res, "Can't interpret response as diagnostic primitive 'DSC_PR'.");
        break;
      }
      else
      {
        TestStepPass( "Received primitive can be interpreted as diagnostic primitive 'DSC_PR'.");
      }
    }
  }
  while(0);


  // Response, check & read aspect
  {
    __res = 1;
    __tableHandle = ReportTableHead5Columns(__cCheckCaption, __cTSym, __cTOp, __cRefVal, __cActual, __cRes);
    {
      __bDiagValueArrayCtr = DiagGetParameterErrorHandled(__resp, "DiagSessionType", __bDiagValueArray, elcount(__bDiagValueArray), __cDiagValueArray, elcount(__cDiagValueArray));
      {
        byte __bArray2[1] = { 0x03 };
        __bArrayCtr = __CopyBytes(__bDiagValueArray, __bDiagValueArrayCtr, __bArray);
        __bArrayCtr2 = elCount(__bArray2);
        __csr = CompareBytes(__bArray, __bArrayCtr, __bArray2, __bArrayCtr2) == 0;
        snprintf(__cArray, 8192, "%s", "Diagnostic parameter \'DiagSessionType\'");
        snprintf(__cArray2, 8192, "%s", __cArray);
        snprintf(__cArray3, 8192, "%s", "");
        ReportTableRow(__tableHandle, 0, __cArray2, "Bytes", __bArray2, __bArrayCtr2, __cArray3, __oneOfFlag, __bSetInCheckAlignment);
        ReportCell(__tableHandle, __bArray, __bArrayCtr);
        ReportCellResult(__tableHandle, __csr, __ePassFail);
      }
    
      __res = __res && __csr;
    
    }
    ReportTableEndVerdict(__tableHandle, __cEvaluateResponse, __res);
	__bVerdict = __bVerdict && __res;
  }
  if (__bVerdict == __eVerdictFail)
    TestReportWriteDiagObjectList();
}
  
void __diagService56gpegf_3(DiagRequest * __req, DiagResponse * __resp )
{
  stack long __tableHandle;
  long __res, __paramLen, __bytePos;

   __bVerdict = __eVerdictPass;

  do {
    TestReportResetDiagObjectList();
    DiagSetReportDetailLevel("CVADAS_0001_00000000_000", EnumServiceDetails_onfail);
    // Request aspect
    {
      {
        {
          byte __bArray[1] = { 0x01 };
          __bArrayCtr = elCount(__bArray);
          __bDiagValueArrayCtr = __CopyBytes(__bArray, __bArrayCtr, __bDiagValueArray);
        }
      
        __res = DiagSetParameterErrorHandled(__req, "RoutineControlType", __bDiagValueArray, __bDiagValueArrayCtr);
        if(__res < 0)
        {
          __bVerdict = __eVerdictFail;
          DiagErrCodeTestStep(__res, "Cannot set diagnostic parameter 'RoutineControlType'");
          break;
        }
      }
      {
        __res = DiagSetParameterErrorHandled(__req, "RoutineIdentifier", 0x1000);
        if(__res < 0)
        {
          __bVerdict = __eVerdictFail;
          DiagErrCodeTestStep(__res, "Cannot set diagnostic parameter 'RoutineIdentifier'");
          break;
        }
      }
      {
        __res = DiagSetParameterErrorHandled(__req, "Mode", "Debug");
        if(__res < 0)
        {
          __bVerdict = __eVerdictFail;
          DiagErrCodeTestStep(__res, "Cannot set diagnostic parameter 'Mode'");
          break;
        }
      }

      if (0 >= DiagSendReqAndWaitForResp("CVADAS_0001_00000000_000", __req, __resp, __res, -1, -1, -1, -1, -1, EnumResult_pos, EnumServiceDetails_onfail, EnumSendingMode_physical, EnumSuppressPosResBit_asconfigured, EnumVerdictOnInvalidValues_fail))
        break;
    }

    __res = DiagErrCodeTestStep(__res, "Can't retrieve last response for request! No check possible.") < 0;
    if(__res)
    {
	  __bVerdict = __eVerdictFail;
      break;
    }
    {
      __res = DiagInterpretAs(__resp, "RC_STR_PR");
      if(__res != 0)
      {
        __bVerdict = __eVerdictFail;
        DiagErrCodeTestStep(__res, "Can't interpret response as diagnostic primitive 'RC_STR_PR'.");
        break;
      }
      else
      {
        TestStepPass( "Received primitive can be interpreted as diagnostic primitive 'RC_STR_PR'.");
      }
    }
  }
  while(0);


  // Response, check & read aspect
  {
    __res = 1;
    __tableHandle = ReportTableHead5Columns(__cCheckCaption, __cTSym, __cTOp, __cRefVal, __cActual, __cRes);
    {
      double __nDiagValue;
      DiagGetParameterErrorHandled(__resp, "RoutineIdentifier", __nDiagValue);
      __csr = CheckSignalMatch(__nDiagValue, 0x1000, "==") == 1;
      snprintf(__cArray, 8192, "%s", "Diagnostic parameter \'RoutineIdentifier\'");
      snprintf(__cArray2, 8192, "%s", __cArray);
      snprintf(__cArray3, 8192, "%s", "");
      ReportTableRow(__tableHandle, 0, __cArray2, "==", 0x1000, __cArray3, __oneOfFlag, __bSetInCheckAlignment);
      ReportCell(__tableHandle, __nDiagValue);
      ReportCellResult(__tableHandle, __csr, __ePassFail);
    
      __res = __res && __csr;
    
    }
    {
      DiagGetParameterErrorHandled(__resp, "Mode", __bDiagValueArray, elcount(__bDiagValueArray), __cDiagValueArray, elcount(__cDiagValueArray));
      CheckCaplGenVarStringBufferConsistency(__cDiagValueArray, 8192);
      snprintf(__cArray, 8192, "%s", __cDiagValueArray);
      CheckLiteralGetStringBufferConsistency("Debug", 8192);
      snprintf(__cArray2, 8192, "%s", "Debug");
      __csr = strncmp(__cArray, __cArray2, 8192) == 0;
      snprintf(__cArray3, 8192, "%s", "Diagnostic parameter \'Mode\'");
      snprintf(__cArray4, 8192, "%s", __cArray3);
      snprintf(__cArray5, 8192, "%s", "");
      ReportTableRow(__tableHandle, 0, __cArray4, "==", __cArray2, __cArray5, __oneOfFlag, __bSetInCheckAlignment);
      ReportCell(__tableHandle, __cArray);
      ReportCellResult(__tableHandle, __csr, __ePassFail);
    
      __res = __res && __csr;
    
    }
    ReportTableEndVerdict(__tableHandle, __cEvaluateResponse, __res);
	__bVerdict = __bVerdict && __res;
  }
  if (__bVerdict == __eVerdictFail)
    TestReportWriteDiagObjectList();
}

testcase Tt56gpegf_TRSC_Turn_Off()
{
  stack long __tableHandle;
  SetBreakOnFail(1);

  {
    CreateCaplIFFunction("Disable_CAN_Communication", __eFct);
    CallInterfaceFunction(__cEmpty, __cEmpty, "0");
  }


  {
    CreateCaplIFFunction("Enable_CAN_Communication", __eFct);
    CallInterfaceFunction(__cEmpty, __cEmpty, "1");
  }


  TestCommandBegin(__eWait, __cWait, "", "2");
  {
    Wait("1", (45 * 1000000000LL), 1000000000, "");
  }
  TestCommandEnd();

}

testsequence Tt56gpegf_EOL_Calibration()
{
  stack long __tableHandle;
  SetBreakOnFail(1);

  CreateTTEIFFunction("Tt56gpegf_TsTc0", __eTcDef, __eLocal);
  AddIFParameterTestCaseAttribute("TC_ID", "");
  AddIFParameterTestCaseAttribute("Test Case ID", "");
  CallInterfaceFunction("21189419_Calibrate_All_Cameras", __cEmpty , "dacc6588-021b-4514-bb9b-11e75a534853");

}

testcase Tt56gpegf_TsTc0()
{
  stack long __tableHandle;
  SetBreakOnFail(1);

  TestCommandBegin(__eWait, __cWait, "", "0");
  {
    Wait("1", (10000 * 1000000LL), 1000000, "");
  }
  TestCommandEnd();

  TestCommandBegin(__eDiagService, __cDiagService, "", "1");
  {
    if (DiagIsFunctionalGroup("CVADAS_0001_00000000_000"))
    {
      DiagResponse * __resp;
      DiagRequest CVADAS_0001_00000000_000.Extended_Diagnostic_Session_Start __req;
      __diagService56gpegf_4(__req, __resp);
    }
    else
    {
      DiagResponse CVADAS_0001_00000000_000.* __resp;
      DiagRequest CVADAS_0001_00000000_000.Extended_Diagnostic_Session_Start __req;
      __diagService56gpegf_4(__req, __resp);
    }
  }
  TestCommandEnd();


  TestCommandBegin(__eWait, __cWait, "", "2");
  {
    Wait("1", (1000 * 1000000LL), 1000000, "");
  }
  TestCommandEnd();

  TestCommandBegin(__eDiagService, __cDiagService, "", "3");
  {
    if (DiagIsFunctionalGroup("CVADAS_0001_00000000_000"))
    {
      DiagResponse * __resp;
      DiagRequest CVADAS_0001_00000000_000._22FD00_Plant_Camera_Calibration_Data_Write __req;
      __diagService56gpegf_5(__req, __resp);
    }
    else
    {
      DiagResponse CVADAS_0001_00000000_000.* __resp;
      DiagRequest CVADAS_0001_00000000_000._22FD00_Plant_Camera_Calibration_Data_Write __req;
      __diagService56gpegf_5(__req, __resp);
    }
  }
  TestCommandEnd();


  TestCommandBegin(__eWait, __cWait, "", "4");
  {
    Wait("1", (1000 * 1000000LL), 1000000, "");
  }
  TestCommandEnd();

  TestCommandBegin(__eDiagService, __cDiagService, "", "5");
  {
    if (DiagIsFunctionalGroup("CVADAS_0001_00000000_000"))
    {
      DiagResponse * __resp;
      DiagRequest CVADAS_0001_00000000_000.Extended_Diagnostic_Session_Start __req;
      __diagService56gpegf_6(__req, __resp);
    }
    else
    {
      DiagResponse CVADAS_0001_00000000_000.* __resp;
      DiagRequest CVADAS_0001_00000000_000.Extended_Diagnostic_Session_Start __req;
      __diagService56gpegf_6(__req, __resp);
    }
  }
  TestCommandEnd();


  TestCommandBegin(__eWait, __cWait, "", "6");
  {
    Wait("1", (1000 * 1000000LL), 1000000, "");
  }
  TestCommandEnd();

  TestCommandBegin(__eWait, __cWait, "", "8");
  {
    Wait("1", (1000 * 1000000LL), 1000000, "");
  }
  TestCommandEnd();

  {
    CreateCaplIFFunction("Hard_Reset", __eFct);
    CallInterfaceFunction(__cEmpty, __cEmpty, "9");
  }


  TestCommandBegin(__eWait, __cWait, "", "10");
  {
    Wait("1", (35000 * 1000000LL), 1000000, "");
  }
  TestCommandEnd();

  {
    CreateCaplIFFunction("Clear_DTC", __eFct);
    CallInterfaceFunction(__cEmpty, __cEmpty, "11");
  }


}

  
void __diagService56gpegf_4(DiagRequest * __req, DiagResponse * __resp )
{
  stack long __tableHandle;
  long __res, __paramLen, __bytePos;

   __bVerdict = __eVerdictPass;

  do {
    TestReportResetDiagObjectList();
    DiagSetReportDetailLevel("CVADAS_0001_00000000_000", EnumServiceDetails_onfail);
    // Request aspect
    {
      {
        __res = DiagSetParameterErrorHandled(__req, "DiagSessionType", 03);
        if(__res < 0)
        {
          __bVerdict = __eVerdictFail;
          DiagErrCodeTestStep(__res, "Cannot set diagnostic parameter 'DiagSessionType'");
          break;
        }
      }

      if (0 >= DiagSendReqAndWaitForResp("CVADAS_0001_00000000_000", __req, __resp, __res, -1, -1, -1, -1, -1, EnumResult_pos, EnumServiceDetails_onfail, EnumSendingMode_physical, EnumSuppressPosResBit_asconfigured, EnumVerdictOnInvalidValues_fail))
        break;
    }

    __res = DiagErrCodeTestStep(__res, "Can't retrieve last response for request! No check possible.") < 0;
    if(__res)
    {
	  __bVerdict = __eVerdictFail;
      break;
    }
    {
      __res = DiagInterpretAs(__resp, "DSC_PR");
      if(__res != 0)
      {
        __bVerdict = __eVerdictFail;
        DiagErrCodeTestStep(__res, "Can't interpret response as diagnostic primitive 'DSC_PR'.");
        break;
      }
      else
      {
        TestStepPass( "Received primitive can be interpreted as diagnostic primitive 'DSC_PR'.");
      }
    }
  }
  while(0);


  // Response, check & read aspect
  {
    __res = 1;
    __tableHandle = ReportTableHead5Columns(__cCheckCaption, __cTSym, __cTOp, __cRefVal, __cActual, __cRes);
    {
      double __nDiagValue;
      DiagGetParameterErrorHandled(__resp, "DiagSessionType", __nDiagValue);
      __csr = CheckSignalMatch(__nDiagValue, 03, "==") == 1;
      snprintf(__cArray, 8192, "%s", "Diagnostic parameter \'DiagSessionType\'");
      snprintf(__cArray2, 8192, "%s", __cArray);
      snprintf(__cArray3, 8192, "%s", "");
      ReportTableRow(__tableHandle, 0, __cArray2, "==", 03, __cArray3, __oneOfFlag, __bSetInCheckAlignment);
      ReportCell(__tableHandle, __nDiagValue);
      ReportCellResult(__tableHandle, __csr, __ePassFail);
    
      __res = __res && __csr;
    
    }
    ReportTableEndVerdict(__tableHandle, __cEvaluateResponse, __res);
	__bVerdict = __bVerdict && __res;
  }
  if (__bVerdict == __eVerdictFail)
    TestReportWriteDiagObjectList();
}
  
void __diagService56gpegf_5(DiagRequest * __req, DiagResponse * __resp )
{
  stack long __tableHandle;
  long __res, __paramLen, __bytePos;

   __bVerdict = __eVerdictPass;

  do {
    TestReportResetDiagObjectList();
    DiagSetReportDetailLevel("CVADAS_0001_00000000_000", EnumServiceDetails_onfail);
    // Request aspect
    {
      {
        {
          byte __bArray[1] = { 0x03 };
          __bArrayCtr = elCount(__bArray);
          __bDiagValueArrayCtr = __CopyBytes(__bArray, __bArrayCtr, __bDiagValueArray);
        }
      
        __res = DiagSetParameterErrorHandled(__req, "CalibrationStatus_Front", __bDiagValueArray, __bDiagValueArrayCtr);
        if(__res < 0)
        {
          __bVerdict = __eVerdictFail;
          DiagErrCodeTestStep(__res, "Cannot set diagnostic parameter 'CalibrationStatus_Front'");
          break;
        }
      }
      {
        {
          byte __bArray[1] = { 0x03 };
          __bArrayCtr = elCount(__bArray);
          __bDiagValueArrayCtr = __CopyBytes(__bArray, __bArrayCtr, __bDiagValueArray);
        }
      
        __res = DiagSetParameterErrorHandled(__req, "CalibrationStatus_Left", __bDiagValueArray, __bDiagValueArrayCtr);
        if(__res < 0)
        {
          __bVerdict = __eVerdictFail;
          DiagErrCodeTestStep(__res, "Cannot set diagnostic parameter 'CalibrationStatus_Left'");
          break;
        }
      }
      {
        {
          byte __bArray[1] = { 0x03 };
          __bArrayCtr = elCount(__bArray);
          __bDiagValueArrayCtr = __CopyBytes(__bArray, __bArrayCtr, __bDiagValueArray);
        }
      
        __res = DiagSetParameterErrorHandled(__req, "CalibrationStatus_Rear", __bDiagValueArray, __bDiagValueArrayCtr);
        if(__res < 0)
        {
          __bVerdict = __eVerdictFail;
          DiagErrCodeTestStep(__res, "Cannot set diagnostic parameter 'CalibrationStatus_Rear'");
          break;
        }
      }
      {
        {
          byte __bArray[1] = { 0x03 };
          __bArrayCtr = elCount(__bArray);
          __bDiagValueArrayCtr = __CopyBytes(__bArray, __bArrayCtr, __bDiagValueArray);
        }
      
        __res = DiagSetParameterErrorHandled(__req, "CalibrationStatus_Right", __bDiagValueArray, __bDiagValueArrayCtr);
        if(__res < 0)
        {
          __bVerdict = __eVerdictFail;
          DiagErrCodeTestStep(__res, "Cannot set diagnostic parameter 'CalibrationStatus_Right'");
          break;
        }
      }
      {
        __res = DiagSetParameterErrorHandled(__req, "Odometer_Value_at_Plant_Calibration", 500);
        if(__res < 0)
        {
          __bVerdict = __eVerdictFail;
          DiagErrCodeTestStep(__res, "Cannot set diagnostic parameter 'Odometer_Value_at_Plant_Calibration'");
          break;
        }
      }

      if (0 >= DiagSendReqAndWaitForResp("CVADAS_0001_00000000_000", __req, __resp, __res, -1, -1, -1, -1, -1, EnumResult_pos, EnumServiceDetails_onfail, EnumSendingMode_physical, EnumSuppressPosResBit_asconfigured, EnumVerdictOnInvalidValues_fail))
        break;
    }

    __res = DiagErrCodeTestStep(__res, "Can't retrieve last response for request! No check possible.") < 0;
    if(__res)
    {
	  __bVerdict = __eVerdictFail;
      break;
    }
    {
      __res = DiagInterpretAs(__resp, "WDBI_PR");
      if(__res != 0)
      {
        __bVerdict = __eVerdictFail;
        DiagErrCodeTestStep(__res, "Can't interpret response as diagnostic primitive 'WDBI_PR'.");
        break;
      }
      else
      {
        TestStepPass( "Received primitive can be interpreted as diagnostic primitive 'WDBI_PR'.");
      }
    }
  }
  while(0);


  if (__bVerdict == __eVerdictFail)
    TestReportWriteDiagObjectList();
}
  
void __diagService56gpegf_6(DiagRequest * __req, DiagResponse * __resp )
{
  stack long __tableHandle;
  long __res, __paramLen, __bytePos;

   __bVerdict = __eVerdictPass;

  do {
    TestReportResetDiagObjectList();
    DiagSetReportDetailLevel("CVADAS_0001_00000000_000", EnumServiceDetails_onfail);
    // Request aspect
    {
      {
        __res = DiagSetParameterErrorHandled(__req, "DiagSessionType", 03);
        if(__res < 0)
        {
          __bVerdict = __eVerdictFail;
          DiagErrCodeTestStep(__res, "Cannot set diagnostic parameter 'DiagSessionType'");
          break;
        }
      }

      if (0 >= DiagSendReqAndWaitForResp("CVADAS_0001_00000000_000", __req, __resp, __res, -1, -1, -1, -1, -1, EnumResult_pos, EnumServiceDetails_onfail, EnumSendingMode_physical, EnumSuppressPosResBit_asconfigured, EnumVerdictOnInvalidValues_fail))
        break;
    }

    __res = DiagErrCodeTestStep(__res, "Can't retrieve last response for request! No check possible.") < 0;
    if(__res)
    {
	  __bVerdict = __eVerdictFail;
      break;
    }
    {
      __res = DiagInterpretAs(__resp, "DSC_PR");
      if(__res != 0)
      {
        __bVerdict = __eVerdictFail;
        DiagErrCodeTestStep(__res, "Can't interpret response as diagnostic primitive 'DSC_PR'.");
        break;
      }
      else
      {
        TestStepPass( "Received primitive can be interpreted as diagnostic primitive 'DSC_PR'.");
      }
    }
  }
  while(0);


  // Response, check & read aspect
  {
    __res = 1;
    __tableHandle = ReportTableHead5Columns(__cCheckCaption, __cTSym, __cTOp, __cRefVal, __cActual, __cRes);
    {
      double __nDiagValue;
      DiagGetParameterErrorHandled(__resp, "DiagSessionType", __nDiagValue);
      __csr = CheckSignalMatch(__nDiagValue, 03, "==") == 1;
      snprintf(__cArray, 8192, "%s", "Diagnostic parameter \'DiagSessionType\'");
      snprintf(__cArray2, 8192, "%s", __cArray);
      snprintf(__cArray3, 8192, "%s", "");
      ReportTableRow(__tableHandle, 0, __cArray2, "==", 03, __cArray3, __oneOfFlag, __bSetInCheckAlignment);
      ReportCell(__tableHandle, __nDiagValue);
      ReportCellResult(__tableHandle, __csr, __ePassFail);
    
      __res = __res && __csr;
    
    }
    ReportTableEndVerdict(__tableHandle, __cEvaluateResponse, __res);
	__bVerdict = __bVerdict && __res;
  }
  if (__bVerdict == __eVerdictFail)
    TestReportWriteDiagObjectList();
}

testsequence Tt56gpegf_Reset_NVM()
{
  stack long __tableHandle;
  SetBreakOnFail(1);

  CreateTTEIFFunction("Tt56gpegf_TsTc1", __eTcDef, __eLocal);
  AddIFParameterTestCaseAttribute("TC_ID", "");
  AddIFParameterTestCaseAttribute("Test Case ID", "");
  CallInterfaceFunction("20657328_Reset_NVM", __cEmpty , "65d01d70-8e7e-4854-b94f-96ed0f5239ae");

}

testcase Tt56gpegf_TsTc1()
{
  stack long __tableHandle;
  SetBreakOnFail(1);

  TestPreparationBegin();
  {
  }
  TestPreparationEnd();

  TestCaseDescription("");

  TestCommandBegin(__eWait, __cWait, "Wait for boot up initally after flash", "0");
  {
    Wait("1", (45000 * 1000000LL), 1000000, "");
  }
  TestCommandEnd();

  TestCommandBegin(__eDiagService, __cDiagService, "", "1");
  {
    if (DiagIsFunctionalGroup("CVADAS_0001_00000000_000"))
    {
      DiagResponse * __resp;
      DiagRequest CVADAS_0001_00000000_000.Extended_Diagnostic_Session_Start __req;
      __diagService56gpegf_7(__req, __resp);
    }
    else
    {
      DiagResponse CVADAS_0001_00000000_000.* __resp;
      DiagRequest CVADAS_0001_00000000_000.Extended_Diagnostic_Session_Start __req;
      __diagService56gpegf_7(__req, __resp);
    }
  }
  TestCommandEnd();


  TestCommandBegin(__eDiagService, __cDiagService, "", "2");
  {
    if (DiagIsFunctionalGroup("CVADAS_0001_00000000_000"))
    {
      DiagResponse * __resp;
      DiagRequest CVADAS_0001_00000000_000._2EFD4E_Reset_NVM_Write __req;
      __diagService56gpegf_8(__req, __resp);
    }
    else
    {
      DiagResponse CVADAS_0001_00000000_000.* __resp;
      DiagRequest CVADAS_0001_00000000_000._2EFD4E_Reset_NVM_Write __req;
      __diagService56gpegf_8(__req, __resp);
    }
  }
  TestCommandEnd();


  TestCommandBegin(__eWait, __cWait, "", "3");
  {
    Wait("1", (10000 * 1000000LL), 1000000, "");
  }
  TestCommandEnd();

  {
    CreateCaplIFFunction("Hard_Reset", __eFct);
    CallInterfaceFunction(__cEmpty, __cEmpty, "4");
  }


  TestCommandBegin(__eWait, __cWait, "", "5");
  {
    Wait("1", (45000 * 1000000LL), 1000000, "");
  }
  TestCommandEnd();

}

  
void __diagService56gpegf_7(DiagRequest * __req, DiagResponse * __resp )
{
  stack long __tableHandle;
  long __res, __paramLen, __bytePos;

   __bVerdict = __eVerdictPass;

  do {
    TestReportResetDiagObjectList();
    DiagSetReportDetailLevel("CVADAS_0001_00000000_000", EnumServiceDetails_onfail);
    // Request aspect
    {
      {
        __res = DiagSetParameterErrorHandled(__req, "DiagSessionType", 03);
        if(__res < 0)
        {
          __bVerdict = __eVerdictFail;
          DiagErrCodeTestStep(__res, "Cannot set diagnostic parameter 'DiagSessionType'");
          break;
        }
      }

      if (0 >= DiagSendReqAndWaitForResp("CVADAS_0001_00000000_000", __req, __resp, __res, -1, -1, -1, -1, -1, EnumResult_pos, EnumServiceDetails_onfail, EnumSendingMode_physical, EnumSuppressPosResBit_asconfigured, EnumVerdictOnInvalidValues_fail))
        break;
    }

    __res = DiagErrCodeTestStep(__res, "Can't retrieve last response for request! No check possible.") < 0;
    if(__res)
    {
	  __bVerdict = __eVerdictFail;
      break;
    }
    {
      __res = DiagInterpretAs(__resp, "DSC_PR");
      if(__res != 0)
      {
        __bVerdict = __eVerdictFail;
        DiagErrCodeTestStep(__res, "Can't interpret response as diagnostic primitive 'DSC_PR'.");
        break;
      }
      else
      {
        TestStepPass( "Received primitive can be interpreted as diagnostic primitive 'DSC_PR'.");
      }
    }
  }
  while(0);


  // Response, check & read aspect
  {
    __res = 1;
    __tableHandle = ReportTableHead5Columns(__cCheckCaption, __cTSym, __cTOp, __cRefVal, __cActual, __cRes);
    {
      double __nDiagValue;
      DiagGetParameterErrorHandled(__resp, "DiagSessionType", __nDiagValue);
      __csr = CheckSignalMatch(__nDiagValue, 03, "==") == 1;
      snprintf(__cArray, 8192, "%s", "Diagnostic parameter \'DiagSessionType\'");
      snprintf(__cArray2, 8192, "%s", __cArray);
      snprintf(__cArray3, 8192, "%s", "");
      ReportTableRow(__tableHandle, 0, __cArray2, "==", 03, __cArray3, __oneOfFlag, __bSetInCheckAlignment);
      ReportCell(__tableHandle, __nDiagValue);
      ReportCellResult(__tableHandle, __csr, __ePassFail);
    
      __res = __res && __csr;
    
    }
    ReportTableEndVerdict(__tableHandle, __cEvaluateResponse, __res);
	__bVerdict = __bVerdict && __res;
  }
  if (__bVerdict == __eVerdictFail)
    TestReportWriteDiagObjectList();
}
  
void __diagService56gpegf_8(DiagRequest * __req, DiagResponse * __resp )
{
  stack long __tableHandle;
  long __res, __paramLen, __bytePos;

   __bVerdict = __eVerdictPass;

  do {
    TestReportResetDiagObjectList();
    DiagSetReportDetailLevel("CVADAS_0001_00000000_000", EnumServiceDetails_onfail);
    // Request aspect
    {
      {
        {
          byte __bArray[1] = { 0x00 };
          __bArrayCtr = elCount(__bArray);
          __bDiagValueArrayCtr = __CopyBytes(__bArray, __bArrayCtr, __bDiagValueArray);
        }
      
        __res = DiagSetParameterErrorHandled(__req, "HighLevel_NVM_Block_ID", __bDiagValueArray, __bDiagValueArrayCtr);
        if(__res < 0)
        {
          __bVerdict = __eVerdictFail;
          DiagErrCodeTestStep(__res, "Cannot set diagnostic parameter 'HighLevel_NVM_Block_ID'");
          break;
        }
      }

      if (0 >= DiagSendReqAndWaitForResp("CVADAS_0001_00000000_000", __req, __resp, __res, -1, -1, -1, -1, -1, EnumResult_pos, EnumServiceDetails_onfail, EnumSendingMode_physical, EnumSuppressPosResBit_asconfigured, EnumVerdictOnInvalidValues_fail))
        break;
    }

    __res = DiagErrCodeTestStep(__res, "Can't retrieve last response for request! No check possible.") < 0;
    if(__res)
    {
	  __bVerdict = __eVerdictFail;
      break;
    }
    {
      __res = DiagInterpretAs(__resp, "WDBI_PR");
      if(__res != 0)
      {
        __bVerdict = __eVerdictFail;
        DiagErrCodeTestStep(__res, "Can't interpret response as diagnostic primitive 'WDBI_PR'.");
        break;
      }
      else
      {
        TestStepPass( "Received primitive can be interpreted as diagnostic primitive 'WDBI_PR'.");
      }
    }
  }
  while(0);


  if (__bVerdict == __eVerdictFail)
    TestReportWriteDiagObjectList();
}

testsequence Tt56gpegf_HMI_View_Switch()
{
  stack long __tableHandle;
  SetBreakOnFail(1);

  CreateTTEIFFunction("Tt56gpegf_TsTc2_Completion", __eFct, __eLocal);
  
  AddIFAsCleanUpFunction();

  TestPreparationBegin();
  {
    {
      CreateTTEIFFunction("Tt56gpegf_General_Precondition", __eFct, __eLocal);
      CallInterfaceFunction(__cEmpty, __cEmpty, "43b50592-ee14-4403-86eb-feacfb5147e3");
    }


  }
  TestPreparationEnd();

  CreateTTEIFFunction("Tt56gpegf_TsTc3", __eTcDef, __eLocal);
  AddIFParameterTestCaseAttribute("TC_ID", "");
  AddIFParameterTestCaseAttribute("Test Case ID", "");
  CallInterfaceFunction("Set to Surround View Camera", __cEmpty , "f920fc90-9511-4f8e-8a23-d4e4c68d33f9");

  CreateTTEIFFunction("Tt56gpegf_TsTc4", __eTcDef, __eLocal);
  AddIFParameterTestCaseAttribute("TC_ID", "");
  AddIFParameterTestCaseAttribute("Test Case ID", "");
  CallInterfaceFunction("Default View", __cEmpty , "2b1e2025-f8d0-417c-956e-0de1dab89741");

  CreateTTEIFFunction("Tt56gpegf_TsTc5", __eTcDef, __eLocal);
  AddIFParameterTestCaseAttribute("TC_ID", "");
  AddIFParameterTestCaseAttribute("Test Case ID", "");
  CallInterfaceFunction("View 1: FVTV_RVTV", __cEmpty , "b39fabb0-ec33-40be-96b1-624cf1d3a87a");

  CreateTTEIFFunction("Tt56gpegf_TsTc6", __eTcDef, __eLocal);
  AddIFParameterTestCaseAttribute("TC_ID", "");
  AddIFParameterTestCaseAttribute("Test Case ID", "");
  CallInterfaceFunction("View 2: BackupRearView", __cEmpty , "ce48b509-13e6-44ed-a05b-60abc7ca0f95");

  CreateTTEIFFunction("Tt56gpegf_TsTc7", __eTcDef, __eLocal);
  AddIFParameterTestCaseAttribute("TC_ID", "");
  AddIFParameterTestCaseAttribute("Test Case ID", "");
  CallInterfaceFunction("View 3: Forward Facing Camera", __cEmpty , "84c2cf7a-2501-4fbb-b7e2-ddfda1e72afa");

  CreateTTEIFFunction("Tt56gpegf_TsTc8", __eTcDef, __eLocal);
  AddIFParameterTestCaseAttribute("TC_ID", "");
  AddIFParameterTestCaseAttribute("Test Case ID", "");
  CallInterfaceFunction("View 4: Cargo Camera", __cEmpty , "1a0087ce-f6ab-4757-8d8c-ea47f0d81316");

  CreateTTEIFFunction("Tt56gpegf_TsTc9", __eTcDef, __eLocal);
  AddIFParameterTestCaseAttribute("TC_ID", "");
  AddIFParameterTestCaseAttribute("Test Case ID", "");
  CallInterfaceFunction("View 5: Trailer Reverse Guidance", __cEmpty , "baa7604b-b337-47d4-b426-1880ca05f9fc");

  CreateTTEIFFunction("Tt56gpegf_TsTc10", __eTcDef, __eLocal);
  AddIFParameterTestCaseAttribute("TC_ID", "");
  AddIFParameterTestCaseAttribute("Test Case ID", "");
  CallInterfaceFunction("View 6: Trailer Left View", __cEmpty , "f81e3511-26bc-4d94-bb2a-d7b463a403b1");

  CreateTTEIFFunction("Tt56gpegf_TsTc11", __eTcDef, __eLocal);
  AddIFParameterTestCaseAttribute("TC_ID", "");
  AddIFParameterTestCaseAttribute("Test Case ID", "");
  CallInterfaceFunction("View 7: Trailer Right View", __cEmpty , "37a3a589-67b3-4f9d-b6c9-c3677e305f2a");

  CreateTTEIFFunction("Tt56gpegf_TsTc12", __eTcDef, __eLocal);
  AddIFParameterTestCaseAttribute("TC_ID", "");
  AddIFParameterTestCaseAttribute("Test Case ID", "");
  CallInterfaceFunction("View 8: Blind Spot Left View", __cEmpty , "86e35589-6011-4506-8886-fbf0a929cedb");

  CreateTTEIFFunction("Tt56gpegf_TsTc13", __eTcDef, __eLocal);
  AddIFParameterTestCaseAttribute("TC_ID", "");
  AddIFParameterTestCaseAttribute("Test Case ID", "");
  CallInterfaceFunction("View 9: Blind Spot Right View", __cEmpty , "3a1dcd18-1593-495d-847e-68022f936d2e");

  CreateTTEIFFunction("Tt56gpegf_TsTc14", __eTcDef, __eLocal);
  AddIFParameterTestCaseAttribute("TC_ID", "");
  AddIFParameterTestCaseAttribute("Test Case ID", "");
  CallInterfaceFunction("View 11: FVTV", __cEmpty , "8e3320a8-8517-437b-b9a0-375c0f43771b");

  CreateTTEIFFunction("Tt56gpegf_TsTc15", __eTcDef, __eLocal);
  AddIFParameterTestCaseAttribute("TC_ID", "");
  AddIFParameterTestCaseAttribute("Test Case ID", "");
  CallInterfaceFunction("View 12: RVTV", __cEmpty , "5a78ae74-2023-44d2-b8d4-bc332413ae3d");

  CreateTTEIFFunction("Tt56gpegf_TsTc16", __eTcDef, __eLocal);
  AddIFParameterTestCaseAttribute("TC_ID", "");
  AddIFParameterTestCaseAttribute("Test Case ID", "");
  CallInterfaceFunction("View 13: FrontCrossPathView", __cEmpty , "1d9df939-0173-4673-b639-dd4ddba19ec0");

  CreateTTEIFFunction("Tt56gpegf_TsTc17", __eTcDef, __eLocal);
  AddIFParameterTestCaseAttribute("TC_ID", "");
  AddIFParameterTestCaseAttribute("Test Case ID", "");
  CallInterfaceFunction("View 14: RearCrossPathView", __cEmpty , "83a65e29-68ce-4ce7-a6d8-74aa497e5f8c");


}

void Tt56gpegf_TsTc2_Completion()
{
  stack long __tableHandle;
  TestCompletionBegin();
  {
    {
      CreateTTEIFFunction("Tt56gpegf_General_Postconditions", __eFct, __eLocal);
      CallInterfaceFunction(__cEmpty, __cEmpty, "d53919e9-7a4a-4475-b807-22904a2462c8");
    }


  }
  TestCompletionEnd();
}

testcase Tt56gpegf_TsTc3()
{
  stack long __tableHandle;
  SetBreakOnFail(1);

  TestPreparationBegin();
  {
  }
  TestPreparationEnd();

  TestCommandBegin(__eSet, __cSet, "", "0");
  {
    __tableHandle = ReportTableHead3Columns(__cSetCaption , __cTSym, __cTOp, __cAssigned); 
    {
      $`FDCAN2::dbNode::`SGW::`TELEMATIC_FD_14::`TGW_CAMERA_DISP_STAT.phys = 4;
      snprintf(__cArray, 8192, "%s", "TGW_CAMERA_DISP_STAT");
      snprintf(__cArray2, 8192, "%s '%s'", __cCANSignal, __cArray);
      snprintf(__cArray3, 8192, "%s", "");
      
      ReportSetLValueOrSignalNotOnline(getSignalTime(`FDCAN2::dbNode::`SGW::`TELEMATIC_FD_14::`TGW_CAMERA_DISP_STAT), __cArray2, __cArray4, 8192);
      ReportTableRow(__tableHandle, 0, __cArray4, __cAOp, 4, __cArray3, __oneOfFlag, __bSetInCheckAlignment);
      
  
    }
    {
      $`FDCAN2::dbNode::`SGW::`TELEMATIC_FD_5::`CameraDisplaySts2.phys = 0;
      snprintf(__cArray, 8192, "%s", "CameraDisplaySts2");
      snprintf(__cArray2, 8192, "%s '%s'", __cCANSignal, __cArray);
      snprintf(__cArray3, 8192, "%s", "Default");
      
      ReportSetLValueOrSignalNotOnline(getSignalTime(`FDCAN2::dbNode::`SGW::`TELEMATIC_FD_5::`CameraDisplaySts2), __cArray2, __cArray4, 8192);
      ReportTableRow(__tableHandle, 0, __cArray4, __cAOp, 0, __cArray3, __oneOfFlag, __bSetInCheckAlignment);
      
  
    }
    ReportTableEndTestStep(__tableHandle, "1");
  }
  TestCommandEnd();


  TestCommandBegin(__eWait, __cWait, "", "1");
  {
    Wait("1", (1 * 1000000000LL), 1000000000, "");
  }
  TestCommandEnd();

  TestCommandBegin(__eCheck, __cCheck, "", "2");
  {
    __bVerdict = __eVerdictPass;
    __tableHandle = ReportTableHead5Columns(__cCheckCaption, __cTSym, __cTOp, __cRefVal, __cActual, __cRes);
    {
      {
        int __res1,__res2;
        __res1 = CheckSignalMatch(`FDCAN2::dbNode::`SGW::`TELEMATIC_FD_14::`TGW_CAMERA_DISP_STAT, 0, __cGreaterEqualThan) == 1;
        __res2 = CheckSignalMatch(`FDCAN2::dbNode::`SGW::`TELEMATIC_FD_14::`TGW_CAMERA_DISP_STAT, 4, __cLessEqualThan) == 1;
        __csr = __res1 && __res2;
        snprintf(__cArray, 8192, "%s", "TGW_CAMERA_DISP_STAT");
        snprintf(__cArray2, 8192, "%s '%s'", __cCANSignal, __cArray);
        snprintf(__cArray3, 8192, "%s", "");
        snprintf(__cArray4, 8192, "%s", "");
        snprintf(__cArray5, 8192, "%s", __cArray3);
        snprintf(__cArray6, 8192, "%s", __cArray4);
        ReportRange(0, 4, __cArray5, __cArray6, __cArray7, 8192);
        ReportTableRow(__tableHandle, 0, __cArray2, __cRange, __cArray7, __cEmpty, __oneOfFlag, __bSetInCheckAlignment);
        ReportLValueOrSignalNotOnline(`FDCAN2::dbNode::`SGW::`TELEMATIC_FD_14::`TGW_CAMERA_DISP_STAT, __cArray8, 8192);
        ReportCell(__tableHandle, __cArray8);
        ReportCellResult(__tableHandle, __csr, __ePassFail);
      }
  
      __bVerdict = __bVerdict && __csr;
    }
    ReportTableEndVerdict(__tableHandle, "1", __bVerdict);
  }
  TestCommandEnd();


  TestCommandBegin(__eWait, __cWait, "", "3");
  {
    Wait("1", (1 * 1000000000LL), 1000000000, "");
  }
  TestCommandEnd();

}

testcase Tt56gpegf_TsTc4()
{
  stack long __tableHandle;
  SetBreakOnFail(1);

  TestCommandBegin(__eSet, __cSet, "", "0");
  {
    __tableHandle = ReportTableHead3Columns(__cSetCaption , __cTSym, __cTOp, __cAssigned); 
    {
      $`FDCAN2::dbNode::`SGW::`TELEMATIC_FD_5::`CameraDisplaySts2.phys = 2;
      snprintf(__cArray, 8192, "%s", "CameraDisplaySts2");
      snprintf(__cArray2, 8192, "%s '%s'", __cCANSignal, __cArray);
      snprintf(__cArray3, 8192, "%s", "");
      
      ReportSetLValueOrSignalNotOnline(getSignalTime(`FDCAN2::dbNode::`SGW::`TELEMATIC_FD_5::`CameraDisplaySts2), __cArray2, __cArray4, 8192);
      ReportTableRow(__tableHandle, 0, __cArray4, __cAOp, 2, __cArray3, __oneOfFlag, __bSetInCheckAlignment);
      
  
    }
    ReportTableEndTestStep(__tableHandle, "1");
  }
  TestCommandEnd();


  TestCommandBegin(__eWait, __cWait, "", "1");
  {
    Wait("1", (1000 * 1000000LL), 1000000, "");
  }
  TestCommandEnd();

  TestCommandBegin(__eSet, __cSet, "", "2");
  {
    __tableHandle = ReportTableHead3Columns(__cSetCaption , __cTSym, __cTOp, __cAssigned); 
    {
      $`FDCAN2::dbNode::`SGW::`TELEMATIC_FD_5::`CameraDisplaySts2.phys = 0;
      snprintf(__cArray, 8192, "%s", "CameraDisplaySts2");
      snprintf(__cArray2, 8192, "%s '%s'", __cCANSignal, __cArray);
      snprintf(__cArray3, 8192, "%s", "");
      
      ReportSetLValueOrSignalNotOnline(getSignalTime(`FDCAN2::dbNode::`SGW::`TELEMATIC_FD_5::`CameraDisplaySts2), __cArray2, __cArray4, 8192);
      ReportTableRow(__tableHandle, 0, __cArray4, __cAOp, 0, __cArray3, __oneOfFlag, __bSetInCheckAlignment);
      
  
    }
    ReportTableEndTestStep(__tableHandle, "1");
  }
  TestCommandEnd();


  TestCommandBegin(__eWait, __cWait, "", "3");
  {
    Wait("1", (1000 * 1000000LL), 1000000, "");
  }
  TestCommandEnd();

  TestCommandBegin(__eCheck, __cCheck, "", "4");
  {
    __bVerdict = __eVerdictPass;
    __tableHandle = ReportTableHead5Columns(__cCheckCaption, __cTSym, __cTOp, __cRefVal, __cActual, __cRes);
    {
      {
        int __res1,__res2;
        __res1 = CheckSignalMatch(`FDCAN2::dbNode::`CVADAS::`CVPAM_FD_Info::`DisplayView2, 1, __cGreaterEqualThan) == 1;
        __res2 = CheckSignalMatch(`FDCAN2::dbNode::`CVADAS::`CVPAM_FD_Info::`DisplayView2, 15, __cLessEqualThan) == 1;
        __csr = __res1 && __res2;
        snprintf(__cArray, 8192, "%s", "DisplayView2");
        snprintf(__cArray2, 8192, "%s '%s'", __cCANSignal, __cArray);
        snprintf(__cArray3, 8192, "%s", "");
        snprintf(__cArray4, 8192, "%s", "");
        snprintf(__cArray5, 8192, "%s", __cArray3);
        snprintf(__cArray6, 8192, "%s", __cArray4);
        ReportRange(1, 15, __cArray5, __cArray6, __cArray7, 8192);
        ReportTableRow(__tableHandle, 0, __cArray2, __cRange, __cArray7, __cEmpty, __oneOfFlag, __bSetInCheckAlignment);
        ReportLValueOrSignalNotOnline(`FDCAN2::dbNode::`CVADAS::`CVPAM_FD_Info::`DisplayView2, __cArray8, 8192);
        ReportCell(__tableHandle, __cArray8);
        ReportCellResult(__tableHandle, __csr, __ePassFail);
      }
  
      __bVerdict = __bVerdict && __csr;
    }
    ReportTableEndVerdict(__tableHandle, "1", __bVerdict);
  }
  TestCommandEnd();


}

testcase Tt56gpegf_TsTc5()
{
  stack long __tableHandle;
  SetBreakOnFail(1);

  TestCommandBegin(__eSet, __cSet, "", "0");
  {
    __tableHandle = ReportTableHead3Columns(__cSetCaption , __cTSym, __cTOp, __cAssigned); 
    {
      $`FDCAN2::dbNode::`SGW::`TELEMATIC_FD_5::`CameraDisplaySts2.phys = 3;
      snprintf(__cArray, 8192, "%s", "CameraDisplaySts2");
      snprintf(__cArray2, 8192, "%s '%s'", __cCANSignal, __cArray);
      snprintf(__cArray3, 8192, "%s", "");
      
      ReportSetLValueOrSignalNotOnline(getSignalTime(`FDCAN2::dbNode::`SGW::`TELEMATIC_FD_5::`CameraDisplaySts2), __cArray2, __cArray4, 8192);
      ReportTableRow(__tableHandle, 0, __cArray4, __cAOp, 3, __cArray3, __oneOfFlag, __bSetInCheckAlignment);
      
  
    }
    ReportTableEndTestStep(__tableHandle, "1");
  }
  TestCommandEnd();


  TestCommandBegin(__eWait, __cWait, "", "1");
  {
    Wait("1", (1000 * 1000000LL), 1000000, "");
  }
  TestCommandEnd();

  TestCommandBegin(__eSet, __cSet, "", "2");
  {
    __tableHandle = ReportTableHead3Columns(__cSetCaption , __cTSym, __cTOp, __cAssigned); 
    {
      $`FDCAN2::dbNode::`SGW::`TELEMATIC_FD_5::`CameraDisplaySts2.phys = 1;
      snprintf(__cArray, 8192, "%s", "CameraDisplaySts2");
      snprintf(__cArray2, 8192, "%s '%s'", __cCANSignal, __cArray);
      snprintf(__cArray3, 8192, "%s", "");
      
      ReportSetLValueOrSignalNotOnline(getSignalTime(`FDCAN2::dbNode::`SGW::`TELEMATIC_FD_5::`CameraDisplaySts2), __cArray2, __cArray4, 8192);
      ReportTableRow(__tableHandle, 0, __cArray4, __cAOp, 1, __cArray3, __oneOfFlag, __bSetInCheckAlignment);
      
  
    }
    ReportTableEndTestStep(__tableHandle, "1");
  }
  TestCommandEnd();


  {
    CreateTTEIFFunction("Tt56gpegf_CaptureMasterImage", __eFct, __eLocal);
    CallInterfaceFunction(__cEmpty, __cEmpty, "462fe35e-f3f1-4850-92f7-450c4a81e94a");
  }


  TestCommandBegin(__eWait, __cWait, "", "4");
  {
    Wait("1", (1000 * 1000000LL), 1000000, "");
  }
  TestCommandEnd();

  {
    CreateTTEIFFunction("Tt56gpegf_CaptureImage", __eFct, __eLocal);
    CallInterfaceFunction(__cEmpty, __cEmpty, "f85b6d5d-1712-4240-ad83-a1e628197c1d");
  }


  TestCommandBegin(__eCheck, __cCheck, "", "6");
  {
    __bVerdict = __eVerdictPass;
    __tableHandle = ReportTableHead5Columns(__cCheckCaption, __cTSym, __cTOp, __cRefVal, __cActual, __cRes);
    {
      {
        int __res1,__res2;
        __res1 = CheckSignalMatch(`FDCAN2::dbNode::`CVADAS::`CVPAM_FD_Info::`DisplayView2, 1, __cGreaterEqualThan) == 1;
        __res2 = CheckSignalMatch(`FDCAN2::dbNode::`CVADAS::`CVPAM_FD_Info::`DisplayView2, 15, __cLessEqualThan) == 1;
        __csr = __res1 && __res2;
        snprintf(__cArray, 8192, "%s", "DisplayView2");
        snprintf(__cArray2, 8192, "%s '%s'", __cCANSignal, __cArray);
        snprintf(__cArray3, 8192, "%s", "");
        snprintf(__cArray4, 8192, "%s", "");
        snprintf(__cArray5, 8192, "%s", __cArray3);
        snprintf(__cArray6, 8192, "%s", __cArray4);
        ReportRange(1, 15, __cArray5, __cArray6, __cArray7, 8192);
        ReportTableRow(__tableHandle, 0, __cArray2, __cRange, __cArray7, __cEmpty, __oneOfFlag, __bSetInCheckAlignment);
        ReportLValueOrSignalNotOnline(`FDCAN2::dbNode::`CVADAS::`CVPAM_FD_Info::`DisplayView2, __cArray8, 8192);
        ReportCell(__tableHandle, __cArray8);
        ReportCellResult(__tableHandle, __csr, __ePassFail);
      }
  
      __bVerdict = __bVerdict && __csr;
    }
    ReportTableEndVerdict(__tableHandle, "1", __bVerdict);
  }
  TestCommandEnd();


}

testcase Tt56gpegf_TsTc6()
{
  stack long __tableHandle;
  SetBreakOnFail(1);

  TestCommandBegin(__eSet, __cSet, "", "0");
  {
    __tableHandle = ReportTableHead3Columns(__cSetCaption , __cTSym, __cTOp, __cAssigned); 
    {
      $`FDCAN2::dbNode::`SGW::`TELEMATIC_FD_5::`CameraDisplaySts2.phys = 2;
      snprintf(__cArray, 8192, "%s", "CameraDisplaySts2");
      snprintf(__cArray2, 8192, "%s '%s'", __cCANSignal, __cArray);
      snprintf(__cArray3, 8192, "%s", "");
      
      ReportSetLValueOrSignalNotOnline(getSignalTime(`FDCAN2::dbNode::`SGW::`TELEMATIC_FD_5::`CameraDisplaySts2), __cArray2, __cArray4, 8192);
      ReportTableRow(__tableHandle, 0, __cArray4, __cAOp, 2, __cArray3, __oneOfFlag, __bSetInCheckAlignment);
      
  
    }
    ReportTableEndTestStep(__tableHandle, "1");
  }
  TestCommandEnd();


  {
    CreateTTEIFFunction("Tt56gpegf_CaptureMasterImage", __eFct, __eLocal);
    CallInterfaceFunction(__cEmpty, __cEmpty, "462fe35e-f3f1-4850-92f7-450c4a81e94a");
  }


  TestCommandBegin(__eWait, __cWait, "", "2");
  {
    Wait("1", (1000 * 1000000LL), 1000000, "");
  }
  TestCommandEnd();

  {
    CreateTTEIFFunction("Tt56gpegf_CaptureImage", __eFct, __eLocal);
    CallInterfaceFunction(__cEmpty, __cEmpty, "f85b6d5d-1712-4240-ad83-a1e628197c1d");
  }


  TestCommandBegin(__eCheck, __cCheck, "", "4");
  {
    __bVerdict = __eVerdictPass;
    __tableHandle = ReportTableHead5Columns(__cCheckCaption, __cTSym, __cTOp, __cRefVal, __cActual, __cRes);
    {
      {
        int __res1,__res2;
        __res1 = CheckSignalMatch(`FDCAN2::dbNode::`CVADAS::`CVPAM_FD_Info::`DisplayView2, 1, __cGreaterEqualThan) == 1;
        __res2 = CheckSignalMatch(`FDCAN2::dbNode::`CVADAS::`CVPAM_FD_Info::`DisplayView2, 15, __cLessEqualThan) == 1;
        __csr = __res1 && __res2;
        snprintf(__cArray, 8192, "%s", "DisplayView2");
        snprintf(__cArray2, 8192, "%s '%s'", __cCANSignal, __cArray);
        snprintf(__cArray3, 8192, "%s", "");
        snprintf(__cArray4, 8192, "%s", "");
        snprintf(__cArray5, 8192, "%s", __cArray3);
        snprintf(__cArray6, 8192, "%s", __cArray4);
        ReportRange(1, 15, __cArray5, __cArray6, __cArray7, 8192);
        ReportTableRow(__tableHandle, 0, __cArray2, __cRange, __cArray7, __cEmpty, __oneOfFlag, __bSetInCheckAlignment);
        ReportLValueOrSignalNotOnline(`FDCAN2::dbNode::`CVADAS::`CVPAM_FD_Info::`DisplayView2, __cArray8, 8192);
        ReportCell(__tableHandle, __cArray8);
        ReportCellResult(__tableHandle, __csr, __ePassFail);
      }
  
      __bVerdict = __bVerdict && __csr;
    }
    ReportTableEndVerdict(__tableHandle, "1", __bVerdict);
  }
  TestCommandEnd();


}

testcase Tt56gpegf_TsTc7()
{
  stack long __tableHandle;
  SetBreakOnFail(1);

  TestCommandBegin(__eSet, __cSet, "", "0");
  {
    __tableHandle = ReportTableHead3Columns(__cSetCaption , __cTSym, __cTOp, __cAssigned); 
    {
      $`FDCAN2::dbNode::`SGW::`TELEMATIC_FD_5::`CameraDisplaySts2.phys = 3;
      snprintf(__cArray, 8192, "%s", "CameraDisplaySts2");
      snprintf(__cArray2, 8192, "%s '%s'", __cCANSignal, __cArray);
      snprintf(__cArray3, 8192, "%s", "");
      
      ReportSetLValueOrSignalNotOnline(getSignalTime(`FDCAN2::dbNode::`SGW::`TELEMATIC_FD_5::`CameraDisplaySts2), __cArray2, __cArray4, 8192);
      ReportTableRow(__tableHandle, 0, __cArray4, __cAOp, 3, __cArray3, __oneOfFlag, __bSetInCheckAlignment);
      
  
    }
    ReportTableEndTestStep(__tableHandle, "1");
  }
  TestCommandEnd();


  {
    CreateTTEIFFunction("Tt56gpegf_CaptureMasterImage", __eFct, __eLocal);
    CallInterfaceFunction(__cEmpty, __cEmpty, "462fe35e-f3f1-4850-92f7-450c4a81e94a");
  }


  TestCommandBegin(__eWait, __cWait, "", "2");
  {
    Wait("1", (1000 * 1000000LL), 1000000, "");
  }
  TestCommandEnd();

  {
    CreateTTEIFFunction("Tt56gpegf_CaptureImage", __eFct, __eLocal);
    CallInterfaceFunction(__cEmpty, __cEmpty, "f85b6d5d-1712-4240-ad83-a1e628197c1d");
  }


  TestCommandBegin(__eCheck, __cCheck, "", "4");
  {
    __bVerdict = __eVerdictPass;
    __tableHandle = ReportTableHead5Columns(__cCheckCaption, __cTSym, __cTOp, __cRefVal, __cActual, __cRes);
    {
      {
        int __res1,__res2;
        __res1 = CheckSignalMatch(`FDCAN2::dbNode::`CVADAS::`CVPAM_FD_Info::`DisplayView2, 1, __cGreaterEqualThan) == 1;
        __res2 = CheckSignalMatch(`FDCAN2::dbNode::`CVADAS::`CVPAM_FD_Info::`DisplayView2, 15, __cLessEqualThan) == 1;
        __csr = __res1 && __res2;
        snprintf(__cArray, 8192, "%s", "DisplayView2");
        snprintf(__cArray2, 8192, "%s '%s'", __cCANSignal, __cArray);
        snprintf(__cArray3, 8192, "%s", "");
        snprintf(__cArray4, 8192, "%s", "");
        snprintf(__cArray5, 8192, "%s", __cArray3);
        snprintf(__cArray6, 8192, "%s", __cArray4);
        ReportRange(1, 15, __cArray5, __cArray6, __cArray7, 8192);
        ReportTableRow(__tableHandle, 0, __cArray2, __cRange, __cArray7, __cEmpty, __oneOfFlag, __bSetInCheckAlignment);
        ReportLValueOrSignalNotOnline(`FDCAN2::dbNode::`CVADAS::`CVPAM_FD_Info::`DisplayView2, __cArray8, 8192);
        ReportCell(__tableHandle, __cArray8);
        ReportCellResult(__tableHandle, __csr, __ePassFail);
      }
  
      __bVerdict = __bVerdict && __csr;
    }
    ReportTableEndVerdict(__tableHandle, "1", __bVerdict);
  }
  TestCommandEnd();


}

testcase Tt56gpegf_TsTc8()
{
  stack long __tableHandle;
  SetBreakOnFail(1);

  TestCommandBegin(__eSet, __cSet, "", "0");
  {
    __tableHandle = ReportTableHead3Columns(__cSetCaption , __cTSym, __cTOp, __cAssigned); 
    {
      $`FDCAN2::dbNode::`SGW::`TELEMATIC_FD_5::`CameraDisplaySts2.phys = 3;
      snprintf(__cArray, 8192, "%s", "CameraDisplaySts2");
      snprintf(__cArray2, 8192, "%s '%s'", __cCANSignal, __cArray);
      snprintf(__cArray3, 8192, "%s", "");
      
      ReportSetLValueOrSignalNotOnline(getSignalTime(`FDCAN2::dbNode::`SGW::`TELEMATIC_FD_5::`CameraDisplaySts2), __cArray2, __cArray4, 8192);
      ReportTableRow(__tableHandle, 0, __cArray4, __cAOp, 3, __cArray3, __oneOfFlag, __bSetInCheckAlignment);
      
  
    }
    ReportTableEndTestStep(__tableHandle, "1");
  }
  TestCommandEnd();


  {
    CreateTTEIFFunction("Tt56gpegf_CaptureMasterImage", __eFct, __eLocal);
    CallInterfaceFunction(__cEmpty, __cEmpty, "462fe35e-f3f1-4850-92f7-450c4a81e94a");
  }


  TestCommandBegin(__eWait, __cWait, "", "2");
  {
    Wait("1", (1000 * 1000000LL), 1000000, "");
  }
  TestCommandEnd();

  {
    CreateTTEIFFunction("Tt56gpegf_CaptureImage", __eFct, __eLocal);
    CallInterfaceFunction(__cEmpty, __cEmpty, "f85b6d5d-1712-4240-ad83-a1e628197c1d");
  }


  TestCommandBegin(__eWait, __cWait, "", "4");
  {
    Wait("1", (1000 * 1000000LL), 1000000, "");
  }
  TestCommandEnd();

  TestCommandBegin(__eCheck, __cCheck, "", "5");
  {
    __bVerdict = __eVerdictPass;
    __tableHandle = ReportTableHead5Columns(__cCheckCaption, __cTSym, __cTOp, __cRefVal, __cActual, __cRes);
    {
      {
        int __res1,__res2;
        __res1 = CheckSignalMatch(`FDCAN2::dbNode::`CVADAS::`CVPAM_FD_Info::`DisplayView2, 1, __cGreaterEqualThan) == 1;
        __res2 = CheckSignalMatch(`FDCAN2::dbNode::`CVADAS::`CVPAM_FD_Info::`DisplayView2, 15, __cLessEqualThan) == 1;
        __csr = __res1 && __res2;
        snprintf(__cArray, 8192, "%s", "DisplayView2");
        snprintf(__cArray2, 8192, "%s '%s'", __cCANSignal, __cArray);
        snprintf(__cArray3, 8192, "%s", "");
        snprintf(__cArray4, 8192, "%s", "");
        snprintf(__cArray5, 8192, "%s", __cArray3);
        snprintf(__cArray6, 8192, "%s", __cArray4);
        ReportRange(1, 15, __cArray5, __cArray6, __cArray7, 8192);
        ReportTableRow(__tableHandle, 0, __cArray2, __cRange, __cArray7, __cEmpty, __oneOfFlag, __bSetInCheckAlignment);
        ReportLValueOrSignalNotOnline(`FDCAN2::dbNode::`CVADAS::`CVPAM_FD_Info::`DisplayView2, __cArray8, 8192);
        ReportCell(__tableHandle, __cArray8);
        ReportCellResult(__tableHandle, __csr, __ePassFail);
      }
  
      __bVerdict = __bVerdict && __csr;
    }
    ReportTableEndVerdict(__tableHandle, "1", __bVerdict);
  }
  TestCommandEnd();


}

testcase Tt56gpegf_TsTc9()
{
  stack long __tableHandle;
  SetBreakOnFail(1);

  TestCommandBegin(__eSet, __cSet, "", "0");
  {
    __tableHandle = ReportTableHead3Columns(__cSetCaption , __cTSym, __cTOp, __cAssigned); 
    {
      $`FDCAN2::dbNode::`SGW::`TELEMATIC_FD_5::`CameraDisplaySts2.phys = 5;
      snprintf(__cArray, 8192, "%s", "CameraDisplaySts2");
      snprintf(__cArray2, 8192, "%s '%s'", __cCANSignal, __cArray);
      snprintf(__cArray3, 8192, "%s", "");
      
      ReportSetLValueOrSignalNotOnline(getSignalTime(`FDCAN2::dbNode::`SGW::`TELEMATIC_FD_5::`CameraDisplaySts2), __cArray2, __cArray4, 8192);
      ReportTableRow(__tableHandle, 0, __cArray4, __cAOp, 5, __cArray3, __oneOfFlag, __bSetInCheckAlignment);
      
  
    }
    ReportTableEndTestStep(__tableHandle, "1");
  }
  TestCommandEnd();


  {
    CreateTTEIFFunction("Tt56gpegf_CaptureMasterImage", __eFct, __eLocal);
    CallInterfaceFunction(__cEmpty, __cEmpty, "462fe35e-f3f1-4850-92f7-450c4a81e94a");
  }


  TestCommandBegin(__eWait, __cWait, "", "2");
  {
    Wait("1", (1000 * 1000000LL), 1000000, "");
  }
  TestCommandEnd();

  {
    CreateTTEIFFunction("Tt56gpegf_CaptureImage", __eFct, __eLocal);
    CallInterfaceFunction(__cEmpty, __cEmpty, "f85b6d5d-1712-4240-ad83-a1e628197c1d");
  }


  TestCommandBegin(__eCheck, __cCheck, "", "4");
  {
    __bVerdict = __eVerdictPass;
    __tableHandle = ReportTableHead5Columns(__cCheckCaption, __cTSym, __cTOp, __cRefVal, __cActual, __cRes);
    {
      {
        int __res1,__res2;
        __res1 = CheckSignalMatch(`FDCAN2::dbNode::`CVADAS::`CVPAM_FD_Info::`DisplayView2, 1, __cGreaterEqualThan) == 1;
        __res2 = CheckSignalMatch(`FDCAN2::dbNode::`CVADAS::`CVPAM_FD_Info::`DisplayView2, 15, __cLessEqualThan) == 1;
        __csr = __res1 && __res2;
        snprintf(__cArray, 8192, "%s", "DisplayView2");
        snprintf(__cArray2, 8192, "%s '%s'", __cCANSignal, __cArray);
        snprintf(__cArray3, 8192, "%s", "");
        snprintf(__cArray4, 8192, "%s", "");
        snprintf(__cArray5, 8192, "%s", __cArray3);
        snprintf(__cArray6, 8192, "%s", __cArray4);
        ReportRange(1, 15, __cArray5, __cArray6, __cArray7, 8192);
        ReportTableRow(__tableHandle, 0, __cArray2, __cRange, __cArray7, __cEmpty, __oneOfFlag, __bSetInCheckAlignment);
        ReportLValueOrSignalNotOnline(`FDCAN2::dbNode::`CVADAS::`CVPAM_FD_Info::`DisplayView2, __cArray8, 8192);
        ReportCell(__tableHandle, __cArray8);
        ReportCellResult(__tableHandle, __csr, __ePassFail);
      }
  
      __bVerdict = __bVerdict && __csr;
    }
    ReportTableEndVerdict(__tableHandle, "1", __bVerdict);
  }
  TestCommandEnd();


}

testcase Tt56gpegf_TsTc10()
{
  stack long __tableHandle;
  SetBreakOnFail(1);

  TestCommandBegin(__eSet, __cSet, "", "0");
  {
    __tableHandle = ReportTableHead3Columns(__cSetCaption , __cTSym, __cTOp, __cAssigned); 
    {
      $`FDCAN2::dbNode::`SGW::`TELEMATIC_FD_5::`CameraDisplaySts2.phys = 6;
      snprintf(__cArray, 8192, "%s", "CameraDisplaySts2");
      snprintf(__cArray2, 8192, "%s '%s'", __cCANSignal, __cArray);
      snprintf(__cArray3, 8192, "%s", "");
      
      ReportSetLValueOrSignalNotOnline(getSignalTime(`FDCAN2::dbNode::`SGW::`TELEMATIC_FD_5::`CameraDisplaySts2), __cArray2, __cArray4, 8192);
      ReportTableRow(__tableHandle, 0, __cArray4, __cAOp, 6, __cArray3, __oneOfFlag, __bSetInCheckAlignment);
      
  
    }
    ReportTableEndTestStep(__tableHandle, "1");
  }
  TestCommandEnd();


  {
    CreateTTEIFFunction("Tt56gpegf_CaptureMasterImage", __eFct, __eLocal);
    CallInterfaceFunction(__cEmpty, __cEmpty, "462fe35e-f3f1-4850-92f7-450c4a81e94a");
  }


  TestCommandBegin(__eWait, __cWait, "", "2");
  {
    Wait("1", (1000 * 1000000LL), 1000000, "");
  }
  TestCommandEnd();

  {
    CreateTTEIFFunction("Tt56gpegf_CaptureImage", __eFct, __eLocal);
    CallInterfaceFunction(__cEmpty, __cEmpty, "f85b6d5d-1712-4240-ad83-a1e628197c1d");
  }


  TestCommandBegin(__eCheck, __cCheck, "", "4");
  {
    __bVerdict = __eVerdictPass;
    __tableHandle = ReportTableHead5Columns(__cCheckCaption, __cTSym, __cTOp, __cRefVal, __cActual, __cRes);
    {
      {
        int __res1,__res2;
        __res1 = CheckSignalMatch(`FDCAN2::dbNode::`CVADAS::`CVPAM_FD_Info::`DisplayView2, 1, __cGreaterEqualThan) == 1;
        __res2 = CheckSignalMatch(`FDCAN2::dbNode::`CVADAS::`CVPAM_FD_Info::`DisplayView2, 15, __cLessEqualThan) == 1;
        __csr = __res1 && __res2;
        snprintf(__cArray, 8192, "%s", "DisplayView2");
        snprintf(__cArray2, 8192, "%s '%s'", __cCANSignal, __cArray);
        snprintf(__cArray3, 8192, "%s", "");
        snprintf(__cArray4, 8192, "%s", "");
        snprintf(__cArray5, 8192, "%s", __cArray3);
        snprintf(__cArray6, 8192, "%s", __cArray4);
        ReportRange(1, 15, __cArray5, __cArray6, __cArray7, 8192);
        ReportTableRow(__tableHandle, 0, __cArray2, __cRange, __cArray7, __cEmpty, __oneOfFlag, __bSetInCheckAlignment);
        ReportLValueOrSignalNotOnline(`FDCAN2::dbNode::`CVADAS::`CVPAM_FD_Info::`DisplayView2, __cArray8, 8192);
        ReportCell(__tableHandle, __cArray8);
        ReportCellResult(__tableHandle, __csr, __ePassFail);
      }
  
      __bVerdict = __bVerdict && __csr;
    }
    ReportTableEndVerdict(__tableHandle, "1", __bVerdict);
  }
  TestCommandEnd();


}

testcase Tt56gpegf_TsTc11()
{
  stack long __tableHandle;
  SetBreakOnFail(1);

  TestCommandBegin(__eSet, __cSet, "", "0");
  {
    __tableHandle = ReportTableHead3Columns(__cSetCaption , __cTSym, __cTOp, __cAssigned); 
    {
      $`FDCAN2::dbNode::`SGW::`TELEMATIC_FD_5::`CameraDisplaySts2.phys = 7;
      snprintf(__cArray, 8192, "%s", "CameraDisplaySts2");
      snprintf(__cArray2, 8192, "%s '%s'", __cCANSignal, __cArray);
      snprintf(__cArray3, 8192, "%s", "");
      
      ReportSetLValueOrSignalNotOnline(getSignalTime(`FDCAN2::dbNode::`SGW::`TELEMATIC_FD_5::`CameraDisplaySts2), __cArray2, __cArray4, 8192);
      ReportTableRow(__tableHandle, 0, __cArray4, __cAOp, 7, __cArray3, __oneOfFlag, __bSetInCheckAlignment);
      
  
    }
    ReportTableEndTestStep(__tableHandle, "1");
  }
  TestCommandEnd();


  {
    CreateTTEIFFunction("Tt56gpegf_CaptureMasterImage", __eFct, __eLocal);
    CallInterfaceFunction(__cEmpty, __cEmpty, "462fe35e-f3f1-4850-92f7-450c4a81e94a");
  }


  TestCommandBegin(__eWait, __cWait, "", "2");
  {
    Wait("1", (1000 * 1000000LL), 1000000, "");
  }
  TestCommandEnd();

  {
    CreateTTEIFFunction("Tt56gpegf_CaptureImage", __eFct, __eLocal);
    CallInterfaceFunction(__cEmpty, __cEmpty, "f85b6d5d-1712-4240-ad83-a1e628197c1d");
  }


  TestCommandBegin(__eCheck, __cCheck, "", "4");
  {
    __bVerdict = __eVerdictPass;
    __tableHandle = ReportTableHead5Columns(__cCheckCaption, __cTSym, __cTOp, __cRefVal, __cActual, __cRes);
    {
      {
        int __res1,__res2;
        __res1 = CheckSignalMatch(`FDCAN2::dbNode::`CVADAS::`CVPAM_FD_Info::`DisplayView2, 1, __cGreaterEqualThan) == 1;
        __res2 = CheckSignalMatch(`FDCAN2::dbNode::`CVADAS::`CVPAM_FD_Info::`DisplayView2, 15, __cLessEqualThan) == 1;
        __csr = __res1 && __res2;
        snprintf(__cArray, 8192, "%s", "DisplayView2");
        snprintf(__cArray2, 8192, "%s '%s'", __cCANSignal, __cArray);
        snprintf(__cArray3, 8192, "%s", "");
        snprintf(__cArray4, 8192, "%s", "");
        snprintf(__cArray5, 8192, "%s", __cArray3);
        snprintf(__cArray6, 8192, "%s", __cArray4);
        ReportRange(1, 15, __cArray5, __cArray6, __cArray7, 8192);
        ReportTableRow(__tableHandle, 0, __cArray2, __cRange, __cArray7, __cEmpty, __oneOfFlag, __bSetInCheckAlignment);
        ReportLValueOrSignalNotOnline(`FDCAN2::dbNode::`CVADAS::`CVPAM_FD_Info::`DisplayView2, __cArray8, 8192);
        ReportCell(__tableHandle, __cArray8);
        ReportCellResult(__tableHandle, __csr, __ePassFail);
      }
  
      __bVerdict = __bVerdict && __csr;
    }
    ReportTableEndVerdict(__tableHandle, "1", __bVerdict);
  }
  TestCommandEnd();


}

testcase Tt56gpegf_TsTc12()
{
  stack long __tableHandle;
  SetBreakOnFail(1);

  TestCommandBegin(__eSet, __cSet, "", "0");
  {
    __tableHandle = ReportTableHead3Columns(__cSetCaption , __cTSym, __cTOp, __cAssigned); 
    {
      $`FDCAN2::dbNode::`SGW::`TELEMATIC_FD_5::`CameraDisplaySts2.phys = 8;
      snprintf(__cArray, 8192, "%s", "CameraDisplaySts2");
      snprintf(__cArray2, 8192, "%s '%s'", __cCANSignal, __cArray);
      snprintf(__cArray3, 8192, "%s", "");
      
      ReportSetLValueOrSignalNotOnline(getSignalTime(`FDCAN2::dbNode::`SGW::`TELEMATIC_FD_5::`CameraDisplaySts2), __cArray2, __cArray4, 8192);
      ReportTableRow(__tableHandle, 0, __cArray4, __cAOp, 8, __cArray3, __oneOfFlag, __bSetInCheckAlignment);
      
  
    }
    ReportTableEndTestStep(__tableHandle, "1");
  }
  TestCommandEnd();


  {
    CreateTTEIFFunction("Tt56gpegf_CaptureMasterImage", __eFct, __eLocal);
    CallInterfaceFunction(__cEmpty, __cEmpty, "462fe35e-f3f1-4850-92f7-450c4a81e94a");
  }


  TestCommandBegin(__eWait, __cWait, "", "2");
  {
    Wait("1", (1000 * 1000000LL), 1000000, "");
  }
  TestCommandEnd();

  {
    CreateTTEIFFunction("Tt56gpegf_CaptureImage", __eFct, __eLocal);
    CallInterfaceFunction(__cEmpty, __cEmpty, "f85b6d5d-1712-4240-ad83-a1e628197c1d");
  }


  TestCommandBegin(__eCheck, __cCheck, "", "4");
  {
    __bVerdict = __eVerdictPass;
    __tableHandle = ReportTableHead5Columns(__cCheckCaption, __cTSym, __cTOp, __cRefVal, __cActual, __cRes);
    {
      {
        int __res1,__res2;
        __res1 = CheckSignalMatch(`FDCAN2::dbNode::`CVADAS::`CVPAM_FD_Info::`DisplayView2, 1, __cGreaterEqualThan) == 1;
        __res2 = CheckSignalMatch(`FDCAN2::dbNode::`CVADAS::`CVPAM_FD_Info::`DisplayView2, 15, __cLessEqualThan) == 1;
        __csr = __res1 && __res2;
        snprintf(__cArray, 8192, "%s", "DisplayView2");
        snprintf(__cArray2, 8192, "%s '%s'", __cCANSignal, __cArray);
        snprintf(__cArray3, 8192, "%s", "");
        snprintf(__cArray4, 8192, "%s", "");
        snprintf(__cArray5, 8192, "%s", __cArray3);
        snprintf(__cArray6, 8192, "%s", __cArray4);
        ReportRange(1, 15, __cArray5, __cArray6, __cArray7, 8192);
        ReportTableRow(__tableHandle, 0, __cArray2, __cRange, __cArray7, __cEmpty, __oneOfFlag, __bSetInCheckAlignment);
        ReportLValueOrSignalNotOnline(`FDCAN2::dbNode::`CVADAS::`CVPAM_FD_Info::`DisplayView2, __cArray8, 8192);
        ReportCell(__tableHandle, __cArray8);
        ReportCellResult(__tableHandle, __csr, __ePassFail);
      }
  
      __bVerdict = __bVerdict && __csr;
    }
    ReportTableEndVerdict(__tableHandle, "1", __bVerdict);
  }
  TestCommandEnd();


}

testcase Tt56gpegf_TsTc13()
{
  stack long __tableHandle;
  SetBreakOnFail(1);

  TestCommandBegin(__eSet, __cSet, "", "0");
  {
    __tableHandle = ReportTableHead3Columns(__cSetCaption , __cTSym, __cTOp, __cAssigned); 
    {
      $`FDCAN2::dbNode::`SGW::`TELEMATIC_FD_5::`CameraDisplaySts2.phys = 9;
      snprintf(__cArray, 8192, "%s", "CameraDisplaySts2");
      snprintf(__cArray2, 8192, "%s '%s'", __cCANSignal, __cArray);
      snprintf(__cArray3, 8192, "%s", "");
      
      ReportSetLValueOrSignalNotOnline(getSignalTime(`FDCAN2::dbNode::`SGW::`TELEMATIC_FD_5::`CameraDisplaySts2), __cArray2, __cArray4, 8192);
      ReportTableRow(__tableHandle, 0, __cArray4, __cAOp, 9, __cArray3, __oneOfFlag, __bSetInCheckAlignment);
      
  
    }
    ReportTableEndTestStep(__tableHandle, "1");
  }
  TestCommandEnd();


  {
    CreateTTEIFFunction("Tt56gpegf_CaptureMasterImage", __eFct, __eLocal);
    CallInterfaceFunction(__cEmpty, __cEmpty, "462fe35e-f3f1-4850-92f7-450c4a81e94a");
  }


  TestCommandBegin(__eWait, __cWait, "", "2");
  {
    Wait("1", (1000 * 1000000LL), 1000000, "");
  }
  TestCommandEnd();

  {
    CreateTTEIFFunction("Tt56gpegf_CaptureImage", __eFct, __eLocal);
    CallInterfaceFunction(__cEmpty, __cEmpty, "f85b6d5d-1712-4240-ad83-a1e628197c1d");
  }


  TestCommandBegin(__eCheck, __cCheck, "", "4");
  {
    __bVerdict = __eVerdictPass;
    __tableHandle = ReportTableHead5Columns(__cCheckCaption, __cTSym, __cTOp, __cRefVal, __cActual, __cRes);
    {
      {
        int __res1,__res2;
        __res1 = CheckSignalMatch(`FDCAN2::dbNode::`CVADAS::`CVPAM_FD_Info::`DisplayView2, 1, __cGreaterEqualThan) == 1;
        __res2 = CheckSignalMatch(`FDCAN2::dbNode::`CVADAS::`CVPAM_FD_Info::`DisplayView2, 15, __cLessEqualThan) == 1;
        __csr = __res1 && __res2;
        snprintf(__cArray, 8192, "%s", "DisplayView2");
        snprintf(__cArray2, 8192, "%s '%s'", __cCANSignal, __cArray);
        snprintf(__cArray3, 8192, "%s", "");
        snprintf(__cArray4, 8192, "%s", "");
        snprintf(__cArray5, 8192, "%s", __cArray3);
        snprintf(__cArray6, 8192, "%s", __cArray4);
        ReportRange(1, 15, __cArray5, __cArray6, __cArray7, 8192);
        ReportTableRow(__tableHandle, 0, __cArray2, __cRange, __cArray7, __cEmpty, __oneOfFlag, __bSetInCheckAlignment);
        ReportLValueOrSignalNotOnline(`FDCAN2::dbNode::`CVADAS::`CVPAM_FD_Info::`DisplayView2, __cArray8, 8192);
        ReportCell(__tableHandle, __cArray8);
        ReportCellResult(__tableHandle, __csr, __ePassFail);
      }
  
      __bVerdict = __bVerdict && __csr;
    }
    ReportTableEndVerdict(__tableHandle, "1", __bVerdict);
  }
  TestCommandEnd();


}

testcase Tt56gpegf_TsTc14()
{
  stack long __tableHandle;
  SetBreakOnFail(1);

  TestCommandBegin(__eSet, __cSet, "", "0");
  {
    __tableHandle = ReportTableHead3Columns(__cSetCaption , __cTSym, __cTOp, __cAssigned); 
    {
      $`FDCAN2::dbNode::`SGW::`TELEMATIC_FD_5::`CameraDisplaySts2.phys = 11;
      snprintf(__cArray, 8192, "%s", "CameraDisplaySts2");
      snprintf(__cArray2, 8192, "%s '%s'", __cCANSignal, __cArray);
      snprintf(__cArray3, 8192, "%s", "");
      
      ReportSetLValueOrSignalNotOnline(getSignalTime(`FDCAN2::dbNode::`SGW::`TELEMATIC_FD_5::`CameraDisplaySts2), __cArray2, __cArray4, 8192);
      ReportTableRow(__tableHandle, 0, __cArray4, __cAOp, 11, __cArray3, __oneOfFlag, __bSetInCheckAlignment);
      
  
    }
    ReportTableEndTestStep(__tableHandle, "1");
  }
  TestCommandEnd();


  {
    CreateTTEIFFunction("Tt56gpegf_CaptureMasterImage", __eFct, __eLocal);
    CallInterfaceFunction(__cEmpty, __cEmpty, "462fe35e-f3f1-4850-92f7-450c4a81e94a");
  }


  TestCommandBegin(__eWait, __cWait, "", "2");
  {
    Wait("1", (1000 * 1000000LL), 1000000, "");
  }
  TestCommandEnd();

  {
    CreateTTEIFFunction("Tt56gpegf_CaptureImage", __eFct, __eLocal);
    CallInterfaceFunction(__cEmpty, __cEmpty, "f85b6d5d-1712-4240-ad83-a1e628197c1d");
  }


  TestCommandBegin(__eCheck, __cCheck, "", "4");
  {
    __bVerdict = __eVerdictPass;
    __tableHandle = ReportTableHead5Columns(__cCheckCaption, __cTSym, __cTOp, __cRefVal, __cActual, __cRes);
    {
      {
        int __res1,__res2;
        __res1 = CheckSignalMatch(`FDCAN2::dbNode::`CVADAS::`CVPAM_FD_Info::`DisplayView2, 1, __cGreaterEqualThan) == 1;
        __res2 = CheckSignalMatch(`FDCAN2::dbNode::`CVADAS::`CVPAM_FD_Info::`DisplayView2, 15, __cLessEqualThan) == 1;
        __csr = __res1 && __res2;
        snprintf(__cArray, 8192, "%s", "DisplayView2");
        snprintf(__cArray2, 8192, "%s '%s'", __cCANSignal, __cArray);
        snprintf(__cArray3, 8192, "%s", "");
        snprintf(__cArray4, 8192, "%s", "");
        snprintf(__cArray5, 8192, "%s", __cArray3);
        snprintf(__cArray6, 8192, "%s", __cArray4);
        ReportRange(1, 15, __cArray5, __cArray6, __cArray7, 8192);
        ReportTableRow(__tableHandle, 0, __cArray2, __cRange, __cArray7, __cEmpty, __oneOfFlag, __bSetInCheckAlignment);
        ReportLValueOrSignalNotOnline(`FDCAN2::dbNode::`CVADAS::`CVPAM_FD_Info::`DisplayView2, __cArray8, 8192);
        ReportCell(__tableHandle, __cArray8);
        ReportCellResult(__tableHandle, __csr, __ePassFail);
      }
  
      __bVerdict = __bVerdict && __csr;
    }
    ReportTableEndVerdict(__tableHandle, "1", __bVerdict);
  }
  TestCommandEnd();


}

testcase Tt56gpegf_TsTc15()
{
  stack long __tableHandle;
  SetBreakOnFail(1);

  TestCommandBegin(__eSet, __cSet, "", "0");
  {
    __tableHandle = ReportTableHead3Columns(__cSetCaption , __cTSym, __cTOp, __cAssigned); 
    {
      $`FDCAN2::dbNode::`SGW::`TELEMATIC_FD_5::`CameraDisplaySts2.phys = 12;
      snprintf(__cArray, 8192, "%s", "CameraDisplaySts2");
      snprintf(__cArray2, 8192, "%s '%s'", __cCANSignal, __cArray);
      snprintf(__cArray3, 8192, "%s", "");
      
      ReportSetLValueOrSignalNotOnline(getSignalTime(`FDCAN2::dbNode::`SGW::`TELEMATIC_FD_5::`CameraDisplaySts2), __cArray2, __cArray4, 8192);
      ReportTableRow(__tableHandle, 0, __cArray4, __cAOp, 12, __cArray3, __oneOfFlag, __bSetInCheckAlignment);
      
  
    }
    ReportTableEndTestStep(__tableHandle, "1");
  }
  TestCommandEnd();


  {
    CreateTTEIFFunction("Tt56gpegf_CaptureMasterImage", __eFct, __eLocal);
    CallInterfaceFunction(__cEmpty, __cEmpty, "462fe35e-f3f1-4850-92f7-450c4a81e94a");
  }


  TestCommandBegin(__eWait, __cWait, "", "2");
  {
    Wait("1", (1000 * 1000000LL), 1000000, "");
  }
  TestCommandEnd();

  {
    CreateTTEIFFunction("Tt56gpegf_CaptureImage", __eFct, __eLocal);
    CallInterfaceFunction(__cEmpty, __cEmpty, "f85b6d5d-1712-4240-ad83-a1e628197c1d");
  }


  TestCommandBegin(__eCheck, __cCheck, "", "4");
  {
    __bVerdict = __eVerdictPass;
    __tableHandle = ReportTableHead5Columns(__cCheckCaption, __cTSym, __cTOp, __cRefVal, __cActual, __cRes);
    {
      {
        int __res1,__res2;
        __res1 = CheckSignalMatch(`FDCAN2::dbNode::`CVADAS::`CVPAM_FD_Info::`DisplayView2, 1, __cGreaterEqualThan) == 1;
        __res2 = CheckSignalMatch(`FDCAN2::dbNode::`CVADAS::`CVPAM_FD_Info::`DisplayView2, 15, __cLessEqualThan) == 1;
        __csr = __res1 && __res2;
        snprintf(__cArray, 8192, "%s", "DisplayView2");
        snprintf(__cArray2, 8192, "%s '%s'", __cCANSignal, __cArray);
        snprintf(__cArray3, 8192, "%s", "");
        snprintf(__cArray4, 8192, "%s", "");
        snprintf(__cArray5, 8192, "%s", __cArray3);
        snprintf(__cArray6, 8192, "%s", __cArray4);
        ReportRange(1, 15, __cArray5, __cArray6, __cArray7, 8192);
        ReportTableRow(__tableHandle, 0, __cArray2, __cRange, __cArray7, __cEmpty, __oneOfFlag, __bSetInCheckAlignment);
        ReportLValueOrSignalNotOnline(`FDCAN2::dbNode::`CVADAS::`CVPAM_FD_Info::`DisplayView2, __cArray8, 8192);
        ReportCell(__tableHandle, __cArray8);
        ReportCellResult(__tableHandle, __csr, __ePassFail);
      }
  
      __bVerdict = __bVerdict && __csr;
    }
    ReportTableEndVerdict(__tableHandle, "1", __bVerdict);
  }
  TestCommandEnd();


}

testcase Tt56gpegf_TsTc16()
{
  stack long __tableHandle;
  SetBreakOnFail(1);

  TestCommandBegin(__eSet, __cSet, "", "0");
  {
    __tableHandle = ReportTableHead3Columns(__cSetCaption , __cTSym, __cTOp, __cAssigned); 
    {
      $`FDCAN2::dbNode::`SGW::`TELEMATIC_FD_5::`CameraDisplaySts2.phys = 13;
      snprintf(__cArray, 8192, "%s", "CameraDisplaySts2");
      snprintf(__cArray2, 8192, "%s '%s'", __cCANSignal, __cArray);
      snprintf(__cArray3, 8192, "%s", "");
      
      ReportSetLValueOrSignalNotOnline(getSignalTime(`FDCAN2::dbNode::`SGW::`TELEMATIC_FD_5::`CameraDisplaySts2), __cArray2, __cArray4, 8192);
      ReportTableRow(__tableHandle, 0, __cArray4, __cAOp, 13, __cArray3, __oneOfFlag, __bSetInCheckAlignment);
      
  
    }
    ReportTableEndTestStep(__tableHandle, "1");
  }
  TestCommandEnd();


  {
    CreateTTEIFFunction("Tt56gpegf_CaptureMasterImage", __eFct, __eLocal);
    CallInterfaceFunction(__cEmpty, __cEmpty, "462fe35e-f3f1-4850-92f7-450c4a81e94a");
  }


  TestCommandBegin(__eWait, __cWait, "", "2");
  {
    Wait("1", (1000 * 1000000LL), 1000000, "");
  }
  TestCommandEnd();

  {
    CreateTTEIFFunction("Tt56gpegf_CaptureImage", __eFct, __eLocal);
    CallInterfaceFunction(__cEmpty, __cEmpty, "f85b6d5d-1712-4240-ad83-a1e628197c1d");
  }


  TestCommandBegin(__eCheck, __cCheck, "", "4");
  {
    __bVerdict = __eVerdictPass;
    __tableHandle = ReportTableHead5Columns(__cCheckCaption, __cTSym, __cTOp, __cRefVal, __cActual, __cRes);
    {
      {
        int __res1,__res2;
        __res1 = CheckSignalMatch(`FDCAN2::dbNode::`CVADAS::`CVPAM_FD_Info::`DisplayView2, 1, __cGreaterEqualThan) == 1;
        __res2 = CheckSignalMatch(`FDCAN2::dbNode::`CVADAS::`CVPAM_FD_Info::`DisplayView2, 15, __cLessEqualThan) == 1;
        __csr = __res1 && __res2;
        snprintf(__cArray, 8192, "%s", "DisplayView2");
        snprintf(__cArray2, 8192, "%s '%s'", __cCANSignal, __cArray);
        snprintf(__cArray3, 8192, "%s", "");
        snprintf(__cArray4, 8192, "%s", "");
        snprintf(__cArray5, 8192, "%s", __cArray3);
        snprintf(__cArray6, 8192, "%s", __cArray4);
        ReportRange(1, 15, __cArray5, __cArray6, __cArray7, 8192);
        ReportTableRow(__tableHandle, 0, __cArray2, __cRange, __cArray7, __cEmpty, __oneOfFlag, __bSetInCheckAlignment);
        ReportLValueOrSignalNotOnline(`FDCAN2::dbNode::`CVADAS::`CVPAM_FD_Info::`DisplayView2, __cArray8, 8192);
        ReportCell(__tableHandle, __cArray8);
        ReportCellResult(__tableHandle, __csr, __ePassFail);
      }
  
      __bVerdict = __bVerdict && __csr;
    }
    ReportTableEndVerdict(__tableHandle, "1", __bVerdict);
  }
  TestCommandEnd();


}

testcase Tt56gpegf_TsTc17()
{
  stack long __tableHandle;
  SetBreakOnFail(1);

  TestCommandBegin(__eSet, __cSet, "", "0");
  {
    __tableHandle = ReportTableHead3Columns(__cSetCaption , __cTSym, __cTOp, __cAssigned); 
    {
      $`FDCAN2::dbNode::`SGW::`TELEMATIC_FD_5::`CameraDisplaySts2.phys = 14;
      snprintf(__cArray, 8192, "%s", "CameraDisplaySts2");
      snprintf(__cArray2, 8192, "%s '%s'", __cCANSignal, __cArray);
      snprintf(__cArray3, 8192, "%s", "");
      
      ReportSetLValueOrSignalNotOnline(getSignalTime(`FDCAN2::dbNode::`SGW::`TELEMATIC_FD_5::`CameraDisplaySts2), __cArray2, __cArray4, 8192);
      ReportTableRow(__tableHandle, 0, __cArray4, __cAOp, 14, __cArray3, __oneOfFlag, __bSetInCheckAlignment);
      
  
    }
    ReportTableEndTestStep(__tableHandle, "1");
  }
  TestCommandEnd();


  {
    CreateTTEIFFunction("Tt56gpegf_CaptureMasterImage", __eFct, __eLocal);
    CallInterfaceFunction(__cEmpty, __cEmpty, "462fe35e-f3f1-4850-92f7-450c4a81e94a");
  }


  TestCommandBegin(__eWait, __cWait, "", "2");
  {
    Wait("1", (1000 * 1000000LL), 1000000, "");
  }
  TestCommandEnd();

  {
    CreateTTEIFFunction("Tt56gpegf_CaptureImage", __eFct, __eLocal);
    CallInterfaceFunction(__cEmpty, __cEmpty, "f85b6d5d-1712-4240-ad83-a1e628197c1d");
  }


  TestCommandBegin(__eCheck, __cCheck, "", "4");
  {
    __bVerdict = __eVerdictPass;
    __tableHandle = ReportTableHead5Columns(__cCheckCaption, __cTSym, __cTOp, __cRefVal, __cActual, __cRes);
    {
      {
        int __res1,__res2;
        __res1 = CheckSignalMatch(`FDCAN2::dbNode::`CVADAS::`CVPAM_FD_Info::`DisplayView2, 1, __cGreaterEqualThan) == 1;
        __res2 = CheckSignalMatch(`FDCAN2::dbNode::`CVADAS::`CVPAM_FD_Info::`DisplayView2, 15, __cLessEqualThan) == 1;
        __csr = __res1 && __res2;
        snprintf(__cArray, 8192, "%s", "DisplayView2");
        snprintf(__cArray2, 8192, "%s '%s'", __cCANSignal, __cArray);
        snprintf(__cArray3, 8192, "%s", "");
        snprintf(__cArray4, 8192, "%s", "");
        snprintf(__cArray5, 8192, "%s", __cArray3);
        snprintf(__cArray6, 8192, "%s", __cArray4);
        ReportRange(1, 15, __cArray5, __cArray6, __cArray7, 8192);
        ReportTableRow(__tableHandle, 0, __cArray2, __cRange, __cArray7, __cEmpty, __oneOfFlag, __bSetInCheckAlignment);
        ReportLValueOrSignalNotOnline(`FDCAN2::dbNode::`CVADAS::`CVPAM_FD_Info::`DisplayView2, __cArray8, 8192);
        ReportCell(__tableHandle, __cArray8);
        ReportCellResult(__tableHandle, __csr, __ePassFail);
      }
  
      __bVerdict = __bVerdict && __csr;
    }
    ReportTableEndVerdict(__tableHandle, "1", __bVerdict);
  }
  TestCommandEnd();


}

testsequence Tt56gpegf_SteeringAngleTest_HMI_View_Switch()
{
  stack long __tableHandle;
  SetBreakOnFail(1);

  CreateTTEIFFunction("Tt56gpegf_TsTc18_Completion", __eFct, __eLocal);
  
  AddIFAsCleanUpFunction();

  TestPreparationBegin();
  {
    {
      CreateTTEIFFunction("Tt56gpegf_General_Precondition", __eFct, __eLocal);
      CallInterfaceFunction(__cEmpty, __cEmpty, "43b50592-ee14-4403-86eb-feacfb5147e3");
    }


  }
  TestPreparationEnd();

  {
    __type_of(0) __tcLocVar0;
    __type_of(500) __tcLocVar1;
    __type_of(100) __tcLocVar2;
  
    __tcLocVar0 = 0;
    __tcLocVar1 = 500;
    __tcLocVar2 = 100;
  
    snprintf(__cArray, 8192, "%s", "0");
    snprintf(__cArray2, 8192, "%s", "500");
    snprintf(__cArray3, 8192, "%s", "100");
  
    snprintf(__cArray4, 8192, "For (For i=%s..%s, increment=%s)", __cArray, __cArray2, __cArray3);
    TestControlStructBegin(__cFor, __cArray4, "0");  
    for(__tt2LoopVar1 = __tcLocVar0; (__tcLocVar2 < 0) ? (CheckSignalMatch(__tt2LoopVar1, __tcLocVar1, ">=" ) == 1) : (CheckSignalMatch(__tt2LoopVar1, __tcLocVar1, "<=") == 1); __tt2LoopVar1 += __tcLocVar2)
    {
      if(__LoopIsBlocking())  
        break;
  
      snprintf(__cArray, 8192, "%s", "0");
      snprintf(__cArray2, 8192, "%s", "500");
      snprintf(__cArray3, 8192, "%s", "100");
      snprintf(__cArray4, 8192, "For (For i=%s..%s, increment=%s; current i = %lld)", __cArray, __cArray2, __cArray3, __tt2LoopVar1);
      TestControlStructBegin(__cForIteration, __cArray4, "1");
      TestCommandBegin(__eSet, __cSet, "", "2");
      {
        __tableHandle = ReportTableHead3Columns(__cSetCaption , __cTSym, __cTOp, __cAssigned); 
        {
          $`FDCAN2::dbNode::`BCM::`IPC_VEHICLE_SETUP::`SVC_Guidelines.phys = 1;
          snprintf(__cArray, 8192, "%s", "SVC_Guidelines");
          snprintf(__cArray2, 8192, "%s '%s'", __cCANSignal, __cArray);
          snprintf(__cArray3, 8192, "%s", "");
          
          ReportSetLValueOrSignalNotOnline(getSignalTime(`FDCAN2::dbNode::`BCM::`IPC_VEHICLE_SETUP::`SVC_Guidelines), __cArray2, __cArray4, 8192);
          ReportTableRow(__tableHandle, 0, __cArray4, __cAOp, 1, __cArray3, __oneOfFlag, __bSetInCheckAlignment);
          
      
        }
        ReportTableEndTestStep(__tableHandle, "1");
      }
      TestCommandEnd();


      TestCommandBegin(__eSet, __cSet, "", "3");
      {
        __tableHandle = ReportTableHead3Columns(__cSetCaption , __cTSym, __cTOp, __cAssigned); 
        {
          $`FDCAN2::dbNode::`BCM::`IPC_VEHICLE_SETUP::`Fwrd_Cam_Guidelines.phys = 1;
          snprintf(__cArray, 8192, "%s", "Fwrd_Cam_Guidelines");
          snprintf(__cArray2, 8192, "%s '%s'", __cCANSignal, __cArray);
          snprintf(__cArray3, 8192, "%s", "");
          
          ReportSetLValueOrSignalNotOnline(getSignalTime(`FDCAN2::dbNode::`BCM::`IPC_VEHICLE_SETUP::`Fwrd_Cam_Guidelines), __cArray2, __cArray4, 8192);
          ReportTableRow(__tableHandle, 0, __cArray4, __cAOp, 1, __cArray3, __oneOfFlag, __bSetInCheckAlignment);
          
      
        }
        ReportTableEndTestStep(__tableHandle, "1");
      }
      TestCommandEnd();


      TestCommandBegin(__eSet, __cSet, "", "4");
      {
        __tableHandle = ReportTableHead3Columns(__cSetCaption , __cTSym, __cTOp, __cAssigned); 
        {
          $`FDCAN14::dbNode::`EPS::`EPS_FD_1::`LwsAngle.phys = __tt2LoopVar1;
          snprintf(__cArray, 8192, "%s", "FDCAN14::EPS::EPS_FD_1::LwsAngle");
          snprintf(__cArray2, 8192, "%s '%s'", __cCANSignal, __cArray);
          snprintf(__cArray3, 8192, "%s", "i");
          
          ReportSetLValueOrSignalNotOnline(getSignalTime(`FDCAN14::dbNode::`EPS::`EPS_FD_1::`LwsAngle), __cArray2, __cArray4, 8192);
          ReportTableRow(__tableHandle, 0, __cArray4, __cAOp, __tt2LoopVar1, __cArray3, __oneOfFlag, __bSetInCheckAlignment);
          
      
        }
        ReportTableEndTestStep(__tableHandle, "1");
      }
      TestCommandEnd();


      CreateTTEIFFunction("Tt56gpegf_TsTc19", __eTcDef, __eLocal);
      AddIFParameterTestCaseAttribute("TC_ID", "");
      AddIFParameterTestCaseAttribute("Test Case ID", "");
      CallInterfaceFunction("Set to Surround View Camera", __cEmpty , "ee21b4d8-7688-4693-9578-536cb525d235");

      CreateTTEIFFunction("Tt56gpegf_TsTc20", __eTcDef, __eLocal);
      AddIFParameterTestCaseAttribute("TC_ID", "");
      AddIFParameterTestCaseAttribute("Test Case ID", "");
      CallInterfaceFunction("View 3: Forward Facing Camera", __cEmpty , "74a739d5-b741-4f47-b5e6-26ebd06f57b0");

      CreateTTEIFFunction("Tt56gpegf_TsTc21", __eTcDef, __eLocal);
      AddIFParameterTestCaseAttribute("TC_ID", "");
      AddIFParameterTestCaseAttribute("Test Case ID", "");
      CallInterfaceFunction("View 11: FVTV", __cEmpty , "32cbe3bd-e49c-4c6f-b96d-f14ee028f5a6");

      CreateTTEIFFunction("Tt56gpegf_TsTc22", __eTcDef, __eLocal);
      AddIFParameterTestCaseAttribute("TC_ID", "");
      AddIFParameterTestCaseAttribute("Test Case ID", "");
      CallInterfaceFunction("View 12: RVTV", __cEmpty , "4b4d45aa-2184-46aa-8722-d9f12829b073");

      TestControlStructEnd(__eUndefined);
    }
    TestControlStructEnd(__eUndefined);
  }

  {
    __type_of(-500) __tcLocVar0;
    __type_of(0) __tcLocVar1;
    __type_of(100) __tcLocVar2;
  
    __tcLocVar0 = -500;
    __tcLocVar1 = 0;
    __tcLocVar2 = 100;
  
    snprintf(__cArray, 8192, "%s", "-500");
    snprintf(__cArray2, 8192, "%s", "0");
    snprintf(__cArray3, 8192, "%s", "100");
  
    snprintf(__cArray4, 8192, "For (For i=%s..%s, increment=%s)", __cArray, __cArray2, __cArray3);
    TestControlStructBegin(__cFor, __cArray4, "0");  
    for(__tt2LoopVar2 = __tcLocVar0; (__tcLocVar2 < 0) ? (CheckSignalMatch(__tt2LoopVar2, __tcLocVar1, ">=" ) == 1) : (CheckSignalMatch(__tt2LoopVar2, __tcLocVar1, "<=") == 1); __tt2LoopVar2 += __tcLocVar2)
    {
      if(__LoopIsBlocking())  
        break;
  
      snprintf(__cArray, 8192, "%s", "-500");
      snprintf(__cArray2, 8192, "%s", "0");
      snprintf(__cArray3, 8192, "%s", "100");
      snprintf(__cArray4, 8192, "For (For i=%s..%s, increment=%s; current i = %.15g)", __cArray, __cArray2, __cArray3, __tt2LoopVar2);
      TestControlStructBegin(__cForIteration, __cArray4, "5");
      TestCommandBegin(__eSet, __cSet, "", "6");
      {
        __tableHandle = ReportTableHead3Columns(__cSetCaption , __cTSym, __cTOp, __cAssigned); 
        {
          $`FDCAN2::dbNode::`BCM::`IPC_VEHICLE_SETUP::`SVC_Guidelines.phys = 1;
          snprintf(__cArray, 8192, "%s", "SVC_Guidelines");
          snprintf(__cArray2, 8192, "%s '%s'", __cCANSignal, __cArray);
          snprintf(__cArray3, 8192, "%s", "");
          
          ReportSetLValueOrSignalNotOnline(getSignalTime(`FDCAN2::dbNode::`BCM::`IPC_VEHICLE_SETUP::`SVC_Guidelines), __cArray2, __cArray4, 8192);
          ReportTableRow(__tableHandle, 0, __cArray4, __cAOp, 1, __cArray3, __oneOfFlag, __bSetInCheckAlignment);
          
      
        }
        ReportTableEndTestStep(__tableHandle, "1");
      }
      TestCommandEnd();


      TestCommandBegin(__eSet, __cSet, "", "7");
      {
        __tableHandle = ReportTableHead3Columns(__cSetCaption , __cTSym, __cTOp, __cAssigned); 
        {
          $`FDCAN2::dbNode::`BCM::`IPC_VEHICLE_SETUP::`Fwrd_Cam_Guidelines.phys = 1;
          snprintf(__cArray, 8192, "%s", "Fwrd_Cam_Guidelines");
          snprintf(__cArray2, 8192, "%s '%s'", __cCANSignal, __cArray);
          snprintf(__cArray3, 8192, "%s", "");
          
          ReportSetLValueOrSignalNotOnline(getSignalTime(`FDCAN2::dbNode::`BCM::`IPC_VEHICLE_SETUP::`Fwrd_Cam_Guidelines), __cArray2, __cArray4, 8192);
          ReportTableRow(__tableHandle, 0, __cArray4, __cAOp, 1, __cArray3, __oneOfFlag, __bSetInCheckAlignment);
          
      
        }
        ReportTableEndTestStep(__tableHandle, "1");
      }
      TestCommandEnd();


      TestCommandBegin(__eSet, __cSet, "", "8");
      {
        __tableHandle = ReportTableHead3Columns(__cSetCaption , __cTSym, __cTOp, __cAssigned); 
        {
          $`FDCAN14::dbNode::`EPS::`EPS_FD_1::`LwsAngle.phys = __tt2LoopVar2;
          snprintf(__cArray, 8192, "%s", "FDCAN14::EPS::EPS_FD_1::LwsAngle");
          snprintf(__cArray2, 8192, "%s '%s'", __cCANSignal, __cArray);
          snprintf(__cArray3, 8192, "%s", "i");
          
          ReportSetLValueOrSignalNotOnline(getSignalTime(`FDCAN14::dbNode::`EPS::`EPS_FD_1::`LwsAngle), __cArray2, __cArray4, 8192);
          ReportTableRow(__tableHandle, 0, __cArray4, __cAOp, __tt2LoopVar2, __cArray3, __oneOfFlag, __bSetInCheckAlignment);
          
      
        }
        ReportTableEndTestStep(__tableHandle, "1");
      }
      TestCommandEnd();


      CreateTTEIFFunction("Tt56gpegf_TsTc23", __eTcDef, __eLocal);
      AddIFParameterTestCaseAttribute("TC_ID", "");
      AddIFParameterTestCaseAttribute("Test Case ID", "");
      CallInterfaceFunction("Set to Surround View Camera", __cEmpty , "ff757b51-169c-4528-a844-a6cbaa01ded8");

      CreateTTEIFFunction("Tt56gpegf_TsTc24", __eTcDef, __eLocal);
      AddIFParameterTestCaseAttribute("TC_ID", "");
      AddIFParameterTestCaseAttribute("Test Case ID", "");
      CallInterfaceFunction("View 3: Forward Facing Camera", __cEmpty , "f1f3ab9f-a334-482d-ae64-c63c3c5933e4");

      CreateTTEIFFunction("Tt56gpegf_TsTc25", __eTcDef, __eLocal);
      AddIFParameterTestCaseAttribute("TC_ID", "");
      AddIFParameterTestCaseAttribute("Test Case ID", "");
      CallInterfaceFunction("View 11: FVTV", __cEmpty , "f7caca6b-0cd2-4fa1-823e-e2b1400a4db3");

      CreateTTEIFFunction("Tt56gpegf_TsTc26", __eTcDef, __eLocal);
      AddIFParameterTestCaseAttribute("TC_ID", "");
      AddIFParameterTestCaseAttribute("Test Case ID", "");
      CallInterfaceFunction("View 12: RVTV", __cEmpty , "8858dc86-426d-4270-9d4b-2bb1e7035142");

      TestControlStructEnd(__eUndefined);
    }
    TestControlStructEnd(__eUndefined);
  }


}

void Tt56gpegf_TsTc18_Completion()
{
  stack long __tableHandle;
  TestCompletionBegin();
  {
    {
      CreateTTEIFFunction("Tt56gpegf_General_Postconditions", __eFct, __eLocal);
      CallInterfaceFunction(__cEmpty, __cEmpty, "d53919e9-7a4a-4475-b807-22904a2462c8");
    }


  }
  TestCompletionEnd();
}

testcase Tt56gpegf_TsTc19()
{
  stack long __tableHandle;
  SetBreakOnFail(1);

  TestPreparationBegin();
  {
  }
  TestPreparationEnd();

  TestCommandBegin(__eSet, __cSet, "", "0");
  {
    __tableHandle = ReportTableHead3Columns(__cSetCaption , __cTSym, __cTOp, __cAssigned); 
    {
      $`FDCAN2::dbNode::`SGW::`TELEMATIC_FD_14::`TGW_CAMERA_DISP_STAT.phys = 4;
      snprintf(__cArray, 8192, "%s", "TGW_CAMERA_DISP_STAT");
      snprintf(__cArray2, 8192, "%s '%s'", __cCANSignal, __cArray);
      snprintf(__cArray3, 8192, "%s", "");
      
      ReportSetLValueOrSignalNotOnline(getSignalTime(`FDCAN2::dbNode::`SGW::`TELEMATIC_FD_14::`TGW_CAMERA_DISP_STAT), __cArray2, __cArray4, 8192);
      ReportTableRow(__tableHandle, 0, __cArray4, __cAOp, 4, __cArray3, __oneOfFlag, __bSetInCheckAlignment);
      
  
    }
    {
      $`FDCAN2::dbNode::`SGW::`TELEMATIC_FD_5::`CameraDisplaySts2.phys = 0;
      snprintf(__cArray, 8192, "%s", "CameraDisplaySts2");
      snprintf(__cArray2, 8192, "%s '%s'", __cCANSignal, __cArray);
      snprintf(__cArray3, 8192, "%s", "Default");
      
      ReportSetLValueOrSignalNotOnline(getSignalTime(`FDCAN2::dbNode::`SGW::`TELEMATIC_FD_5::`CameraDisplaySts2), __cArray2, __cArray4, 8192);
      ReportTableRow(__tableHandle, 0, __cArray4, __cAOp, 0, __cArray3, __oneOfFlag, __bSetInCheckAlignment);
      
  
    }
    ReportTableEndTestStep(__tableHandle, "1");
  }
  TestCommandEnd();


  TestCommandBegin(__eWait, __cWait, "", "1");
  {
    Wait("1", (1000 * 1000000LL), 1000000, "");
  }
  TestCommandEnd();

  TestCommandBegin(__eCheck, __cCheck, "", "2");
  {
    __bVerdict = __eVerdictPass;
    __tableHandle = ReportTableHead5Columns(__cCheckCaption, __cTSym, __cTOp, __cRefVal, __cActual, __cRes);
    {
      {
        int __res1,__res2;
        __res1 = CheckSignalMatch(`FDCAN2::dbNode::`SGW::`TELEMATIC_FD_14::`TGW_CAMERA_DISP_STAT, 0, __cGreaterEqualThan) == 1;
        __res2 = CheckSignalMatch(`FDCAN2::dbNode::`SGW::`TELEMATIC_FD_14::`TGW_CAMERA_DISP_STAT, 4, __cLessEqualThan) == 1;
        __csr = __res1 && __res2;
        snprintf(__cArray, 8192, "%s", "TGW_CAMERA_DISP_STAT");
        snprintf(__cArray2, 8192, "%s '%s'", __cCANSignal, __cArray);
        snprintf(__cArray3, 8192, "%s", "");
        snprintf(__cArray4, 8192, "%s", "");
        snprintf(__cArray5, 8192, "%s", __cArray3);
        snprintf(__cArray6, 8192, "%s", __cArray4);
        ReportRange(0, 4, __cArray5, __cArray6, __cArray7, 8192);
        ReportTableRow(__tableHandle, 0, __cArray2, __cRange, __cArray7, __cEmpty, __oneOfFlag, __bSetInCheckAlignment);
        ReportLValueOrSignalNotOnline(`FDCAN2::dbNode::`SGW::`TELEMATIC_FD_14::`TGW_CAMERA_DISP_STAT, __cArray8, 8192);
        ReportCell(__tableHandle, __cArray8);
        ReportCellResult(__tableHandle, __csr, __ePassFail);
      }
  
      __bVerdict = __bVerdict && __csr;
    }
    ReportTableEndVerdict(__tableHandle, "1", __bVerdict);
  }
  TestCommandEnd();


  TestCommandBegin(__eWait, __cWait, "", "3");
  {
    Wait("1", (3000 * 1000000LL), 1000000, "");
  }
  TestCommandEnd();

}

testcase Tt56gpegf_TsTc20()
{
  stack long __tableHandle;
  SetBreakOnFail(1);

  {
    CreateTTEIFFunction("Tt56gpegf_CaptureImage", __eFct, __eLocal);
    CallInterfaceFunction(__cEmpty, __cEmpty, "f85b6d5d-1712-4240-ad83-a1e628197c1d");
  }


  TestCommandBegin(__eSet, __cSet, "", "1");
  {
    __tableHandle = ReportTableHead3Columns(__cSetCaption , __cTSym, __cTOp, __cAssigned); 
    {
      $`FDCAN2::dbNode::`SGW::`TELEMATIC_FD_5::`CameraDisplaySts2.phys = 3;
      snprintf(__cArray, 8192, "%s", "CameraDisplaySts2");
      snprintf(__cArray2, 8192, "%s '%s'", __cCANSignal, __cArray);
      snprintf(__cArray3, 8192, "%s", "");
      
      ReportSetLValueOrSignalNotOnline(getSignalTime(`FDCAN2::dbNode::`SGW::`TELEMATIC_FD_5::`CameraDisplaySts2), __cArray2, __cArray4, 8192);
      ReportTableRow(__tableHandle, 0, __cArray4, __cAOp, 3, __cArray3, __oneOfFlag, __bSetInCheckAlignment);
      
  
    }
    ReportTableEndTestStep(__tableHandle, "1");
  }
  TestCommandEnd();


  TestCommandBegin(__eWait, __cWait, "", "2");
  {
    Wait("1", (1000 * 1000000LL), 1000000, "");
  }
  TestCommandEnd();

  TestCommandBegin(__eCheck, __cCheck, "", "3");
  {
    __bVerdict = __eVerdictPass;
    __tableHandle = ReportTableHead5Columns(__cCheckCaption, __cTSym, __cTOp, __cRefVal, __cActual, __cRes);
    {
      {
        int __res1,__res2;
        __res1 = CheckSignalMatch(`FDCAN2::dbNode::`CVADAS::`CVPAM_FD_Info::`DisplayView2, 1, __cGreaterEqualThan) == 1;
        __res2 = CheckSignalMatch(`FDCAN2::dbNode::`CVADAS::`CVPAM_FD_Info::`DisplayView2, 15, __cLessEqualThan) == 1;
        __csr = __res1 && __res2;
        snprintf(__cArray, 8192, "%s", "DisplayView2");
        snprintf(__cArray2, 8192, "%s '%s'", __cCANSignal, __cArray);
        snprintf(__cArray3, 8192, "%s", "");
        snprintf(__cArray4, 8192, "%s", "");
        snprintf(__cArray5, 8192, "%s", __cArray3);
        snprintf(__cArray6, 8192, "%s", __cArray4);
        ReportRange(1, 15, __cArray5, __cArray6, __cArray7, 8192);
        ReportTableRow(__tableHandle, 0, __cArray2, __cRange, __cArray7, __cEmpty, __oneOfFlag, __bSetInCheckAlignment);
        ReportLValueOrSignalNotOnline(`FDCAN2::dbNode::`CVADAS::`CVPAM_FD_Info::`DisplayView2, __cArray8, 8192);
        ReportCell(__tableHandle, __cArray8);
        ReportCellResult(__tableHandle, __csr, __ePassFail);
      }
  
      __bVerdict = __bVerdict && __csr;
    }
    ReportTableEndVerdict(__tableHandle, "1", __bVerdict);
  }
  TestCommandEnd();


}

testcase Tt56gpegf_TsTc21()
{
  stack long __tableHandle;
  SetBreakOnFail(1);

  {
    CreateTTEIFFunction("Tt56gpegf_CaptureImage", __eFct, __eLocal);
    CallInterfaceFunction(__cEmpty, __cEmpty, "f85b6d5d-1712-4240-ad83-a1e628197c1d");
  }


  TestCommandBegin(__eSet, __cSet, "", "1");
  {
    __tableHandle = ReportTableHead3Columns(__cSetCaption , __cTSym, __cTOp, __cAssigned); 
    {
      $`FDCAN2::dbNode::`SGW::`TELEMATIC_FD_5::`CameraDisplaySts2.phys = 11;
      snprintf(__cArray, 8192, "%s", "CameraDisplaySts2");
      snprintf(__cArray2, 8192, "%s '%s'", __cCANSignal, __cArray);
      snprintf(__cArray3, 8192, "%s", "");
      
      ReportSetLValueOrSignalNotOnline(getSignalTime(`FDCAN2::dbNode::`SGW::`TELEMATIC_FD_5::`CameraDisplaySts2), __cArray2, __cArray4, 8192);
      ReportTableRow(__tableHandle, 0, __cArray4, __cAOp, 11, __cArray3, __oneOfFlag, __bSetInCheckAlignment);
      
  
    }
    ReportTableEndTestStep(__tableHandle, "1");
  }
  TestCommandEnd();


  TestCommandBegin(__eWait, __cWait, "", "2");
  {
    Wait("1", (1000 * 1000000LL), 1000000, "");
  }
  TestCommandEnd();

  TestCommandBegin(__eCheck, __cCheck, "", "3");
  {
    __bVerdict = __eVerdictPass;
    __tableHandle = ReportTableHead5Columns(__cCheckCaption, __cTSym, __cTOp, __cRefVal, __cActual, __cRes);
    {
      {
        int __res1,__res2;
        __res1 = CheckSignalMatch(`FDCAN2::dbNode::`CVADAS::`CVPAM_FD_Info::`DisplayView2, 1, __cGreaterEqualThan) == 1;
        __res2 = CheckSignalMatch(`FDCAN2::dbNode::`CVADAS::`CVPAM_FD_Info::`DisplayView2, 15, __cLessEqualThan) == 1;
        __csr = __res1 && __res2;
        snprintf(__cArray, 8192, "%s", "DisplayView2");
        snprintf(__cArray2, 8192, "%s '%s'", __cCANSignal, __cArray);
        snprintf(__cArray3, 8192, "%s", "");
        snprintf(__cArray4, 8192, "%s", "");
        snprintf(__cArray5, 8192, "%s", __cArray3);
        snprintf(__cArray6, 8192, "%s", __cArray4);
        ReportRange(1, 15, __cArray5, __cArray6, __cArray7, 8192);
        ReportTableRow(__tableHandle, 0, __cArray2, __cRange, __cArray7, __cEmpty, __oneOfFlag, __bSetInCheckAlignment);
        ReportLValueOrSignalNotOnline(`FDCAN2::dbNode::`CVADAS::`CVPAM_FD_Info::`DisplayView2, __cArray8, 8192);
        ReportCell(__tableHandle, __cArray8);
        ReportCellResult(__tableHandle, __csr, __ePassFail);
      }
  
      __bVerdict = __bVerdict && __csr;
    }
    ReportTableEndVerdict(__tableHandle, "1", __bVerdict);
  }
  TestCommandEnd();


}

testcase Tt56gpegf_TsTc22()
{
  stack long __tableHandle;
  SetBreakOnFail(1);

  {
    CreateTTEIFFunction("Tt56gpegf_CaptureImage", __eFct, __eLocal);
    CallInterfaceFunction(__cEmpty, __cEmpty, "f85b6d5d-1712-4240-ad83-a1e628197c1d");
  }


  TestCommandBegin(__eSet, __cSet, "", "1");
  {
    __tableHandle = ReportTableHead3Columns(__cSetCaption , __cTSym, __cTOp, __cAssigned); 
    {
      $`FDCAN2::dbNode::`SGW::`TELEMATIC_FD_5::`CameraDisplaySts2.phys = 12;
      snprintf(__cArray, 8192, "%s", "CameraDisplaySts2");
      snprintf(__cArray2, 8192, "%s '%s'", __cCANSignal, __cArray);
      snprintf(__cArray3, 8192, "%s", "");
      
      ReportSetLValueOrSignalNotOnline(getSignalTime(`FDCAN2::dbNode::`SGW::`TELEMATIC_FD_5::`CameraDisplaySts2), __cArray2, __cArray4, 8192);
      ReportTableRow(__tableHandle, 0, __cArray4, __cAOp, 12, __cArray3, __oneOfFlag, __bSetInCheckAlignment);
      
  
    }
    ReportTableEndTestStep(__tableHandle, "1");
  }
  TestCommandEnd();


  TestCommandBegin(__eWait, __cWait, "", "2");
  {
    Wait("1", (1000 * 1000000LL), 1000000, "");
  }
  TestCommandEnd();

  TestCommandBegin(__eCheck, __cCheck, "", "3");
  {
    __bVerdict = __eVerdictPass;
    __tableHandle = ReportTableHead5Columns(__cCheckCaption, __cTSym, __cTOp, __cRefVal, __cActual, __cRes);
    {
      {
        int __res1,__res2;
        __res1 = CheckSignalMatch(`FDCAN2::dbNode::`CVADAS::`CVPAM_FD_Info::`DisplayView2, 1, __cGreaterEqualThan) == 1;
        __res2 = CheckSignalMatch(`FDCAN2::dbNode::`CVADAS::`CVPAM_FD_Info::`DisplayView2, 15, __cLessEqualThan) == 1;
        __csr = __res1 && __res2;
        snprintf(__cArray, 8192, "%s", "DisplayView2");
        snprintf(__cArray2, 8192, "%s '%s'", __cCANSignal, __cArray);
        snprintf(__cArray3, 8192, "%s", "");
        snprintf(__cArray4, 8192, "%s", "");
        snprintf(__cArray5, 8192, "%s", __cArray3);
        snprintf(__cArray6, 8192, "%s", __cArray4);
        ReportRange(1, 15, __cArray5, __cArray6, __cArray7, 8192);
        ReportTableRow(__tableHandle, 0, __cArray2, __cRange, __cArray7, __cEmpty, __oneOfFlag, __bSetInCheckAlignment);
        ReportLValueOrSignalNotOnline(`FDCAN2::dbNode::`CVADAS::`CVPAM_FD_Info::`DisplayView2, __cArray8, 8192);
        ReportCell(__tableHandle, __cArray8);
        ReportCellResult(__tableHandle, __csr, __ePassFail);
      }
  
      __bVerdict = __bVerdict && __csr;
    }
    ReportTableEndVerdict(__tableHandle, "1", __bVerdict);
  }
  TestCommandEnd();


}

testcase Tt56gpegf_TsTc23()
{
  stack long __tableHandle;
  SetBreakOnFail(1);

  TestPreparationBegin();
  {
  }
  TestPreparationEnd();

  TestCommandBegin(__eSet, __cSet, "", "0");
  {
    __tableHandle = ReportTableHead3Columns(__cSetCaption , __cTSym, __cTOp, __cAssigned); 
    {
      $`FDCAN2::dbNode::`SGW::`TELEMATIC_FD_14::`TGW_CAMERA_DISP_STAT.phys = 4;
      snprintf(__cArray, 8192, "%s", "TGW_CAMERA_DISP_STAT");
      snprintf(__cArray2, 8192, "%s '%s'", __cCANSignal, __cArray);
      snprintf(__cArray3, 8192, "%s", "");
      
      ReportSetLValueOrSignalNotOnline(getSignalTime(`FDCAN2::dbNode::`SGW::`TELEMATIC_FD_14::`TGW_CAMERA_DISP_STAT), __cArray2, __cArray4, 8192);
      ReportTableRow(__tableHandle, 0, __cArray4, __cAOp, 4, __cArray3, __oneOfFlag, __bSetInCheckAlignment);
      
  
    }
    {
      $`FDCAN2::dbNode::`SGW::`TELEMATIC_FD_5::`CameraDisplaySts2.phys = 0;
      snprintf(__cArray, 8192, "%s", "CameraDisplaySts2");
      snprintf(__cArray2, 8192, "%s '%s'", __cCANSignal, __cArray);
      snprintf(__cArray3, 8192, "%s", "Default");
      
      ReportSetLValueOrSignalNotOnline(getSignalTime(`FDCAN2::dbNode::`SGW::`TELEMATIC_FD_5::`CameraDisplaySts2), __cArray2, __cArray4, 8192);
      ReportTableRow(__tableHandle, 0, __cArray4, __cAOp, 0, __cArray3, __oneOfFlag, __bSetInCheckAlignment);
      
  
    }
    ReportTableEndTestStep(__tableHandle, "1");
  }
  TestCommandEnd();


  TestCommandBegin(__eWait, __cWait, "", "1");
  {
    Wait("1", (1000 * 1000000LL), 1000000, "");
  }
  TestCommandEnd();

  TestCommandBegin(__eCheck, __cCheck, "", "2");
  {
    __bVerdict = __eVerdictPass;
    __tableHandle = ReportTableHead5Columns(__cCheckCaption, __cTSym, __cTOp, __cRefVal, __cActual, __cRes);
    {
      {
        int __res1,__res2;
        __res1 = CheckSignalMatch(`FDCAN2::dbNode::`SGW::`TELEMATIC_FD_14::`TGW_CAMERA_DISP_STAT, 0, __cGreaterEqualThan) == 1;
        __res2 = CheckSignalMatch(`FDCAN2::dbNode::`SGW::`TELEMATIC_FD_14::`TGW_CAMERA_DISP_STAT, 4, __cLessEqualThan) == 1;
        __csr = __res1 && __res2;
        snprintf(__cArray, 8192, "%s", "TGW_CAMERA_DISP_STAT");
        snprintf(__cArray2, 8192, "%s '%s'", __cCANSignal, __cArray);
        snprintf(__cArray3, 8192, "%s", "");
        snprintf(__cArray4, 8192, "%s", "");
        snprintf(__cArray5, 8192, "%s", __cArray3);
        snprintf(__cArray6, 8192, "%s", __cArray4);
        ReportRange(0, 4, __cArray5, __cArray6, __cArray7, 8192);
        ReportTableRow(__tableHandle, 0, __cArray2, __cRange, __cArray7, __cEmpty, __oneOfFlag, __bSetInCheckAlignment);
        ReportLValueOrSignalNotOnline(`FDCAN2::dbNode::`SGW::`TELEMATIC_FD_14::`TGW_CAMERA_DISP_STAT, __cArray8, 8192);
        ReportCell(__tableHandle, __cArray8);
        ReportCellResult(__tableHandle, __csr, __ePassFail);
      }
  
      __bVerdict = __bVerdict && __csr;
    }
    ReportTableEndVerdict(__tableHandle, "1", __bVerdict);
  }
  TestCommandEnd();


  TestCommandBegin(__eWait, __cWait, "", "3");
  {
    Wait("1", (3000 * 1000000LL), 1000000, "");
  }
  TestCommandEnd();

}

testcase Tt56gpegf_TsTc24()
{
  stack long __tableHandle;
  SetBreakOnFail(1);

  TestCommandBegin(__eSet, __cSet, "", "0");
  {
    __tableHandle = ReportTableHead3Columns(__cSetCaption , __cTSym, __cTOp, __cAssigned); 
    {
      $`FDCAN2::dbNode::`SGW::`TELEMATIC_FD_5::`CameraDisplaySts2.phys = 3;
      snprintf(__cArray, 8192, "%s", "CameraDisplaySts2");
      snprintf(__cArray2, 8192, "%s '%s'", __cCANSignal, __cArray);
      snprintf(__cArray3, 8192, "%s", "");
      
      ReportSetLValueOrSignalNotOnline(getSignalTime(`FDCAN2::dbNode::`SGW::`TELEMATIC_FD_5::`CameraDisplaySts2), __cArray2, __cArray4, 8192);
      ReportTableRow(__tableHandle, 0, __cArray4, __cAOp, 3, __cArray3, __oneOfFlag, __bSetInCheckAlignment);
      
  
    }
    ReportTableEndTestStep(__tableHandle, "1");
  }
  TestCommandEnd();


  {
    CreateTTEIFFunction("Tt56gpegf_CaptureMasterImage", __eFct, __eLocal);
    CallInterfaceFunction(__cEmpty, __cEmpty, "462fe35e-f3f1-4850-92f7-450c4a81e94a");
  }


  TestCommandBegin(__eWait, __cWait, "", "2");
  {
    Wait("1", (1000 * 1000000LL), 1000000, "");
  }
  TestCommandEnd();

  {
    CreateTTEIFFunction("Tt56gpegf_CaptureImage", __eFct, __eLocal);
    CallInterfaceFunction(__cEmpty, __cEmpty, "f85b6d5d-1712-4240-ad83-a1e628197c1d");
  }


  TestCommandBegin(__eCheck, __cCheck, "", "4");
  {
    __bVerdict = __eVerdictPass;
    __tableHandle = ReportTableHead5Columns(__cCheckCaption, __cTSym, __cTOp, __cRefVal, __cActual, __cRes);
    {
      {
        int __res1,__res2;
        __res1 = CheckSignalMatch(`FDCAN2::dbNode::`CVADAS::`CVPAM_FD_Info::`DisplayView2, 1, __cGreaterEqualThan) == 1;
        __res2 = CheckSignalMatch(`FDCAN2::dbNode::`CVADAS::`CVPAM_FD_Info::`DisplayView2, 15, __cLessEqualThan) == 1;
        __csr = __res1 && __res2;
        snprintf(__cArray, 8192, "%s", "DisplayView2");
        snprintf(__cArray2, 8192, "%s '%s'", __cCANSignal, __cArray);
        snprintf(__cArray3, 8192, "%s", "");
        snprintf(__cArray4, 8192, "%s", "");
        snprintf(__cArray5, 8192, "%s", __cArray3);
        snprintf(__cArray6, 8192, "%s", __cArray4);
        ReportRange(1, 15, __cArray5, __cArray6, __cArray7, 8192);
        ReportTableRow(__tableHandle, 0, __cArray2, __cRange, __cArray7, __cEmpty, __oneOfFlag, __bSetInCheckAlignment);
        ReportLValueOrSignalNotOnline(`FDCAN2::dbNode::`CVADAS::`CVPAM_FD_Info::`DisplayView2, __cArray8, 8192);
        ReportCell(__tableHandle, __cArray8);
        ReportCellResult(__tableHandle, __csr, __ePassFail);
      }
  
      __bVerdict = __bVerdict && __csr;
    }
    ReportTableEndVerdict(__tableHandle, "1", __bVerdict);
  }
  TestCommandEnd();


}

testcase Tt56gpegf_TsTc25()
{
  stack long __tableHandle;
  SetBreakOnFail(1);

  TestCommandBegin(__eSet, __cSet, "", "0");
  {
    __tableHandle = ReportTableHead3Columns(__cSetCaption , __cTSym, __cTOp, __cAssigned); 
    {
      $`FDCAN2::dbNode::`SGW::`TELEMATIC_FD_5::`CameraDisplaySts2.phys = 11;
      snprintf(__cArray, 8192, "%s", "CameraDisplaySts2");
      snprintf(__cArray2, 8192, "%s '%s'", __cCANSignal, __cArray);
      snprintf(__cArray3, 8192, "%s", "");
      
      ReportSetLValueOrSignalNotOnline(getSignalTime(`FDCAN2::dbNode::`SGW::`TELEMATIC_FD_5::`CameraDisplaySts2), __cArray2, __cArray4, 8192);
      ReportTableRow(__tableHandle, 0, __cArray4, __cAOp, 11, __cArray3, __oneOfFlag, __bSetInCheckAlignment);
      
  
    }
    ReportTableEndTestStep(__tableHandle, "1");
  }
  TestCommandEnd();


  {
    CreateTTEIFFunction("Tt56gpegf_CaptureMasterImage", __eFct, __eLocal);
    CallInterfaceFunction(__cEmpty, __cEmpty, "462fe35e-f3f1-4850-92f7-450c4a81e94a");
  }


  TestCommandBegin(__eWait, __cWait, "", "2");
  {
    Wait("1", (1000 * 1000000LL), 1000000, "");
  }
  TestCommandEnd();

  {
    CreateTTEIFFunction("Tt56gpegf_CaptureImage", __eFct, __eLocal);
    CallInterfaceFunction(__cEmpty, __cEmpty, "f85b6d5d-1712-4240-ad83-a1e628197c1d");
  }


  TestCommandBegin(__eCheck, __cCheck, "", "4");
  {
    __bVerdict = __eVerdictPass;
    __tableHandle = ReportTableHead5Columns(__cCheckCaption, __cTSym, __cTOp, __cRefVal, __cActual, __cRes);
    {
      {
        int __res1,__res2;
        __res1 = CheckSignalMatch(`FDCAN2::dbNode::`CVADAS::`CVPAM_FD_Info::`DisplayView2, 1, __cGreaterEqualThan) == 1;
        __res2 = CheckSignalMatch(`FDCAN2::dbNode::`CVADAS::`CVPAM_FD_Info::`DisplayView2, 15, __cLessEqualThan) == 1;
        __csr = __res1 && __res2;
        snprintf(__cArray, 8192, "%s", "DisplayView2");
        snprintf(__cArray2, 8192, "%s '%s'", __cCANSignal, __cArray);
        snprintf(__cArray3, 8192, "%s", "");
        snprintf(__cArray4, 8192, "%s", "");
        snprintf(__cArray5, 8192, "%s", __cArray3);
        snprintf(__cArray6, 8192, "%s", __cArray4);
        ReportRange(1, 15, __cArray5, __cArray6, __cArray7, 8192);
        ReportTableRow(__tableHandle, 0, __cArray2, __cRange, __cArray7, __cEmpty, __oneOfFlag, __bSetInCheckAlignment);
        ReportLValueOrSignalNotOnline(`FDCAN2::dbNode::`CVADAS::`CVPAM_FD_Info::`DisplayView2, __cArray8, 8192);
        ReportCell(__tableHandle, __cArray8);
        ReportCellResult(__tableHandle, __csr, __ePassFail);
      }
  
      __bVerdict = __bVerdict && __csr;
    }
    ReportTableEndVerdict(__tableHandle, "1", __bVerdict);
  }
  TestCommandEnd();


}

testcase Tt56gpegf_TsTc26()
{
  stack long __tableHandle;
  SetBreakOnFail(1);

  TestCommandBegin(__eSet, __cSet, "", "0");
  {
    __tableHandle = ReportTableHead3Columns(__cSetCaption , __cTSym, __cTOp, __cAssigned); 
    {
      $`FDCAN2::dbNode::`SGW::`TELEMATIC_FD_5::`CameraDisplaySts2.phys = 12;
      snprintf(__cArray, 8192, "%s", "CameraDisplaySts2");
      snprintf(__cArray2, 8192, "%s '%s'", __cCANSignal, __cArray);
      snprintf(__cArray3, 8192, "%s", "");
      
      ReportSetLValueOrSignalNotOnline(getSignalTime(`FDCAN2::dbNode::`SGW::`TELEMATIC_FD_5::`CameraDisplaySts2), __cArray2, __cArray4, 8192);
      ReportTableRow(__tableHandle, 0, __cArray4, __cAOp, 12, __cArray3, __oneOfFlag, __bSetInCheckAlignment);
      
  
    }
    ReportTableEndTestStep(__tableHandle, "1");
  }
  TestCommandEnd();


  {
    CreateTTEIFFunction("Tt56gpegf_CaptureMasterImage", __eFct, __eLocal);
    CallInterfaceFunction(__cEmpty, __cEmpty, "462fe35e-f3f1-4850-92f7-450c4a81e94a");
  }


  TestCommandBegin(__eWait, __cWait, "", "2");
  {
    Wait("1", (1000 * 1000000LL), 1000000, "");
  }
  TestCommandEnd();

  {
    CreateTTEIFFunction("Tt56gpegf_CaptureImage", __eFct, __eLocal);
    CallInterfaceFunction(__cEmpty, __cEmpty, "f85b6d5d-1712-4240-ad83-a1e628197c1d");
  }


  TestCommandBegin(__eCheck, __cCheck, "", "4");
  {
    __bVerdict = __eVerdictPass;
    __tableHandle = ReportTableHead5Columns(__cCheckCaption, __cTSym, __cTOp, __cRefVal, __cActual, __cRes);
    {
      {
        int __res1,__res2;
        __res1 = CheckSignalMatch(`FDCAN2::dbNode::`CVADAS::`CVPAM_FD_Info::`DisplayView2, 1, __cGreaterEqualThan) == 1;
        __res2 = CheckSignalMatch(`FDCAN2::dbNode::`CVADAS::`CVPAM_FD_Info::`DisplayView2, 15, __cLessEqualThan) == 1;
        __csr = __res1 && __res2;
        snprintf(__cArray, 8192, "%s", "DisplayView2");
        snprintf(__cArray2, 8192, "%s '%s'", __cCANSignal, __cArray);
        snprintf(__cArray3, 8192, "%s", "");
        snprintf(__cArray4, 8192, "%s", "");
        snprintf(__cArray5, 8192, "%s", __cArray3);
        snprintf(__cArray6, 8192, "%s", __cArray4);
        ReportRange(1, 15, __cArray5, __cArray6, __cArray7, 8192);
        ReportTableRow(__tableHandle, 0, __cArray2, __cRange, __cArray7, __cEmpty, __oneOfFlag, __bSetInCheckAlignment);
        ReportLValueOrSignalNotOnline(`FDCAN2::dbNode::`CVADAS::`CVPAM_FD_Info::`DisplayView2, __cArray8, 8192);
        ReportCell(__tableHandle, __cArray8);
        ReportCellResult(__tableHandle, __csr, __ePassFail);
      }
  
      __bVerdict = __bVerdict && __csr;
    }
    ReportTableEndVerdict(__tableHandle, "1", __bVerdict);
  }
  TestCommandEnd();


}

testsequence Tt56gpegf_CPU_Load_Suite()
{
  stack long __tableHandle;
  SetBreakOnFail(1);

}

void Tt56gpegf_Tet_TtInit()
{
  stack long __tableHandle;
}

void Tt56gpegf_Tet_TcCall0()
{
  stack long __tableHandle;
  CreateTTEIFFunction("Tt56gpegf_TRSC_Calibrating_CurState_5", __eTcDef, __eLocal);
  AddIFParameterTestCaseAttribute("TC_ID", "");
  AddIFParameterTestCaseAttribute("Test Case ID", "");
  CallInterfaceFunction(__cEmpty , "", __cEmpty );
}

void Tt56gpegf_Tet_CaplTcCall0()
{
  stack long __tableHandle;
  CreateCaplIFFunction("MCU1_0", __eTcDef);
  AddIFParameterTestCaseAttribute("TC_ID", "");
  AddIFParameterTestCaseAttribute("Test Case ID", "");
  AddIFParameterInt(syspar::`iterations);
  AddIFParameterChar(syspar::`Python_Script_Path);
  CallInterfaceFunction(__cEmpty , "", __cEmpty );
}

void Tt56gpegf_Tet_CaplTcCall1()
{
  stack long __tableHandle;
  CreateCaplIFFunction("CPU_Load_Test_MCU2_0", __eTcDef);
  AddIFParameterTestCaseAttribute("TC_ID", "");
  AddIFParameterTestCaseAttribute("Test Case ID", "");
  AddIFParameterInt(syspar::`iterations);
  AddIFParameterChar(syspar::`command_CPU_MCU2_0);
  AddIFParameterChar(syspar::`Python_Script_Path);
  CallInterfaceFunction(__cEmpty , "", __cEmpty );
}

void Tt56gpegf_Tet_CaplTcCall2()
{
  stack long __tableHandle;
  CreateCaplIFFunction("CPU_Load_Test_MCU2_1", __eTcDef);
  AddIFParameterTestCaseAttribute("TC_ID", "");
  AddIFParameterTestCaseAttribute("Test Case ID", "");
  AddIFParameterInt(syspar::`iterations);
  AddIFParameterChar(syspar::`command_CPU_MCU2_1);
  AddIFParameterChar(syspar::`Python_Script_Path);
  CallInterfaceFunction(__cEmpty , "", __cEmpty );
}

void Tt56gpegf_Tet_CaplTcCall3()
{
  stack long __tableHandle;
  CreateCaplIFFunction("CPU_load_A72", __eTcDef);
  AddIFParameterTestCaseAttribute("TC_ID", "");
  AddIFParameterTestCaseAttribute("Test Case ID", "");
  AddIFParameterInt(syspar::`iterations);
  AddIFParameterChar(syspar::`command_CPU_A72);
  AddIFParameterChar(syspar::`Python_Script_Path);
  CallInterfaceFunction(__cEmpty , "", __cEmpty );
}

void Tt56gpegf_Tet_TcCall1()
{
  stack long __tableHandle;
  CreateTTEIFFunction("Tt56gpegf_TRSC_Turn_Off", __eTcDef, __eLocal);
  AddIFParameterTestCaseAttribute("TC_ID", "");
  AddIFParameterTestCaseAttribute("Test Case ID", "");
  CallInterfaceFunction(__cEmpty , "", __cEmpty );
}

