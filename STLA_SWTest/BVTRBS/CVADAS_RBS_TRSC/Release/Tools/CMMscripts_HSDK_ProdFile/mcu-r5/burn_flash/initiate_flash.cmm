; --------------------------------------------------------------------------------
; @Title: OSPI FLASH Program script for the j721e-evm (AM752X, DRA829, TDA4X)
; @Description:
; The MT35XU1G (Micron) is connected to the OSPI_CS0 controller
;
; SRAM:
; OSPI(controller) Base: 0x47040000
; OSPI memory mapped ADDRESS: 0x50000000
;
; Prerequisites: Switch Settings: CONFIG_SW[1] = OFF (SW3.1 on common board)
;
; @Chip: AM752X, DRA829, TDA4*
; @Board: J721E-EVM
; @Author: CMO
; @Keywords: Micron TD4*, Micron DRA829, Micron AM752X
; @Copyright: (C) 1989-2019 Lauterbach GmbH, licensed for use with TRACE32(R) only
; --------------------------------------------------------------------------------
;

;
;  FLASH SNOR hyperflash driver (not flashfile xspi)
;
 LOCAL &OSPI_BASE &OSPI_MEMORY_BASE &WDG_BASE &HS_device
 &OSPI_BASE=0x47040000
 &OSPI_MEMORY_BASE=0x60000000  ; flash contents memory mapped address
 &WDG_BASE=0x44135100   ;TODO: check address
 GLOBAL &DDR_2G
 &DDR_2G="yes"
 &HS_FStype="no"
 
;WinExt.DIALOG
;(
; HEADER "Flash Programming"
; POS 0. 0. 30. 4.
; BOX ""
; POS 1. 1. 15. 1.
; TEXT "Select Flash device"
; POS 1. 2. 8. 1.
; A.A: CHOOSEBOX "GP"
; (
;   &HS_device="GP"
; )
; POS 9. 2. 8. 1.
; A.B: CHOOSEBOX "HS'-DK"
; (
;   &HS_device="DK"
; )
; POS 18. 2. 8. 1.
; A.C: CHOOSEBOX "HS'-SE"
; (
;   &HS_device="FS"
; )
; POS 5. 4. 7. 1.
; BUTTON "Start Flash"
; (
;   DIALOG.END
;   GOSUB FLASH_IMAGE
; ) 
;)
 &HS_device="FS"
 GOSUB FLASH_IMAGE
 STOP
 ENDDO

FLASH_IMAGE:
(
  IF "&HS_device"=="DK"
  (
    ;DIALOG.OK "Run in SD boot mode"
    DO "../../x_gel_to_cmm/J721S2_secure_unlock.cmm"
    &bare_metal="no" ; if R5 is booted say no
  )
  ELSE
  (
    IF "&HS_device"=="FS"
    (
      ;DIALOG.OK "Generate a certificate bin for your board and place it in the Secure unlock script"
      DO "../../x_gel_to_cmm/J721S2_secure_unlock.cmm"
    )
    &bare_metal="no" ; if R5 is not yet booted say yes
  )
  
  IF "&bare_metal"=="yes"
  (
  TITLE "TRACE32 for ARM CM4-0 - MASTER"
  DO "../../x_gel_to_cmm/_J721S2_m4.cmm" CM4-0 PREPARE
  register
  DO "../../x_gel_to_cmm/J7AEP_SI.cmm"
  wait 1s
  )

  ; --------------------------------------------------------------------------------
  ; Connect to MCU-CR5 to program flash

	; Disable CR5-MCU lockstep
    ;Data.Set EZAXI:0x45A50040 %Long 0x00000000
    ;GOSUB WATCHDOG_DISABLE

//    IF !INTERCOM.PING(CM4)
//      TargetSystem.NewInstance CM4 /ARCHitecture ARM
//    InterCOM.Wait CM4
//    InterCOM CM4  DO "../../mcu-r5/burn_flash/j721s2-spinand.cmm"
  DO "../../mcu-r5/burn_flash/j721s2-spinand.cmm" &HS_device

  RETURN
)

WATCHDOG_DISABLE:
(
  //Fill in if >3min burn time needed
  Data.Set EZAXI:&WDG_BASE+0x20  %LE %Long 0x4658fc21
  Data.Set EZAXI:&WDG_BASE+0x24  %LE %Long 0x3ac4f102
  Data.Set EZAXI:&WDG_BASE+0x50  %LE %Long 0xa
  Data.Set EZAXI:&WDG_BASE+0x20  %LE %Long 0x0
  Data.Set EZAXI:&WDG_BASE+0x24  %LE %Long 0x0

  RETURN
)