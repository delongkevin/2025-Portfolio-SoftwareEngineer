/*@!Encoding:1252*/
//  ====================================================
//   VEONEER - Constants for T32
//  ====================================================
//
//  File name: ccT32.cin
//
//  Created(DD.MM.YYYY): 04.05.2022
//
//  Description: Constants for T32 library
//          
//  --------------------------------------------------------------------

variables
{
  //T32 state
 enum eT32State {
    T32_State_Down = 0,
    T32_State_Halted = 1,
    T32_State_Stopped = 2,
    T32_State_Running = 3
  };

 enum eBitStatus{
  eNotSet = 0,
  eSet = 1
  };

  // This debug flag will be used to enable/disable the debug messages in all functions of the current module
  // 0x00 - No debug messages displayed (only function calls).
  // 0x01 - Only function call messages displayed (this will always displayed).
  // 0x02 - Function parameter + 0x01.
  // 0x04 - Internal function actions + 0x01 and 0x02.
  // 0xFF - All of the above (function calls, function parameters, internal function actions).
  const byte cc_bT32_GlobalDebugFlag = 0x01;

  const dword cc_dwT32_MaxTimeout = 3000;//ms

  // Timeout used when waiting for a breakpoint to be reached after GO.
  // Longer than cc_dwT32_MaxTimeout to allow for RTOS scheduling latency.
  const dword cc_dwT32_BP_HaltTimeout = 5000;//ms

  // Retry constants for BREAK.SET when the symbol table is still loading.
  // T32_API can transiently report symbol-not-found while ELF symbols are
  // being resolved; retrying with a short delay avoids false failures.
  //
  // If all initial retries are exhausted the library issues a SYMBOL.RELOAD
  // command (equivalent to the manual "Reload Symbols" action in the T32 IDE)
  // and then retries for up to cc_nT32_BPSetMaxRetries total attempts.
  // cc_nT32_BPSetSymbolReloadAt must be < cc_nT32_BPSetMaxRetries.
  const int   cc_nT32_BPSetMaxRetries         = 10;   // max BREAK.SET attempts; increased to allow retries after SYMBOL.RELOAD
  const dword cc_dwT32_BPSetRetryInterval     = 1000; // ms between attempts
  const int   cc_nT32_BPSetSymbolReloadAt     = 5;    // trigger SYMBOL.RELOAD after this many failed attempts
  const dword cc_dwT32_SymbolReloadWait       = 2000; // ms to wait after issuing SYMBOL.RELOAD before retrying

  // How long to wait for Trace32 to become connected after auto-launch.
  const dword cc_dwT32_LaunchTimeout = 30000; // ms

}

 